ASAP2_VERSION 1 70
/begin PROJECT XCPonCANFD "Generated for ETAS and Vector "
/begin MODULE XCPonCANFD "Generated for ETAS and Vector "
/begin MOD_COMMON "XCPonCANFD" BYTE_ORDER MSB_FIRST ALIGNMENT_BYTE 1 ALIGNMENT_WORD 2 ALIGNMENT_LONG 4 ALIGNMENT_FLOAT32_IEEE 4 ALIGNMENT_FLOAT64_IEEE 8 ALIGNMENT_INT64 8 /end MOD_COMMON
/begin MEASUREMENT DFLF_EE.usrInstFaultCnt "Instantaneous fault counter" UBYTE NO_COMPU_METHOD 0 0 0 255 ECU_ADDRESS 0x4000C007 SYMBOL_LINK "xAdiaEeDataB" 558 /end MEASUREMENT
/begin MEASUREMENT DFLF_EE.usrWucCnt "Machine B Warm-up cycles counter" UBYTE NO_COMPU_METHOD 0 0 0 255 ECU_ADDRESS 0x4000C008 SYMBOL_LINK "xAdiaEeDataB" 559 /end MEASUREMENT
/begin MEASUREMENT DFLL_EE.eCodErr "Machine B fault type" UBYTE eCodErr.Conversion 0 0 0 255 ECU_ADDRESS 0x4000C00A SYMBOL_LINK "xAdiaEeDataB" 561 /end MEASUREMENT
/begin MEASUREMENT DFLL_EE.eErrSt "Machine B error state" UBYTE eErrSt.Conversion 0 0 0 255 ECU_ADDRESS 0x4000C009 SYMBOL_LINK "xAdiaEeDataB" 560 /end MEASUREMENT
/begin MEASUREMENT DFLL_EE.usrEventCnt "Machine B Warm-up cycles counter" UBYTE NO_COMPU_METHOD 0 0 0 255 ECU_ADDRESS 0x4000C00B SYMBOL_LINK "xAdiaEeDataB" 562 /end MEASUREMENT
/begin MEASUREMENT DFLL_EE.usrInstFaultCnt "Instantaneous fault counter" UBYTE NO_COMPU_METHOD 0 0 0 255 ECU_ADDRESS 0x4000C00C SYMBOL_LINK "xAdiaEeDataB" 563 /end MEASUREMENT
/begin MEASUREMENT DFLL_EE.usrWucCnt "Machine B Warm-up cycles counter" UBYTE NO_COMPU_METHOD 0 0 0 255 ECU_ADDRESS 0x4000C00D SYMBOL_LINK "xAdiaEeDataB" 564 /end MEASUREMENT
/begin MEASUREMENT DFLR_EE.eCodErr "Machine B fault type" UBYTE eCodErr.Conversion 0 0 0 255 ECU_ADDRESS 0x4000C00F SYMBOL_LINK "xAdiaEeDataB" 566 /end MEASUREMENT
/begin MEASUREMENT DFLR_EE.eErrSt "Machine B error state" UBYTE eErrSt.Conversion 0 0 0 255 ECU_ADDRESS 0x4000C00E SYMBOL_LINK "xAdiaEeDataB" 565 /end MEASUREMENT
/begin MEASUREMENT DFLR_EE.usrEventCnt "Machine B Warm-up cycles counter" UBYTE NO_COMPU_METHOD 0 0 0 255 ECU_ADDRESS 0x4000C010 SYMBOL_LINK "xAdiaEeDataB" 567 /end MEASUREMENT
/begin MEASUREMENT DFLR_EE.usrInstFaultCnt "Instantaneous fault counter" UBYTE NO_COMPU_METHOD 0 0 0 255 ECU_ADDRESS 0x4000C011 SYMBOL_LINK "xAdiaEeDataB" 568 /end MEASUREMENT
/begin MEASUREMENT DFLR_EE.usrWucCnt "Machine B Warm-up cycles counter" UBYTE NO_COMPU_METHOD 0 0 0 255 ECU_ADDRESS 0x4000C012 SYMBOL_LINK "xAdiaEeDataB" 569 /end MEASUREMENT
/begin MEASUREMENT DCAT_EE.eCodErr "Machine B fault type" UBYTE eCodErr.Conversion 0 0 0 255 ECU_ADDRESS 0x4000C014 SYMBOL_LINK "xAdiaEeDataB" 571 /end MEASUREMENT
/begin MEASUREMENT DCAT_EE.eErrSt "Machine B error state" UBYTE eErrSt.Conversion 0 0 0 255 ECU_ADDRESS 0x4000C013 SYMBOL_LINK "xAdiaEeDataB" 570 /end MEASUREMENT
/begin MEASUREMENT DCAT_EE.usrEventCnt "Machine B Warm-up cycles counter" UBYTE NO_COMPU_METHOD 0 0 0 255 ECU_ADDRESS 0x4000C015 SYMBOL_LINK "xAdiaEeDataB" 572 /end MEASUREMENT
/begin MEASUREMENT DCAT_EE.usrInstFaultCnt "Instantaneous fault counter" UBYTE NO_COMPU_METHOD 0 0 0 255 ECU_ADDRESS 0x4000C016 SYMBOL_LINK "xAdiaEeDataB" 573 /end MEASUREMENT
/begin MEASUREMENT DCAT_EE.usrWucCnt "Machine B Warm-up cycles counter" UBYTE NO_COMPU_METHOD 0 0 0 255 ECU_ADDRESS 0x4000C017 SYMBOL_LINK "xAdiaEeDataB" 574 /end MEASUREMENT
/begin MEASUREMENT DCMV_EE.eCodErr "Machine B fault type" UBYTE eCodErr.Conversion 0 0 0 255 ECU_ADDRESS 0x4000C019 SYMBOL_LINK "xAdiaEeDataB" 576 /end MEASUREMENT
/begin MEASUREMENT DCMV_EE.eErrSt "Machine B error state" UBYTE eErrSt.Conversion 0 0 0 255 ECU_ADDRESS 0x4000C018 SYMBOL_LINK "xAdiaEeDataB" 575 /end MEASUREMENT
/begin MEASUREMENT DCMV_EE.usrEventCnt "Machine B Warm-up cycles counter" UBYTE NO_COMPU_METHOD 0 0 0 255 ECU_ADDRESS 0x4000C01A SYMBOL_LINK "xAdiaEeDataB" 577 /end MEASUREMENT
/begin MEASUREMENT DCMV_EE.usrInstFaultCnt "Instantaneous fault counter" UBYTE NO_COMPU_METHOD 0 0 0 255 ECU_ADDRESS 0x4000C01B SYMBOL_LINK "xAdiaEeDataB" 578 /end MEASUREMENT
/begin MEASUREMENT DCMV_EE.usrWucCnt "Machine B Warm-up cycles counter" UBYTE NO_COMPU_METHOD 0 0 0 255 ECU_ADDRESS 0x4000C01C SYMBOL_LINK "xAdiaEeDataB" 579 /end MEASUREMENT
/begin MEASUREMENT DLAM_EE.eCodErr "Machine B fault type" UBYTE eCodErr.Conversion 0 0 0 255 ECU_ADDRESS 0x4000C01E SYMBOL_LINK "xAdiaEeDataB" 581 /end MEASUREMENT
/begin MEASUREMENT DLAM_EE.eErrSt "Machine B error state" UBYTE eErrSt.Conversion 0 0 0 255 ECU_ADDRESS 0x4000C01D SYMBOL_LINK "xAdiaEeDataB" 580 /end MEASUREMENT
/begin MEASUREMENT DLAM_EE.usrEventCnt "Machine B Warm-up cycles counter" UBYTE NO_COMPU_METHOD 0 0 0 255 ECU_ADDRESS 0x4000C01F SYMBOL_LINK "xAdiaEeDataB" 582 /end MEASUREMENT
/begin MEASUREMENT DLAM_EE.usrInstFaultCnt "Instantaneous fault counter" UBYTE NO_COMPU_METHOD 0 0 0 255 ECU_ADDRESS 0x4000C020 SYMBOL_LINK "xAdiaEeDataB" 583 /end MEASUREMENT
/begin MEASUREMENT DLAM_EE.usrWucCnt "Machine B Warm-up cycles counter" UBYTE NO_COMPU_METHOD 0 0 0 255 ECU_ADDRESS 0x4000C021 SYMBOL_LINK "xAdiaEeDataB" 584 /end MEASUREMENT
/begin MEASUREMENT SPA_EE.eCodErr "Machine B fault type" UBYTE eCodErr.Conversion 0 0 0 255 ECU_ADDRESS 0x4000BE11 SYMBOL_LINK "xAdiaEeDataB" 56 /end MEASUREMENT
/begin MEASUREMENT SPA_EE.eErrSt "Machine B error state" UBYTE eErrSt.Conversion 0 0 0 255 ECU_ADDRESS 0x4000BE10 SYMBOL_LINK "xAdiaEeDataB" 55 /end MEASUREMENT
/begin MEASUREMENT SPA_EE.usrEventCnt "Machine B Warm-up cycles counter" UBYTE NO_COMPU_METHOD 0 0 0 255 ECU_ADDRESS 0x4000BE12 SYMBOL_LINK "xAdiaEeDataB" 57 /end MEASUREMENT
/begin MEASUREMENT SPA_EE.usrInstFaultCnt "Instantaneous fault counter" UBYTE NO_COMPU_METHOD 0 0 0 255 ECU_ADDRESS 0x4000BE13 SYMBOL_LINK "xAdiaEeDataB" 58 /end MEASUREMENT
/begin MEASUREMENT SPA_EE.usrWucCnt "Machine B Warm-up cycles counter" UBYTE NO_COMPU_METHOD 0 0 0 255 ECU_ADDRESS 0x4000BE14 SYMBOL_LINK "xAdiaEeDataB" 59 /end MEASUREMENT
/begin MEASUREMENT BAT_EE.eCodErr "Machine B fault type" UBYTE eCodErr.Conversion 0 0 0 255 ECU_ADDRESS 0x4000BE16 SYMBOL_LINK "xAdiaEeDataB" 61 /end MEASUREMENT
/begin MEASUREMENT BAT_EE.eErrSt "Machine B error state" UBYTE eErrSt.Conversion 0 0 0 255 ECU_ADDRESS 0x4000BE15 SYMBOL_LINK "xAdiaEeDataB" 60 /end MEASUREMENT
/begin MEASUREMENT BAT_EE.usrEventCnt "Machine B Warm-up cycles counter" UBYTE NO_COMPU_METHOD 0 0 0 255 ECU_ADDRESS 0x4000BE17 SYMBOL_LINK "xAdiaEeDataB" 62 /end MEASUREMENT
/begin MEASUREMENT BAT_EE.usrInstFaultCnt "Instantaneous fault counter" UBYTE NO_COMPU_METHOD 0 0 0 255 ECU_ADDRESS 0x4000BE18 SYMBOL_LINK "xAdiaEeDataB" 63 /end MEASUREMENT
/begin MEASUREMENT BAT_EE.usrWucCnt "Machine B Warm-up cycles counter" UBYTE NO_COMPU_METHOD 0 0 0 255 ECU_ADDRESS 0x4000BE19 SYMBOL_LINK "xAdiaEeDataB" 64 /end MEASUREMENT
/begin MEASUREMENT VBP_EE.eCodErr "Machine B fault type" UBYTE eCodErr.Conversion 0 0 0 255 ECU_ADDRESS 0x4000BE1B SYMBOL_LINK "xAdiaEeDataB" 66 /end MEASUREMENT
/begin MEASUREMENT VBP_EE.eErrSt "Machine B error state" UBYTE eErrSt.Conversion 0 0 0 255 ECU_ADDRESS 0x4000BE1A SYMBOL_LINK "xAdiaEeDataB" 65 /end MEASUREMENT
/begin MEASUREMENT VBP_EE.usrEventCnt "Machine B Warm-up cycles counter" UBYTE NO_COMPU_METHOD 0 0 0 255 ECU_ADDRESS 0x4000BE1C SYMBOL_LINK "xAdiaEeDataB" 67 /end MEASUREMENT
/begin MEASUREMENT VBP_EE.usrInstFaultCnt "Instantaneous fault counter" UBYTE NO_COMPU_METHOD 0 0 0 255 ECU_ADDRESS 0x4000BE1D SYMBOL_LINK "xAdiaEeDataB" 68 /end MEASUREMENT
/begin MEASUREMENT VBP_EE.usrWucCnt "Machine B Warm-up cycles counter" UBYTE NO_COMPU_METHOD 0 0 0 255 ECU_ADDRESS 0x4000BE1E SYMBOL_LINK "xAdiaEeDataB" 69 /end MEASUREMENT
/begin MEASUREMENT WGT_EE.eCodErr "Machine B fault type" UBYTE eCodErr.Conversion 0 0 0 255 ECU_ADDRESS 0x4000BE20 SYMBOL_LINK "xAdiaEeDataB" 71 /end MEASUREMENT
/begin MEASUREMENT WGT_EE.eErrSt "Machine B error state" UBYTE eErrSt.Conversion 0 0 0 255 ECU_ADDRESS 0x4000BE1F SYMBOL_LINK "xAdiaEeDataB" 70 /end MEASUREMENT
/begin MEASUREMENT WGT_EE.usrEventCnt "Machine B Warm-up cycles counter" UBYTE NO_COMPU_METHOD 0 0 0 255 ECU_ADDRESS 0x4000BE21 SYMBOL_LINK "xAdiaEeDataB" 72 /end MEASUREMENT
/begin MEASUREMENT WGT_EE.usrInstFaultCnt "Instantaneous fault counter" UBYTE NO_COMPU_METHOD 0 0 0 255 ECU_ADDRESS 0x4000BE22 SYMBOL_LINK "xAdiaEeDataB" 73 /end MEASUREMENT
/begin MEASUREMENT WGT_EE.usrWucCnt "Machine B Warm-up cycles counter" UBYTE NO_COMPU_METHOD 0 0 0 255 ECU_ADDRESS 0x4000BE23 SYMBOL_LINK "xAdiaEeDataB" 74 /end MEASUREMENT
/begin MEASUREMENT COIL1_EE.eCodErr "Machine B fault type" UBYTE eCodErr.Conversion 0 0 0 255 ECU_ADDRESS 0x4000BE25 SYMBOL_LINK "xAdiaEeDataB" 76 /end MEASUREMENT
/begin MEASUREMENT COIL1_EE.eErrSt "Machine B error state" UBYTE eErrSt.Conversion 0 0 0 255 ECU_ADDRESS 0x4000BE24 SYMBOL_LINK "xAdiaEeDataB" 75 /end MEASUREMENT
/begin MEASUREMENT COIL1_EE.usrEventCnt "Machine B Warm-up cycles counter" UBYTE NO_COMPU_METHOD 0 0 0 255 ECU_ADDRESS 0x4000BE26 SYMBOL_LINK "xAdiaEeDataB" 77 /end MEASUREMENT
/begin MEASUREMENT COIL1_EE.usrInstFaultCnt "Instantaneous fault counter" UBYTE NO_COMPU_METHOD 0 0 0 255 ECU_ADDRESS 0x4000BE27 SYMBOL_LINK "xAdiaEeDataB" 78 /end MEASUREMENT
/begin MEASUREMENT COIL1_EE.usrWucCnt "Machine B Warm-up cycles counter" UBYTE NO_COMPU_METHOD 0 0 0 255 ECU_ADDRESS 0x4000BE28 SYMBOL_LINK "xAdiaEeDataB" 79 /end MEASUREMENT
/begin MEASUREMENT COIL2_EE.eCodErr "Machine B fault type" UBYTE eCodErr.Conversion 0 0 0 255 ECU_ADDRESS 0x4000BE2A SYMBOL_LINK "xAdiaEeDataB" 81 /end MEASUREMENT
/begin MEASUREMENT COIL2_EE.eErrSt "Machine B error state" UBYTE eErrSt.Conversion 0 0 0 255 ECU_ADDRESS 0x4000BE29 SYMBOL_LINK "xAdiaEeDataB" 80 /end MEASUREMENT
/begin MEASUREMENT COIL2_EE.usrEventCnt "Machine B Warm-up cycles counter" UBYTE NO_COMPU_METHOD 0 0 0 255 ECU_ADDRESS 0x4000BE2B SYMBOL_LINK "xAdiaEeDataB" 82 /end MEASUREMENT
/begin MEASUREMENT COIL2_EE.usrInstFaultCnt "Instantaneous fault counter" UBYTE NO_COMPU_METHOD 0 0 0 255 ECU_ADDRESS 0x4000BE2C SYMBOL_LINK "xAdiaEeDataB" 83 /end MEASUREMENT
/begin MEASUREMENT COIL2_EE.usrWucCnt "Machine B Warm-up cycles counter" UBYTE NO_COMPU_METHOD 0 0 0 255 ECU_ADDRESS 0x4000BE2D SYMBOL_LINK "xAdiaEeDataB" 84 /end MEASUREMENT
/begin MEASUREMENT COIL3_EE.eCodErr "Machine B fault type" UBYTE eCodErr.Conversion 0 0 0 255 ECU_ADDRESS 0x4000BE2F SYMBOL_LINK "xAdiaEeDataB" 86 /end MEASUREMENT
/begin MEASUREMENT COIL3_EE.eErrSt "Machine B error state" UBYTE eErrSt.Conversion 0 0 0 255 ECU_ADDRESS 0x4000BE2E SYMBOL_LINK "xAdiaEeDataB" 85 /end MEASUREMENT
/begin MEASUREMENT COIL3_EE.usrEventCnt "Machine B Warm-up cycles counter" UBYTE NO_COMPU_METHOD 0 0 0 255 ECU_ADDRESS 0x4000BE30 SYMBOL_LINK "xAdiaEeDataB" 87 /end MEASUREMENT
/begin MEASUREMENT COIL3_EE.usrInstFaultCnt "Instantaneous fault counter" UBYTE NO_COMPU_METHOD 0 0 0 255 ECU_ADDRESS 0x4000BE31 SYMBOL_LINK "xAdiaEeDataB" 88 /end MEASUREMENT
/begin MEASUREMENT COIL3_EE.usrWucCnt "Machine B Warm-up cycles counter" UBYTE NO_COMPU_METHOD 0 0 0 255 ECU_ADDRESS 0x4000BE32 SYMBOL_LINK "xAdiaEeDataB" 89 /end MEASUREMENT
/begin MEASUREMENT COIL4_EE.eCodErr "Machine B fault type" UBYTE eCodErr.Conversion 0 0 0 255 ECU_ADDRESS 0x4000BE34 SYMBOL_LINK "xAdiaEeDataB" 91 /end MEASUREMENT
/begin MEASUREMENT COIL4_EE.eErrSt "Machine B error state" UBYTE eErrSt.Conversion 0 0 0 255 ECU_ADDRESS 0x4000BE33 SYMBOL_LINK "xAdiaEeDataB" 90 /end MEASUREMENT
/begin MEASUREMENT COIL4_EE.usrEventCnt "Machine B Warm-up cycles counter" UBYTE NO_COMPU_METHOD 0 0 0 255 ECU_ADDRESS 0x4000BE35 SYMBOL_LINK "xAdiaEeDataB" 92 /end MEASUREMENT
/begin MEASUREMENT COIL4_EE.usrInstFaultCnt "Instantaneous fault counter" UBYTE NO_COMPU_METHOD 0 0 0 255 ECU_ADDRESS 0x4000BE36 SYMBOL_LINK "xAdiaEeDataB" 93 /end MEASUREMENT
/begin MEASUREMENT COIL4_EE.usrWucCnt "Machine B Warm-up cycles counter" UBYTE NO_COMPU_METHOD 0 0 0 255 ECU_ADDRESS 0x4000BE37 SYMBOL_LINK "xAdiaEeDataB" 94 /end MEASUREMENT
/begin MEASUREMENT COIL5_EE.eCodErr "Machine B fault type" UBYTE eCodErr.Conversion 0 0 0 255 ECU_ADDRESS 0x4000BE39 SYMBOL_LINK "xAdiaEeDataB" 96 /end MEASUREMENT
/begin MEASUREMENT COIL5_EE.eErrSt "Machine B error state" UBYTE eErrSt.Conversion 0 0 0 255 ECU_ADDRESS 0x4000BE38 SYMBOL_LINK "xAdiaEeDataB" 95 /end MEASUREMENT
/begin MEASUREMENT COIL5_EE.usrEventCnt "Machine B Warm-up cycles counter" UBYTE NO_COMPU_METHOD 0 0 0 255 ECU_ADDRESS 0x4000BE3A SYMBOL_LINK "xAdiaEeDataB" 97 /end MEASUREMENT
/begin MEASUREMENT COIL5_EE.usrInstFaultCnt "Instantaneous fault counter" UBYTE NO_COMPU_METHOD 0 0 0 255 ECU_ADDRESS 0x4000BE3B SYMBOL_LINK "xAdiaEeDataB" 98 /end MEASUREMENT
/begin MEASUREMENT COIL5_EE.usrWucCnt "Machine B Warm-up cycles counter" UBYTE NO_COMPU_METHOD 0 0 0 255 ECU_ADDRESS 0x4000BE3C SYMBOL_LINK "xAdiaEeDataB" 99 /end MEASUREMENT
/begin MEASUREMENT STO_EE.eCodErr "Machine B fault type" UBYTE eCodErr.Conversion 0 0 0 255 ECU_ADDRESS 0x4000BDDF SYMBOL_LINK "xAdiaEeDataB" 6 /end MEASUREMENT
/begin MEASUREMENT STO_EE.eErrSt "Machine B error state" UBYTE eErrSt.Conversion 0 0 0 255 ECU_ADDRESS 0x4000BDDE SYMBOL_LINK "xAdiaEeDataB" 5 /end MEASUREMENT
/begin MEASUREMENT STO_EE.usrEventCnt "Machine B Warm-up cycles counter" UBYTE NO_COMPU_METHOD 0 0 0 255 ECU_ADDRESS 0x4000BDE0 SYMBOL_LINK "xAdiaEeDataB" 7 /end MEASUREMENT
/begin MEASUREMENT STO_EE.usrInstFaultCnt "Instantaneous fault counter" UBYTE NO_COMPU_METHOD 0 0 0 255 ECU_ADDRESS 0x4000BDE1 SYMBOL_LINK "xAdiaEeDataB" 8 /end MEASUREMENT
/begin MEASUREMENT STO_EE.usrWucCnt "Machine B Warm-up cycles counter" UBYTE NO_COMPU_METHOD 0 0 0 255 ECU_ADDRESS 0x4000BDE2 SYMBOL_LINK "xAdiaEeDataB" 9 /end MEASUREMENT
/begin MEASUREMENT COIL6_EE.eCodErr "Machine B fault type" UBYTE eCodErr.Conversion 0 0 0 255 ECU_ADDRESS 0x4000BE3E SYMBOL_LINK "xAdiaEeDataB" 101 /end MEASUREMENT
/begin MEASUREMENT COIL6_EE.eErrSt "Machine B error state" UBYTE eErrSt.Conversion 0 0 0 255 ECU_ADDRESS 0x4000BE3D SYMBOL_LINK "xAdiaEeDataB" 100 /end MEASUREMENT
/begin MEASUREMENT COIL6_EE.usrEventCnt "Machine B Warm-up cycles counter" UBYTE NO_COMPU_METHOD 0 0 0 255 ECU_ADDRESS 0x4000BE3F SYMBOL_LINK "xAdiaEeDataB" 102 /end MEASUREMENT
/begin MEASUREMENT COIL6_EE.usrInstFaultCnt "Instantaneous fault counter" UBYTE NO_COMPU_METHOD 0 0 0 255 ECU_ADDRESS 0x4000BE40 SYMBOL_LINK "xAdiaEeDataB" 103 /end MEASUREMENT
/begin MEASUREMENT COIL6_EE.usrWucCnt "Machine B Warm-up cycles counter" UBYTE NO_COMPU_METHOD 0 0 0 255 ECU_ADDRESS 0x4000BE41 SYMBOL_LINK "xAdiaEeDataB" 104 /end MEASUREMENT
/begin MEASUREMENT COIL7_EE.eCodErr "Machine B fault type" UBYTE eCodErr.Conversion 0 0 0 255 ECU_ADDRESS 0x4000BE43 SYMBOL_LINK "xAdiaEeDataB" 106 /end MEASUREMENT
/begin MEASUREMENT COIL7_EE.eErrSt "Machine B error state" UBYTE eErrSt.Conversion 0 0 0 255 ECU_ADDRESS 0x4000BE42 SYMBOL_LINK "xAdiaEeDataB" 105 /end MEASUREMENT
/begin MEASUREMENT COIL7_EE.usrEventCnt "Machine B Warm-up cycles counter" UBYTE NO_COMPU_METHOD 0 0 0 255 ECU_ADDRESS 0x4000BE44 SYMBOL_LINK "xAdiaEeDataB" 107 /end MEASUREMENT
/begin MEASUREMENT COIL7_EE.usrInstFaultCnt "Instantaneous fault counter" UBYTE NO_COMPU_METHOD 0 0 0 255 ECU_ADDRESS 0x4000BE45 SYMBOL_LINK "xAdiaEeDataB" 108 /end MEASUREMENT
/begin MEASUREMENT COIL7_EE.usrWucCnt "Machine B Warm-up cycles counter" UBYTE NO_COMPU_METHOD 0 0 0 255 ECU_ADDRESS 0x4000BE46 SYMBOL_LINK "xAdiaEeDataB" 109 /end MEASUREMENT
/begin MEASUREMENT COIL8_EE.eCodErr "Machine B fault type" UBYTE eCodErr.Conversion 0 0 0 255 ECU_ADDRESS 0x4000BE48 SYMBOL_LINK "xAdiaEeDataB" 111 /end MEASUREMENT
/begin MEASUREMENT COIL8_EE.eErrSt "Machine B error state" UBYTE eErrSt.Conversion 0 0 0 255 ECU_ADDRESS 0x4000BE47 SYMBOL_LINK "xAdiaEeDataB" 110 /end MEASUREMENT
/begin MEASUREMENT COIL8_EE.usrEventCnt "Machine B Warm-up cycles counter" UBYTE NO_COMPU_METHOD 0 0 0 255 ECU_ADDRESS 0x4000BE49 SYMBOL_LINK "xAdiaEeDataB" 112 /end MEASUREMENT
/begin MEASUREMENT COIL8_EE.usrInstFaultCnt "Instantaneous fault counter" UBYTE NO_COMPU_METHOD 0 0 0 255 ECU_ADDRESS 0x4000BE4A SYMBOL_LINK "xAdiaEeDataB" 113 /end MEASUREMENT
/begin MEASUREMENT COIL8_EE.usrWucCnt "Machine B Warm-up cycles counter" UBYTE NO_COMPU_METHOD 0 0 0 255 ECU_ADDRESS 0x4000BE4B SYMBOL_LINK "xAdiaEeDataB" 114 /end MEASUREMENT
/begin MEASUREMENT INJ1_EE.eCodErr "Machine B fault type" UBYTE eCodErr.Conversion 0 0 0 255 ECU_ADDRESS 0x4000BE4D SYMBOL_LINK "xAdiaEeDataB" 116 /end MEASUREMENT
/begin MEASUREMENT INJ1_EE.eErrSt "Machine B error state" UBYTE eErrSt.Conversion 0 0 0 255 ECU_ADDRESS 0x4000BE4C SYMBOL_LINK "xAdiaEeDataB" 115 /end MEASUREMENT
/begin MEASUREMENT INJ1_EE.usrEventCnt "Machine B Warm-up cycles counter" UBYTE NO_COMPU_METHOD 0 0 0 255 ECU_ADDRESS 0x4000BE4E SYMBOL_LINK "xAdiaEeDataB" 117 /end MEASUREMENT
/begin MEASUREMENT INJ1_EE.usrInstFaultCnt "Instantaneous fault counter" UBYTE NO_COMPU_METHOD 0 0 0 255 ECU_ADDRESS 0x4000BE4F SYMBOL_LINK "xAdiaEeDataB" 118 /end MEASUREMENT
/begin MEASUREMENT INJ1_EE.usrWucCnt "Machine B Warm-up cycles counter" UBYTE NO_COMPU_METHOD 0 0 0 255 ECU_ADDRESS 0x4000BE50 SYMBOL_LINK "xAdiaEeDataB" 119 /end MEASUREMENT
/begin MEASUREMENT INJ2_EE.eCodErr "Machine B fault type" UBYTE eCodErr.Conversion 0 0 0 255 ECU_ADDRESS 0x4000BE52 SYMBOL_LINK "xAdiaEeDataB" 121 /end MEASUREMENT
/begin MEASUREMENT INJ2_EE.eErrSt "Machine B error state" UBYTE eErrSt.Conversion 0 0 0 255 ECU_ADDRESS 0x4000BE51 SYMBOL_LINK "xAdiaEeDataB" 120 /end MEASUREMENT
/begin MEASUREMENT INJ2_EE.usrEventCnt "Machine B Warm-up cycles counter" UBYTE NO_COMPU_METHOD 0 0 0 255 ECU_ADDRESS 0x4000BE53 SYMBOL_LINK "xAdiaEeDataB" 122 /end MEASUREMENT
/begin MEASUREMENT INJ2_EE.usrInstFaultCnt "Instantaneous fault counter" UBYTE NO_COMPU_METHOD 0 0 0 255 ECU_ADDRESS 0x4000BE54 SYMBOL_LINK "xAdiaEeDataB" 123 /end MEASUREMENT
/begin MEASUREMENT INJ2_EE.usrWucCnt "Machine B Warm-up cycles counter" UBYTE NO_COMPU_METHOD 0 0 0 255 ECU_ADDRESS 0x4000BE55 SYMBOL_LINK "xAdiaEeDataB" 124 /end MEASUREMENT
/begin MEASUREMENT INJ3_EE.eCodErr "Machine B fault type" UBYTE eCodErr.Conversion 0 0 0 255 ECU_ADDRESS 0x4000BE57 SYMBOL_LINK "xAdiaEeDataB" 126 /end MEASUREMENT
/begin MEASUREMENT INJ3_EE.eErrSt "Machine B error state" UBYTE eErrSt.Conversion 0 0 0 255 ECU_ADDRESS 0x4000BE56 SYMBOL_LINK "xAdiaEeDataB" 125 /end MEASUREMENT
/begin MEASUREMENT INJ3_EE.usrEventCnt "Machine B Warm-up cycles counter" UBYTE NO_COMPU_METHOD 0 0 0 255 ECU_ADDRESS 0x4000BE58 SYMBOL_LINK "xAdiaEeDataB" 127 /end MEASUREMENT
/begin MEASUREMENT INJ3_EE.usrInstFaultCnt "Instantaneous fault counter" UBYTE NO_COMPU_METHOD 0 0 0 255 ECU_ADDRESS 0x4000BE59 SYMBOL_LINK "xAdiaEeDataB" 128 /end MEASUREMENT
/begin MEASUREMENT INJ3_EE.usrWucCnt "Machine B Warm-up cycles counter" UBYTE NO_COMPU_METHOD 0 0 0 255 ECU_ADDRESS 0x4000BE5A SYMBOL_LINK "xAdiaEeDataB" 129 /end MEASUREMENT
/begin MEASUREMENT INJ4_EE.eCodErr "Machine B fault type" UBYTE eCodErr.Conversion 0 0 0 255 ECU_ADDRESS 0x4000BE5C SYMBOL_LINK "xAdiaEeDataB" 131 /end MEASUREMENT
/begin MEASUREMENT INJ4_EE.eErrSt "Machine B error state" UBYTE eErrSt.Conversion 0 0 0 255 ECU_ADDRESS 0x4000BE5B SYMBOL_LINK "xAdiaEeDataB" 130 /end MEASUREMENT
/begin MEASUREMENT INJ4_EE.usrEventCnt "Machine B Warm-up cycles counter" UBYTE NO_COMPU_METHOD 0 0 0 255 ECU_ADDRESS 0x4000BE5D SYMBOL_LINK "xAdiaEeDataB" 132 /end MEASUREMENT
/begin MEASUREMENT INJ4_EE.usrInstFaultCnt "Instantaneous fault counter" UBYTE NO_COMPU_METHOD 0 0 0 255 ECU_ADDRESS 0x4000BE5E SYMBOL_LINK "xAdiaEeDataB" 133 /end MEASUREMENT
/begin MEASUREMENT INJ4_EE.usrWucCnt "Machine B Warm-up cycles counter" UBYTE NO_COMPU_METHOD 0 0 0 255 ECU_ADDRESS 0x4000BE5F SYMBOL_LINK "xAdiaEeDataB" 134 /end MEASUREMENT
/begin MEASUREMENT INJ5_EE.eCodErr "Machine B fault type" UBYTE eCodErr.Conversion 0 0 0 255 ECU_ADDRESS 0x4000BE61 SYMBOL_LINK "xAdiaEeDataB" 136 /end MEASUREMENT
/begin MEASUREMENT INJ5_EE.eErrSt "Machine B error state" UBYTE eErrSt.Conversion 0 0 0 255 ECU_ADDRESS 0x4000BE60 SYMBOL_LINK "xAdiaEeDataB" 135 /end MEASUREMENT
/begin MEASUREMENT INJ5_EE.usrEventCnt "Machine B Warm-up cycles counter" UBYTE NO_COMPU_METHOD 0 0 0 255 ECU_ADDRESS 0x4000BE62 SYMBOL_LINK "xAdiaEeDataB" 137 /end MEASUREMENT
/begin MEASUREMENT INJ5_EE.usrInstFaultCnt "Instantaneous fault counter" UBYTE NO_COMPU_METHOD 0 0 0 255 ECU_ADDRESS 0x4000BE63 SYMBOL_LINK "xAdiaEeDataB" 138 /end MEASUREMENT
/begin MEASUREMENT INJ5_EE.usrWucCnt "Machine B Warm-up cycles counter" UBYTE NO_COMPU_METHOD 0 0 0 255 ECU_ADDRESS 0x4000BE64 SYMBOL_LINK "xAdiaEeDataB" 139 /end MEASUREMENT
/begin MEASUREMENT INJ6_EE.eCodErr "Machine B fault type" UBYTE eCodErr.Conversion 0 0 0 255 ECU_ADDRESS 0x4000BE66 SYMBOL_LINK "xAdiaEeDataB" 141 /end MEASUREMENT
/begin MEASUREMENT INJ6_EE.eErrSt "Machine B error state" UBYTE eErrSt.Conversion 0 0 0 255 ECU_ADDRESS 0x4000BE65 SYMBOL_LINK "xAdiaEeDataB" 140 /end MEASUREMENT
/begin MEASUREMENT INJ6_EE.usrEventCnt "Machine B Warm-up cycles counter" UBYTE NO_COMPU_METHOD 0 0 0 255 ECU_ADDRESS 0x4000BE67 SYMBOL_LINK "xAdiaEeDataB" 142 /end MEASUREMENT
/begin MEASUREMENT INJ6_EE.usrInstFaultCnt "Instantaneous fault counter" UBYTE NO_COMPU_METHOD 0 0 0 255 ECU_ADDRESS 0x4000BE68 SYMBOL_LINK "xAdiaEeDataB" 143 /end MEASUREMENT
/begin MEASUREMENT INJ6_EE.usrWucCnt "Machine B Warm-up cycles counter" UBYTE NO_COMPU_METHOD 0 0 0 255 ECU_ADDRESS 0x4000BE69 SYMBOL_LINK "xAdiaEeDataB" 144 /end MEASUREMENT
/begin MEASUREMENT INJ7_EE.eCodErr "Machine B fault type" UBYTE eCodErr.Conversion 0 0 0 255 ECU_ADDRESS 0x4000BE6B SYMBOL_LINK "xAdiaEeDataB" 146 /end MEASUREMENT
/begin MEASUREMENT INJ7_EE.eErrSt "Machine B error state" UBYTE eErrSt.Conversion 0 0 0 255 ECU_ADDRESS 0x4000BE6A SYMBOL_LINK "xAdiaEeDataB" 145 /end MEASUREMENT
/begin MEASUREMENT INJ7_EE.usrEventCnt "Machine B Warm-up cycles counter" UBYTE NO_COMPU_METHOD 0 0 0 255 ECU_ADDRESS 0x4000BE6C SYMBOL_LINK "xAdiaEeDataB" 147 /end MEASUREMENT
/begin MEASUREMENT INJ7_EE.usrInstFaultCnt "Instantaneous fault counter" UBYTE NO_COMPU_METHOD 0 0 0 255 ECU_ADDRESS 0x4000BE6D SYMBOL_LINK "xAdiaEeDataB" 148 /end MEASUREMENT
/begin MEASUREMENT INJ7_EE.usrWucCnt "Machine B Warm-up cycles counter" UBYTE NO_COMPU_METHOD 0 0 0 255 ECU_ADDRESS 0x4000BE6E SYMBOL_LINK "xAdiaEeDataB" 149 /end MEASUREMENT
/begin MEASUREMENT STA_EE.eCodErr "Machine B fault type" UBYTE eCodErr.Conversion 0 0 0 255 ECU_ADDRESS 0x4000BDE4 SYMBOL_LINK "xAdiaEeDataB" 11 /end MEASUREMENT
/begin MEASUREMENT STA_EE.eErrSt "Machine B error state" UBYTE eErrSt.Conversion 0 0 0 255 ECU_ADDRESS 0x4000BDE3 SYMBOL_LINK "xAdiaEeDataB" 10 /end MEASUREMENT
/begin MEASUREMENT STA_EE.usrEventCnt "Machine B Warm-up cycles counter" UBYTE NO_COMPU_METHOD 0 0 0 255 ECU_ADDRESS 0x4000BDE5 SYMBOL_LINK "xAdiaEeDataB" 12 /end MEASUREMENT
/begin MEASUREMENT STA_EE.usrInstFaultCnt "Instantaneous fault counter" UBYTE NO_COMPU_METHOD 0 0 0 255 ECU_ADDRESS 0x4000BDE6 SYMBOL_LINK "xAdiaEeDataB" 13 /end MEASUREMENT
/begin MEASUREMENT STA_EE.usrWucCnt "Machine B Warm-up cycles counter" UBYTE NO_COMPU_METHOD 0 0 0 255 ECU_ADDRESS 0x4000BDE7 SYMBOL_LINK "xAdiaEeDataB" 14 /end MEASUREMENT
/begin MEASUREMENT INJ8_EE.eCodErr "Machine B fault type" UBYTE eCodErr.Conversion 0 0 0 255 ECU_ADDRESS 0x4000BE70 SYMBOL_LINK "xAdiaEeDataB" 151 /end MEASUREMENT
/begin MEASUREMENT INJ8_EE.eErrSt "Machine B error state" UBYTE eErrSt.Conversion 0 0 0 255 ECU_ADDRESS 0x4000BE6F SYMBOL_LINK "xAdiaEeDataB" 150 /end MEASUREMENT
/begin MEASUREMENT INJ8_EE.usrEventCnt "Machine B Warm-up cycles counter" UBYTE NO_COMPU_METHOD 0 0 0 255 ECU_ADDRESS 0x4000BE71 SYMBOL_LINK "xAdiaEeDataB" 152 /end MEASUREMENT
/begin MEASUREMENT INJ8_EE.usrInstFaultCnt "Instantaneous fault counter" UBYTE NO_COMPU_METHOD 0 0 0 255 ECU_ADDRESS 0x4000BE72 SYMBOL_LINK "xAdiaEeDataB" 153 /end MEASUREMENT
/begin MEASUREMENT INJ8_EE.usrWucCnt "Machine B Warm-up cycles counter" UBYTE NO_COMPU_METHOD 0 0 0 255 ECU_ADDRESS 0x4000BE73 SYMBOL_LINK "xAdiaEeDataB" 154 /end MEASUREMENT
/begin MEASUREMENT PWRCOL_EE.eCodErr "Machine B fault type" UBYTE eCodErr.Conversion 0 0 0 255 ECU_ADDRESS 0x4000BE75 SYMBOL_LINK "xAdiaEeDataB" 156 /end MEASUREMENT
/begin MEASUREMENT PWRCOL_EE.eErrSt "Machine B error state" UBYTE eErrSt.Conversion 0 0 0 255 ECU_ADDRESS 0x4000BE74 SYMBOL_LINK "xAdiaEeDataB" 155 /end MEASUREMENT
/begin MEASUREMENT PWRCOL_EE.usrEventCnt "Machine B Warm-up cycles counter" UBYTE NO_COMPU_METHOD 0 0 0 255 ECU_ADDRESS 0x4000BE76 SYMBOL_LINK "xAdiaEeDataB" 157 /end MEASUREMENT
/begin MEASUREMENT PWRCOL_EE.usrInstFaultCnt "Instantaneous fault counter" UBYTE NO_COMPU_METHOD 0 0 0 255 ECU_ADDRESS 0x4000BE77 SYMBOL_LINK "xAdiaEeDataB" 158 /end MEASUREMENT
/begin MEASUREMENT PWRCOL_EE.usrWucCnt "Machine B Warm-up cycles counter" UBYTE NO_COMPU_METHOD 0 0 0 255 ECU_ADDRESS 0x4000BE78 SYMBOL_LINK "xAdiaEeDataB" 159 /end MEASUREMENT
/begin MEASUREMENT PWRCGND_EE.eCodErr "Machine B fault type" UBYTE eCodErr.Conversion 0 0 0 255 ECU_ADDRESS 0x4000BE7A SYMBOL_LINK "xAdiaEeDataB" 161 /end MEASUREMENT
/begin MEASUREMENT PWRCGND_EE.eErrSt "Machine B error state" UBYTE eErrSt.Conversion 0 0 0 255 ECU_ADDRESS 0x4000BE79 SYMBOL_LINK "xAdiaEeDataB" 160 /end MEASUREMENT
/begin MEASUREMENT PWRCGND_EE.usrEventCnt "Machine B Warm-up cycles counter" UBYTE NO_COMPU_METHOD 0 0 0 255 ECU_ADDRESS 0x4000BE7B SYMBOL_LINK "xAdiaEeDataB" 162 /end MEASUREMENT
/begin MEASUREMENT PWRCGND_EE.usrInstFaultCnt "Instantaneous fault counter" UBYTE NO_COMPU_METHOD 0 0 0 255 ECU_ADDRESS 0x4000BE7C SYMBOL_LINK "xAdiaEeDataB" 163 /end MEASUREMENT
/begin MEASUREMENT PWRCGND_EE.usrWucCnt "Machine B Warm-up cycles counter" UBYTE NO_COMPU_METHOD 0 0 0 255 ECU_ADDRESS 0x4000BE7D SYMBOL_LINK "xAdiaEeDataB" 164 /end MEASUREMENT
/begin MEASUREMENT PWRCVB_EE.eCodErr "Machine B fault type" UBYTE eCodErr.Conversion 0 0 0 255 ECU_ADDRESS 0x4000BE7F SYMBOL_LINK "xAdiaEeDataB" 166 /end MEASUREMENT
/begin MEASUREMENT PWRCVB_EE.eErrSt "Machine B error state" UBYTE eErrSt.Conversion 0 0 0 255 ECU_ADDRESS 0x4000BE7E SYMBOL_LINK "xAdiaEeDataB" 165 /end MEASUREMENT
/begin MEASUREMENT PWRCVB_EE.usrEventCnt "Machine B Warm-up cycles counter" UBYTE NO_COMPU_METHOD 0 0 0 255 ECU_ADDRESS 0x4000BE80 SYMBOL_LINK "xAdiaEeDataB" 167 /end MEASUREMENT
/begin MEASUREMENT PWRCVB_EE.usrInstFaultCnt "Instantaneous fault counter" UBYTE NO_COMPU_METHOD 0 0 0 255 ECU_ADDRESS 0x4000BE81 SYMBOL_LINK "xAdiaEeDataB" 168 /end MEASUREMENT
/begin MEASUREMENT PWRCVB_EE.usrWucCnt "Machine B Warm-up cycles counter" UBYTE NO_COMPU_METHOD 0 0 0 255 ECU_ADDRESS 0x4000BE82 SYMBOL_LINK "xAdiaEeDataB" 169 /end MEASUREMENT
/begin MEASUREMENT PWROC_EE.eCodErr "Machine B fault type" UBYTE eCodErr.Conversion 0 0 0 255 ECU_ADDRESS 0x4000BE84 SYMBOL_LINK "xAdiaEeDataB" 171 /end MEASUREMENT
/begin MEASUREMENT PWROC_EE.eErrSt "Machine B error state" UBYTE eErrSt.Conversion 0 0 0 255 ECU_ADDRESS 0x4000BE83 SYMBOL_LINK "xAdiaEeDataB" 170 /end MEASUREMENT
/begin MEASUREMENT PWROC_EE.usrEventCnt "Machine B Warm-up cycles counter" UBYTE NO_COMPU_METHOD 0 0 0 255 ECU_ADDRESS 0x4000BE85 SYMBOL_LINK "xAdiaEeDataB" 172 /end MEASUREMENT
/begin MEASUREMENT PWROC_EE.usrInstFaultCnt "Instantaneous fault counter" UBYTE NO_COMPU_METHOD 0 0 0 255 ECU_ADDRESS 0x4000BE86 SYMBOL_LINK "xAdiaEeDataB" 173 /end MEASUREMENT
/begin MEASUREMENT PWROC_EE.usrWucCnt "Machine B Warm-up cycles counter" UBYTE NO_COMPU_METHOD 0 0 0 255 ECU_ADDRESS 0x4000BE87 SYMBOL_LINK "xAdiaEeDataB" 174 /end MEASUREMENT
/begin MEASUREMENT PWRCC_EE.eCodErr "Machine B fault type" UBYTE eCodErr.Conversion 0 0 0 255 ECU_ADDRESS 0x4000BE89 SYMBOL_LINK "xAdiaEeDataB" 176 /end MEASUREMENT
/begin MEASUREMENT PWRCC_EE.eErrSt "Machine B error state" UBYTE eErrSt.Conversion 0 0 0 255 ECU_ADDRESS 0x4000BE88 SYMBOL_LINK "xAdiaEeDataB" 175 /end MEASUREMENT
/begin MEASUREMENT PWRCC_EE.usrEventCnt "Machine B Warm-up cycles counter" UBYTE NO_COMPU_METHOD 0 0 0 255 ECU_ADDRESS 0x4000BE8A SYMBOL_LINK "xAdiaEeDataB" 177 /end MEASUREMENT
/begin MEASUREMENT PWRCC_EE.usrInstFaultCnt "Instantaneous fault counter" UBYTE NO_COMPU_METHOD 0 0 0 255 ECU_ADDRESS 0x4000BE8B SYMBOL_LINK "xAdiaEeDataB" 178 /end MEASUREMENT
/begin MEASUREMENT PWRCC_EE.usrWucCnt "Machine B Warm-up cycles counter" UBYTE NO_COMPU_METHOD 0 0 0 255 ECU_ADDRESS 0x4000BE8C SYMBOL_LINK "xAdiaEeDataB" 179 /end MEASUREMENT
/begin MEASUREMENT SGM_EE.eCodErr "Machine B fault type" UBYTE eCodErr.Conversion 0 0 0 255 ECU_ADDRESS 0x4000BE8E SYMBOL_LINK "xAdiaEeDataB" 181 /end MEASUREMENT
/begin MEASUREMENT SGM_EE.eErrSt "Machine B error state" UBYTE eErrSt.Conversion 0 0 0 255 ECU_ADDRESS 0x4000BE8D SYMBOL_LINK "xAdiaEeDataB" 180 /end MEASUREMENT
/begin MEASUREMENT SGM_EE.usrEventCnt "Machine B Warm-up cycles counter" UBYTE NO_COMPU_METHOD 0 0 0 255 ECU_ADDRESS 0x4000BE8F SYMBOL_LINK "xAdiaEeDataB" 182 /end MEASUREMENT
/begin MEASUREMENT SGM_EE.usrInstFaultCnt "Instantaneous fault counter" UBYTE NO_COMPU_METHOD 0 0 0 255 ECU_ADDRESS 0x4000BE90 SYMBOL_LINK "xAdiaEeDataB" 183 /end MEASUREMENT
/begin MEASUREMENT SGM_EE.usrWucCnt "Machine B Warm-up cycles counter" UBYTE NO_COMPU_METHOD 0 0 0 255 ECU_ADDRESS 0x4000BE91 SYMBOL_LINK "xAdiaEeDataB" 184 /end MEASUREMENT
/begin MEASUREMENT EVRCOL_EE.eCodErr "Machine B fault type" UBYTE eCodErr.Conversion 0 0 0 255 ECU_ADDRESS 0x4000BE93 SYMBOL_LINK "xAdiaEeDataB" 186 /end MEASUREMENT
/begin MEASUREMENT EVRCOL_EE.eErrSt "Machine B error state" UBYTE eErrSt.Conversion 0 0 0 255 ECU_ADDRESS 0x4000BE92 SYMBOL_LINK "xAdiaEeDataB" 185 /end MEASUREMENT
/begin MEASUREMENT EVRCOL_EE.usrEventCnt "Machine B Warm-up cycles counter" UBYTE NO_COMPU_METHOD 0 0 0 255 ECU_ADDRESS 0x4000BE94 SYMBOL_LINK "xAdiaEeDataB" 187 /end MEASUREMENT
/begin MEASUREMENT EVRCOL_EE.usrInstFaultCnt "Instantaneous fault counter" UBYTE NO_COMPU_METHOD 0 0 0 255 ECU_ADDRESS 0x4000BE95 SYMBOL_LINK "xAdiaEeDataB" 188 /end MEASUREMENT
/begin MEASUREMENT EVRCOL_EE.usrWucCnt "Machine B Warm-up cycles counter" UBYTE NO_COMPU_METHOD 0 0 0 255 ECU_ADDRESS 0x4000BE96 SYMBOL_LINK "xAdiaEeDataB" 189 /end MEASUREMENT
/begin MEASUREMENT EVRCGND_EE.eCodErr "Machine B fault type" UBYTE eCodErr.Conversion 0 0 0 255 ECU_ADDRESS 0x4000BE98 SYMBOL_LINK "xAdiaEeDataB" 191 /end MEASUREMENT
/begin MEASUREMENT EVRCGND_EE.eErrSt "Machine B error state" UBYTE eErrSt.Conversion 0 0 0 255 ECU_ADDRESS 0x4000BE97 SYMBOL_LINK "xAdiaEeDataB" 190 /end MEASUREMENT
/begin MEASUREMENT EVRCGND_EE.usrEventCnt "Machine B Warm-up cycles counter" UBYTE NO_COMPU_METHOD 0 0 0 255 ECU_ADDRESS 0x4000BE99 SYMBOL_LINK "xAdiaEeDataB" 192 /end MEASUREMENT
/begin MEASUREMENT EVRCGND_EE.usrInstFaultCnt "Instantaneous fault counter" UBYTE NO_COMPU_METHOD 0 0 0 255 ECU_ADDRESS 0x4000BE9A SYMBOL_LINK "xAdiaEeDataB" 193 /end MEASUREMENT
/begin MEASUREMENT EVRCGND_EE.usrWucCnt "Machine B Warm-up cycles counter" UBYTE NO_COMPU_METHOD 0 0 0 255 ECU_ADDRESS 0x4000BE9B SYMBOL_LINK "xAdiaEeDataB" 194 /end MEASUREMENT
/begin MEASUREMENT EVRCVB_EE.eCodErr "Machine B fault type" UBYTE eCodErr.Conversion 0 0 0 255 ECU_ADDRESS 0x4000BE9D SYMBOL_LINK "xAdiaEeDataB" 196 /end MEASUREMENT
/begin MEASUREMENT EVRCVB_EE.eErrSt "Machine B error state" UBYTE eErrSt.Conversion 0 0 0 255 ECU_ADDRESS 0x4000BE9C SYMBOL_LINK "xAdiaEeDataB" 195 /end MEASUREMENT
/begin MEASUREMENT EVRCVB_EE.usrEventCnt "Machine B Warm-up cycles counter" UBYTE NO_COMPU_METHOD 0 0 0 255 ECU_ADDRESS 0x4000BE9E SYMBOL_LINK "xAdiaEeDataB" 197 /end MEASUREMENT
/begin MEASUREMENT EVRCVB_EE.usrInstFaultCnt "Instantaneous fault counter" UBYTE NO_COMPU_METHOD 0 0 0 255 ECU_ADDRESS 0x4000BE9F SYMBOL_LINK "xAdiaEeDataB" 198 /end MEASUREMENT
/begin MEASUREMENT EVRCVB_EE.usrWucCnt "Machine B Warm-up cycles counter" UBYTE NO_COMPU_METHOD 0 0 0 255 ECU_ADDRESS 0x4000BEA0 SYMBOL_LINK "xAdiaEeDataB" 199 /end MEASUREMENT
/begin MEASUREMENT SPO_EE.eCodErr "Machine B fault type" UBYTE eCodErr.Conversion 0 0 0 255 ECU_ADDRESS 0x4000BDE9 SYMBOL_LINK "xAdiaEeDataB" 16 /end MEASUREMENT
/begin MEASUREMENT SPO_EE.eErrSt "Machine B error state" UBYTE eErrSt.Conversion 0 0 0 255 ECU_ADDRESS 0x4000BDE8 SYMBOL_LINK "xAdiaEeDataB" 15 /end MEASUREMENT
/begin MEASUREMENT SPO_EE.usrEventCnt "Machine B Warm-up cycles counter" UBYTE NO_COMPU_METHOD 0 0 0 255 ECU_ADDRESS 0x4000BDEA SYMBOL_LINK "xAdiaEeDataB" 17 /end MEASUREMENT
/begin MEASUREMENT SPO_EE.usrInstFaultCnt "Instantaneous fault counter" UBYTE NO_COMPU_METHOD 0 0 0 255 ECU_ADDRESS 0x4000BDEB SYMBOL_LINK "xAdiaEeDataB" 18 /end MEASUREMENT
/begin MEASUREMENT SPO_EE.usrWucCnt "Machine B Warm-up cycles counter" UBYTE NO_COMPU_METHOD 0 0 0 255 ECU_ADDRESS 0x4000BDEC SYMBOL_LINK "xAdiaEeDataB" 19 /end MEASUREMENT
/begin MEASUREMENT PRVCOL_EE.eCodErr "Machine B fault type" UBYTE eCodErr.Conversion 0 0 0 255 ECU_ADDRESS 0x4000BEA2 SYMBOL_LINK "xAdiaEeDataB" 201 /end MEASUREMENT
/begin MEASUREMENT PRVCOL_EE.eErrSt "Machine B error state" UBYTE eErrSt.Conversion 0 0 0 255 ECU_ADDRESS 0x4000BEA1 SYMBOL_LINK "xAdiaEeDataB" 200 /end MEASUREMENT
/begin MEASUREMENT PRVCOL_EE.usrEventCnt "Machine B Warm-up cycles counter" UBYTE NO_COMPU_METHOD 0 0 0 255 ECU_ADDRESS 0x4000BEA3 SYMBOL_LINK "xAdiaEeDataB" 202 /end MEASUREMENT
/begin MEASUREMENT PRVCOL_EE.usrInstFaultCnt "Instantaneous fault counter" UBYTE NO_COMPU_METHOD 0 0 0 255 ECU_ADDRESS 0x4000BEA4 SYMBOL_LINK "xAdiaEeDataB" 203 /end MEASUREMENT
/begin MEASUREMENT PRVCOL_EE.usrWucCnt "Machine B Warm-up cycles counter" UBYTE NO_COMPU_METHOD 0 0 0 255 ECU_ADDRESS 0x4000BEA5 SYMBOL_LINK "xAdiaEeDataB" 204 /end MEASUREMENT
/begin MEASUREMENT PRVCGND_EE.eCodErr "Machine B fault type" UBYTE eCodErr.Conversion 0 0 0 255 ECU_ADDRESS 0x4000BEA7 SYMBOL_LINK "xAdiaEeDataB" 206 /end MEASUREMENT
/begin MEASUREMENT PRVCGND_EE.eErrSt "Machine B error state" UBYTE eErrSt.Conversion 0 0 0 255 ECU_ADDRESS 0x4000BEA6 SYMBOL_LINK "xAdiaEeDataB" 205 /end MEASUREMENT
/begin MEASUREMENT PRVCGND_EE.usrEventCnt "Machine B Warm-up cycles counter" UBYTE NO_COMPU_METHOD 0 0 0 255 ECU_ADDRESS 0x4000BEA8 SYMBOL_LINK "xAdiaEeDataB" 207 /end MEASUREMENT
/begin MEASUREMENT PRVCGND_EE.usrInstFaultCnt "Instantaneous fault counter" UBYTE NO_COMPU_METHOD 0 0 0 255 ECU_ADDRESS 0x4000BEA9 SYMBOL_LINK "xAdiaEeDataB" 208 /end MEASUREMENT
/begin MEASUREMENT PRVCGND_EE.usrWucCnt "Machine B Warm-up cycles counter" UBYTE NO_COMPU_METHOD 0 0 0 255 ECU_ADDRESS 0x4000BEAA SYMBOL_LINK "xAdiaEeDataB" 209 /end MEASUREMENT
/begin MEASUREMENT PRVCVB_EE.eCodErr "Machine B fault type" UBYTE eCodErr.Conversion 0 0 0 255 ECU_ADDRESS 0x4000BEAC SYMBOL_LINK "xAdiaEeDataB" 211 /end MEASUREMENT
/begin MEASUREMENT PRVCVB_EE.eErrSt "Machine B error state" UBYTE eErrSt.Conversion 0 0 0 255 ECU_ADDRESS 0x4000BEAB SYMBOL_LINK "xAdiaEeDataB" 210 /end MEASUREMENT
/begin MEASUREMENT PRVCVB_EE.usrEventCnt "Machine B Warm-up cycles counter" UBYTE NO_COMPU_METHOD 0 0 0 255 ECU_ADDRESS 0x4000BEAD SYMBOL_LINK "xAdiaEeDataB" 212 /end MEASUREMENT
/begin MEASUREMENT PRVCVB_EE.usrInstFaultCnt "Instantaneous fault counter" UBYTE NO_COMPU_METHOD 0 0 0 255 ECU_ADDRESS 0x4000BEAE SYMBOL_LINK "xAdiaEeDataB" 213 /end MEASUREMENT
/begin MEASUREMENT PRVCVB_EE.usrWucCnt "Machine B Warm-up cycles counter" UBYTE NO_COMPU_METHOD 0 0 0 255 ECU_ADDRESS 0x4000BEAF SYMBOL_LINK "xAdiaEeDataB" 214 /end MEASUREMENT
/begin MEASUREMENT LHR_EE.eCodErr "Machine B fault type" UBYTE eCodErr.Conversion 0 0 0 255 ECU_ADDRESS 0x4000BEB1 SYMBOL_LINK "xAdiaEeDataB" 216 /end MEASUREMENT
/begin MEASUREMENT LHR_EE.eErrSt "Machine B error state" UBYTE eErrSt.Conversion 0 0 0 255 ECU_ADDRESS 0x4000BEB0 SYMBOL_LINK "xAdiaEeDataB" 215 /end MEASUREMENT
/begin MEASUREMENT LHR_EE.usrEventCnt "Machine B Warm-up cycles counter" UBYTE NO_COMPU_METHOD 0 0 0 255 ECU_ADDRESS 0x4000BEB2 SYMBOL_LINK "xAdiaEeDataB" 217 /end MEASUREMENT
/begin MEASUREMENT LHR_EE.usrInstFaultCnt "Instantaneous fault counter" UBYTE NO_COMPU_METHOD 0 0 0 255 ECU_ADDRESS 0x4000BEB3 SYMBOL_LINK "xAdiaEeDataB" 218 /end MEASUREMENT
/begin MEASUREMENT LHR_EE.usrWucCnt "Machine B Warm-up cycles counter" UBYTE NO_COMPU_METHOD 0 0 0 255 ECU_ADDRESS 0x4000BEB4 SYMBOL_LINK "xAdiaEeDataB" 219 /end MEASUREMENT
/begin MEASUREMENT SPMP_EE.eCodErr "Machine B fault type" UBYTE eCodErr.Conversion 0 0 0 255 ECU_ADDRESS 0x4000BEB6 SYMBOL_LINK "xAdiaEeDataB" 221 /end MEASUREMENT
/begin MEASUREMENT SPMP_EE.eErrSt "Machine B error state" UBYTE eErrSt.Conversion 0 0 0 255 ECU_ADDRESS 0x4000BEB5 SYMBOL_LINK "xAdiaEeDataB" 220 /end MEASUREMENT
/begin MEASUREMENT SPMP_EE.usrEventCnt "Machine B Warm-up cycles counter" UBYTE NO_COMPU_METHOD 0 0 0 255 ECU_ADDRESS 0x4000BEB7 SYMBOL_LINK "xAdiaEeDataB" 222 /end MEASUREMENT
/begin MEASUREMENT SPMP_EE.usrInstFaultCnt "Instantaneous fault counter" UBYTE NO_COMPU_METHOD 0 0 0 255 ECU_ADDRESS 0x4000BEB8 SYMBOL_LINK "xAdiaEeDataB" 223 /end MEASUREMENT
/begin MEASUREMENT SPMP_EE.usrWucCnt "Machine B Warm-up cycles counter" UBYTE NO_COMPU_METHOD 0 0 0 255 ECU_ADDRESS 0x4000BEB9 SYMBOL_LINK "xAdiaEeDataB" 224 /end MEASUREMENT
/begin MEASUREMENT STC1_EE.eCodErr "Machine B fault type" UBYTE eCodErr.Conversion 0 0 0 255 ECU_ADDRESS 0x4000BEBB SYMBOL_LINK "xAdiaEeDataB" 226 /end MEASUREMENT
/begin MEASUREMENT STC1_EE.eErrSt "Machine B error state" UBYTE eErrSt.Conversion 0 0 0 255 ECU_ADDRESS 0x4000BEBA SYMBOL_LINK "xAdiaEeDataB" 225 /end MEASUREMENT
/begin MEASUREMENT STC1_EE.usrEventCnt "Machine B Warm-up cycles counter" UBYTE NO_COMPU_METHOD 0 0 0 255 ECU_ADDRESS 0x4000BEBC SYMBOL_LINK "xAdiaEeDataB" 227 /end MEASUREMENT
/begin MEASUREMENT STC1_EE.usrInstFaultCnt "Instantaneous fault counter" UBYTE NO_COMPU_METHOD 0 0 0 255 ECU_ADDRESS 0x4000BEBD SYMBOL_LINK "xAdiaEeDataB" 228 /end MEASUREMENT
/begin MEASUREMENT STC1_EE.usrWucCnt "Machine B Warm-up cycles counter" UBYTE NO_COMPU_METHOD 0 0 0 255 ECU_ADDRESS 0x4000BEBE SYMBOL_LINK "xAdiaEeDataB" 229 /end MEASUREMENT
/begin MEASUREMENT STC2_EE.eCodErr "Machine B fault type" UBYTE eCodErr.Conversion 0 0 0 255 ECU_ADDRESS 0x4000BEC0 SYMBOL_LINK "xAdiaEeDataB" 231 /end MEASUREMENT
/begin MEASUREMENT STC2_EE.eErrSt "Machine B error state" UBYTE eErrSt.Conversion 0 0 0 255 ECU_ADDRESS 0x4000BEBF SYMBOL_LINK "xAdiaEeDataB" 230 /end MEASUREMENT
/begin MEASUREMENT STC2_EE.usrEventCnt "Machine B Warm-up cycles counter" UBYTE NO_COMPU_METHOD 0 0 0 255 ECU_ADDRESS 0x4000BEC1 SYMBOL_LINK "xAdiaEeDataB" 232 /end MEASUREMENT
/begin MEASUREMENT STC2_EE.usrInstFaultCnt "Instantaneous fault counter" UBYTE NO_COMPU_METHOD 0 0 0 255 ECU_ADDRESS 0x4000BEC2 SYMBOL_LINK "xAdiaEeDataB" 233 /end MEASUREMENT
/begin MEASUREMENT STC2_EE.usrWucCnt "Machine B Warm-up cycles counter" UBYTE NO_COMPU_METHOD 0 0 0 255 ECU_ADDRESS 0x4000BEC3 SYMBOL_LINK "xAdiaEeDataB" 234 /end MEASUREMENT
/begin MEASUREMENT VS1_EE.eCodErr "Machine B fault type" UBYTE eCodErr.Conversion 0 0 0 255 ECU_ADDRESS 0x4000BEC5 SYMBOL_LINK "xAdiaEeDataB" 236 /end MEASUREMENT
/begin MEASUREMENT VS1_EE.eErrSt "Machine B error state" UBYTE eErrSt.Conversion 0 0 0 255 ECU_ADDRESS 0x4000BEC4 SYMBOL_LINK "xAdiaEeDataB" 235 /end MEASUREMENT
/begin MEASUREMENT VS1_EE.usrEventCnt "Machine B Warm-up cycles counter" UBYTE NO_COMPU_METHOD 0 0 0 255 ECU_ADDRESS 0x4000BEC6 SYMBOL_LINK "xAdiaEeDataB" 237 /end MEASUREMENT
/begin MEASUREMENT VS1_EE.usrInstFaultCnt "Instantaneous fault counter" UBYTE NO_COMPU_METHOD 0 0 0 255 ECU_ADDRESS 0x4000BEC7 SYMBOL_LINK "xAdiaEeDataB" 238 /end MEASUREMENT
/begin MEASUREMENT VS1_EE.usrWucCnt "Machine B Warm-up cycles counter" UBYTE NO_COMPU_METHOD 0 0 0 255 ECU_ADDRESS 0x4000BEC8 SYMBOL_LINK "xAdiaEeDataB" 239 /end MEASUREMENT
/begin MEASUREMENT VS2_EE.eCodErr "Machine B fault type" UBYTE eCodErr.Conversion 0 0 0 255 ECU_ADDRESS 0x4000BECA SYMBOL_LINK "xAdiaEeDataB" 241 /end MEASUREMENT
/begin MEASUREMENT VS2_EE.eErrSt "Machine B error state" UBYTE eErrSt.Conversion 0 0 0 255 ECU_ADDRESS 0x4000BEC9 SYMBOL_LINK "xAdiaEeDataB" 240 /end MEASUREMENT
/begin MEASUREMENT VS2_EE.usrEventCnt "Machine B Warm-up cycles counter" UBYTE NO_COMPU_METHOD 0 0 0 255 ECU_ADDRESS 0x4000BECB SYMBOL_LINK "xAdiaEeDataB" 242 /end MEASUREMENT
/begin MEASUREMENT VS2_EE.usrInstFaultCnt "Instantaneous fault counter" UBYTE NO_COMPU_METHOD 0 0 0 255 ECU_ADDRESS 0x4000BECC SYMBOL_LINK "xAdiaEeDataB" 243 /end MEASUREMENT
/begin MEASUREMENT VS2_EE.usrWucCnt "Machine B Warm-up cycles counter" UBYTE NO_COMPU_METHOD 0 0 0 255 ECU_ADDRESS 0x4000BECD SYMBOL_LINK "xAdiaEeDataB" 244 /end MEASUREMENT
/begin MEASUREMENT VS3_EE.eCodErr "Machine B fault type" UBYTE eCodErr.Conversion 0 0 0 255 ECU_ADDRESS 0x4000BECF SYMBOL_LINK "xAdiaEeDataB" 246 /end MEASUREMENT
/begin MEASUREMENT VS3_EE.eErrSt "Machine B error state" UBYTE eErrSt.Conversion 0 0 0 255 ECU_ADDRESS 0x4000BECE SYMBOL_LINK "xAdiaEeDataB" 245 /end MEASUREMENT
/begin MEASUREMENT VS3_EE.usrEventCnt "Machine B Warm-up cycles counter" UBYTE NO_COMPU_METHOD 0 0 0 255 ECU_ADDRESS 0x4000BED0 SYMBOL_LINK "xAdiaEeDataB" 247 /end MEASUREMENT
/begin MEASUREMENT VS3_EE.usrInstFaultCnt "Instantaneous fault counter" UBYTE NO_COMPU_METHOD 0 0 0 255 ECU_ADDRESS 0x4000BED1 SYMBOL_LINK "xAdiaEeDataB" 248 /end MEASUREMENT
/begin MEASUREMENT VS3_EE.usrWucCnt "Machine B Warm-up cycles counter" UBYTE NO_COMPU_METHOD 0 0 0 255 ECU_ADDRESS 0x4000BED2 SYMBOL_LINK "xAdiaEeDataB" 249 /end MEASUREMENT
/begin MEASUREMENT SPT_EE.eCodErr "Machine B fault type" UBYTE eCodErr.Conversion 0 0 0 255 ECU_ADDRESS 0x4000BDEE SYMBOL_LINK "xAdiaEeDataB" 21 /end MEASUREMENT
/begin MEASUREMENT SPT_EE.eErrSt "Machine B error state" UBYTE eErrSt.Conversion 0 0 0 255 ECU_ADDRESS 0x4000BDED SYMBOL_LINK "xAdiaEeDataB" 20 /end MEASUREMENT
/begin MEASUREMENT SPT_EE.usrEventCnt "Machine B Warm-up cycles counter" UBYTE NO_COMPU_METHOD 0 0 0 255 ECU_ADDRESS 0x4000BDEF SYMBOL_LINK "xAdiaEeDataB" 22 /end MEASUREMENT
/begin MEASUREMENT SPT_EE.usrInstFaultCnt "Instantaneous fault counter" UBYTE NO_COMPU_METHOD 0 0 0 255 ECU_ADDRESS 0x4000BDF0 SYMBOL_LINK "xAdiaEeDataB" 23 /end MEASUREMENT
/begin MEASUREMENT SPT_EE.usrWucCnt "Machine B Warm-up cycles counter" UBYTE NO_COMPU_METHOD 0 0 0 255 ECU_ADDRESS 0x4000BDF1 SYMBOL_LINK "xAdiaEeDataB" 24 /end MEASUREMENT
/begin MEASUREMENT CLO1_EE.eCodErr "Machine B fault type" UBYTE eCodErr.Conversion 0 0 0 255 ECU_ADDRESS 0x4000BED4 SYMBOL_LINK "xAdiaEeDataB" 251 /end MEASUREMENT
/begin MEASUREMENT CLO1_EE.eErrSt "Machine B error state" UBYTE eErrSt.Conversion 0 0 0 255 ECU_ADDRESS 0x4000BED3 SYMBOL_LINK "xAdiaEeDataB" 250 /end MEASUREMENT
/begin MEASUREMENT CLO1_EE.usrEventCnt "Machine B Warm-up cycles counter" UBYTE NO_COMPU_METHOD 0 0 0 255 ECU_ADDRESS 0x4000BED5 SYMBOL_LINK "xAdiaEeDataB" 252 /end MEASUREMENT
/begin MEASUREMENT CLO1_EE.usrInstFaultCnt "Instantaneous fault counter" UBYTE NO_COMPU_METHOD 0 0 0 255 ECU_ADDRESS 0x4000BED6 SYMBOL_LINK "xAdiaEeDataB" 253 /end MEASUREMENT
/begin MEASUREMENT CLO1_EE.usrWucCnt "Machine B Warm-up cycles counter" UBYTE NO_COMPU_METHOD 0 0 0 255 ECU_ADDRESS 0x4000BED7 SYMBOL_LINK "xAdiaEeDataB" 254 /end MEASUREMENT
/begin MEASUREMENT CLO2_EE.eCodErr "Machine B fault type" UBYTE eCodErr.Conversion 0 0 0 255 ECU_ADDRESS 0x4000BED9 SYMBOL_LINK "xAdiaEeDataB" 256 /end MEASUREMENT
/begin MEASUREMENT CLO2_EE.eErrSt "Machine B error state" UBYTE eErrSt.Conversion 0 0 0 255 ECU_ADDRESS 0x4000BED8 SYMBOL_LINK "xAdiaEeDataB" 255 /end MEASUREMENT
/begin MEASUREMENT CLO2_EE.usrEventCnt "Machine B Warm-up cycles counter" UBYTE NO_COMPU_METHOD 0 0 0 255 ECU_ADDRESS 0x4000BEDA SYMBOL_LINK "xAdiaEeDataB" 257 /end MEASUREMENT
/begin MEASUREMENT CLO2_EE.usrInstFaultCnt "Instantaneous fault counter" UBYTE NO_COMPU_METHOD 0 0 0 255 ECU_ADDRESS 0x4000BEDB SYMBOL_LINK "xAdiaEeDataB" 258 /end MEASUREMENT
/begin MEASUREMENT CLO2_EE.usrWucCnt "Machine B Warm-up cycles counter" UBYTE NO_COMPU_METHOD 0 0 0 255 ECU_ADDRESS 0x4000BEDC SYMBOL_LINK "xAdiaEeDataB" 259 /end MEASUREMENT
/begin MEASUREMENT CLO3_EE.eCodErr "Machine B fault type" UBYTE eCodErr.Conversion 0 0 0 255 ECU_ADDRESS 0x4000BEDE SYMBOL_LINK "xAdiaEeDataB" 261 /end MEASUREMENT
/begin MEASUREMENT CLO3_EE.eErrSt "Machine B error state" UBYTE eErrSt.Conversion 0 0 0 255 ECU_ADDRESS 0x4000BEDD SYMBOL_LINK "xAdiaEeDataB" 260 /end MEASUREMENT
/begin MEASUREMENT CLO3_EE.usrEventCnt "Machine B Warm-up cycles counter" UBYTE NO_COMPU_METHOD 0 0 0 255 ECU_ADDRESS 0x4000BEDF SYMBOL_LINK "xAdiaEeDataB" 262 /end MEASUREMENT
/begin MEASUREMENT CLO3_EE.usrInstFaultCnt "Instantaneous fault counter" UBYTE NO_COMPU_METHOD 0 0 0 255 ECU_ADDRESS 0x4000BEE0 SYMBOL_LINK "xAdiaEeDataB" 263 /end MEASUREMENT
/begin MEASUREMENT CLO3_EE.usrWucCnt "Machine B Warm-up cycles counter" UBYTE NO_COMPU_METHOD 0 0 0 255 ECU_ADDRESS 0x4000BEE1 SYMBOL_LINK "xAdiaEeDataB" 264 /end MEASUREMENT
/begin MEASUREMENT CLO4_EE.eCodErr "Machine B fault type" UBYTE eCodErr.Conversion 0 0 0 255 ECU_ADDRESS 0x4000BEE3 SYMBOL_LINK "xAdiaEeDataB" 266 /end MEASUREMENT
/begin MEASUREMENT CLO4_EE.eErrSt "Machine B error state" UBYTE eErrSt.Conversion 0 0 0 255 ECU_ADDRESS 0x4000BEE2 SYMBOL_LINK "xAdiaEeDataB" 265 /end MEASUREMENT
/begin MEASUREMENT CLO4_EE.usrEventCnt "Machine B Warm-up cycles counter" UBYTE NO_COMPU_METHOD 0 0 0 255 ECU_ADDRESS 0x4000BEE4 SYMBOL_LINK "xAdiaEeDataB" 267 /end MEASUREMENT
/begin MEASUREMENT CLO4_EE.usrInstFaultCnt "Instantaneous fault counter" UBYTE NO_COMPU_METHOD 0 0 0 255 ECU_ADDRESS 0x4000BEE5 SYMBOL_LINK "xAdiaEeDataB" 268 /end MEASUREMENT
/begin MEASUREMENT CLO4_EE.usrWucCnt "Machine B Warm-up cycles counter" UBYTE NO_COMPU_METHOD 0 0 0 255 ECU_ADDRESS 0x4000BEE6 SYMBOL_LINK "xAdiaEeDataB" 269 /end MEASUREMENT
/begin MEASUREMENT FAR02_EE.eCodErr "Machine B fault type" UBYTE eCodErr.Conversion 0 0 0 255 ECU_ADDRESS 0x4000BEE8 SYMBOL_LINK "xAdiaEeDataB" 271 /end MEASUREMENT
/begin MEASUREMENT FAR02_EE.eErrSt "Machine B error state" UBYTE eErrSt.Conversion 0 0 0 255 ECU_ADDRESS 0x4000BEE7 SYMBOL_LINK "xAdiaEeDataB" 270 /end MEASUREMENT
/begin MEASUREMENT FAR02_EE.usrEventCnt "Machine B Warm-up cycles counter" UBYTE NO_COMPU_METHOD 0 0 0 255 ECU_ADDRESS 0x4000BEE9 SYMBOL_LINK "xAdiaEeDataB" 272 /end MEASUREMENT
/begin MEASUREMENT FAR02_EE.usrInstFaultCnt "Instantaneous fault counter" UBYTE NO_COMPU_METHOD 0 0 0 255 ECU_ADDRESS 0x4000BEEA SYMBOL_LINK "xAdiaEeDataB" 273 /end MEASUREMENT
/begin MEASUREMENT FAR02_EE.usrWucCnt "Machine B Warm-up cycles counter" UBYTE NO_COMPU_METHOD 0 0 0 255 ECU_ADDRESS 0x4000BEEB SYMBOL_LINK "xAdiaEeDataB" 274 /end MEASUREMENT
/begin MEASUREMENT FARCH_EE.eCodErr "Machine B fault type" UBYTE eCodErr.Conversion 0 0 0 255 ECU_ADDRESS 0x4000BEED SYMBOL_LINK "xAdiaEeDataB" 276 /end MEASUREMENT
/begin MEASUREMENT FARCH_EE.eErrSt "Machine B error state" UBYTE eErrSt.Conversion 0 0 0 255 ECU_ADDRESS 0x4000BEEC SYMBOL_LINK "xAdiaEeDataB" 275 /end MEASUREMENT
/begin MEASUREMENT FARCH_EE.usrEventCnt "Machine B Warm-up cycles counter" UBYTE NO_COMPU_METHOD 0 0 0 255 ECU_ADDRESS 0x4000BEEE SYMBOL_LINK "xAdiaEeDataB" 277 /end MEASUREMENT
/begin MEASUREMENT FARCH_EE.usrInstFaultCnt "Instantaneous fault counter" UBYTE NO_COMPU_METHOD 0 0 0 255 ECU_ADDRESS 0x4000BEEF SYMBOL_LINK "xAdiaEeDataB" 278 /end MEASUREMENT
/begin MEASUREMENT FARCH_EE.usrWucCnt "Machine B Warm-up cycles counter" UBYTE NO_COMPU_METHOD 0 0 0 255 ECU_ADDRESS 0x4000BEF0 SYMBOL_LINK "xAdiaEeDataB" 279 /end MEASUREMENT
/begin MEASUREMENT THRCVB_EE.eCodErr "Machine B fault type" UBYTE eCodErr.Conversion 0 0 0 255 ECU_ADDRESS 0x4000BEF2 SYMBOL_LINK "xAdiaEeDataB" 281 /end MEASUREMENT
/begin MEASUREMENT THRCVB_EE.eErrSt "Machine B error state" UBYTE eErrSt.Conversion 0 0 0 255 ECU_ADDRESS 0x4000BEF1 SYMBOL_LINK "xAdiaEeDataB" 280 /end MEASUREMENT
/begin MEASUREMENT THRCVB_EE.usrEventCnt "Machine B Warm-up cycles counter" UBYTE NO_COMPU_METHOD 0 0 0 255 ECU_ADDRESS 0x4000BEF3 SYMBOL_LINK "xAdiaEeDataB" 282 /end MEASUREMENT
/begin MEASUREMENT THRCVB_EE.usrInstFaultCnt "Instantaneous fault counter" UBYTE NO_COMPU_METHOD 0 0 0 255 ECU_ADDRESS 0x4000BEF4 SYMBOL_LINK "xAdiaEeDataB" 283 /end MEASUREMENT
/begin MEASUREMENT THRCVB_EE.usrWucCnt "Machine B Warm-up cycles counter" UBYTE NO_COMPU_METHOD 0 0 0 255 ECU_ADDRESS 0x4000BEF5 SYMBOL_LINK "xAdiaEeDataB" 284 /end MEASUREMENT
/begin MEASUREMENT THRCGND_EE.eCodErr "Machine B fault type" UBYTE eCodErr.Conversion 0 0 0 255 ECU_ADDRESS 0x4000BEF7 SYMBOL_LINK "xAdiaEeDataB" 286 /end MEASUREMENT
/begin MEASUREMENT THRCGND_EE.eErrSt "Machine B error state" UBYTE eErrSt.Conversion 0 0 0 255 ECU_ADDRESS 0x4000BEF6 SYMBOL_LINK "xAdiaEeDataB" 285 /end MEASUREMENT
/begin MEASUREMENT THRCGND_EE.usrEventCnt "Machine B Warm-up cycles counter" UBYTE NO_COMPU_METHOD 0 0 0 255 ECU_ADDRESS 0x4000BEF8 SYMBOL_LINK "xAdiaEeDataB" 287 /end MEASUREMENT
/begin MEASUREMENT THRCGND_EE.usrInstFaultCnt "Instantaneous fault counter" UBYTE NO_COMPU_METHOD 0 0 0 255 ECU_ADDRESS 0x4000BEF9 SYMBOL_LINK "xAdiaEeDataB" 288 /end MEASUREMENT
/begin MEASUREMENT THRCGND_EE.usrWucCnt "Machine B Warm-up cycles counter" UBYTE NO_COMPU_METHOD 0 0 0 255 ECU_ADDRESS 0x4000BEFA SYMBOL_LINK "xAdiaEeDataB" 289 /end MEASUREMENT
/begin MEASUREMENT AIR2H_EE.eCodErr "Machine B fault type" UBYTE eCodErr.Conversion 0 0 0 255 ECU_ADDRESS 0x4000BEFC SYMBOL_LINK "xAdiaEeDataB" 291 /end MEASUREMENT
/begin MEASUREMENT AIR2H_EE.eErrSt "Machine B error state" UBYTE eErrSt.Conversion 0 0 0 255 ECU_ADDRESS 0x4000BEFB SYMBOL_LINK "xAdiaEeDataB" 290 /end MEASUREMENT
/begin MEASUREMENT AIR2H_EE.usrEventCnt "Machine B Warm-up cycles counter" UBYTE NO_COMPU_METHOD 0 0 0 255 ECU_ADDRESS 0x4000BEFD SYMBOL_LINK "xAdiaEeDataB" 292 /end MEASUREMENT
/begin MEASUREMENT AIR2H_EE.usrInstFaultCnt "Instantaneous fault counter" UBYTE NO_COMPU_METHOD 0 0 0 255 ECU_ADDRESS 0x4000BEFE SYMBOL_LINK "xAdiaEeDataB" 293 /end MEASUREMENT
/begin MEASUREMENT AIR2H_EE.usrWucCnt "Machine B Warm-up cycles counter" UBYTE NO_COMPU_METHOD 0 0 0 255 ECU_ADDRESS 0x4000BEFF SYMBOL_LINK "xAdiaEeDataB" 294 /end MEASUREMENT
/begin MEASUREMENT AIR2L_EE.eCodErr "Machine B fault type" UBYTE eCodErr.Conversion 0 0 0 255 ECU_ADDRESS 0x4000BF01 SYMBOL_LINK "xAdiaEeDataB" 296 /end MEASUREMENT
/begin MEASUREMENT AIR2L_EE.eErrSt "Machine B error state" UBYTE eErrSt.Conversion 0 0 0 255 ECU_ADDRESS 0x4000BF00 SYMBOL_LINK "xAdiaEeDataB" 295 /end MEASUREMENT
/begin MEASUREMENT AIR2L_EE.usrEventCnt "Machine B Warm-up cycles counter" UBYTE NO_COMPU_METHOD 0 0 0 255 ECU_ADDRESS 0x4000BF02 SYMBOL_LINK "xAdiaEeDataB" 297 /end MEASUREMENT
/begin MEASUREMENT AIR2L_EE.usrInstFaultCnt "Instantaneous fault counter" UBYTE NO_COMPU_METHOD 0 0 0 255 ECU_ADDRESS 0x4000BF03 SYMBOL_LINK "xAdiaEeDataB" 298 /end MEASUREMENT
/begin MEASUREMENT AIR2L_EE.usrWucCnt "Machine B Warm-up cycles counter" UBYTE NO_COMPU_METHOD 0 0 0 255 ECU_ADDRESS 0x4000BF04 SYMBOL_LINK "xAdiaEeDataB" 299 /end MEASUREMENT
/begin MEASUREMENT STM_EE.eCodErr "Machine B fault type" UBYTE eCodErr.Conversion 0 0 0 255 ECU_ADDRESS 0x4000BDF3 SYMBOL_LINK "xAdiaEeDataB" 26 /end MEASUREMENT
/begin MEASUREMENT STM_EE.eErrSt "Machine B error state" UBYTE eErrSt.Conversion 0 0 0 255 ECU_ADDRESS 0x4000BDF2 SYMBOL_LINK "xAdiaEeDataB" 25 /end MEASUREMENT
/begin MEASUREMENT STM_EE.usrEventCnt "Machine B Warm-up cycles counter" UBYTE NO_COMPU_METHOD 0 0 0 255 ECU_ADDRESS 0x4000BDF4 SYMBOL_LINK "xAdiaEeDataB" 27 /end MEASUREMENT
/begin MEASUREMENT STM_EE.usrInstFaultCnt "Instantaneous fault counter" UBYTE NO_COMPU_METHOD 0 0 0 255 ECU_ADDRESS 0x4000BDF5 SYMBOL_LINK "xAdiaEeDataB" 28 /end MEASUREMENT
/begin MEASUREMENT STM_EE.usrWucCnt "Machine B Warm-up cycles counter" UBYTE NO_COMPU_METHOD 0 0 0 255 ECU_ADDRESS 0x4000BDF6 SYMBOL_LINK "xAdiaEeDataB" 29 /end MEASUREMENT
/begin MEASUREMENT SAFPON_EE.eCodErr "Machine B fault type" UBYTE eCodErr.Conversion 0 0 0 255 ECU_ADDRESS 0x4000BF06 SYMBOL_LINK "xAdiaEeDataB" 301 /end MEASUREMENT
/begin MEASUREMENT SAFPON_EE.eErrSt "Machine B error state" UBYTE eErrSt.Conversion 0 0 0 255 ECU_ADDRESS 0x4000BF05 SYMBOL_LINK "xAdiaEeDataB" 300 /end MEASUREMENT
/begin MEASUREMENT SAFPON_EE.usrEventCnt "Machine B Warm-up cycles counter" UBYTE NO_COMPU_METHOD 0 0 0 255 ECU_ADDRESS 0x4000BF07 SYMBOL_LINK "xAdiaEeDataB" 302 /end MEASUREMENT
/begin MEASUREMENT SAFPON_EE.usrInstFaultCnt "Instantaneous fault counter" UBYTE NO_COMPU_METHOD 0 0 0 255 ECU_ADDRESS 0x4000BF08 SYMBOL_LINK "xAdiaEeDataB" 303 /end MEASUREMENT
/begin MEASUREMENT SAFPON_EE.usrWucCnt "Machine B Warm-up cycles counter" UBYTE NO_COMPU_METHOD 0 0 0 255 ECU_ADDRESS 0x4000BF09 SYMBOL_LINK "xAdiaEeDataB" 304 /end MEASUREMENT
/begin MEASUREMENT SAFRTF_EE.eCodErr "Machine B fault type" UBYTE eCodErr.Conversion 0 0 0 255 ECU_ADDRESS 0x4000BF0B SYMBOL_LINK "xAdiaEeDataB" 306 /end MEASUREMENT
/begin MEASUREMENT SAFRTF_EE.eErrSt "Machine B error state" UBYTE eErrSt.Conversion 0 0 0 255 ECU_ADDRESS 0x4000BF0A SYMBOL_LINK "xAdiaEeDataB" 305 /end MEASUREMENT
/begin MEASUREMENT SAFRTF_EE.usrEventCnt "Machine B Warm-up cycles counter" UBYTE NO_COMPU_METHOD 0 0 0 255 ECU_ADDRESS 0x4000BF0C SYMBOL_LINK "xAdiaEeDataB" 307 /end MEASUREMENT
/begin MEASUREMENT SAFRTF_EE.usrInstFaultCnt "Instantaneous fault counter" UBYTE NO_COMPU_METHOD 0 0 0 255 ECU_ADDRESS 0x4000BF0D SYMBOL_LINK "xAdiaEeDataB" 308 /end MEASUREMENT
/begin MEASUREMENT SAFRTF_EE.usrWucCnt "Machine B Warm-up cycles counter" UBYTE NO_COMPU_METHOD 0 0 0 255 ECU_ADDRESS 0x4000BF0E SYMBOL_LINK "xAdiaEeDataB" 309 /end MEASUREMENT
/begin MEASUREMENT LHR2_EE.eCodErr "Machine B fault type" UBYTE eCodErr.Conversion 0 0 0 255 ECU_ADDRESS 0x4000BF10 SYMBOL_LINK "xAdiaEeDataB" 311 /end MEASUREMENT
/begin MEASUREMENT LHR2_EE.eErrSt "Machine B error state" UBYTE eErrSt.Conversion 0 0 0 255 ECU_ADDRESS 0x4000BF0F SYMBOL_LINK "xAdiaEeDataB" 310 /end MEASUREMENT
/begin MEASUREMENT LHR2_EE.usrEventCnt "Machine B Warm-up cycles counter" UBYTE NO_COMPU_METHOD 0 0 0 255 ECU_ADDRESS 0x4000BF11 SYMBOL_LINK "xAdiaEeDataB" 312 /end MEASUREMENT
/begin MEASUREMENT LHR2_EE.usrInstFaultCnt "Instantaneous fault counter" UBYTE NO_COMPU_METHOD 0 0 0 255 ECU_ADDRESS 0x4000BF12 SYMBOL_LINK "xAdiaEeDataB" 313 /end MEASUREMENT
/begin MEASUREMENT LHR2_EE.usrWucCnt "Machine B Warm-up cycles counter" UBYTE NO_COMPU_METHOD 0 0 0 255 ECU_ADDRESS 0x4000BF13 SYMBOL_LINK "xAdiaEeDataB" 314 /end MEASUREMENT
/begin MEASUREMENT FAN1_EE.eCodErr "Machine B fault type" UBYTE eCodErr.Conversion 0 0 0 255 ECU_ADDRESS 0x4000BF15 SYMBOL_LINK "xAdiaEeDataB" 316 /end MEASUREMENT
/begin MEASUREMENT FAN1_EE.eErrSt "Machine B error state" UBYTE eErrSt.Conversion 0 0 0 255 ECU_ADDRESS 0x4000BF14 SYMBOL_LINK "xAdiaEeDataB" 315 /end MEASUREMENT
/begin MEASUREMENT FAN1_EE.usrEventCnt "Machine B Warm-up cycles counter" UBYTE NO_COMPU_METHOD 0 0 0 255 ECU_ADDRESS 0x4000BF16 SYMBOL_LINK "xAdiaEeDataB" 317 /end MEASUREMENT
/begin MEASUREMENT FAN1_EE.usrInstFaultCnt "Instantaneous fault counter" UBYTE NO_COMPU_METHOD 0 0 0 255 ECU_ADDRESS 0x4000BF17 SYMBOL_LINK "xAdiaEeDataB" 318 /end MEASUREMENT
/begin MEASUREMENT FAN1_EE.usrWucCnt "Machine B Warm-up cycles counter" UBYTE NO_COMPU_METHOD 0 0 0 255 ECU_ADDRESS 0x4000BF18 SYMBOL_LINK "xAdiaEeDataB" 319 /end MEASUREMENT
/begin MEASUREMENT FAN2_EE.eCodErr "Machine B fault type" UBYTE eCodErr.Conversion 0 0 0 255 ECU_ADDRESS 0x4000BF1A SYMBOL_LINK "xAdiaEeDataB" 321 /end MEASUREMENT
/begin MEASUREMENT FAN2_EE.eErrSt "Machine B error state" UBYTE eErrSt.Conversion 0 0 0 255 ECU_ADDRESS 0x4000BF19 SYMBOL_LINK "xAdiaEeDataB" 320 /end MEASUREMENT
/begin MEASUREMENT FAN2_EE.usrEventCnt "Machine B Warm-up cycles counter" UBYTE NO_COMPU_METHOD 0 0 0 255 ECU_ADDRESS 0x4000BF1B SYMBOL_LINK "xAdiaEeDataB" 322 /end MEASUREMENT
/begin MEASUREMENT FAN2_EE.usrInstFaultCnt "Instantaneous fault counter" UBYTE NO_COMPU_METHOD 0 0 0 255 ECU_ADDRESS 0x4000BF1C SYMBOL_LINK "xAdiaEeDataB" 323 /end MEASUREMENT
/begin MEASUREMENT FAN2_EE.usrWucCnt "Machine B Warm-up cycles counter" UBYTE NO_COMPU_METHOD 0 0 0 255 ECU_ADDRESS 0x4000BF1D SYMBOL_LINK "xAdiaEeDataB" 324 /end MEASUREMENT
/begin MEASUREMENT TH2H_EE.eCodErr "Machine B fault type" UBYTE eCodErr.Conversion 0 0 0 255 ECU_ADDRESS 0x4000BF1F SYMBOL_LINK "xAdiaEeDataB" 326 /end MEASUREMENT
/begin MEASUREMENT TH2H_EE.eErrSt "Machine B error state" UBYTE eErrSt.Conversion 0 0 0 255 ECU_ADDRESS 0x4000BF1E SYMBOL_LINK "xAdiaEeDataB" 325 /end MEASUREMENT
/begin MEASUREMENT TH2H_EE.usrEventCnt "Machine B Warm-up cycles counter" UBYTE NO_COMPU_METHOD 0 0 0 255 ECU_ADDRESS 0x4000BF20 SYMBOL_LINK "xAdiaEeDataB" 327 /end MEASUREMENT
/begin MEASUREMENT TH2H_EE.usrInstFaultCnt "Instantaneous fault counter" UBYTE NO_COMPU_METHOD 0 0 0 255 ECU_ADDRESS 0x4000BF21 SYMBOL_LINK "xAdiaEeDataB" 328 /end MEASUREMENT
/begin MEASUREMENT TH2H_EE.usrWucCnt "Machine B Warm-up cycles counter" UBYTE NO_COMPU_METHOD 0 0 0 255 ECU_ADDRESS 0x4000BF22 SYMBOL_LINK "xAdiaEeDataB" 329 /end MEASUREMENT
/begin MEASUREMENT PO2L_EE.eCodErr "Machine B fault type" UBYTE eCodErr.Conversion 0 0 0 255 ECU_ADDRESS 0x4000BF24 SYMBOL_LINK "xAdiaEeDataB" 331 /end MEASUREMENT
/begin MEASUREMENT PO2L_EE.eErrSt "Machine B error state" UBYTE eErrSt.Conversion 0 0 0 255 ECU_ADDRESS 0x4000BF23 SYMBOL_LINK "xAdiaEeDataB" 330 /end MEASUREMENT
/begin MEASUREMENT PO2L_EE.usrEventCnt "Machine B Warm-up cycles counter" UBYTE NO_COMPU_METHOD 0 0 0 255 ECU_ADDRESS 0x4000BF25 SYMBOL_LINK "xAdiaEeDataB" 332 /end MEASUREMENT
/begin MEASUREMENT PO2L_EE.usrInstFaultCnt "Instantaneous fault counter" UBYTE NO_COMPU_METHOD 0 0 0 255 ECU_ADDRESS 0x4000BF26 SYMBOL_LINK "xAdiaEeDataB" 333 /end MEASUREMENT
/begin MEASUREMENT PO2L_EE.usrWucCnt "Machine B Warm-up cycles counter" UBYTE NO_COMPU_METHOD 0 0 0 255 ECU_ADDRESS 0x4000BF27 SYMBOL_LINK "xAdiaEeDataB" 334 /end MEASUREMENT
/begin MEASUREMENT THRST_EE.eCodErr "Machine B fault type" UBYTE eCodErr.Conversion 0 0 0 255 ECU_ADDRESS 0x4000BF29 SYMBOL_LINK "xAdiaEeDataB" 336 /end MEASUREMENT
/begin MEASUREMENT THRST_EE.eErrSt "Machine B error state" UBYTE eErrSt.Conversion 0 0 0 255 ECU_ADDRESS 0x4000BF28 SYMBOL_LINK "xAdiaEeDataB" 335 /end MEASUREMENT
/begin MEASUREMENT THRST_EE.usrEventCnt "Machine B Warm-up cycles counter" UBYTE NO_COMPU_METHOD 0 0 0 255 ECU_ADDRESS 0x4000BF2A SYMBOL_LINK "xAdiaEeDataB" 337 /end MEASUREMENT
/begin MEASUREMENT THRST_EE.usrInstFaultCnt "Instantaneous fault counter" UBYTE NO_COMPU_METHOD 0 0 0 255 ECU_ADDRESS 0x4000BF2B SYMBOL_LINK "xAdiaEeDataB" 338 /end MEASUREMENT
/begin MEASUREMENT THRST_EE.usrWucCnt "Machine B Warm-up cycles counter" UBYTE NO_COMPU_METHOD 0 0 0 255 ECU_ADDRESS 0x4000BF2C SYMBOL_LINK "xAdiaEeDataB" 339 /end MEASUREMENT
/begin MEASUREMENT SPEED_EE.eCodErr "Machine B fault type" UBYTE eCodErr.Conversion 0 0 0 255 ECU_ADDRESS 0x4000BF2E SYMBOL_LINK "xAdiaEeDataB" 341 /end MEASUREMENT
/begin MEASUREMENT SPEED_EE.eErrSt "Machine B error state" UBYTE eErrSt.Conversion 0 0 0 255 ECU_ADDRESS 0x4000BF2D SYMBOL_LINK "xAdiaEeDataB" 340 /end MEASUREMENT
/begin MEASUREMENT SPEED_EE.usrEventCnt "Machine B Warm-up cycles counter" UBYTE NO_COMPU_METHOD 0 0 0 255 ECU_ADDRESS 0x4000BF2F SYMBOL_LINK "xAdiaEeDataB" 342 /end MEASUREMENT
/begin MEASUREMENT SPEED_EE.usrInstFaultCnt "Instantaneous fault counter" UBYTE NO_COMPU_METHOD 0 0 0 255 ECU_ADDRESS 0x4000BF30 SYMBOL_LINK "xAdiaEeDataB" 343 /end MEASUREMENT
/begin MEASUREMENT SPEED_EE.usrWucCnt "Machine B Warm-up cycles counter" UBYTE NO_COMPU_METHOD 0 0 0 255 ECU_ADDRESS 0x4000BF31 SYMBOL_LINK "xAdiaEeDataB" 344 /end MEASUREMENT
/begin MEASUREMENT THRDR_EE.eCodErr "Machine B fault type" UBYTE eCodErr.Conversion 0 0 0 255 ECU_ADDRESS 0x4000BF33 SYMBOL_LINK "xAdiaEeDataB" 346 /end MEASUREMENT
/begin MEASUREMENT THRDR_EE.eErrSt "Machine B error state" UBYTE eErrSt.Conversion 0 0 0 255 ECU_ADDRESS 0x4000BF32 SYMBOL_LINK "xAdiaEeDataB" 345 /end MEASUREMENT
/begin MEASUREMENT THRDR_EE.usrEventCnt "Machine B Warm-up cycles counter" UBYTE NO_COMPU_METHOD 0 0 0 255 ECU_ADDRESS 0x4000BF34 SYMBOL_LINK "xAdiaEeDataB" 347 /end MEASUREMENT
/begin MEASUREMENT THRDR_EE.usrInstFaultCnt "Instantaneous fault counter" UBYTE NO_COMPU_METHOD 0 0 0 255 ECU_ADDRESS 0x4000BF35 SYMBOL_LINK "xAdiaEeDataB" 348 /end MEASUREMENT
/begin MEASUREMENT THRDR_EE.usrWucCnt "Machine B Warm-up cycles counter" UBYTE NO_COMPU_METHOD 0 0 0 255 ECU_ADDRESS 0x4000BF36 SYMBOL_LINK "xAdiaEeDataB" 349 /end MEASUREMENT
/begin MEASUREMENT STC_EE.eCodErr "Machine B fault type" UBYTE eCodErr.Conversion 0 0 0 255 ECU_ADDRESS 0x4000BDF8 SYMBOL_LINK "xAdiaEeDataB" 31 /end MEASUREMENT
/begin MEASUREMENT STC_EE.eErrSt "Machine B error state" UBYTE eErrSt.Conversion 0 0 0 255 ECU_ADDRESS 0x4000BDF7 SYMBOL_LINK "xAdiaEeDataB" 30 /end MEASUREMENT
/begin MEASUREMENT STC_EE.usrEventCnt "Machine B Warm-up cycles counter" UBYTE NO_COMPU_METHOD 0 0 0 255 ECU_ADDRESS 0x4000BDF9 SYMBOL_LINK "xAdiaEeDataB" 32 /end MEASUREMENT
/begin MEASUREMENT STC_EE.usrInstFaultCnt "Instantaneous fault counter" UBYTE NO_COMPU_METHOD 0 0 0 255 ECU_ADDRESS 0x4000BDFA SYMBOL_LINK "xAdiaEeDataB" 33 /end MEASUREMENT
/begin MEASUREMENT STC_EE.usrWucCnt "Machine B Warm-up cycles counter" UBYTE NO_COMPU_METHOD 0 0 0 255 ECU_ADDRESS 0x4000BDFB SYMBOL_LINK "xAdiaEeDataB" 34 /end MEASUREMENT
/begin MEASUREMENT STRCGNDOL_EE.eCodErr "Machine B fault type" UBYTE eCodErr.Conversion 0 0 0 255 ECU_ADDRESS 0x4000BF38 SYMBOL_LINK "xAdiaEeDataB" 351 /end MEASUREMENT
/begin MEASUREMENT STRCGNDOL_EE.eErrSt "Machine B error state" UBYTE eErrSt.Conversion 0 0 0 255 ECU_ADDRESS 0x4000BF37 SYMBOL_LINK "xAdiaEeDataB" 350 /end MEASUREMENT
/begin MEASUREMENT STRCGNDOL_EE.usrEventCnt "Machine B Warm-up cycles counter" UBYTE NO_COMPU_METHOD 0 0 0 255 ECU_ADDRESS 0x4000BF39 SYMBOL_LINK "xAdiaEeDataB" 352 /end MEASUREMENT
/begin MEASUREMENT STRCGNDOL_EE.usrInstFaultCnt "Instantaneous fault counter" UBYTE NO_COMPU_METHOD 0 0 0 255 ECU_ADDRESS 0x4000BF3A SYMBOL_LINK "xAdiaEeDataB" 353 /end MEASUREMENT
/begin MEASUREMENT STRCGNDOL_EE.usrWucCnt "Machine B Warm-up cycles counter" UBYTE NO_COMPU_METHOD 0 0 0 255 ECU_ADDRESS 0x4000BF3B SYMBOL_LINK "xAdiaEeDataB" 354 /end MEASUREMENT
/begin MEASUREMENT STRCVB_EE.eCodErr "Machine B fault type" UBYTE eCodErr.Conversion 0 0 0 255 ECU_ADDRESS 0x4000BF3D SYMBOL_LINK "xAdiaEeDataB" 356 /end MEASUREMENT
/begin MEASUREMENT STRCVB_EE.eErrSt "Machine B error state" UBYTE eErrSt.Conversion 0 0 0 255 ECU_ADDRESS 0x4000BF3C SYMBOL_LINK "xAdiaEeDataB" 355 /end MEASUREMENT
/begin MEASUREMENT STRCVB_EE.usrEventCnt "Machine B Warm-up cycles counter" UBYTE NO_COMPU_METHOD 0 0 0 255 ECU_ADDRESS 0x4000BF3E SYMBOL_LINK "xAdiaEeDataB" 357 /end MEASUREMENT
/begin MEASUREMENT STRCVB_EE.usrInstFaultCnt "Instantaneous fault counter" UBYTE NO_COMPU_METHOD 0 0 0 255 ECU_ADDRESS 0x4000BF3F SYMBOL_LINK "xAdiaEeDataB" 358 /end MEASUREMENT
/begin MEASUREMENT STRCVB_EE.usrWucCnt "Machine B Warm-up cycles counter" UBYTE NO_COMPU_METHOD 0 0 0 255 ECU_ADDRESS 0x4000BF40 SYMBOL_LINK "xAdiaEeDataB" 359 /end MEASUREMENT
/begin MEASUREMENT SPP01_EE.eCodErr "Machine B fault type" UBYTE eCodErr.Conversion 0 0 0 255 ECU_ADDRESS 0x4000BF42 SYMBOL_LINK "xAdiaEeDataB" 361 /end MEASUREMENT
/begin MEASUREMENT SPP01_EE.eErrSt "Machine B error state" UBYTE eErrSt.Conversion 0 0 0 255 ECU_ADDRESS 0x4000BF41 SYMBOL_LINK "xAdiaEeDataB" 360 /end MEASUREMENT
/begin MEASUREMENT SPP01_EE.usrEventCnt "Machine B Warm-up cycles counter" UBYTE NO_COMPU_METHOD 0 0 0 255 ECU_ADDRESS 0x4000BF43 SYMBOL_LINK "xAdiaEeDataB" 362 /end MEASUREMENT
/begin MEASUREMENT SPP01_EE.usrInstFaultCnt "Instantaneous fault counter" UBYTE NO_COMPU_METHOD 0 0 0 255 ECU_ADDRESS 0x4000BF44 SYMBOL_LINK "xAdiaEeDataB" 363 /end MEASUREMENT
/begin MEASUREMENT SPP01_EE.usrWucCnt "Machine B Warm-up cycles counter" UBYTE NO_COMPU_METHOD 0 0 0 255 ECU_ADDRESS 0x4000BF45 SYMBOL_LINK "xAdiaEeDataB" 364 /end MEASUREMENT
/begin MEASUREMENT SPP02_EE.eCodErr "Machine B fault type" UBYTE eCodErr.Conversion 0 0 0 255 ECU_ADDRESS 0x4000BF47 SYMBOL_LINK "xAdiaEeDataB" 366 /end MEASUREMENT
/begin MEASUREMENT SPP02_EE.eErrSt "Machine B error state" UBYTE eErrSt.Conversion 0 0 0 255 ECU_ADDRESS 0x4000BF46 SYMBOL_LINK "xAdiaEeDataB" 365 /end MEASUREMENT
/begin MEASUREMENT SPP02_EE.usrEventCnt "Machine B Warm-up cycles counter" UBYTE NO_COMPU_METHOD 0 0 0 255 ECU_ADDRESS 0x4000BF48 SYMBOL_LINK "xAdiaEeDataB" 367 /end MEASUREMENT
/begin MEASUREMENT SPP02_EE.usrInstFaultCnt "Instantaneous fault counter" UBYTE NO_COMPU_METHOD 0 0 0 255 ECU_ADDRESS 0x4000BF49 SYMBOL_LINK "xAdiaEeDataB" 368 /end MEASUREMENT
/begin MEASUREMENT SPP02_EE.usrWucCnt "Machine B Warm-up cycles counter" UBYTE NO_COMPU_METHOD 0 0 0 255 ECU_ADDRESS 0x4000BF4A SYMBOL_LINK "xAdiaEeDataB" 369 /end MEASUREMENT
/begin MEASUREMENT SPPC2_EE.eCodErr "Machine B fault type" UBYTE eCodErr.Conversion 0 0 0 255 ECU_ADDRESS 0x4000BF4C SYMBOL_LINK "xAdiaEeDataB" 371 /end MEASUREMENT
/begin MEASUREMENT SPPC2_EE.eErrSt "Machine B error state" UBYTE eErrSt.Conversion 0 0 0 255 ECU_ADDRESS 0x4000BF4B SYMBOL_LINK "xAdiaEeDataB" 370 /end MEASUREMENT
/begin MEASUREMENT SPPC2_EE.usrEventCnt "Machine B Warm-up cycles counter" UBYTE NO_COMPU_METHOD 0 0 0 255 ECU_ADDRESS 0x4000BF4D SYMBOL_LINK "xAdiaEeDataB" 372 /end MEASUREMENT
/begin MEASUREMENT SPPC2_EE.usrInstFaultCnt "Instantaneous fault counter" UBYTE NO_COMPU_METHOD 0 0 0 255 ECU_ADDRESS 0x4000BF4E SYMBOL_LINK "xAdiaEeDataB" 373 /end MEASUREMENT
/begin MEASUREMENT SPPC2_EE.usrWucCnt "Machine B Warm-up cycles counter" UBYTE NO_COMPU_METHOD 0 0 0 255 ECU_ADDRESS 0x4000BF4F SYMBOL_LINK "xAdiaEeDataB" 374 /end MEASUREMENT
/begin MEASUREMENT SPPC1_EE.eCodErr "Machine B fault type" UBYTE eCodErr.Conversion 0 0 0 255 ECU_ADDRESS 0x4000BF51 SYMBOL_LINK "xAdiaEeDataB" 376 /end MEASUREMENT
/begin MEASUREMENT SPPC1_EE.eErrSt "Machine B error state" UBYTE eErrSt.Conversion 0 0 0 255 ECU_ADDRESS 0x4000BF50 SYMBOL_LINK "xAdiaEeDataB" 375 /end MEASUREMENT
/begin MEASUREMENT SPPC1_EE.usrEventCnt "Machine B Warm-up cycles counter" UBYTE NO_COMPU_METHOD 0 0 0 255 ECU_ADDRESS 0x4000BF52 SYMBOL_LINK "xAdiaEeDataB" 377 /end MEASUREMENT
/begin MEASUREMENT SPPC1_EE.usrInstFaultCnt "Instantaneous fault counter" UBYTE NO_COMPU_METHOD 0 0 0 255 ECU_ADDRESS 0x4000BF53 SYMBOL_LINK "xAdiaEeDataB" 378 /end MEASUREMENT
/begin MEASUREMENT SPPC1_EE.usrWucCnt "Machine B Warm-up cycles counter" UBYTE NO_COMPU_METHOD 0 0 0 255 ECU_ADDRESS 0x4000BF54 SYMBOL_LINK "xAdiaEeDataB" 379 /end MEASUREMENT
/begin MEASUREMENT SPPCH_EE.eCodErr "Machine B fault type" UBYTE eCodErr.Conversion 0 0 0 255 ECU_ADDRESS 0x4000BF56 SYMBOL_LINK "xAdiaEeDataB" 381 /end MEASUREMENT
/begin MEASUREMENT SPPCH_EE.eErrSt "Machine B error state" UBYTE eErrSt.Conversion 0 0 0 255 ECU_ADDRESS 0x4000BF55 SYMBOL_LINK "xAdiaEeDataB" 380 /end MEASUREMENT
/begin MEASUREMENT SPPCH_EE.usrEventCnt "Machine B Warm-up cycles counter" UBYTE NO_COMPU_METHOD 0 0 0 255 ECU_ADDRESS 0x4000BF57 SYMBOL_LINK "xAdiaEeDataB" 382 /end MEASUREMENT
/begin MEASUREMENT SPPCH_EE.usrInstFaultCnt "Instantaneous fault counter" UBYTE NO_COMPU_METHOD 0 0 0 255 ECU_ADDRESS 0x4000BF58 SYMBOL_LINK "xAdiaEeDataB" 383 /end MEASUREMENT
/begin MEASUREMENT SPPCH_EE.usrWucCnt "Machine B Warm-up cycles counter" UBYTE NO_COMPU_METHOD 0 0 0 255 ECU_ADDRESS 0x4000BF59 SYMBOL_LINK "xAdiaEeDataB" 384 /end MEASUREMENT
/begin MEASUREMENT BRKCH_EE.eCodErr "Machine B fault type" UBYTE eCodErr.Conversion 0 0 0 255 ECU_ADDRESS 0x4000BF5B SYMBOL_LINK "xAdiaEeDataB" 386 /end MEASUREMENT
/begin MEASUREMENT BRKCH_EE.eErrSt "Machine B error state" UBYTE eErrSt.Conversion 0 0 0 255 ECU_ADDRESS 0x4000BF5A SYMBOL_LINK "xAdiaEeDataB" 385 /end MEASUREMENT
/begin MEASUREMENT BRKCH_EE.usrEventCnt "Machine B Warm-up cycles counter" UBYTE NO_COMPU_METHOD 0 0 0 255 ECU_ADDRESS 0x4000BF5C SYMBOL_LINK "xAdiaEeDataB" 387 /end MEASUREMENT
/begin MEASUREMENT BRKCH_EE.usrInstFaultCnt "Instantaneous fault counter" UBYTE NO_COMPU_METHOD 0 0 0 255 ECU_ADDRESS 0x4000BF5D SYMBOL_LINK "xAdiaEeDataB" 388 /end MEASUREMENT
/begin MEASUREMENT BRKCH_EE.usrWucCnt "Machine B Warm-up cycles counter" UBYTE NO_COMPU_METHOD 0 0 0 255 ECU_ADDRESS 0x4000BF5E SYMBOL_LINK "xAdiaEeDataB" 389 /end MEASUREMENT
/begin MEASUREMENT SUO_EE.eCodErr "Machine B fault type" UBYTE eCodErr.Conversion 0 0 0 255 ECU_ADDRESS 0x4000BF60 SYMBOL_LINK "xAdiaEeDataB" 391 /end MEASUREMENT
/begin MEASUREMENT SUO_EE.eErrSt "Machine B error state" UBYTE eErrSt.Conversion 0 0 0 255 ECU_ADDRESS 0x4000BF5F SYMBOL_LINK "xAdiaEeDataB" 390 /end MEASUREMENT
/begin MEASUREMENT SUO_EE.usrEventCnt "Machine B Warm-up cycles counter" UBYTE NO_COMPU_METHOD 0 0 0 255 ECU_ADDRESS 0x4000BF61 SYMBOL_LINK "xAdiaEeDataB" 392 /end MEASUREMENT
/begin MEASUREMENT SUO_EE.usrInstFaultCnt "Instantaneous fault counter" UBYTE NO_COMPU_METHOD 0 0 0 255 ECU_ADDRESS 0x4000BF62 SYMBOL_LINK "xAdiaEeDataB" 393 /end MEASUREMENT
/begin MEASUREMENT SUO_EE.usrWucCnt "Machine B Warm-up cycles counter" UBYTE NO_COMPU_METHOD 0 0 0 255 ECU_ADDRESS 0x4000BF63 SYMBOL_LINK "xAdiaEeDataB" 394 /end MEASUREMENT
/begin MEASUREMENT UDP_EE.eCodErr "Machine B fault type" UBYTE eCodErr.Conversion 0 0 0 255 ECU_ADDRESS 0x4000BF65 SYMBOL_LINK "xAdiaEeDataB" 396 /end MEASUREMENT
/begin MEASUREMENT UDP_EE.eErrSt "Machine B error state" UBYTE eErrSt.Conversion 0 0 0 255 ECU_ADDRESS 0x4000BF64 SYMBOL_LINK "xAdiaEeDataB" 395 /end MEASUREMENT
/begin MEASUREMENT UDP_EE.usrEventCnt "Machine B Warm-up cycles counter" UBYTE NO_COMPU_METHOD 0 0 0 255 ECU_ADDRESS 0x4000BF66 SYMBOL_LINK "xAdiaEeDataB" 397 /end MEASUREMENT
/begin MEASUREMENT UDP_EE.usrInstFaultCnt "Instantaneous fault counter" UBYTE NO_COMPU_METHOD 0 0 0 255 ECU_ADDRESS 0x4000BF67 SYMBOL_LINK "xAdiaEeDataB" 398 /end MEASUREMENT
/begin MEASUREMENT UDP_EE.usrWucCnt "Machine B Warm-up cycles counter" UBYTE NO_COMPU_METHOD 0 0 0 255 ECU_ADDRESS 0x4000BF68 SYMBOL_LINK "xAdiaEeDataB" 399 /end MEASUREMENT
/begin MEASUREMENT SPM_EE.eCodErr "Machine B fault type" UBYTE eCodErr.Conversion 0 0 0 255 ECU_ADDRESS 0x4000BDFD SYMBOL_LINK "xAdiaEeDataB" 36 /end MEASUREMENT
/begin MEASUREMENT SPM_EE.eErrSt "Machine B error state" UBYTE eErrSt.Conversion 0 0 0 255 ECU_ADDRESS 0x4000BDFC SYMBOL_LINK "xAdiaEeDataB" 35 /end MEASUREMENT
/begin MEASUREMENT SPM_EE.usrEventCnt "Machine B Warm-up cycles counter" UBYTE NO_COMPU_METHOD 0 0 0 255 ECU_ADDRESS 0x4000BDFE SYMBOL_LINK "xAdiaEeDataB" 37 /end MEASUREMENT
/begin MEASUREMENT SPM_EE.usrInstFaultCnt "Instantaneous fault counter" UBYTE NO_COMPU_METHOD 0 0 0 255 ECU_ADDRESS 0x4000BDFF SYMBOL_LINK "xAdiaEeDataB" 38 /end MEASUREMENT
/begin MEASUREMENT SPM_EE.usrWucCnt "Machine B Warm-up cycles counter" UBYTE NO_COMPU_METHOD 0 0 0 255 ECU_ADDRESS 0x4000BE00 SYMBOL_LINK "xAdiaEeDataB" 39 /end MEASUREMENT
/begin MEASUREMENT UHR_EE.eCodErr "Machine B fault type" UBYTE eCodErr.Conversion 0 0 0 255 ECU_ADDRESS 0x4000BF6A SYMBOL_LINK "xAdiaEeDataB" 401 /end MEASUREMENT
/begin MEASUREMENT UHR_EE.eErrSt "Machine B error state" UBYTE eErrSt.Conversion 0 0 0 255 ECU_ADDRESS 0x4000BF69 SYMBOL_LINK "xAdiaEeDataB" 400 /end MEASUREMENT
/begin MEASUREMENT UHR_EE.usrEventCnt "Machine B Warm-up cycles counter" UBYTE NO_COMPU_METHOD 0 0 0 255 ECU_ADDRESS 0x4000BF6B SYMBOL_LINK "xAdiaEeDataB" 402 /end MEASUREMENT
/begin MEASUREMENT UHR_EE.usrInstFaultCnt "Instantaneous fault counter" UBYTE NO_COMPU_METHOD 0 0 0 255 ECU_ADDRESS 0x4000BF6C SYMBOL_LINK "xAdiaEeDataB" 403 /end MEASUREMENT
/begin MEASUREMENT UHR_EE.usrWucCnt "Machine B Warm-up cycles counter" UBYTE NO_COMPU_METHOD 0 0 0 255 ECU_ADDRESS 0x4000BF6D SYMBOL_LINK "xAdiaEeDataB" 404 /end MEASUREMENT
/begin MEASUREMENT SK1_EE.eCodErr "Machine B fault type" UBYTE eCodErr.Conversion 0 0 0 255 ECU_ADDRESS 0x4000BF6F SYMBOL_LINK "xAdiaEeDataB" 406 /end MEASUREMENT
/begin MEASUREMENT SK1_EE.eErrSt "Machine B error state" UBYTE eErrSt.Conversion 0 0 0 255 ECU_ADDRESS 0x4000BF6E SYMBOL_LINK "xAdiaEeDataB" 405 /end MEASUREMENT
/begin MEASUREMENT SK1_EE.usrEventCnt "Machine B Warm-up cycles counter" UBYTE NO_COMPU_METHOD 0 0 0 255 ECU_ADDRESS 0x4000BF70 SYMBOL_LINK "xAdiaEeDataB" 407 /end MEASUREMENT
/begin MEASUREMENT SK1_EE.usrInstFaultCnt "Instantaneous fault counter" UBYTE NO_COMPU_METHOD 0 0 0 255 ECU_ADDRESS 0x4000BF71 SYMBOL_LINK "xAdiaEeDataB" 408 /end MEASUREMENT
/begin MEASUREMENT SK1_EE.usrWucCnt "Machine B Warm-up cycles counter" UBYTE NO_COMPU_METHOD 0 0 0 255 ECU_ADDRESS 0x4000BF72 SYMBOL_LINK "xAdiaEeDataB" 409 /end MEASUREMENT
/begin MEASUREMENT SK2_EE.eCodErr "Machine B fault type" UBYTE eCodErr.Conversion 0 0 0 255 ECU_ADDRESS 0x4000BF74 SYMBOL_LINK "xAdiaEeDataB" 411 /end MEASUREMENT
/begin MEASUREMENT SK2_EE.eErrSt "Machine B error state" UBYTE eErrSt.Conversion 0 0 0 255 ECU_ADDRESS 0x4000BF73 SYMBOL_LINK "xAdiaEeDataB" 410 /end MEASUREMENT
/begin MEASUREMENT SK2_EE.usrEventCnt "Machine B Warm-up cycles counter" UBYTE NO_COMPU_METHOD 0 0 0 255 ECU_ADDRESS 0x4000BF75 SYMBOL_LINK "xAdiaEeDataB" 412 /end MEASUREMENT
/begin MEASUREMENT SK2_EE.usrInstFaultCnt "Instantaneous fault counter" UBYTE NO_COMPU_METHOD 0 0 0 255 ECU_ADDRESS 0x4000BF76 SYMBOL_LINK "xAdiaEeDataB" 413 /end MEASUREMENT
/begin MEASUREMENT SK2_EE.usrWucCnt "Machine B Warm-up cycles counter" UBYTE NO_COMPU_METHOD 0 0 0 255 ECU_ADDRESS 0x4000BF77 SYMBOL_LINK "xAdiaEeDataB" 414 /end MEASUREMENT
/begin MEASUREMENT SK3_EE.eCodErr "Machine B fault type" UBYTE eCodErr.Conversion 0 0 0 255 ECU_ADDRESS 0x4000BF79 SYMBOL_LINK "xAdiaEeDataB" 416 /end MEASUREMENT
/begin MEASUREMENT SK3_EE.eErrSt "Machine B error state" UBYTE eErrSt.Conversion 0 0 0 255 ECU_ADDRESS 0x4000BF78 SYMBOL_LINK "xAdiaEeDataB" 415 /end MEASUREMENT
/begin MEASUREMENT SK3_EE.usrEventCnt "Machine B Warm-up cycles counter" UBYTE NO_COMPU_METHOD 0 0 0 255 ECU_ADDRESS 0x4000BF7A SYMBOL_LINK "xAdiaEeDataB" 417 /end MEASUREMENT
/begin MEASUREMENT SK3_EE.usrInstFaultCnt "Instantaneous fault counter" UBYTE NO_COMPU_METHOD 0 0 0 255 ECU_ADDRESS 0x4000BF7B SYMBOL_LINK "xAdiaEeDataB" 418 /end MEASUREMENT
/begin MEASUREMENT SK3_EE.usrWucCnt "Machine B Warm-up cycles counter" UBYTE NO_COMPU_METHOD 0 0 0 255 ECU_ADDRESS 0x4000BF7C SYMBOL_LINK "xAdiaEeDataB" 419 /end MEASUREMENT
/begin MEASUREMENT SK4_EE.eCodErr "Machine B fault type" UBYTE eCodErr.Conversion 0 0 0 255 ECU_ADDRESS 0x4000BF7E SYMBOL_LINK "xAdiaEeDataB" 421 /end MEASUREMENT
/begin MEASUREMENT SK4_EE.eErrSt "Machine B error state" UBYTE eErrSt.Conversion 0 0 0 255 ECU_ADDRESS 0x4000BF7D SYMBOL_LINK "xAdiaEeDataB" 420 /end MEASUREMENT
/begin MEASUREMENT SK4_EE.usrEventCnt "Machine B Warm-up cycles counter" UBYTE NO_COMPU_METHOD 0 0 0 255 ECU_ADDRESS 0x4000BF7F SYMBOL_LINK "xAdiaEeDataB" 422 /end MEASUREMENT
/begin MEASUREMENT SK4_EE.usrInstFaultCnt "Instantaneous fault counter" UBYTE NO_COMPU_METHOD 0 0 0 255 ECU_ADDRESS 0x4000BF80 SYMBOL_LINK "xAdiaEeDataB" 423 /end MEASUREMENT
/begin MEASUREMENT SK4_EE.usrWucCnt "Machine B Warm-up cycles counter" UBYTE NO_COMPU_METHOD 0 0 0 255 ECU_ADDRESS 0x4000BF81 SYMBOL_LINK "xAdiaEeDataB" 424 /end MEASUREMENT
/begin MEASUREMENT SK5_EE.eCodErr "Machine B fault type" UBYTE eCodErr.Conversion 0 0 0 255 ECU_ADDRESS 0x4000BF83 SYMBOL_LINK "xAdiaEeDataB" 426 /end MEASUREMENT
/begin MEASUREMENT SK5_EE.eErrSt "Machine B error state" UBYTE eErrSt.Conversion 0 0 0 255 ECU_ADDRESS 0x4000BF82 SYMBOL_LINK "xAdiaEeDataB" 425 /end MEASUREMENT
/begin MEASUREMENT SK5_EE.usrEventCnt "Machine B Warm-up cycles counter" UBYTE NO_COMPU_METHOD 0 0 0 255 ECU_ADDRESS 0x4000BF84 SYMBOL_LINK "xAdiaEeDataB" 427 /end MEASUREMENT
/begin MEASUREMENT SK5_EE.usrInstFaultCnt "Instantaneous fault counter" UBYTE NO_COMPU_METHOD 0 0 0 255 ECU_ADDRESS 0x4000BF85 SYMBOL_LINK "xAdiaEeDataB" 428 /end MEASUREMENT
/begin MEASUREMENT SK5_EE.usrWucCnt "Machine B Warm-up cycles counter" UBYTE NO_COMPU_METHOD 0 0 0 255 ECU_ADDRESS 0x4000BF86 SYMBOL_LINK "xAdiaEeDataB" 429 /end MEASUREMENT
/begin MEASUREMENT SK6_EE.eCodErr "Machine B fault type" UBYTE eCodErr.Conversion 0 0 0 255 ECU_ADDRESS 0x4000BF88 SYMBOL_LINK "xAdiaEeDataB" 431 /end MEASUREMENT
/begin MEASUREMENT SK6_EE.eErrSt "Machine B error state" UBYTE eErrSt.Conversion 0 0 0 255 ECU_ADDRESS 0x4000BF87 SYMBOL_LINK "xAdiaEeDataB" 430 /end MEASUREMENT
/begin MEASUREMENT SK6_EE.usrEventCnt "Machine B Warm-up cycles counter" UBYTE NO_COMPU_METHOD 0 0 0 255 ECU_ADDRESS 0x4000BF89 SYMBOL_LINK "xAdiaEeDataB" 432 /end MEASUREMENT
/begin MEASUREMENT SK6_EE.usrInstFaultCnt "Instantaneous fault counter" UBYTE NO_COMPU_METHOD 0 0 0 255 ECU_ADDRESS 0x4000BF8A SYMBOL_LINK "xAdiaEeDataB" 433 /end MEASUREMENT
/begin MEASUREMENT SK6_EE.usrWucCnt "Machine B Warm-up cycles counter" UBYTE NO_COMPU_METHOD 0 0 0 255 ECU_ADDRESS 0x4000BF8B SYMBOL_LINK "xAdiaEeDataB" 434 /end MEASUREMENT
/begin MEASUREMENT SK7_EE.eCodErr "Machine B fault type" UBYTE eCodErr.Conversion 0 0 0 255 ECU_ADDRESS 0x4000BF8D SYMBOL_LINK "xAdiaEeDataB" 436 /end MEASUREMENT
/begin MEASUREMENT SK7_EE.eErrSt "Machine B error state" UBYTE eErrSt.Conversion 0 0 0 255 ECU_ADDRESS 0x4000BF8C SYMBOL_LINK "xAdiaEeDataB" 435 /end MEASUREMENT
/begin MEASUREMENT SK7_EE.usrEventCnt "Machine B Warm-up cycles counter" UBYTE NO_COMPU_METHOD 0 0 0 255 ECU_ADDRESS 0x4000BF8E SYMBOL_LINK "xAdiaEeDataB" 437 /end MEASUREMENT
/begin MEASUREMENT SK7_EE.usrInstFaultCnt "Instantaneous fault counter" UBYTE NO_COMPU_METHOD 0 0 0 255 ECU_ADDRESS 0x4000BF8F SYMBOL_LINK "xAdiaEeDataB" 438 /end MEASUREMENT
/begin MEASUREMENT SK7_EE.usrWucCnt "Machine B Warm-up cycles counter" UBYTE NO_COMPU_METHOD 0 0 0 255 ECU_ADDRESS 0x4000BF90 SYMBOL_LINK "xAdiaEeDataB" 439 /end MEASUREMENT
/begin MEASUREMENT SK8_EE.eCodErr "Machine B fault type" UBYTE eCodErr.Conversion 0 0 0 255 ECU_ADDRESS 0x4000BF92 SYMBOL_LINK "xAdiaEeDataB" 441 /end MEASUREMENT
/begin MEASUREMENT SK8_EE.eErrSt "Machine B error state" UBYTE eErrSt.Conversion 0 0 0 255 ECU_ADDRESS 0x4000BF91 SYMBOL_LINK "xAdiaEeDataB" 440 /end MEASUREMENT
/begin MEASUREMENT SK8_EE.usrEventCnt "Machine B Warm-up cycles counter" UBYTE NO_COMPU_METHOD 0 0 0 255 ECU_ADDRESS 0x4000BF93 SYMBOL_LINK "xAdiaEeDataB" 442 /end MEASUREMENT
/begin MEASUREMENT SK8_EE.usrInstFaultCnt "Instantaneous fault counter" UBYTE NO_COMPU_METHOD 0 0 0 255 ECU_ADDRESS 0x4000BF94 SYMBOL_LINK "xAdiaEeDataB" 443 /end MEASUREMENT
/begin MEASUREMENT SK8_EE.usrWucCnt "Machine B Warm-up cycles counter" UBYTE NO_COMPU_METHOD 0 0 0 255 ECU_ADDRESS 0x4000BF95 SYMBOL_LINK "xAdiaEeDataB" 444 /end MEASUREMENT
/begin MEASUREMENT WRNL_EE.eCodErr "Machine B fault type" UBYTE eCodErr.Conversion 0 0 0 255 ECU_ADDRESS 0x4000BF97 SYMBOL_LINK "xAdiaEeDataB" 446 /end MEASUREMENT
/begin MEASUREMENT WRNL_EE.eErrSt "Machine B error state" UBYTE eErrSt.Conversion 0 0 0 255 ECU_ADDRESS 0x4000BF96 SYMBOL_LINK "xAdiaEeDataB" 445 /end MEASUREMENT
/begin MEASUREMENT WRNL_EE.usrEventCnt "Machine B Warm-up cycles counter" UBYTE NO_COMPU_METHOD 0 0 0 255 ECU_ADDRESS 0x4000BF98 SYMBOL_LINK "xAdiaEeDataB" 447 /end MEASUREMENT
/begin MEASUREMENT WRNL_EE.usrInstFaultCnt "Instantaneous fault counter" UBYTE NO_COMPU_METHOD 0 0 0 255 ECU_ADDRESS 0x4000BF99 SYMBOL_LINK "xAdiaEeDataB" 448 /end MEASUREMENT
/begin MEASUREMENT WRNL_EE.usrWucCnt "Machine B Warm-up cycles counter" UBYTE NO_COMPU_METHOD 0 0 0 255 ECU_ADDRESS 0x4000BF9A SYMBOL_LINK "xAdiaEeDataB" 449 /end MEASUREMENT
/begin MEASUREMENT SPB_EE.eCodErr "Machine B fault type" UBYTE eCodErr.Conversion 0 0 0 255 ECU_ADDRESS 0x4000BE02 SYMBOL_LINK "xAdiaEeDataB" 41 /end MEASUREMENT
/begin MEASUREMENT SPB_EE.eErrSt "Machine B error state" UBYTE eErrSt.Conversion 0 0 0 255 ECU_ADDRESS 0x4000BE01 SYMBOL_LINK "xAdiaEeDataB" 40 /end MEASUREMENT
/begin MEASUREMENT SPB_EE.usrEventCnt "Machine B Warm-up cycles counter" UBYTE NO_COMPU_METHOD 0 0 0 255 ECU_ADDRESS 0x4000BE03 SYMBOL_LINK "xAdiaEeDataB" 42 /end MEASUREMENT
/begin MEASUREMENT SPB_EE.usrInstFaultCnt "Instantaneous fault counter" UBYTE NO_COMPU_METHOD 0 0 0 255 ECU_ADDRESS 0x4000BE04 SYMBOL_LINK "xAdiaEeDataB" 43 /end MEASUREMENT
/begin MEASUREMENT SPB_EE.usrWucCnt "Machine B Warm-up cycles counter" UBYTE NO_COMPU_METHOD 0 0 0 255 ECU_ADDRESS 0x4000BE05 SYMBOL_LINK "xAdiaEeDataB" 44 /end MEASUREMENT
/begin MEASUREMENT REDL_EE.eCodErr "Machine B fault type" UBYTE eCodErr.Conversion 0 0 0 255 ECU_ADDRESS 0x4000BF9C SYMBOL_LINK "xAdiaEeDataB" 451 /end MEASUREMENT
/begin MEASUREMENT REDL_EE.eErrSt "Machine B error state" UBYTE eErrSt.Conversion 0 0 0 255 ECU_ADDRESS 0x4000BF9B SYMBOL_LINK "xAdiaEeDataB" 450 /end MEASUREMENT
/begin MEASUREMENT REDL_EE.usrEventCnt "Machine B Warm-up cycles counter" UBYTE NO_COMPU_METHOD 0 0 0 255 ECU_ADDRESS 0x4000BF9D SYMBOL_LINK "xAdiaEeDataB" 452 /end MEASUREMENT
/begin MEASUREMENT REDL_EE.usrInstFaultCnt "Instantaneous fault counter" UBYTE NO_COMPU_METHOD 0 0 0 255 ECU_ADDRESS 0x4000BF9E SYMBOL_LINK "xAdiaEeDataB" 453 /end MEASUREMENT
/begin MEASUREMENT REDL_EE.usrWucCnt "Machine B Warm-up cycles counter" UBYTE NO_COMPU_METHOD 0 0 0 255 ECU_ADDRESS 0x4000BF9F SYMBOL_LINK "xAdiaEeDataB" 454 /end MEASUREMENT
/begin MEASUREMENT MIL_EE.eCodErr "Machine B fault type" UBYTE eCodErr.Conversion 0 0 0 255 ECU_ADDRESS 0x4000BFA1 SYMBOL_LINK "xAdiaEeDataB" 456 /end MEASUREMENT
/begin MEASUREMENT MIL_EE.eErrSt "Machine B error state" UBYTE eErrSt.Conversion 0 0 0 255 ECU_ADDRESS 0x4000BFA0 SYMBOL_LINK "xAdiaEeDataB" 455 /end MEASUREMENT
/begin MEASUREMENT MIL_EE.usrEventCnt "Machine B Warm-up cycles counter" UBYTE NO_COMPU_METHOD 0 0 0 255 ECU_ADDRESS 0x4000BFA2 SYMBOL_LINK "xAdiaEeDataB" 457 /end MEASUREMENT
/begin MEASUREMENT MIL_EE.usrInstFaultCnt "Instantaneous fault counter" UBYTE NO_COMPU_METHOD 0 0 0 255 ECU_ADDRESS 0x4000BFA3 SYMBOL_LINK "xAdiaEeDataB" 458 /end MEASUREMENT
/begin MEASUREMENT MIL_EE.usrWucCnt "Machine B Warm-up cycles counter" UBYTE NO_COMPU_METHOD 0 0 0 255 ECU_ADDRESS 0x4000BFA4 SYMBOL_LINK "xAdiaEeDataB" 459 /end MEASUREMENT
/begin MEASUREMENT STE_EE.eCodErr "Machine B fault type" UBYTE eCodErr.Conversion 0 0 0 255 ECU_ADDRESS 0x4000BFA6 SYMBOL_LINK "xAdiaEeDataB" 461 /end MEASUREMENT
/begin MEASUREMENT STE_EE.eErrSt "Machine B error state" UBYTE eErrSt.Conversion 0 0 0 255 ECU_ADDRESS 0x4000BFA5 SYMBOL_LINK "xAdiaEeDataB" 460 /end MEASUREMENT
/begin MEASUREMENT STE_EE.usrEventCnt "Machine B Warm-up cycles counter" UBYTE NO_COMPU_METHOD 0 0 0 255 ECU_ADDRESS 0x4000BFA7 SYMBOL_LINK "xAdiaEeDataB" 462 /end MEASUREMENT
/begin MEASUREMENT STE_EE.usrInstFaultCnt "Instantaneous fault counter" UBYTE NO_COMPU_METHOD 0 0 0 255 ECU_ADDRESS 0x4000BFA8 SYMBOL_LINK "xAdiaEeDataB" 463 /end MEASUREMENT
/begin MEASUREMENT STE_EE.usrWucCnt "Machine B Warm-up cycles counter" UBYTE NO_COMPU_METHOD 0 0 0 255 ECU_ADDRESS 0x4000BFA9 SYMBOL_LINK "xAdiaEeDataB" 464 /end MEASUREMENT
/begin MEASUREMENT TE2H_EE.eCodErr "Machine B fault type" UBYTE eCodErr.Conversion 0 0 0 255 ECU_ADDRESS 0x4000BFAB SYMBOL_LINK "xAdiaEeDataB" 466 /end MEASUREMENT
/begin MEASUREMENT TE2H_EE.eErrSt "Machine B error state" UBYTE eErrSt.Conversion 0 0 0 255 ECU_ADDRESS 0x4000BFAA SYMBOL_LINK "xAdiaEeDataB" 465 /end MEASUREMENT
/begin MEASUREMENT TE2H_EE.usrEventCnt "Machine B Warm-up cycles counter" UBYTE NO_COMPU_METHOD 0 0 0 255 ECU_ADDRESS 0x4000BFAC SYMBOL_LINK "xAdiaEeDataB" 467 /end MEASUREMENT
/begin MEASUREMENT TE2H_EE.usrInstFaultCnt "Instantaneous fault counter" UBYTE NO_COMPU_METHOD 0 0 0 255 ECU_ADDRESS 0x4000BFAD SYMBOL_LINK "xAdiaEeDataB" 468 /end MEASUREMENT
/begin MEASUREMENT TE2H_EE.usrWucCnt "Machine B Warm-up cycles counter" UBYTE NO_COMPU_METHOD 0 0 0 255 ECU_ADDRESS 0x4000BFAE SYMBOL_LINK "xAdiaEeDataB" 469 /end MEASUREMENT
/begin MEASUREMENT STX_EE.eCodErr "Machine B fault type" UBYTE eCodErr.Conversion 0 0 0 255 ECU_ADDRESS 0x4000BFB0 SYMBOL_LINK "xAdiaEeDataB" 471 /end MEASUREMENT
/begin MEASUREMENT STX_EE.eErrSt "Machine B error state" UBYTE eErrSt.Conversion 0 0 0 255 ECU_ADDRESS 0x4000BFAF SYMBOL_LINK "xAdiaEeDataB" 470 /end MEASUREMENT
/begin MEASUREMENT STX_EE.usrEventCnt "Machine B Warm-up cycles counter" UBYTE NO_COMPU_METHOD 0 0 0 255 ECU_ADDRESS 0x4000BFB1 SYMBOL_LINK "xAdiaEeDataB" 472 /end MEASUREMENT
/begin MEASUREMENT STX_EE.usrInstFaultCnt "Instantaneous fault counter" UBYTE NO_COMPU_METHOD 0 0 0 255 ECU_ADDRESS 0x4000BFB2 SYMBOL_LINK "xAdiaEeDataB" 473 /end MEASUREMENT
/begin MEASUREMENT STX_EE.usrWucCnt "Machine B Warm-up cycles counter" UBYTE NO_COMPU_METHOD 0 0 0 255 ECU_ADDRESS 0x4000BFB3 SYMBOL_LINK "xAdiaEeDataB" 474 /end MEASUREMENT
/begin MEASUREMENT MD1_EE.eCodErr "Machine B fault type" UBYTE eCodErr.Conversion 0 0 0 255 ECU_ADDRESS 0x4000BFB5 SYMBOL_LINK "xAdiaEeDataB" 476 /end MEASUREMENT
/begin MEASUREMENT MD1_EE.eErrSt "Machine B error state" UBYTE eErrSt.Conversion 0 0 0 255 ECU_ADDRESS 0x4000BFB4 SYMBOL_LINK "xAdiaEeDataB" 475 /end MEASUREMENT
/begin MEASUREMENT MD1_EE.usrEventCnt "Machine B Warm-up cycles counter" UBYTE NO_COMPU_METHOD 0 0 0 255 ECU_ADDRESS 0x4000BFB6 SYMBOL_LINK "xAdiaEeDataB" 477 /end MEASUREMENT
/begin MEASUREMENT MD1_EE.usrInstFaultCnt "Instantaneous fault counter" UBYTE NO_COMPU_METHOD 0 0 0 255 ECU_ADDRESS 0x4000BFB7 SYMBOL_LINK "xAdiaEeDataB" 478 /end MEASUREMENT
/begin MEASUREMENT MD1_EE.usrWucCnt "Machine B Warm-up cycles counter" UBYTE NO_COMPU_METHOD 0 0 0 255 ECU_ADDRESS 0x4000BFB8 SYMBOL_LINK "xAdiaEeDataB" 479 /end MEASUREMENT
/begin MEASUREMENT MD2_EE.eCodErr "Machine B fault type" UBYTE eCodErr.Conversion 0 0 0 255 ECU_ADDRESS 0x4000BFBA SYMBOL_LINK "xAdiaEeDataB" 481 /end MEASUREMENT
/begin MEASUREMENT MD2_EE.eErrSt "Machine B error state" UBYTE eErrSt.Conversion 0 0 0 255 ECU_ADDRESS 0x4000BFB9 SYMBOL_LINK "xAdiaEeDataB" 480 /end MEASUREMENT
/begin MEASUREMENT MD2_EE.usrEventCnt "Machine B Warm-up cycles counter" UBYTE NO_COMPU_METHOD 0 0 0 255 ECU_ADDRESS 0x4000BFBB SYMBOL_LINK "xAdiaEeDataB" 482 /end MEASUREMENT
/begin MEASUREMENT MD2_EE.usrInstFaultCnt "Instantaneous fault counter" UBYTE NO_COMPU_METHOD 0 0 0 255 ECU_ADDRESS 0x4000BFBC SYMBOL_LINK "xAdiaEeDataB" 483 /end MEASUREMENT
/begin MEASUREMENT MD2_EE.usrWucCnt "Machine B Warm-up cycles counter" UBYTE NO_COMPU_METHOD 0 0 0 255 ECU_ADDRESS 0x4000BFBD SYMBOL_LINK "xAdiaEeDataB" 484 /end MEASUREMENT
/begin MEASUREMENT MD3_EE.eCodErr "Machine B fault type" UBYTE eCodErr.Conversion 0 0 0 255 ECU_ADDRESS 0x4000BFBF SYMBOL_LINK "xAdiaEeDataB" 486 /end MEASUREMENT
/begin MEASUREMENT MD3_EE.eErrSt "Machine B error state" UBYTE eErrSt.Conversion 0 0 0 255 ECU_ADDRESS 0x4000BFBE SYMBOL_LINK "xAdiaEeDataB" 485 /end MEASUREMENT
/begin MEASUREMENT MD3_EE.usrEventCnt "Machine B Warm-up cycles counter" UBYTE NO_COMPU_METHOD 0 0 0 255 ECU_ADDRESS 0x4000BFC0 SYMBOL_LINK "xAdiaEeDataB" 487 /end MEASUREMENT
/begin MEASUREMENT MD3_EE.usrInstFaultCnt "Instantaneous fault counter" UBYTE NO_COMPU_METHOD 0 0 0 255 ECU_ADDRESS 0x4000BFC1 SYMBOL_LINK "xAdiaEeDataB" 488 /end MEASUREMENT
/begin MEASUREMENT MD3_EE.usrWucCnt "Machine B Warm-up cycles counter" UBYTE NO_COMPU_METHOD 0 0 0 255 ECU_ADDRESS 0x4000BFC2 SYMBOL_LINK "xAdiaEeDataB" 489 /end MEASUREMENT
/begin MEASUREMENT MD4_EE.eCodErr "Machine B fault type" UBYTE eCodErr.Conversion 0 0 0 255 ECU_ADDRESS 0x4000BFC4 SYMBOL_LINK "xAdiaEeDataB" 491 /end MEASUREMENT
/begin MEASUREMENT MD4_EE.eErrSt "Machine B error state" UBYTE eErrSt.Conversion 0 0 0 255 ECU_ADDRESS 0x4000BFC3 SYMBOL_LINK "xAdiaEeDataB" 490 /end MEASUREMENT
/begin MEASUREMENT MD4_EE.usrEventCnt "Machine B Warm-up cycles counter" UBYTE NO_COMPU_METHOD 0 0 0 255 ECU_ADDRESS 0x4000BFC5 SYMBOL_LINK "xAdiaEeDataB" 492 /end MEASUREMENT
/begin MEASUREMENT MD4_EE.usrInstFaultCnt "Instantaneous fault counter" UBYTE NO_COMPU_METHOD 0 0 0 255 ECU_ADDRESS 0x4000BFC6 SYMBOL_LINK "xAdiaEeDataB" 493 /end MEASUREMENT
/begin MEASUREMENT MD4_EE.usrWucCnt "Machine B Warm-up cycles counter" UBYTE NO_COMPU_METHOD 0 0 0 255 ECU_ADDRESS 0x4000BFC7 SYMBOL_LINK "xAdiaEeDataB" 494 /end MEASUREMENT
/begin MEASUREMENT MD5_EE.eCodErr "Machine B fault type" UBYTE eCodErr.Conversion 0 0 0 255 ECU_ADDRESS 0x4000BFC9 SYMBOL_LINK "xAdiaEeDataB" 496 /end MEASUREMENT
/begin MEASUREMENT MD5_EE.eErrSt "Machine B error state" UBYTE eErrSt.Conversion 0 0 0 255 ECU_ADDRESS 0x4000BFC8 SYMBOL_LINK "xAdiaEeDataB" 495 /end MEASUREMENT
/begin MEASUREMENT MD5_EE.usrEventCnt "Machine B Warm-up cycles counter" UBYTE NO_COMPU_METHOD 0 0 0 255 ECU_ADDRESS 0x4000BFCA SYMBOL_LINK "xAdiaEeDataB" 497 /end MEASUREMENT
/begin MEASUREMENT MD5_EE.usrInstFaultCnt "Instantaneous fault counter" UBYTE NO_COMPU_METHOD 0 0 0 255 ECU_ADDRESS 0x4000BFCB SYMBOL_LINK "xAdiaEeDataB" 498 /end MEASUREMENT
/begin MEASUREMENT MD5_EE.usrWucCnt "Machine B Warm-up cycles counter" UBYTE NO_COMPU_METHOD 0 0 0 255 ECU_ADDRESS 0x4000BFCC SYMBOL_LINK "xAdiaEeDataB" 499 /end MEASUREMENT
/begin MEASUREMENT SPS_EE.eCodErr "Machine B fault type" UBYTE eCodErr.Conversion 0 0 0 255 ECU_ADDRESS 0x4000BE07 SYMBOL_LINK "xAdiaEeDataB" 46 /end MEASUREMENT
/begin MEASUREMENT SPS_EE.eErrSt "Machine B error state" UBYTE eErrSt.Conversion 0 0 0 255 ECU_ADDRESS 0x4000BE06 SYMBOL_LINK "xAdiaEeDataB" 45 /end MEASUREMENT
/begin MEASUREMENT SPS_EE.usrEventCnt "Machine B Warm-up cycles counter" UBYTE NO_COMPU_METHOD 0 0 0 255 ECU_ADDRESS 0x4000BE08 SYMBOL_LINK "xAdiaEeDataB" 47 /end MEASUREMENT
/begin MEASUREMENT SPS_EE.usrInstFaultCnt "Instantaneous fault counter" UBYTE NO_COMPU_METHOD 0 0 0 255 ECU_ADDRESS 0x4000BE09 SYMBOL_LINK "xAdiaEeDataB" 48 /end MEASUREMENT
/begin MEASUREMENT SPS_EE.usrWucCnt "Machine B Warm-up cycles counter" UBYTE NO_COMPU_METHOD 0 0 0 255 ECU_ADDRESS 0x4000BE0A SYMBOL_LINK "xAdiaEeDataB" 49 /end MEASUREMENT
/begin MEASUREMENT STC3_EE.eCodErr "Machine C error state" UBYTE eCodErr.Conversion 0 0 0 255 ECU_ADDRESS 0x4000C025 SYMBOL_LINK "xAdiaEeDataC" 1 /end MEASUREMENT
/begin MEASUREMENT STC3_EE.eErrSt "Machine C error state" UBYTE eErrSt.Conversion 0 0 0 255 ECU_ADDRESS 0x4000C024 SYMBOL_LINK "xAdiaEeDataC" 0 /end MEASUREMENT
/begin MEASUREMENT STC3_EE.usrEventCnt "Machine C Warm-up cycles counter" UBYTE NO_COMPU_METHOD 0 0 0 255 ECU_ADDRESS 0x4000C026 SYMBOL_LINK "xAdiaEeDataC" 2 /end MEASUREMENT
/begin MEASUREMENT STC3_EE.usrInstFaultCnt "Instantaneous fault counter" UBYTE NO_COMPU_METHOD 0 0 0 255 ECU_ADDRESS 0x4000C027 SYMBOL_LINK "xAdiaEeDataC" 3 /end MEASUREMENT
/begin MEASUREMENT STC3_EE.usrWucCnt "Machine C Warm-up cycles counter" UBYTE NO_COMPU_METHOD 0 0 0 255 ECU_ADDRESS 0x4000C028 SYMBOL_LINK "xAdiaEeDataC" 4 /end MEASUREMENT
/begin MEASUREMENT MFLV_EE.eCodErr "Machine C error state" UBYTE eCodErr.Conversion 0 0 0 255 ECU_ADDRESS 0x4000C057 SYMBOL_LINK "xAdiaEeDataC" 51 /end MEASUREMENT
/begin MEASUREMENT MFLV_EE.eErrSt "Machine C error state" UBYTE eErrSt.Conversion 0 0 0 255 ECU_ADDRESS 0x4000C056 SYMBOL_LINK "xAdiaEeDataC" 50 /end MEASUREMENT
/begin MEASUREMENT MFLV_EE.usrEventCnt "Machine C Warm-up cycles counter" UBYTE NO_COMPU_METHOD 0 0 0 255 ECU_ADDRESS 0x4000C058 SYMBOL_LINK "xAdiaEeDataC" 52 /end MEASUREMENT
/begin MEASUREMENT MFLV_EE.usrInstFaultCnt "Instantaneous fault counter" UBYTE NO_COMPU_METHOD 0 0 0 255 ECU_ADDRESS 0x4000C059 SYMBOL_LINK "xAdiaEeDataC" 53 /end MEASUREMENT
/begin MEASUREMENT MFLV_EE.usrWucCnt "Machine C Warm-up cycles counter" UBYTE NO_COMPU_METHOD 0 0 0 255 ECU_ADDRESS 0x4000C05A SYMBOL_LINK "xAdiaEeDataC" 54 /end MEASUREMENT
/begin MEASUREMENT CTSP_EE.eCodErr "Machine C error state" UBYTE eCodErr.Conversion 0 0 0 255 ECU_ADDRESS 0x4000C05C SYMBOL_LINK "xAdiaEeDataC" 56 /end MEASUREMENT
/begin MEASUREMENT CTSP_EE.eErrSt "Machine C error state" UBYTE eErrSt.Conversion 0 0 0 255 ECU_ADDRESS 0x4000C05B SYMBOL_LINK "xAdiaEeDataC" 55 /end MEASUREMENT
/begin MEASUREMENT CTSP_EE.usrEventCnt "Machine C Warm-up cycles counter" UBYTE NO_COMPU_METHOD 0 0 0 255 ECU_ADDRESS 0x4000C05D SYMBOL_LINK "xAdiaEeDataC" 57 /end MEASUREMENT
/begin MEASUREMENT CTSP_EE.usrInstFaultCnt "Instantaneous fault counter" UBYTE NO_COMPU_METHOD 0 0 0 255 ECU_ADDRESS 0x4000C05E SYMBOL_LINK "xAdiaEeDataC" 58 /end MEASUREMENT
/begin MEASUREMENT CTSP_EE.usrWucCnt "Machine C Warm-up cycles counter" UBYTE NO_COMPU_METHOD 0 0 0 255 ECU_ADDRESS 0x4000C05F SYMBOL_LINK "xAdiaEeDataC" 59 /end MEASUREMENT
/begin MEASUREMENT CTST_EE.eCodErr "Machine C error state" UBYTE eCodErr.Conversion 0 0 0 255 ECU_ADDRESS 0x4000C061 SYMBOL_LINK "xAdiaEeDataC" 61 /end MEASUREMENT
/begin MEASUREMENT CTST_EE.eErrSt "Machine C error state" UBYTE eErrSt.Conversion 0 0 0 255 ECU_ADDRESS 0x4000C060 SYMBOL_LINK "xAdiaEeDataC" 60 /end MEASUREMENT
/begin MEASUREMENT CTST_EE.usrEventCnt "Machine C Warm-up cycles counter" UBYTE NO_COMPU_METHOD 0 0 0 255 ECU_ADDRESS 0x4000C062 SYMBOL_LINK "xAdiaEeDataC" 62 /end MEASUREMENT
/begin MEASUREMENT CTST_EE.usrInstFaultCnt "Instantaneous fault counter" UBYTE NO_COMPU_METHOD 0 0 0 255 ECU_ADDRESS 0x4000C063 SYMBOL_LINK "xAdiaEeDataC" 63 /end MEASUREMENT
/begin MEASUREMENT CTST_EE.usrWucCnt "Machine C Warm-up cycles counter" UBYTE NO_COMPU_METHOD 0 0 0 255 ECU_ADDRESS 0x4000C064 SYMBOL_LINK "xAdiaEeDataC" 64 /end MEASUREMENT
/begin MEASUREMENT VSS_EE.eCodErr "Machine C error state" UBYTE eCodErr.Conversion 0 0 0 255 ECU_ADDRESS 0x4000C066 SYMBOL_LINK "xAdiaEeDataC" 66 /end MEASUREMENT
/begin MEASUREMENT VSS_EE.eErrSt "Machine C error state" UBYTE eErrSt.Conversion 0 0 0 255 ECU_ADDRESS 0x4000C065 SYMBOL_LINK "xAdiaEeDataC" 65 /end MEASUREMENT
/begin MEASUREMENT VSS_EE.usrEventCnt "Machine C Warm-up cycles counter" UBYTE NO_COMPU_METHOD 0 0 0 255 ECU_ADDRESS 0x4000C067 SYMBOL_LINK "xAdiaEeDataC" 67 /end MEASUREMENT
/begin MEASUREMENT VSS_EE.usrInstFaultCnt "Instantaneous fault counter" UBYTE NO_COMPU_METHOD 0 0 0 255 ECU_ADDRESS 0x4000C068 SYMBOL_LINK "xAdiaEeDataC" 68 /end MEASUREMENT
/begin MEASUREMENT VSS_EE.usrWucCnt "Machine C Warm-up cycles counter" UBYTE NO_COMPU_METHOD 0 0 0 255 ECU_ADDRESS 0x4000C069 SYMBOL_LINK "xAdiaEeDataC" 69 /end MEASUREMENT
/begin MEASUREMENT SAFRTI_EE.eCodErr "Machine C error state" UBYTE eCodErr.Conversion 0 0 0 255 ECU_ADDRESS 0x4000C06B SYMBOL_LINK "xAdiaEeDataC" 71 /end MEASUREMENT
/begin MEASUREMENT SAFRTI_EE.eErrSt "Machine C error state" UBYTE eErrSt.Conversion 0 0 0 255 ECU_ADDRESS 0x4000C06A SYMBOL_LINK "xAdiaEeDataC" 70 /end MEASUREMENT
/begin MEASUREMENT SAFRTI_EE.usrEventCnt "Machine C Warm-up cycles counter" UBYTE NO_COMPU_METHOD 0 0 0 255 ECU_ADDRESS 0x4000C06C SYMBOL_LINK "xAdiaEeDataC" 72 /end MEASUREMENT
/begin MEASUREMENT SAFRTI_EE.usrInstFaultCnt "Instantaneous fault counter" UBYTE NO_COMPU_METHOD 0 0 0 255 ECU_ADDRESS 0x4000C06D SYMBOL_LINK "xAdiaEeDataC" 73 /end MEASUREMENT
/begin MEASUREMENT SAFRTI_EE.usrWucCnt "Machine C Warm-up cycles counter" UBYTE NO_COMPU_METHOD 0 0 0 255 ECU_ADDRESS 0x4000C06E SYMBOL_LINK "xAdiaEeDataC" 74 /end MEASUREMENT
/begin MEASUREMENT SLO_EE.eCodErr "Machine C error state" UBYTE eCodErr.Conversion 0 0 0 255 ECU_ADDRESS 0x4000C02A SYMBOL_LINK "xAdiaEeDataC" 6 /end MEASUREMENT
/begin MEASUREMENT SLO_EE.eErrSt "Machine C error state" UBYTE eErrSt.Conversion 0 0 0 255 ECU_ADDRESS 0x4000C029 SYMBOL_LINK "xAdiaEeDataC" 5 /end MEASUREMENT
/begin MEASUREMENT SLO_EE.usrEventCnt "Machine C Warm-up cycles counter" UBYTE NO_COMPU_METHOD 0 0 0 255 ECU_ADDRESS 0x4000C02B SYMBOL_LINK "xAdiaEeDataC" 7 /end MEASUREMENT
/begin MEASUREMENT SLO_EE.usrInstFaultCnt "Instantaneous fault counter" UBYTE NO_COMPU_METHOD 0 0 0 255 ECU_ADDRESS 0x4000C02C SYMBOL_LINK "xAdiaEeDataC" 8 /end MEASUREMENT
/begin MEASUREMENT SLO_EE.usrWucCnt "Machine C Warm-up cycles counter" UBYTE NO_COMPU_METHOD 0 0 0 255 ECU_ADDRESS 0x4000C02D SYMBOL_LINK "xAdiaEeDataC" 9 /end MEASUREMENT
/begin MEASUREMENT LRN01_EE.eCodErr "Machine C error state" UBYTE eCodErr.Conversion 0 0 0 255 ECU_ADDRESS 0x4000C02F SYMBOL_LINK "xAdiaEeDataC" 11 /end MEASUREMENT
/begin MEASUREMENT LRN01_EE.eErrSt "Machine C error state" UBYTE eErrSt.Conversion 0 0 0 255 ECU_ADDRESS 0x4000C02E SYMBOL_LINK "xAdiaEeDataC" 10 /end MEASUREMENT
/begin MEASUREMENT LRN01_EE.usrEventCnt "Machine C Warm-up cycles counter" UBYTE NO_COMPU_METHOD 0 0 0 255 ECU_ADDRESS 0x4000C030 SYMBOL_LINK "xAdiaEeDataC" 12 /end MEASUREMENT
/begin MEASUREMENT LRN01_EE.usrInstFaultCnt "Instantaneous fault counter" UBYTE NO_COMPU_METHOD 0 0 0 255 ECU_ADDRESS 0x4000C031 SYMBOL_LINK "xAdiaEeDataC" 13 /end MEASUREMENT
/begin MEASUREMENT LRN01_EE.usrWucCnt "Machine C Warm-up cycles counter" UBYTE NO_COMPU_METHOD 0 0 0 255 ECU_ADDRESS 0x4000C032 SYMBOL_LINK "xAdiaEeDataC" 14 /end MEASUREMENT
/begin MEASUREMENT LRN02_EE.eCodErr "Machine C error state" UBYTE eCodErr.Conversion 0 0 0 255 ECU_ADDRESS 0x4000C034 SYMBOL_LINK "xAdiaEeDataC" 16 /end MEASUREMENT
/begin MEASUREMENT LRN02_EE.eErrSt "Machine C error state" UBYTE eErrSt.Conversion 0 0 0 255 ECU_ADDRESS 0x4000C033 SYMBOL_LINK "xAdiaEeDataC" 15 /end MEASUREMENT
/begin MEASUREMENT LRN02_EE.usrEventCnt "Machine C Warm-up cycles counter" UBYTE NO_COMPU_METHOD 0 0 0 255 ECU_ADDRESS 0x4000C035 SYMBOL_LINK "xAdiaEeDataC" 17 /end MEASUREMENT
/begin MEASUREMENT LRN02_EE.usrInstFaultCnt "Instantaneous fault counter" UBYTE NO_COMPU_METHOD 0 0 0 255 ECU_ADDRESS 0x4000C036 SYMBOL_LINK "xAdiaEeDataC" 18 /end MEASUREMENT
/begin MEASUREMENT LRN02_EE.usrWucCnt "Machine C Warm-up cycles counter" UBYTE NO_COMPU_METHOD 0 0 0 255 ECU_ADDRESS 0x4000C037 SYMBOL_LINK "xAdiaEeDataC" 19 /end MEASUREMENT
/begin MEASUREMENT LRN03_EE.eCodErr "Machine C error state" UBYTE eCodErr.Conversion 0 0 0 255 ECU_ADDRESS 0x4000C039 SYMBOL_LINK "xAdiaEeDataC" 21 /end MEASUREMENT
/begin MEASUREMENT LRN03_EE.eErrSt "Machine C error state" UBYTE eErrSt.Conversion 0 0 0 255 ECU_ADDRESS 0x4000C038 SYMBOL_LINK "xAdiaEeDataC" 20 /end MEASUREMENT
/begin MEASUREMENT LRN03_EE.usrEventCnt "Machine C Warm-up cycles counter" UBYTE NO_COMPU_METHOD 0 0 0 255 ECU_ADDRESS 0x4000C03A SYMBOL_LINK "xAdiaEeDataC" 22 /end MEASUREMENT
/begin MEASUREMENT LRN03_EE.usrInstFaultCnt "Instantaneous fault counter" UBYTE NO_COMPU_METHOD 0 0 0 255 ECU_ADDRESS 0x4000C03B SYMBOL_LINK "xAdiaEeDataC" 23 /end MEASUREMENT
/begin MEASUREMENT LRN03_EE.usrWucCnt "Machine C Warm-up cycles counter" UBYTE NO_COMPU_METHOD 0 0 0 255 ECU_ADDRESS 0x4000C03C SYMBOL_LINK "xAdiaEeDataC" 24 /end MEASUREMENT
/begin MEASUREMENT SFM_EE.eCodErr "Machine C error state" UBYTE eCodErr.Conversion 0 0 0 255 ECU_ADDRESS 0x4000C03E SYMBOL_LINK "xAdiaEeDataC" 26 /end MEASUREMENT
/begin MEASUREMENT SFM_EE.eErrSt "Machine C error state" UBYTE eErrSt.Conversion 0 0 0 255 ECU_ADDRESS 0x4000C03D SYMBOL_LINK "xAdiaEeDataC" 25 /end MEASUREMENT
/begin MEASUREMENT SFM_EE.usrEventCnt "Machine C Warm-up cycles counter" UBYTE NO_COMPU_METHOD 0 0 0 255 ECU_ADDRESS 0x4000C03F SYMBOL_LINK "xAdiaEeDataC" 27 /end MEASUREMENT
/begin MEASUREMENT SFM_EE.usrInstFaultCnt "Instantaneous fault counter" UBYTE NO_COMPU_METHOD 0 0 0 255 ECU_ADDRESS 0x4000C040 SYMBOL_LINK "xAdiaEeDataC" 28 /end MEASUREMENT
/begin MEASUREMENT SFM_EE.usrWucCnt "Machine C Warm-up cycles counter" UBYTE NO_COMPU_METHOD 0 0 0 255 ECU_ADDRESS 0x4000C041 SYMBOL_LINK "xAdiaEeDataC" 29 /end MEASUREMENT
/begin MEASUREMENT SFR_EE.eCodErr "Machine C error state" UBYTE eCodErr.Conversion 0 0 0 255 ECU_ADDRESS 0x4000C043 SYMBOL_LINK "xAdiaEeDataC" 31 /end MEASUREMENT
/begin MEASUREMENT SFR_EE.eErrSt "Machine C error state" UBYTE eErrSt.Conversion 0 0 0 255 ECU_ADDRESS 0x4000C042 SYMBOL_LINK "xAdiaEeDataC" 30 /end MEASUREMENT
/begin MEASUREMENT SFR_EE.usrEventCnt "Machine C Warm-up cycles counter" UBYTE NO_COMPU_METHOD 0 0 0 255 ECU_ADDRESS 0x4000C044 SYMBOL_LINK "xAdiaEeDataC" 32 /end MEASUREMENT
/begin MEASUREMENT SFR_EE.usrInstFaultCnt "Instantaneous fault counter" UBYTE NO_COMPU_METHOD 0 0 0 255 ECU_ADDRESS 0x4000C045 SYMBOL_LINK "xAdiaEeDataC" 33 /end MEASUREMENT
/begin MEASUREMENT SFR_EE.usrWucCnt "Machine C Warm-up cycles counter" UBYTE NO_COMPU_METHOD 0 0 0 255 ECU_ADDRESS 0x4000C046 SYMBOL_LINK "xAdiaEeDataC" 34 /end MEASUREMENT
/begin MEASUREMENT ADAT_EE.eCodErr "Machine C error state" UBYTE eCodErr.Conversion 0 0 0 255 ECU_ADDRESS 0x4000C048 SYMBOL_LINK "xAdiaEeDataC" 36 /end MEASUREMENT
/begin MEASUREMENT ADAT_EE.eErrSt "Machine C error state" UBYTE eErrSt.Conversion 0 0 0 255 ECU_ADDRESS 0x4000C047 SYMBOL_LINK "xAdiaEeDataC" 35 /end MEASUREMENT
/begin MEASUREMENT ADAT_EE.usrEventCnt "Machine C Warm-up cycles counter" UBYTE NO_COMPU_METHOD 0 0 0 255 ECU_ADDRESS 0x4000C049 SYMBOL_LINK "xAdiaEeDataC" 37 /end MEASUREMENT
/begin MEASUREMENT ADAT_EE.usrInstFaultCnt "Instantaneous fault counter" UBYTE NO_COMPU_METHOD 0 0 0 255 ECU_ADDRESS 0x4000C04A SYMBOL_LINK "xAdiaEeDataC" 38 /end MEASUREMENT
/begin MEASUREMENT ADAT_EE.usrWucCnt "Machine C Warm-up cycles counter" UBYTE NO_COMPU_METHOD 0 0 0 255 ECU_ADDRESS 0x4000C04B SYMBOL_LINK "xAdiaEeDataC" 39 /end MEASUREMENT
/begin MEASUREMENT ADAT2_EE.eCodErr "Machine C error state" UBYTE eCodErr.Conversion 0 0 0 255 ECU_ADDRESS 0x4000C04D SYMBOL_LINK "xAdiaEeDataC" 41 /end MEASUREMENT
/begin MEASUREMENT ADAT2_EE.eErrSt "Machine C error state" UBYTE eErrSt.Conversion 0 0 0 255 ECU_ADDRESS 0x4000C04C SYMBOL_LINK "xAdiaEeDataC" 40 /end MEASUREMENT
/begin MEASUREMENT ADAT2_EE.usrEventCnt "Machine C Warm-up cycles counter" UBYTE NO_COMPU_METHOD 0 0 0 255 ECU_ADDRESS 0x4000C04E SYMBOL_LINK "xAdiaEeDataC" 42 /end MEASUREMENT
/begin MEASUREMENT ADAT2_EE.usrInstFaultCnt "Instantaneous fault counter" UBYTE NO_COMPU_METHOD 0 0 0 255 ECU_ADDRESS 0x4000C04F SYMBOL_LINK "xAdiaEeDataC" 43 /end MEASUREMENT
/begin MEASUREMENT ADAT2_EE.usrWucCnt "Machine C Warm-up cycles counter" UBYTE NO_COMPU_METHOD 0 0 0 255 ECU_ADDRESS 0x4000C050 SYMBOL_LINK "xAdiaEeDataC" 44 /end MEASUREMENT
/begin MEASUREMENT FAR12_EE.eCodErr "Machine C error state" UBYTE eCodErr.Conversion 0 0 0 255 ECU_ADDRESS 0x4000C052 SYMBOL_LINK "xAdiaEeDataC" 46 /end MEASUREMENT
/begin MEASUREMENT FAR12_EE.eErrSt "Machine C error state" UBYTE eErrSt.Conversion 0 0 0 255 ECU_ADDRESS 0x4000C051 SYMBOL_LINK "xAdiaEeDataC" 45 /end MEASUREMENT
/begin MEASUREMENT FAR12_EE.usrEventCnt "Machine C Warm-up cycles counter" UBYTE NO_COMPU_METHOD 0 0 0 255 ECU_ADDRESS 0x4000C053 SYMBOL_LINK "xAdiaEeDataC" 47 /end MEASUREMENT
/begin MEASUREMENT FAR12_EE.usrInstFaultCnt "Instantaneous fault counter" UBYTE NO_COMPU_METHOD 0 0 0 255 ECU_ADDRESS 0x4000C054 SYMBOL_LINK "xAdiaEeDataC" 48 /end MEASUREMENT
/begin MEASUREMENT FAR12_EE.usrWucCnt "Machine C Warm-up cycles counter" UBYTE NO_COMPU_METHOD 0 0 0 255 ECU_ADDRESS 0x4000C055 SYMBOL_LINK "xAdiaEeDataC" 49 /end MEASUREMENT
/begin MEASUREMENT STH_RAM.eCodErr "Machine B punctual fault type" UBYTE eCodErr.Conversion 0 0 0 255 ECU_ADDRESS 0x40004B80 SYMBOL_LINK "xAdiaRamDataB" 0 /end MEASUREMENT
/begin MEASUREMENT STH_RAM.usrFaultCnt "Machine B faults counter" UWORD NO_COMPU_METHOD 0 0 0 65000 ECU_ADDRESS 0x40004B86 SYMBOL_LINK "xAdiaRamDataB" 6 /end MEASUREMENT
/begin MEASUREMENT MD6_RAM.eCodErr "Machine B punctual fault type" UBYTE eCodErr.Conversion 0 0 0 255 ECU_ADDRESS 0x40004F68 SYMBOL_LINK "xAdiaRamDataB" 1000 /end MEASUREMENT
/begin MEASUREMENT MD6_RAM.usrFaultCnt "Machine B faults counter" UWORD NO_COMPU_METHOD 0 0 0 65000 ECU_ADDRESS 0x40004F6E SYMBOL_LINK "xAdiaRamDataB" 1006 /end MEASUREMENT
/begin MEASUREMENT MD7_RAM.eCodErr "Machine B punctual fault type" UBYTE eCodErr.Conversion 0 0 0 255 ECU_ADDRESS 0x40004F72 SYMBOL_LINK "xAdiaRamDataB" 1010 /end MEASUREMENT
/begin MEASUREMENT MD7_RAM.usrFaultCnt "Machine B faults counter" UWORD NO_COMPU_METHOD 0 0 0 65000 ECU_ADDRESS 0x40004F78 SYMBOL_LINK "xAdiaRamDataB" 1016 /end MEASUREMENT
/begin MEASUREMENT MD8_RAM.eCodErr "Machine B punctual fault type" UBYTE eCodErr.Conversion 0 0 0 255 ECU_ADDRESS 0x40004F7C SYMBOL_LINK "xAdiaRamDataB" 1020 /end MEASUREMENT
/begin MEASUREMENT MD8_RAM.usrFaultCnt "Machine B faults counter" UWORD NO_COMPU_METHOD 0 0 0 65000 ECU_ADDRESS 0x40004F82 SYMBOL_LINK "xAdiaRamDataB" 1026 /end MEASUREMENT
/begin MEASUREMENT MDR_RAM.eCodErr "Machine B punctual fault type" UBYTE eCodErr.Conversion 0 0 0 255 ECU_ADDRESS 0x40004F86 SYMBOL_LINK "xAdiaRamDataB" 1030 /end MEASUREMENT
/begin MEASUREMENT MDR_RAM.usrFaultCnt "Machine B faults counter" UWORD NO_COMPU_METHOD 0 0 0 65000 ECU_ADDRESS 0x40004F8C SYMBOL_LINK "xAdiaRamDataB" 1036 /end MEASUREMENT
/begin MEASUREMENT SPM2H_RAM.eCodErr "Machine B punctual fault type" UBYTE eCodErr.Conversion 0 0 0 255 ECU_ADDRESS 0x40004F90 SYMBOL_LINK "xAdiaRamDataB" 1040 /end MEASUREMENT
/begin MEASUREMENT SPM2H_RAM.usrFaultCnt "Machine B faults counter" UWORD NO_COMPU_METHOD 0 0 0 65000 ECU_ADDRESS 0x40004F96 SYMBOL_LINK "xAdiaRamDataB" 1046 /end MEASUREMENT
/begin MEASUREMENT KSP1_RAM.eCodErr "Machine B punctual fault type" UBYTE eCodErr.Conversion 0 0 0 255 ECU_ADDRESS 0x40004F9A SYMBOL_LINK "xAdiaRamDataB" 1050 /end MEASUREMENT
/begin MEASUREMENT KSP1_RAM.usrFaultCnt "Machine B faults counter" UWORD NO_COMPU_METHOD 0 0 0 65000 ECU_ADDRESS 0x40004FA0 SYMBOL_LINK "xAdiaRamDataB" 1056 /end MEASUREMENT
/begin MEASUREMENT KSP2_RAM.eCodErr "Machine B punctual fault type" UBYTE eCodErr.Conversion 0 0 0 255 ECU_ADDRESS 0x40004FA4 SYMBOL_LINK "xAdiaRamDataB" 1060 /end MEASUREMENT
/begin MEASUREMENT KSP2_RAM.usrFaultCnt "Machine B faults counter" UWORD NO_COMPU_METHOD 0 0 0 65000 ECU_ADDRESS 0x40004FAA SYMBOL_LINK "xAdiaRamDataB" 1066 /end MEASUREMENT
/begin MEASUREMENT EGRP_RAM.eCodErr "Machine B punctual fault type" UBYTE eCodErr.Conversion 0 0 0 255 ECU_ADDRESS 0x40004FAE SYMBOL_LINK "xAdiaRamDataB" 1070 /end MEASUREMENT
/begin MEASUREMENT EGRP_RAM.usrFaultCnt "Machine B faults counter" UWORD NO_COMPU_METHOD 0 0 0 65000 ECU_ADDRESS 0x40004FB4 SYMBOL_LINK "xAdiaRamDataB" 1076 /end MEASUREMENT
/begin MEASUREMENT EGRV_RAM.eCodErr "Machine B punctual fault type" UBYTE eCodErr.Conversion 0 0 0 255 ECU_ADDRESS 0x40004FB8 SYMBOL_LINK "xAdiaRamDataB" 1080 /end MEASUREMENT
/begin MEASUREMENT EGRV_RAM.usrFaultCnt "Machine B faults counter" UWORD NO_COMPU_METHOD 0 0 0 65000 ECU_ADDRESS 0x40004FBE SYMBOL_LINK "xAdiaRamDataB" 1086 /end MEASUREMENT
/begin MEASUREMENT EGRC_RAM.eCodErr "Machine B punctual fault type" UBYTE eCodErr.Conversion 0 0 0 255 ECU_ADDRESS 0x40004FC2 SYMBOL_LINK "xAdiaRamDataB" 1090 /end MEASUREMENT
/begin MEASUREMENT EGRC_RAM.usrFaultCnt "Machine B faults counter" UWORD NO_COMPU_METHOD 0 0 0 65000 ECU_ADDRESS 0x40004FC8 SYMBOL_LINK "xAdiaRamDataB" 1096 /end MEASUREMENT
/begin MEASUREMENT FAR01_RAM.eCodErr "Machine B punctual fault type" UBYTE eCodErr.Conversion 0 0 0 255 ECU_ADDRESS 0x40004BE4 SYMBOL_LINK "xAdiaRamDataB" 100 /end MEASUREMENT
/begin MEASUREMENT FAR01_RAM.usrFaultCnt "Machine B faults counter" UWORD NO_COMPU_METHOD 0 0 0 65000 ECU_ADDRESS 0x40004BEA SYMBOL_LINK "xAdiaRamDataB" 106 /end MEASUREMENT
/begin MEASUREMENT ENGBRK_RAM.eCodErr "Machine B punctual fault type" UBYTE eCodErr.Conversion 0 0 0 255 ECU_ADDRESS 0x40004FCC SYMBOL_LINK "xAdiaRamDataB" 1100 /end MEASUREMENT
/begin MEASUREMENT ENGBRK_RAM.usrFaultCnt "Machine B faults counter" UWORD NO_COMPU_METHOD 0 0 0 65000 ECU_ADDRESS 0x40004FD2 SYMBOL_LINK "xAdiaRamDataB" 1106 /end MEASUREMENT
/begin MEASUREMENT DFLF_RAM.eCodErr "Machine B punctual fault type" UBYTE eCodErr.Conversion 0 0 0 255 ECU_ADDRESS 0x40004FD6 SYMBOL_LINK "xAdiaRamDataB" 1110 /end MEASUREMENT
/begin MEASUREMENT DFLF_RAM.usrFaultCnt "Machine B faults counter" UWORD NO_COMPU_METHOD 0 0 0 65000 ECU_ADDRESS 0x40004FDC SYMBOL_LINK "xAdiaRamDataB" 1116 /end MEASUREMENT
/begin MEASUREMENT DFLL_RAM.eCodErr "Machine B punctual fault type" UBYTE eCodErr.Conversion 0 0 0 255 ECU_ADDRESS 0x40004FE0 SYMBOL_LINK "xAdiaRamDataB" 1120 /end MEASUREMENT
/begin MEASUREMENT DFLL_RAM.usrFaultCnt "Machine B faults counter" UWORD NO_COMPU_METHOD 0 0 0 65000 ECU_ADDRESS 0x40004FE6 SYMBOL_LINK "xAdiaRamDataB" 1126 /end MEASUREMENT
/begin MEASUREMENT DFLR_RAM.eCodErr "Machine B punctual fault type" UBYTE eCodErr.Conversion 0 0 0 255 ECU_ADDRESS 0x40004FEA SYMBOL_LINK "xAdiaRamDataB" 1130 /end MEASUREMENT
/begin MEASUREMENT DFLR_RAM.usrFaultCnt "Machine B faults counter" UWORD NO_COMPU_METHOD 0 0 0 65000 ECU_ADDRESS 0x40004FF0 SYMBOL_LINK "xAdiaRamDataB" 1136 /end MEASUREMENT
/begin MEASUREMENT DCAT_RAM.eCodErr "Machine B punctual fault type" UBYTE eCodErr.Conversion 0 0 0 255 ECU_ADDRESS 0x40004FF4 SYMBOL_LINK "xAdiaRamDataB" 1140 /end MEASUREMENT
/begin MEASUREMENT DCAT_RAM.usrFaultCnt "Machine B faults counter" UWORD NO_COMPU_METHOD 0 0 0 65000 ECU_ADDRESS 0x40004FFA SYMBOL_LINK "xAdiaRamDataB" 1146 /end MEASUREMENT
/begin MEASUREMENT DCMV_RAM.eCodErr "Machine B punctual fault type" UBYTE eCodErr.Conversion 0 0 0 255 ECU_ADDRESS 0x40004FFE SYMBOL_LINK "xAdiaRamDataB" 1150 /end MEASUREMENT
/begin MEASUREMENT DCMV_RAM.usrFaultCnt "Machine B faults counter" UWORD NO_COMPU_METHOD 0 0 0 65000 ECU_ADDRESS 0x40005004 SYMBOL_LINK "xAdiaRamDataB" 1156 /end MEASUREMENT
/begin MEASUREMENT DLAM_RAM.eCodErr "Machine B punctual fault type" UBYTE eCodErr.Conversion 0 0 0 255 ECU_ADDRESS 0x40005008 SYMBOL_LINK "xAdiaRamDataB" 1160 /end MEASUREMENT
/begin MEASUREMENT DLAM_RAM.usrFaultCnt "Machine B faults counter" UWORD NO_COMPU_METHOD 0 0 0 65000 ECU_ADDRESS 0x4000500E SYMBOL_LINK "xAdiaRamDataB" 1166 /end MEASUREMENT
/begin MEASUREMENT SPA_RAM.eCodErr "Machine B punctual fault type" UBYTE eCodErr.Conversion 0 0 0 255 ECU_ADDRESS 0x40004BEE SYMBOL_LINK "xAdiaRamDataB" 110 /end MEASUREMENT
/begin MEASUREMENT SPA_RAM.usrFaultCnt "Machine B faults counter" UWORD NO_COMPU_METHOD 0 0 0 65000 ECU_ADDRESS 0x40004BF4 SYMBOL_LINK "xAdiaRamDataB" 116 /end MEASUREMENT
/begin MEASUREMENT BAT_RAM.eCodErr "Machine B punctual fault type" UBYTE eCodErr.Conversion 0 0 0 255 ECU_ADDRESS 0x40004BF8 SYMBOL_LINK "xAdiaRamDataB" 120 /end MEASUREMENT
/begin MEASUREMENT BAT_RAM.usrFaultCnt "Machine B faults counter" UWORD NO_COMPU_METHOD 0 0 0 65000 ECU_ADDRESS 0x40004BFE SYMBOL_LINK "xAdiaRamDataB" 126 /end MEASUREMENT
/begin MEASUREMENT VBP_RAM.eCodErr "Machine B punctual fault type" UBYTE eCodErr.Conversion 0 0 0 255 ECU_ADDRESS 0x40004C02 SYMBOL_LINK "xAdiaRamDataB" 130 /end MEASUREMENT
/begin MEASUREMENT VBP_RAM.usrFaultCnt "Machine B faults counter" UWORD NO_COMPU_METHOD 0 0 0 65000 ECU_ADDRESS 0x40004C08 SYMBOL_LINK "xAdiaRamDataB" 136 /end MEASUREMENT
/begin MEASUREMENT WGT_RAM.eCodErr "Machine B punctual fault type" UBYTE eCodErr.Conversion 0 0 0 255 ECU_ADDRESS 0x40004C0C SYMBOL_LINK "xAdiaRamDataB" 140 /end MEASUREMENT
/begin MEASUREMENT WGT_RAM.usrFaultCnt "Machine B faults counter" UWORD NO_COMPU_METHOD 0 0 0 65000 ECU_ADDRESS 0x40004C12 SYMBOL_LINK "xAdiaRamDataB" 146 /end MEASUREMENT
/begin MEASUREMENT COIL1_RAM.eCodErr "Machine B punctual fault type" UBYTE eCodErr.Conversion 0 0 0 255 ECU_ADDRESS 0x40004C16 SYMBOL_LINK "xAdiaRamDataB" 150 /end MEASUREMENT
/begin MEASUREMENT COIL1_RAM.usrFaultCnt "Machine B faults counter" UWORD NO_COMPU_METHOD 0 0 0 65000 ECU_ADDRESS 0x40004C1C SYMBOL_LINK "xAdiaRamDataB" 156 /end MEASUREMENT
/begin MEASUREMENT COIL2_RAM.eCodErr "Machine B punctual fault type" UBYTE eCodErr.Conversion 0 0 0 255 ECU_ADDRESS 0x40004C20 SYMBOL_LINK "xAdiaRamDataB" 160 /end MEASUREMENT
/begin MEASUREMENT COIL2_RAM.usrFaultCnt "Machine B faults counter" UWORD NO_COMPU_METHOD 0 0 0 65000 ECU_ADDRESS 0x40004C26 SYMBOL_LINK "xAdiaRamDataB" 166 /end MEASUREMENT
/begin MEASUREMENT COIL3_RAM.eCodErr "Machine B punctual fault type" UBYTE eCodErr.Conversion 0 0 0 255 ECU_ADDRESS 0x40004C2A SYMBOL_LINK "xAdiaRamDataB" 170 /end MEASUREMENT
/begin MEASUREMENT COIL3_RAM.usrFaultCnt "Machine B faults counter" UWORD NO_COMPU_METHOD 0 0 0 65000 ECU_ADDRESS 0x40004C30 SYMBOL_LINK "xAdiaRamDataB" 176 /end MEASUREMENT
/begin MEASUREMENT COIL4_RAM.eCodErr "Machine B punctual fault type" UBYTE eCodErr.Conversion 0 0 0 255 ECU_ADDRESS 0x40004C34 SYMBOL_LINK "xAdiaRamDataB" 180 /end MEASUREMENT
/begin MEASUREMENT COIL4_RAM.usrFaultCnt "Machine B faults counter" UWORD NO_COMPU_METHOD 0 0 0 65000 ECU_ADDRESS 0x40004C3A SYMBOL_LINK "xAdiaRamDataB" 186 /end MEASUREMENT
/begin MEASUREMENT COIL5_RAM.eCodErr "Machine B punctual fault type" UBYTE eCodErr.Conversion 0 0 0 255 ECU_ADDRESS 0x40004C3E SYMBOL_LINK "xAdiaRamDataB" 190 /end MEASUREMENT
/begin MEASUREMENT COIL5_RAM.usrFaultCnt "Machine B faults counter" UWORD NO_COMPU_METHOD 0 0 0 65000 ECU_ADDRESS 0x40004C44 SYMBOL_LINK "xAdiaRamDataB" 196 /end MEASUREMENT
/begin MEASUREMENT STO_RAM.eCodErr "Machine B punctual fault type" UBYTE eCodErr.Conversion 0 0 0 255 ECU_ADDRESS 0x40004B8A SYMBOL_LINK "xAdiaRamDataB" 10 /end MEASUREMENT
/begin MEASUREMENT STO_RAM.usrFaultCnt "Machine B faults counter" UWORD NO_COMPU_METHOD 0 0 0 65000 ECU_ADDRESS 0x40004B90 SYMBOL_LINK "xAdiaRamDataB" 16 /end MEASUREMENT
/begin MEASUREMENT COIL6_RAM.eCodErr "Machine B punctual fault type" UBYTE eCodErr.Conversion 0 0 0 255 ECU_ADDRESS 0x40004C48 SYMBOL_LINK "xAdiaRamDataB" 200 /end MEASUREMENT
/begin MEASUREMENT COIL6_RAM.usrFaultCnt "Machine B faults counter" UWORD NO_COMPU_METHOD 0 0 0 65000 ECU_ADDRESS 0x40004C4E SYMBOL_LINK "xAdiaRamDataB" 206 /end MEASUREMENT
/begin MEASUREMENT COIL7_RAM.eCodErr "Machine B punctual fault type" UBYTE eCodErr.Conversion 0 0 0 255 ECU_ADDRESS 0x40004C52 SYMBOL_LINK "xAdiaRamDataB" 210 /end MEASUREMENT
/begin MEASUREMENT COIL7_RAM.usrFaultCnt "Machine B faults counter" UWORD NO_COMPU_METHOD 0 0 0 65000 ECU_ADDRESS 0x40004C58 SYMBOL_LINK "xAdiaRamDataB" 216 /end MEASUREMENT
/begin MEASUREMENT COIL8_RAM.eCodErr "Machine B punctual fault type" UBYTE eCodErr.Conversion 0 0 0 255 ECU_ADDRESS 0x40004C5C SYMBOL_LINK "xAdiaRamDataB" 220 /end MEASUREMENT
/begin MEASUREMENT COIL8_RAM.usrFaultCnt "Machine B faults counter" UWORD NO_COMPU_METHOD 0 0 0 65000 ECU_ADDRESS 0x40004C62 SYMBOL_LINK "xAdiaRamDataB" 226 /end MEASUREMENT
/begin MEASUREMENT INJ1_RAM.eCodErr "Machine B punctual fault type" UBYTE eCodErr.Conversion 0 0 0 255 ECU_ADDRESS 0x40004C66 SYMBOL_LINK "xAdiaRamDataB" 230 /end MEASUREMENT
/begin MEASUREMENT INJ1_RAM.usrFaultCnt "Machine B faults counter" UWORD NO_COMPU_METHOD 0 0 0 65000 ECU_ADDRESS 0x40004C6C SYMBOL_LINK "xAdiaRamDataB" 236 /end MEASUREMENT
/begin MEASUREMENT INJ2_RAM.eCodErr "Machine B punctual fault type" UBYTE eCodErr.Conversion 0 0 0 255 ECU_ADDRESS 0x40004C70 SYMBOL_LINK "xAdiaRamDataB" 240 /end MEASUREMENT
/begin MEASUREMENT INJ2_RAM.usrFaultCnt "Machine B faults counter" UWORD NO_COMPU_METHOD 0 0 0 65000 ECU_ADDRESS 0x40004C76 SYMBOL_LINK "xAdiaRamDataB" 246 /end MEASUREMENT
/begin MEASUREMENT INJ3_RAM.eCodErr "Machine B punctual fault type" UBYTE eCodErr.Conversion 0 0 0 255 ECU_ADDRESS 0x40004C7A SYMBOL_LINK "xAdiaRamDataB" 250 /end MEASUREMENT
/begin MEASUREMENT INJ3_RAM.usrFaultCnt "Machine B faults counter" UWORD NO_COMPU_METHOD 0 0 0 65000 ECU_ADDRESS 0x40004C80 SYMBOL_LINK "xAdiaRamDataB" 256 /end MEASUREMENT
/begin MEASUREMENT INJ4_RAM.eCodErr "Machine B punctual fault type" UBYTE eCodErr.Conversion 0 0 0 255 ECU_ADDRESS 0x40004C84 SYMBOL_LINK "xAdiaRamDataB" 260 /end MEASUREMENT
/begin MEASUREMENT INJ4_RAM.usrFaultCnt "Machine B faults counter" UWORD NO_COMPU_METHOD 0 0 0 65000 ECU_ADDRESS 0x40004C8A SYMBOL_LINK "xAdiaRamDataB" 266 /end MEASUREMENT
/begin MEASUREMENT INJ5_RAM.eCodErr "Machine B punctual fault type" UBYTE eCodErr.Conversion 0 0 0 255 ECU_ADDRESS 0x40004C8E SYMBOL_LINK "xAdiaRamDataB" 270 /end MEASUREMENT
/begin MEASUREMENT INJ5_RAM.usrFaultCnt "Machine B faults counter" UWORD NO_COMPU_METHOD 0 0 0 65000 ECU_ADDRESS 0x40004C94 SYMBOL_LINK "xAdiaRamDataB" 276 /end MEASUREMENT
/begin MEASUREMENT INJ6_RAM.eCodErr "Machine B punctual fault type" UBYTE eCodErr.Conversion 0 0 0 255 ECU_ADDRESS 0x40004C98 SYMBOL_LINK "xAdiaRamDataB" 280 /end MEASUREMENT
/begin MEASUREMENT INJ6_RAM.usrFaultCnt "Machine B faults counter" UWORD NO_COMPU_METHOD 0 0 0 65000 ECU_ADDRESS 0x40004C9E SYMBOL_LINK "xAdiaRamDataB" 286 /end MEASUREMENT
/begin MEASUREMENT INJ7_RAM.eCodErr "Machine B punctual fault type" UBYTE eCodErr.Conversion 0 0 0 255 ECU_ADDRESS 0x40004CA2 SYMBOL_LINK "xAdiaRamDataB" 290 /end MEASUREMENT
/begin MEASUREMENT INJ7_RAM.usrFaultCnt "Machine B faults counter" UWORD NO_COMPU_METHOD 0 0 0 65000 ECU_ADDRESS 0x40004CA8 SYMBOL_LINK "xAdiaRamDataB" 296 /end MEASUREMENT
/begin MEASUREMENT STA_RAM.eCodErr "Machine B punctual fault type" UBYTE eCodErr.Conversion 0 0 0 255 ECU_ADDRESS 0x40004B94 SYMBOL_LINK "xAdiaRamDataB" 20 /end MEASUREMENT
/begin MEASUREMENT STA_RAM.usrFaultCnt "Machine B faults counter" UWORD NO_COMPU_METHOD 0 0 0 65000 ECU_ADDRESS 0x40004B9A SYMBOL_LINK "xAdiaRamDataB" 26 /end MEASUREMENT
/begin MEASUREMENT INJ8_RAM.eCodErr "Machine B punctual fault type" UBYTE eCodErr.Conversion 0 0 0 255 ECU_ADDRESS 0x40004CAC SYMBOL_LINK "xAdiaRamDataB" 300 /end MEASUREMENT
/begin MEASUREMENT INJ8_RAM.usrFaultCnt "Machine B faults counter" UWORD NO_COMPU_METHOD 0 0 0 65000 ECU_ADDRESS 0x40004CB2 SYMBOL_LINK "xAdiaRamDataB" 306 /end MEASUREMENT
/begin MEASUREMENT PWRCOL_RAM.eCodErr "Machine B punctual fault type" UBYTE eCodErr.Conversion 0 0 0 255 ECU_ADDRESS 0x40004CB6 SYMBOL_LINK "xAdiaRamDataB" 310 /end MEASUREMENT
/begin MEASUREMENT PWRCOL_RAM.usrFaultCnt "Machine B faults counter" UWORD NO_COMPU_METHOD 0 0 0 65000 ECU_ADDRESS 0x40004CBC SYMBOL_LINK "xAdiaRamDataB" 316 /end MEASUREMENT
/begin MEASUREMENT PWRCGND_RAM.eCodErr "Machine B punctual fault type" UBYTE eCodErr.Conversion 0 0 0 255 ECU_ADDRESS 0x40004CC0 SYMBOL_LINK "xAdiaRamDataB" 320 /end MEASUREMENT
/begin MEASUREMENT PWRCGND_RAM.usrFaultCnt "Machine B faults counter" UWORD NO_COMPU_METHOD 0 0 0 65000 ECU_ADDRESS 0x40004CC6 SYMBOL_LINK "xAdiaRamDataB" 326 /end MEASUREMENT
/begin MEASUREMENT PWRCVB_RAM.eCodErr "Machine B punctual fault type" UBYTE eCodErr.Conversion 0 0 0 255 ECU_ADDRESS 0x40004CCA SYMBOL_LINK "xAdiaRamDataB" 330 /end MEASUREMENT
/begin MEASUREMENT PWRCVB_RAM.usrFaultCnt "Machine B faults counter" UWORD NO_COMPU_METHOD 0 0 0 65000 ECU_ADDRESS 0x40004CD0 SYMBOL_LINK "xAdiaRamDataB" 336 /end MEASUREMENT
/begin MEASUREMENT PWROC_RAM.eCodErr "Machine B punctual fault type" UBYTE eCodErr.Conversion 0 0 0 255 ECU_ADDRESS 0x40004CD4 SYMBOL_LINK "xAdiaRamDataB" 340 /end MEASUREMENT
/begin MEASUREMENT PWROC_RAM.usrFaultCnt "Machine B faults counter" UWORD NO_COMPU_METHOD 0 0 0 65000 ECU_ADDRESS 0x40004CDA SYMBOL_LINK "xAdiaRamDataB" 346 /end MEASUREMENT
/begin MEASUREMENT PWRCC_RAM.eCodErr "Machine B punctual fault type" UBYTE eCodErr.Conversion 0 0 0 255 ECU_ADDRESS 0x40004CDE SYMBOL_LINK "xAdiaRamDataB" 350 /end MEASUREMENT
/begin MEASUREMENT PWRCC_RAM.usrFaultCnt "Machine B faults counter" UWORD NO_COMPU_METHOD 0 0 0 65000 ECU_ADDRESS 0x40004CE4 SYMBOL_LINK "xAdiaRamDataB" 356 /end MEASUREMENT
/begin MEASUREMENT SGM_RAM.eCodErr "Machine B punctual fault type" UBYTE eCodErr.Conversion 0 0 0 255 ECU_ADDRESS 0x40004CE8 SYMBOL_LINK "xAdiaRamDataB" 360 /end MEASUREMENT
/begin MEASUREMENT SGM_RAM.usrFaultCnt "Machine B faults counter" UWORD NO_COMPU_METHOD 0 0 0 65000 ECU_ADDRESS 0x40004CEE SYMBOL_LINK "xAdiaRamDataB" 366 /end MEASUREMENT
/begin MEASUREMENT EVRCOL_RAM.eCodErr "Machine B punctual fault type" UBYTE eCodErr.Conversion 0 0 0 255 ECU_ADDRESS 0x40004CF2 SYMBOL_LINK "xAdiaRamDataB" 370 /end MEASUREMENT
/begin MEASUREMENT EVRCOL_RAM.usrFaultCnt "Machine B faults counter" UWORD NO_COMPU_METHOD 0 0 0 65000 ECU_ADDRESS 0x40004CF8 SYMBOL_LINK "xAdiaRamDataB" 376 /end MEASUREMENT
/begin MEASUREMENT EVRCGND_RAM.eCodErr "Machine B punctual fault type" UBYTE eCodErr.Conversion 0 0 0 255 ECU_ADDRESS 0x40004CFC SYMBOL_LINK "xAdiaRamDataB" 380 /end MEASUREMENT
/begin MEASUREMENT EVRCGND_RAM.usrFaultCnt "Machine B faults counter" UWORD NO_COMPU_METHOD 0 0 0 65000 ECU_ADDRESS 0x40004D02 SYMBOL_LINK "xAdiaRamDataB" 386 /end MEASUREMENT
/begin MEASUREMENT EVRCVB_RAM.eCodErr "Machine B punctual fault type" UBYTE eCodErr.Conversion 0 0 0 255 ECU_ADDRESS 0x40004D06 SYMBOL_LINK "xAdiaRamDataB" 390 /end MEASUREMENT
/begin MEASUREMENT EVRCVB_RAM.usrFaultCnt "Machine B faults counter" UWORD NO_COMPU_METHOD 0 0 0 65000 ECU_ADDRESS 0x40004D0C SYMBOL_LINK "xAdiaRamDataB" 396 /end MEASUREMENT
/begin MEASUREMENT SPO_RAM.eCodErr "Machine B punctual fault type" UBYTE eCodErr.Conversion 0 0 0 255 ECU_ADDRESS 0x40004B9E SYMBOL_LINK "xAdiaRamDataB" 30 /end MEASUREMENT
/begin MEASUREMENT SPO_RAM.usrFaultCnt "Machine B faults counter" UWORD NO_COMPU_METHOD 0 0 0 65000 ECU_ADDRESS 0x40004BA4 SYMBOL_LINK "xAdiaRamDataB" 36 /end MEASUREMENT
/begin MEASUREMENT PRVCOL_RAM.eCodErr "Machine B punctual fault type" UBYTE eCodErr.Conversion 0 0 0 255 ECU_ADDRESS 0x40004D10 SYMBOL_LINK "xAdiaRamDataB" 400 /end MEASUREMENT
/begin MEASUREMENT PRVCOL_RAM.usrFaultCnt "Machine B faults counter" UWORD NO_COMPU_METHOD 0 0 0 65000 ECU_ADDRESS 0x40004D16 SYMBOL_LINK "xAdiaRamDataB" 406 /end MEASUREMENT
/begin MEASUREMENT PRVCGND_RAM.eCodErr "Machine B punctual fault type" UBYTE eCodErr.Conversion 0 0 0 255 ECU_ADDRESS 0x40004D1A SYMBOL_LINK "xAdiaRamDataB" 410 /end MEASUREMENT
/begin MEASUREMENT PRVCGND_RAM.usrFaultCnt "Machine B faults counter" UWORD NO_COMPU_METHOD 0 0 0 65000 ECU_ADDRESS 0x40004D20 SYMBOL_LINK "xAdiaRamDataB" 416 /end MEASUREMENT
/begin MEASUREMENT PRVCVB_RAM.eCodErr "Machine B punctual fault type" UBYTE eCodErr.Conversion 0 0 0 255 ECU_ADDRESS 0x40004D24 SYMBOL_LINK "xAdiaRamDataB" 420 /end MEASUREMENT
/begin MEASUREMENT PRVCVB_RAM.usrFaultCnt "Machine B faults counter" UWORD NO_COMPU_METHOD 0 0 0 65000 ECU_ADDRESS 0x40004D2A SYMBOL_LINK "xAdiaRamDataB" 426 /end MEASUREMENT
/begin MEASUREMENT LHR_RAM.eCodErr "Machine B punctual fault type" UBYTE eCodErr.Conversion 0 0 0 255 ECU_ADDRESS 0x40004D2E SYMBOL_LINK "xAdiaRamDataB" 430 /end MEASUREMENT
/begin MEASUREMENT LHR_RAM.usrFaultCnt "Machine B faults counter" UWORD NO_COMPU_METHOD 0 0 0 65000 ECU_ADDRESS 0x40004D34 SYMBOL_LINK "xAdiaRamDataB" 436 /end MEASUREMENT
/begin MEASUREMENT SPMP_RAM.eCodErr "Machine B punctual fault type" UBYTE eCodErr.Conversion 0 0 0 255 ECU_ADDRESS 0x40004D38 SYMBOL_LINK "xAdiaRamDataB" 440 /end MEASUREMENT
/begin MEASUREMENT SPMP_RAM.usrFaultCnt "Machine B faults counter" UWORD NO_COMPU_METHOD 0 0 0 65000 ECU_ADDRESS 0x40004D3E SYMBOL_LINK "xAdiaRamDataB" 446 /end MEASUREMENT
/begin MEASUREMENT STC1_RAM.eCodErr "Machine B punctual fault type" UBYTE eCodErr.Conversion 0 0 0 255 ECU_ADDRESS 0x40004D42 SYMBOL_LINK "xAdiaRamDataB" 450 /end MEASUREMENT
/begin MEASUREMENT STC1_RAM.usrFaultCnt "Machine B faults counter" UWORD NO_COMPU_METHOD 0 0 0 65000 ECU_ADDRESS 0x40004D48 SYMBOL_LINK "xAdiaRamDataB" 456 /end MEASUREMENT
/begin MEASUREMENT STC2_RAM.eCodErr "Machine B punctual fault type" UBYTE eCodErr.Conversion 0 0 0 255 ECU_ADDRESS 0x40004D4C SYMBOL_LINK "xAdiaRamDataB" 460 /end MEASUREMENT
/begin MEASUREMENT STC2_RAM.usrFaultCnt "Machine B faults counter" UWORD NO_COMPU_METHOD 0 0 0 65000 ECU_ADDRESS 0x40004D52 SYMBOL_LINK "xAdiaRamDataB" 466 /end MEASUREMENT
/begin MEASUREMENT VS1_RAM.eCodErr "Machine B punctual fault type" UBYTE eCodErr.Conversion 0 0 0 255 ECU_ADDRESS 0x40004D56 SYMBOL_LINK "xAdiaRamDataB" 470 /end MEASUREMENT
/begin MEASUREMENT VS1_RAM.usrFaultCnt "Machine B faults counter" UWORD NO_COMPU_METHOD 0 0 0 65000 ECU_ADDRESS 0x40004D5C SYMBOL_LINK "xAdiaRamDataB" 476 /end MEASUREMENT
/begin MEASUREMENT VS2_RAM.eCodErr "Machine B punctual fault type" UBYTE eCodErr.Conversion 0 0 0 255 ECU_ADDRESS 0x40004D60 SYMBOL_LINK "xAdiaRamDataB" 480 /end MEASUREMENT
/begin MEASUREMENT VS2_RAM.usrFaultCnt "Machine B faults counter" UWORD NO_COMPU_METHOD 0 0 0 65000 ECU_ADDRESS 0x40004D66 SYMBOL_LINK "xAdiaRamDataB" 486 /end MEASUREMENT
/begin MEASUREMENT VS3_RAM.eCodErr "Machine B punctual fault type" UBYTE eCodErr.Conversion 0 0 0 255 ECU_ADDRESS 0x40004D6A SYMBOL_LINK "xAdiaRamDataB" 490 /end MEASUREMENT
/begin MEASUREMENT VS3_RAM.usrFaultCnt "Machine B faults counter" UWORD NO_COMPU_METHOD 0 0 0 65000 ECU_ADDRESS 0x40004D70 SYMBOL_LINK "xAdiaRamDataB" 496 /end MEASUREMENT
/begin MEASUREMENT SPT_RAM.eCodErr "Machine B punctual fault type" UBYTE eCodErr.Conversion 0 0 0 255 ECU_ADDRESS 0x40004BA8 SYMBOL_LINK "xAdiaRamDataB" 40 /end MEASUREMENT
/begin MEASUREMENT SPT_RAM.usrFaultCnt "Machine B faults counter" UWORD NO_COMPU_METHOD 0 0 0 65000 ECU_ADDRESS 0x40004BAE SYMBOL_LINK "xAdiaRamDataB" 46 /end MEASUREMENT
/begin MEASUREMENT CLO1_RAM.eCodErr "Machine B punctual fault type" UBYTE eCodErr.Conversion 0 0 0 255 ECU_ADDRESS 0x40004D74 SYMBOL_LINK "xAdiaRamDataB" 500 /end MEASUREMENT
/begin MEASUREMENT CLO1_RAM.usrFaultCnt "Machine B faults counter" UWORD NO_COMPU_METHOD 0 0 0 65000 ECU_ADDRESS 0x40004D7A SYMBOL_LINK "xAdiaRamDataB" 506 /end MEASUREMENT
/begin MEASUREMENT CLO2_RAM.eCodErr "Machine B punctual fault type" UBYTE eCodErr.Conversion 0 0 0 255 ECU_ADDRESS 0x40004D7E SYMBOL_LINK "xAdiaRamDataB" 510 /end MEASUREMENT
/begin MEASUREMENT CLO2_RAM.usrFaultCnt "Machine B faults counter" UWORD NO_COMPU_METHOD 0 0 0 65000 ECU_ADDRESS 0x40004D84 SYMBOL_LINK "xAdiaRamDataB" 516 /end MEASUREMENT
/begin MEASUREMENT CLO3_RAM.eCodErr "Machine B punctual fault type" UBYTE eCodErr.Conversion 0 0 0 255 ECU_ADDRESS 0x40004D88 SYMBOL_LINK "xAdiaRamDataB" 520 /end MEASUREMENT
/begin MEASUREMENT CLO3_RAM.usrFaultCnt "Machine B faults counter" UWORD NO_COMPU_METHOD 0 0 0 65000 ECU_ADDRESS 0x40004D8E SYMBOL_LINK "xAdiaRamDataB" 526 /end MEASUREMENT
/begin MEASUREMENT CLO4_RAM.eCodErr "Machine B punctual fault type" UBYTE eCodErr.Conversion 0 0 0 255 ECU_ADDRESS 0x40004D92 SYMBOL_LINK "xAdiaRamDataB" 530 /end MEASUREMENT
/begin MEASUREMENT CLO4_RAM.usrFaultCnt "Machine B faults counter" UWORD NO_COMPU_METHOD 0 0 0 65000 ECU_ADDRESS 0x40004D98 SYMBOL_LINK "xAdiaRamDataB" 536 /end MEASUREMENT
/begin MEASUREMENT FAR02_RAM.eCodErr "Machine B punctual fault type" UBYTE eCodErr.Conversion 0 0 0 255 ECU_ADDRESS 0x40004D9C SYMBOL_LINK "xAdiaRamDataB" 540 /end MEASUREMENT
/begin MEASUREMENT FAR02_RAM.usrFaultCnt "Machine B faults counter" UWORD NO_COMPU_METHOD 0 0 0 65000 ECU_ADDRESS 0x40004DA2 SYMBOL_LINK "xAdiaRamDataB" 546 /end MEASUREMENT
/begin MEASUREMENT FARCH_RAM.eCodErr "Machine B punctual fault type" UBYTE eCodErr.Conversion 0 0 0 255 ECU_ADDRESS 0x40004DA6 SYMBOL_LINK "xAdiaRamDataB" 550 /end MEASUREMENT
/begin MEASUREMENT FARCH_RAM.usrFaultCnt "Machine B faults counter" UWORD NO_COMPU_METHOD 0 0 0 65000 ECU_ADDRESS 0x40004DAC SYMBOL_LINK "xAdiaRamDataB" 556 /end MEASUREMENT
/begin MEASUREMENT THRCVB_RAM.eCodErr "Machine B punctual fault type" UBYTE eCodErr.Conversion 0 0 0 255 ECU_ADDRESS 0x40004DB0 SYMBOL_LINK "xAdiaRamDataB" 560 /end MEASUREMENT
/begin MEASUREMENT THRCVB_RAM.usrFaultCnt "Machine B faults counter" UWORD NO_COMPU_METHOD 0 0 0 65000 ECU_ADDRESS 0x40004DB6 SYMBOL_LINK "xAdiaRamDataB" 566 /end MEASUREMENT
/begin MEASUREMENT THRCGND_RAM.eCodErr "Machine B punctual fault type" UBYTE eCodErr.Conversion 0 0 0 255 ECU_ADDRESS 0x40004DBA SYMBOL_LINK "xAdiaRamDataB" 570 /end MEASUREMENT
/begin MEASUREMENT THRCGND_RAM.usrFaultCnt "Machine B faults counter" UWORD NO_COMPU_METHOD 0 0 0 65000 ECU_ADDRESS 0x40004DC0 SYMBOL_LINK "xAdiaRamDataB" 576 /end MEASUREMENT
/begin MEASUREMENT AIR2H_RAM.eCodErr "Machine B punctual fault type" UBYTE eCodErr.Conversion 0 0 0 255 ECU_ADDRESS 0x40004DC4 SYMBOL_LINK "xAdiaRamDataB" 580 /end MEASUREMENT
/begin MEASUREMENT AIR2H_RAM.usrFaultCnt "Machine B faults counter" UWORD NO_COMPU_METHOD 0 0 0 65000 ECU_ADDRESS 0x40004DCA SYMBOL_LINK "xAdiaRamDataB" 586 /end MEASUREMENT
/begin MEASUREMENT AIR2L_RAM.eCodErr "Machine B punctual fault type" UBYTE eCodErr.Conversion 0 0 0 255 ECU_ADDRESS 0x40004DCE SYMBOL_LINK "xAdiaRamDataB" 590 /end MEASUREMENT
/begin MEASUREMENT AIR2L_RAM.usrFaultCnt "Machine B faults counter" UWORD NO_COMPU_METHOD 0 0 0 65000 ECU_ADDRESS 0x40004DD4 SYMBOL_LINK "xAdiaRamDataB" 596 /end MEASUREMENT
/begin MEASUREMENT STM_RAM.eCodErr "Machine B punctual fault type" UBYTE eCodErr.Conversion 0 0 0 255 ECU_ADDRESS 0x40004BB2 SYMBOL_LINK "xAdiaRamDataB" 50 /end MEASUREMENT
/begin MEASUREMENT STM_RAM.usrFaultCnt "Machine B faults counter" UWORD NO_COMPU_METHOD 0 0 0 65000 ECU_ADDRESS 0x40004BB8 SYMBOL_LINK "xAdiaRamDataB" 56 /end MEASUREMENT
/begin MEASUREMENT SAFPON_RAM.eCodErr "Machine B punctual fault type" UBYTE eCodErr.Conversion 0 0 0 255 ECU_ADDRESS 0x40004DD8 SYMBOL_LINK "xAdiaRamDataB" 600 /end MEASUREMENT
/begin MEASUREMENT SAFPON_RAM.usrFaultCnt "Machine B faults counter" UWORD NO_COMPU_METHOD 0 0 0 65000 ECU_ADDRESS 0x40004DDE SYMBOL_LINK "xAdiaRamDataB" 606 /end MEASUREMENT
/begin MEASUREMENT SAFRTF_RAM.eCodErr "Machine B punctual fault type" UBYTE eCodErr.Conversion 0 0 0 255 ECU_ADDRESS 0x40004DE2 SYMBOL_LINK "xAdiaRamDataB" 610 /end MEASUREMENT
/begin MEASUREMENT SAFRTF_RAM.usrFaultCnt "Machine B faults counter" UWORD NO_COMPU_METHOD 0 0 0 65000 ECU_ADDRESS 0x40004DE8 SYMBOL_LINK "xAdiaRamDataB" 616 /end MEASUREMENT
/begin MEASUREMENT LHR2_RAM.eCodErr "Machine B punctual fault type" UBYTE eCodErr.Conversion 0 0 0 255 ECU_ADDRESS 0x40004DEC SYMBOL_LINK "xAdiaRamDataB" 620 /end MEASUREMENT
/begin MEASUREMENT LHR2_RAM.usrFaultCnt "Machine B faults counter" UWORD NO_COMPU_METHOD 0 0 0 65000 ECU_ADDRESS 0x40004DF2 SYMBOL_LINK "xAdiaRamDataB" 626 /end MEASUREMENT
/begin MEASUREMENT FAN1_RAM.eCodErr "Machine B punctual fault type" UBYTE eCodErr.Conversion 0 0 0 255 ECU_ADDRESS 0x40004DF6 SYMBOL_LINK "xAdiaRamDataB" 630 /end MEASUREMENT
/begin MEASUREMENT FAN1_RAM.usrFaultCnt "Machine B faults counter" UWORD NO_COMPU_METHOD 0 0 0 65000 ECU_ADDRESS 0x40004DFC SYMBOL_LINK "xAdiaRamDataB" 636 /end MEASUREMENT
/begin MEASUREMENT FAN2_RAM.eCodErr "Machine B punctual fault type" UBYTE eCodErr.Conversion 0 0 0 255 ECU_ADDRESS 0x40004E00 SYMBOL_LINK "xAdiaRamDataB" 640 /end MEASUREMENT
/begin MEASUREMENT FAN2_RAM.usrFaultCnt "Machine B faults counter" UWORD NO_COMPU_METHOD 0 0 0 65000 ECU_ADDRESS 0x40004E06 SYMBOL_LINK "xAdiaRamDataB" 646 /end MEASUREMENT
/begin MEASUREMENT TH2H_RAM.eCodErr "Machine B punctual fault type" UBYTE eCodErr.Conversion 0 0 0 255 ECU_ADDRESS 0x40004E0A SYMBOL_LINK "xAdiaRamDataB" 650 /end MEASUREMENT
/begin MEASUREMENT TH2H_RAM.usrFaultCnt "Machine B faults counter" UWORD NO_COMPU_METHOD 0 0 0 65000 ECU_ADDRESS 0x40004E10 SYMBOL_LINK "xAdiaRamDataB" 656 /end MEASUREMENT
/begin MEASUREMENT PO2L_RAM.eCodErr "Machine B punctual fault type" UBYTE eCodErr.Conversion 0 0 0 255 ECU_ADDRESS 0x40004E14 SYMBOL_LINK "xAdiaRamDataB" 660 /end MEASUREMENT
/begin MEASUREMENT PO2L_RAM.usrFaultCnt "Machine B faults counter" UWORD NO_COMPU_METHOD 0 0 0 65000 ECU_ADDRESS 0x40004E1A SYMBOL_LINK "xAdiaRamDataB" 666 /end MEASUREMENT
/begin MEASUREMENT THRST_RAM.eCodErr "Machine B punctual fault type" UBYTE eCodErr.Conversion 0 0 0 255 ECU_ADDRESS 0x40004E1E SYMBOL_LINK "xAdiaRamDataB" 670 /end MEASUREMENT
/begin MEASUREMENT THRST_RAM.usrFaultCnt "Machine B faults counter" UWORD NO_COMPU_METHOD 0 0 0 65000 ECU_ADDRESS 0x40004E24 SYMBOL_LINK "xAdiaRamDataB" 676 /end MEASUREMENT
/begin MEASUREMENT SPEED_RAM.eCodErr "Machine B punctual fault type" UBYTE eCodErr.Conversion 0 0 0 255 ECU_ADDRESS 0x40004E28 SYMBOL_LINK "xAdiaRamDataB" 680 /end MEASUREMENT
/begin MEASUREMENT SPEED_RAM.usrFaultCnt "Machine B faults counter" UWORD NO_COMPU_METHOD 0 0 0 65000 ECU_ADDRESS 0x40004E2E SYMBOL_LINK "xAdiaRamDataB" 686 /end MEASUREMENT
/begin MEASUREMENT THRDR_RAM.eCodErr "Machine B punctual fault type" UBYTE eCodErr.Conversion 0 0 0 255 ECU_ADDRESS 0x40004E32 SYMBOL_LINK "xAdiaRamDataB" 690 /end MEASUREMENT
/begin MEASUREMENT THRDR_RAM.usrFaultCnt "Machine B faults counter" UWORD NO_COMPU_METHOD 0 0 0 65000 ECU_ADDRESS 0x40004E38 SYMBOL_LINK "xAdiaRamDataB" 696 /end MEASUREMENT
/begin MEASUREMENT STC_RAM.eCodErr "Machine B punctual fault type" UBYTE eCodErr.Conversion 0 0 0 255 ECU_ADDRESS 0x40004BBC SYMBOL_LINK "xAdiaRamDataB" 60 /end MEASUREMENT
/begin MEASUREMENT STC_RAM.usrFaultCnt "Machine B faults counter" UWORD NO_COMPU_METHOD 0 0 0 65000 ECU_ADDRESS 0x40004BC2 SYMBOL_LINK "xAdiaRamDataB" 66 /end MEASUREMENT
/begin MEASUREMENT STRCGNDOL_RAM.eCodErr "Machine B punctual fault type" UBYTE eCodErr.Conversion 0 0 0 255 ECU_ADDRESS 0x40004E3C SYMBOL_LINK "xAdiaRamDataB" 700 /end MEASUREMENT
/begin MEASUREMENT STRCGNDOL_RAM.usrFaultCnt "Machine B faults counter" UWORD NO_COMPU_METHOD 0 0 0 65000 ECU_ADDRESS 0x40004E42 SYMBOL_LINK "xAdiaRamDataB" 706 /end MEASUREMENT
/begin MEASUREMENT STRCVB_RAM.eCodErr "Machine B punctual fault type" UBYTE eCodErr.Conversion 0 0 0 255 ECU_ADDRESS 0x40004E46 SYMBOL_LINK "xAdiaRamDataB" 710 /end MEASUREMENT
/begin MEASUREMENT STRCVB_RAM.usrFaultCnt "Machine B faults counter" UWORD NO_COMPU_METHOD 0 0 0 65000 ECU_ADDRESS 0x40004E4C SYMBOL_LINK "xAdiaRamDataB" 716 /end MEASUREMENT
/begin MEASUREMENT SPP01_RAM.eCodErr "Machine B punctual fault type" UBYTE eCodErr.Conversion 0 0 0 255 ECU_ADDRESS 0x40004E50 SYMBOL_LINK "xAdiaRamDataB" 720 /end MEASUREMENT
/begin MEASUREMENT SPP01_RAM.usrFaultCnt "Machine B faults counter" UWORD NO_COMPU_METHOD 0 0 0 65000 ECU_ADDRESS 0x40004E56 SYMBOL_LINK "xAdiaRamDataB" 726 /end MEASUREMENT
/begin MEASUREMENT SPP02_RAM.eCodErr "Machine B punctual fault type" UBYTE eCodErr.Conversion 0 0 0 255 ECU_ADDRESS 0x40004E5A SYMBOL_LINK "xAdiaRamDataB" 730 /end MEASUREMENT
/begin MEASUREMENT SPP02_RAM.usrFaultCnt "Machine B faults counter" UWORD NO_COMPU_METHOD 0 0 0 65000 ECU_ADDRESS 0x40004E60 SYMBOL_LINK "xAdiaRamDataB" 736 /end MEASUREMENT
/begin MEASUREMENT SPPC2_RAM.eCodErr "Machine B punctual fault type" UBYTE eCodErr.Conversion 0 0 0 255 ECU_ADDRESS 0x40004E64 SYMBOL_LINK "xAdiaRamDataB" 740 /end MEASUREMENT
/begin MEASUREMENT SPPC2_RAM.usrFaultCnt "Machine B faults counter" UWORD NO_COMPU_METHOD 0 0 0 65000 ECU_ADDRESS 0x40004E6A SYMBOL_LINK "xAdiaRamDataB" 746 /end MEASUREMENT
/begin MEASUREMENT SPPC1_RAM.eCodErr "Machine B punctual fault type" UBYTE eCodErr.Conversion 0 0 0 255 ECU_ADDRESS 0x40004E6E SYMBOL_LINK "xAdiaRamDataB" 750 /end MEASUREMENT
/begin MEASUREMENT SPPC1_RAM.usrFaultCnt "Machine B faults counter" UWORD NO_COMPU_METHOD 0 0 0 65000 ECU_ADDRESS 0x40004E74 SYMBOL_LINK "xAdiaRamDataB" 756 /end MEASUREMENT
/begin MEASUREMENT SPPCH_RAM.eCodErr "Machine B punctual fault type" UBYTE eCodErr.Conversion 0 0 0 255 ECU_ADDRESS 0x40004E78 SYMBOL_LINK "xAdiaRamDataB" 760 /end MEASUREMENT
/begin MEASUREMENT SPPCH_RAM.usrFaultCnt "Machine B faults counter" UWORD NO_COMPU_METHOD 0 0 0 65000 ECU_ADDRESS 0x40004E7E SYMBOL_LINK "xAdiaRamDataB" 766 /end MEASUREMENT
/begin MEASUREMENT BRKCH_RAM.eCodErr "Machine B punctual fault type" UBYTE eCodErr.Conversion 0 0 0 255 ECU_ADDRESS 0x40004E82 SYMBOL_LINK "xAdiaRamDataB" 770 /end MEASUREMENT
/begin MEASUREMENT BRKCH_RAM.usrFaultCnt "Machine B faults counter" UWORD NO_COMPU_METHOD 0 0 0 65000 ECU_ADDRESS 0x40004E88 SYMBOL_LINK "xAdiaRamDataB" 776 /end MEASUREMENT
/begin MEASUREMENT SUO_RAM.eCodErr "Machine B punctual fault type" UBYTE eCodErr.Conversion 0 0 0 255 ECU_ADDRESS 0x40004E8C SYMBOL_LINK "xAdiaRamDataB" 780 /end MEASUREMENT
/begin MEASUREMENT SUO_RAM.usrFaultCnt "Machine B faults counter" UWORD NO_COMPU_METHOD 0 0 0 65000 ECU_ADDRESS 0x40004E92 SYMBOL_LINK "xAdiaRamDataB" 786 /end MEASUREMENT
/begin MEASUREMENT UDP_RAM.eCodErr "Machine B punctual fault type" UBYTE eCodErr.Conversion 0 0 0 255 ECU_ADDRESS 0x40004E96 SYMBOL_LINK "xAdiaRamDataB" 790 /end MEASUREMENT
/begin MEASUREMENT UDP_RAM.usrFaultCnt "Machine B faults counter" UWORD NO_COMPU_METHOD 0 0 0 65000 ECU_ADDRESS 0x40004E9C SYMBOL_LINK "xAdiaRamDataB" 796 /end MEASUREMENT
/begin MEASUREMENT SPM_RAM.eCodErr "Machine B punctual fault type" UBYTE eCodErr.Conversion 0 0 0 255 ECU_ADDRESS 0x40004BC6 SYMBOL_LINK "xAdiaRamDataB" 70 /end MEASUREMENT
/begin MEASUREMENT SPM_RAM.usrFaultCnt "Machine B faults counter" UWORD NO_COMPU_METHOD 0 0 0 65000 ECU_ADDRESS 0x40004BCC SYMBOL_LINK "xAdiaRamDataB" 76 /end MEASUREMENT
/begin MEASUREMENT UHR_RAM.eCodErr "Machine B punctual fault type" UBYTE eCodErr.Conversion 0 0 0 255 ECU_ADDRESS 0x40004EA0 SYMBOL_LINK "xAdiaRamDataB" 800 /end MEASUREMENT
/begin MEASUREMENT UHR_RAM.usrFaultCnt "Machine B faults counter" UWORD NO_COMPU_METHOD 0 0 0 65000 ECU_ADDRESS 0x40004EA6 SYMBOL_LINK "xAdiaRamDataB" 806 /end MEASUREMENT
/begin MEASUREMENT SK1_RAM.eCodErr "Machine B punctual fault type" UBYTE eCodErr.Conversion 0 0 0 255 ECU_ADDRESS 0x40004EAA SYMBOL_LINK "xAdiaRamDataB" 810 /end MEASUREMENT
/begin MEASUREMENT SK1_RAM.usrFaultCnt "Machine B faults counter" UWORD NO_COMPU_METHOD 0 0 0 65000 ECU_ADDRESS 0x40004EB0 SYMBOL_LINK "xAdiaRamDataB" 816 /end MEASUREMENT
/begin MEASUREMENT SK2_RAM.eCodErr "Machine B punctual fault type" UBYTE eCodErr.Conversion 0 0 0 255 ECU_ADDRESS 0x40004EB4 SYMBOL_LINK "xAdiaRamDataB" 820 /end MEASUREMENT
/begin MEASUREMENT SK2_RAM.usrFaultCnt "Machine B faults counter" UWORD NO_COMPU_METHOD 0 0 0 65000 ECU_ADDRESS 0x40004EBA SYMBOL_LINK "xAdiaRamDataB" 826 /end MEASUREMENT
/begin MEASUREMENT SK3_RAM.eCodErr "Machine B punctual fault type" UBYTE eCodErr.Conversion 0 0 0 255 ECU_ADDRESS 0x40004EBE SYMBOL_LINK "xAdiaRamDataB" 830 /end MEASUREMENT
/begin MEASUREMENT SK3_RAM.usrFaultCnt "Machine B faults counter" UWORD NO_COMPU_METHOD 0 0 0 65000 ECU_ADDRESS 0x40004EC4 SYMBOL_LINK "xAdiaRamDataB" 836 /end MEASUREMENT
/begin MEASUREMENT SK4_RAM.eCodErr "Machine B punctual fault type" UBYTE eCodErr.Conversion 0 0 0 255 ECU_ADDRESS 0x40004EC8 SYMBOL_LINK "xAdiaRamDataB" 840 /end MEASUREMENT
/begin MEASUREMENT SK4_RAM.usrFaultCnt "Machine B faults counter" UWORD NO_COMPU_METHOD 0 0 0 65000 ECU_ADDRESS 0x40004ECE SYMBOL_LINK "xAdiaRamDataB" 846 /end MEASUREMENT
/begin MEASUREMENT SK5_RAM.eCodErr "Machine B punctual fault type" UBYTE eCodErr.Conversion 0 0 0 255 ECU_ADDRESS 0x40004ED2 SYMBOL_LINK "xAdiaRamDataB" 850 /end MEASUREMENT
/begin MEASUREMENT SK5_RAM.usrFaultCnt "Machine B faults counter" UWORD NO_COMPU_METHOD 0 0 0 65000 ECU_ADDRESS 0x40004ED8 SYMBOL_LINK "xAdiaRamDataB" 856 /end MEASUREMENT
/begin MEASUREMENT SK6_RAM.eCodErr "Machine B punctual fault type" UBYTE eCodErr.Conversion 0 0 0 255 ECU_ADDRESS 0x40004EDC SYMBOL_LINK "xAdiaRamDataB" 860 /end MEASUREMENT
/begin MEASUREMENT SK6_RAM.usrFaultCnt "Machine B faults counter" UWORD NO_COMPU_METHOD 0 0 0 65000 ECU_ADDRESS 0x40004EE2 SYMBOL_LINK "xAdiaRamDataB" 866 /end MEASUREMENT
/begin MEASUREMENT SK7_RAM.eCodErr "Machine B punctual fault type" UBYTE eCodErr.Conversion 0 0 0 255 ECU_ADDRESS 0x40004EE6 SYMBOL_LINK "xAdiaRamDataB" 870 /end MEASUREMENT
/begin MEASUREMENT SK7_RAM.usrFaultCnt "Machine B faults counter" UWORD NO_COMPU_METHOD 0 0 0 65000 ECU_ADDRESS 0x40004EEC SYMBOL_LINK "xAdiaRamDataB" 876 /end MEASUREMENT
/begin MEASUREMENT SK8_RAM.eCodErr "Machine B punctual fault type" UBYTE eCodErr.Conversion 0 0 0 255 ECU_ADDRESS 0x40004EF0 SYMBOL_LINK "xAdiaRamDataB" 880 /end MEASUREMENT
/begin MEASUREMENT SK8_RAM.usrFaultCnt "Machine B faults counter" UWORD NO_COMPU_METHOD 0 0 0 65000 ECU_ADDRESS 0x40004EF6 SYMBOL_LINK "xAdiaRamDataB" 886 /end MEASUREMENT
/begin MEASUREMENT WRNL_RAM.eCodErr "Machine B punctual fault type" UBYTE eCodErr.Conversion 0 0 0 255 ECU_ADDRESS 0x40004EFA SYMBOL_LINK "xAdiaRamDataB" 890 /end MEASUREMENT
/begin MEASUREMENT WRNL_RAM.usrFaultCnt "Machine B faults counter" UWORD NO_COMPU_METHOD 0 0 0 65000 ECU_ADDRESS 0x40004F00 SYMBOL_LINK "xAdiaRamDataB" 896 /end MEASUREMENT
/begin MEASUREMENT SPB_RAM.eCodErr "Machine B punctual fault type" UBYTE eCodErr.Conversion 0 0 0 255 ECU_ADDRESS 0x40004BD0 SYMBOL_LINK "xAdiaRamDataB" 80 /end MEASUREMENT
/begin MEASUREMENT SPB_RAM.usrFaultCnt "Machine B faults counter" UWORD NO_COMPU_METHOD 0 0 0 65000 ECU_ADDRESS 0x40004BD6 SYMBOL_LINK "xAdiaRamDataB" 86 /end MEASUREMENT
/begin MEASUREMENT REDL_RAM.eCodErr "Machine B punctual fault type" UBYTE eCodErr.Conversion 0 0 0 255 ECU_ADDRESS 0x40004F04 SYMBOL_LINK "xAdiaRamDataB" 900 /end MEASUREMENT
/begin MEASUREMENT REDL_RAM.usrFaultCnt "Machine B faults counter" UWORD NO_COMPU_METHOD 0 0 0 65000 ECU_ADDRESS 0x40004F0A SYMBOL_LINK "xAdiaRamDataB" 906 /end MEASUREMENT
/begin MEASUREMENT MIL_RAM.eCodErr "Machine B punctual fault type" UBYTE eCodErr.Conversion 0 0 0 255 ECU_ADDRESS 0x40004F0E SYMBOL_LINK "xAdiaRamDataB" 910 /end MEASUREMENT
/begin MEASUREMENT MIL_RAM.usrFaultCnt "Machine B faults counter" UWORD NO_COMPU_METHOD 0 0 0 65000 ECU_ADDRESS 0x40004F14 SYMBOL_LINK "xAdiaRamDataB" 916 /end MEASUREMENT
/begin MEASUREMENT STE_RAM.eCodErr "Machine B punctual fault type" UBYTE eCodErr.Conversion 0 0 0 255 ECU_ADDRESS 0x40004F18 SYMBOL_LINK "xAdiaRamDataB" 920 /end MEASUREMENT
/begin MEASUREMENT STE_RAM.usrFaultCnt "Machine B faults counter" UWORD NO_COMPU_METHOD 0 0 0 65000 ECU_ADDRESS 0x40004F1E SYMBOL_LINK "xAdiaRamDataB" 926 /end MEASUREMENT
/begin MEASUREMENT TE2H_RAM.eCodErr "Machine B punctual fault type" UBYTE eCodErr.Conversion 0 0 0 255 ECU_ADDRESS 0x40004F22 SYMBOL_LINK "xAdiaRamDataB" 930 /end MEASUREMENT
/begin MEASUREMENT TE2H_RAM.usrFaultCnt "Machine B faults counter" UWORD NO_COMPU_METHOD 0 0 0 65000 ECU_ADDRESS 0x40004F28 SYMBOL_LINK "xAdiaRamDataB" 936 /end MEASUREMENT
/begin MEASUREMENT STX_RAM.eCodErr "Machine B punctual fault type" UBYTE eCodErr.Conversion 0 0 0 255 ECU_ADDRESS 0x40004F2C SYMBOL_LINK "xAdiaRamDataB" 940 /end MEASUREMENT
/begin MEASUREMENT STX_RAM.usrFaultCnt "Machine B faults counter" UWORD NO_COMPU_METHOD 0 0 0 65000 ECU_ADDRESS 0x40004F32 SYMBOL_LINK "xAdiaRamDataB" 946 /end MEASUREMENT
/begin MEASUREMENT MD1_RAM.eCodErr "Machine B punctual fault type" UBYTE eCodErr.Conversion 0 0 0 255 ECU_ADDRESS 0x40004F36 SYMBOL_LINK "xAdiaRamDataB" 950 /end MEASUREMENT
/begin MEASUREMENT MD1_RAM.usrFaultCnt "Machine B faults counter" UWORD NO_COMPU_METHOD 0 0 0 65000 ECU_ADDRESS 0x40004F3C SYMBOL_LINK "xAdiaRamDataB" 956 /end MEASUREMENT
/begin MEASUREMENT MD2_RAM.eCodErr "Machine B punctual fault type" UBYTE eCodErr.Conversion 0 0 0 255 ECU_ADDRESS 0x40004F40 SYMBOL_LINK "xAdiaRamDataB" 960 /end MEASUREMENT
/begin MEASUREMENT MD2_RAM.usrFaultCnt "Machine B faults counter" UWORD NO_COMPU_METHOD 0 0 0 65000 ECU_ADDRESS 0x40004F46 SYMBOL_LINK "xAdiaRamDataB" 966 /end MEASUREMENT
/begin MEASUREMENT MD3_RAM.eCodErr "Machine B punctual fault type" UBYTE eCodErr.Conversion 0 0 0 255 ECU_ADDRESS 0x40004F4A SYMBOL_LINK "xAdiaRamDataB" 970 /end MEASUREMENT
/begin MEASUREMENT MD3_RAM.usrFaultCnt "Machine B faults counter" UWORD NO_COMPU_METHOD 0 0 0 65000 ECU_ADDRESS 0x40004F50 SYMBOL_LINK "xAdiaRamDataB" 976 /end MEASUREMENT
/begin MEASUREMENT MD4_RAM.eCodErr "Machine B punctual fault type" UBYTE eCodErr.Conversion 0 0 0 255 ECU_ADDRESS 0x40004F54 SYMBOL_LINK "xAdiaRamDataB" 980 /end MEASUREMENT
/begin MEASUREMENT MD4_RAM.usrFaultCnt "Machine B faults counter" UWORD NO_COMPU_METHOD 0 0 0 65000 ECU_ADDRESS 0x40004F5A SYMBOL_LINK "xAdiaRamDataB" 986 /end MEASUREMENT
/begin MEASUREMENT MD5_RAM.eCodErr "Machine B punctual fault type" UBYTE eCodErr.Conversion 0 0 0 255 ECU_ADDRESS 0x40004F5E SYMBOL_LINK "xAdiaRamDataB" 990 /end MEASUREMENT
/begin MEASUREMENT MD5_RAM.usrFaultCnt "Machine B faults counter" UWORD NO_COMPU_METHOD 0 0 0 65000 ECU_ADDRESS 0x40004F64 SYMBOL_LINK "xAdiaRamDataB" 996 /end MEASUREMENT
/begin MEASUREMENT SPS_RAM.eCodErr "Machine B punctual fault type" UBYTE eCodErr.Conversion 0 0 0 255 ECU_ADDRESS 0x40004BDA SYMBOL_LINK "xAdiaRamDataB" 90 /end MEASUREMENT
/begin MEASUREMENT SPS_RAM.usrFaultCnt "Machine B faults counter" UWORD NO_COMPU_METHOD 0 0 0 65000 ECU_ADDRESS 0x40004BE0 SYMBOL_LINK "xAdiaRamDataB" 96 /end MEASUREMENT
/begin MEASUREMENT STC3_RAM.eCodErr "Machine C punctual fault type" UBYTE eCodErr.Conversion 0 0 0 255 ECU_ADDRESS 0x40005012 SYMBOL_LINK "xAdiaRamDataC" 0 /end MEASUREMENT
/begin MEASUREMENT MFLV_RAM.eCodErr "Machine C punctual fault type" UBYTE eCodErr.Conversion 0 0 0 255 ECU_ADDRESS 0x40005062 SYMBOL_LINK "xAdiaRamDataC" 80 /end MEASUREMENT
/begin MEASUREMENT CTSP_RAM.eCodErr "Machine C punctual fault type" UBYTE eCodErr.Conversion 0 0 0 255 ECU_ADDRESS 0x4000506A SYMBOL_LINK "xAdiaRamDataC" 88 /end MEASUREMENT
/begin MEASUREMENT CTST_RAM.eCodErr "Machine C punctual fault type" UBYTE eCodErr.Conversion 0 0 0 255 ECU_ADDRESS 0x40005072 SYMBOL_LINK "xAdiaRamDataC" 96 /end MEASUREMENT
/begin MEASUREMENT VSS_RAM.eCodErr "Machine C punctual fault type" UBYTE eCodErr.Conversion 0 0 0 255 ECU_ADDRESS 0x4000507A SYMBOL_LINK "xAdiaRamDataC" 104 /end MEASUREMENT
/begin MEASUREMENT SAFRTI_RAM.eCodErr "Machine C punctual fault type" UBYTE eCodErr.Conversion 0 0 0 255 ECU_ADDRESS 0x40005082 SYMBOL_LINK "xAdiaRamDataC" 112 /end MEASUREMENT
/begin MEASUREMENT SLO_RAM.eCodErr "Machine C punctual fault type" UBYTE eCodErr.Conversion 0 0 0 255 ECU_ADDRESS 0x4000501A SYMBOL_LINK "xAdiaRamDataC" 8 /end MEASUREMENT
/begin MEASUREMENT LRN01_RAM.eCodErr "Machine C punctual fault type" UBYTE eCodErr.Conversion 0 0 0 255 ECU_ADDRESS 0x40005022 SYMBOL_LINK "xAdiaRamDataC" 16 /end MEASUREMENT
/begin MEASUREMENT LRN02_RAM.eCodErr "Machine C punctual fault type" UBYTE eCodErr.Conversion 0 0 0 255 ECU_ADDRESS 0x4000502A SYMBOL_LINK "xAdiaRamDataC" 24 /end MEASUREMENT
/begin MEASUREMENT LRN03_RAM.eCodErr "Machine C punctual fault type" UBYTE eCodErr.Conversion 0 0 0 255 ECU_ADDRESS 0x40005032 SYMBOL_LINK "xAdiaRamDataC" 32 /end MEASUREMENT
/begin MEASUREMENT SFM_RAM.eCodErr "Machine C punctual fault type" UBYTE eCodErr.Conversion 0 0 0 255 ECU_ADDRESS 0x4000503A SYMBOL_LINK "xAdiaRamDataC" 40 /end MEASUREMENT
/begin MEASUREMENT SFR_RAM.eCodErr "Machine C punctual fault type" UBYTE eCodErr.Conversion 0 0 0 255 ECU_ADDRESS 0x40005042 SYMBOL_LINK "xAdiaRamDataC" 48 /end MEASUREMENT
/begin MEASUREMENT ADAT_RAM.eCodErr "Machine C punctual fault type" UBYTE eCodErr.Conversion 0 0 0 255 ECU_ADDRESS 0x4000504A SYMBOL_LINK "xAdiaRamDataC" 56 /end MEASUREMENT
/begin MEASUREMENT ADAT2_RAM.eCodErr "Machine C punctual fault type" UBYTE eCodErr.Conversion 0 0 0 255 ECU_ADDRESS 0x40005052 SYMBOL_LINK "xAdiaRamDataC" 64 /end MEASUREMENT
/begin MEASUREMENT FAR12_RAM.eCodErr "Machine C punctual fault type" UBYTE eCodErr.Conversion 0 0 0 255 ECU_ADDRESS 0x4000505A SYMBOL_LINK "xAdiaRamDataC" 72 /end MEASUREMENT
/begin MEASUREMENT STOH_RAM.eCodErr "Machine D punctual fault type" UBYTE eCodErr.Conversion 0 0 0 255 ECU_ADDRESS 0x4000508A SYMBOL_LINK "xAdiaRamDataD" 0 /end MEASUREMENT
/begin MEASUREMENT STOH_RAM.eErrSt "Machine D error state" UBYTE eErrSt.Conversion 0 0 0 255 ECU_ADDRESS 0x40005090 SYMBOL_LINK "xAdiaRamDataD" 6 /end MEASUREMENT
/begin MEASUREMENT xAutoTbEe.bAdatFltOldEEP "Automa related to IDN_ADAT in CONFIRMED state" UBYTE NO_COMPU_METHOD 0 0 0 1 ECU_ADDRESS 0x4000BC5D SYMBOL_LINK "xAutoTbEe" 513 /end MEASUREMENT
/begin MEASUREMENT xAutoTbEe.bPrimaAttivazione "Adaptivity first activation flag (1-active)" UBYTE NO_COMPU_METHOD 0 0 0 1 ECU_ADDRESS 0x4000BC5C SYMBOL_LINK "xAutoTbEe" 512 /end MEASUREMENT
/begin MEASUREMENT xAutoTbEe.s16MappaAdat "Adaptivity correction map" SWORD s16MappaAdat.Conversion 0 0 -0.25 0.25 ECU_ADDRESS 0x4000BA5C MATRIX_DIM 8 16 SYMBOL_LINK "xAutoTbEe" 0 /end MEASUREMENT
/begin MEASUREMENT xAutoTbEe.u16MappaAdatFreq "Adaptivity occurences map" UWORD NO_COMPU_METHOD 0 0 0 65535 ECU_ADDRESS 0x4000BB5C MATRIX_DIM 8 16 SYMBOL_LINK "xAutoTbEe" 256 /end MEASUREMENT
/begin MEASUREMENT xAutoTbEe.u8AdatConfCntEEP "ADAT counter, when it\'s in CONFIRMED state" UBYTE NO_COMPU_METHOD 0 0 0 255 ECU_ADDRESS 0x4000BC5E SYMBOL_LINK "xAutoTbEe" 514 /end MEASUREMENT
/begin MEASUREMENT xDiagMgm_AcClutch_PresRed_OD.eDiagStatus "Diagnosis failure code" UBYTE eDiagStatus.Conversion 0 0 0 255 ECU_ADDRESS 0x400019FE SYMBOL_LINK "xDiagMgm_AcClutch_PresRed_OD" 0 /end MEASUREMENT
/begin MEASUREMENT xDiagMgm_AcClutch_PresRed_OD.u16CntGenericError "Current Number of Generic Error" UWORD NO_COMPU_METHOD 0 0 0 65000 ECU_ADDRESS 0x40001A02 SYMBOL_LINK "xDiagMgm_AcClutch_PresRed_OD" 4 /end MEASUREMENT
/begin MEASUREMENT xDiagMgm_AcClutch_PresRed_OD.u16CntLoadEnableError "Current Number of Load Enable Error" UWORD NO_COMPU_METHOD 0 0 0 65000 ECU_ADDRESS 0x40001A04 SYMBOL_LINK "xDiagMgm_AcClutch_PresRed_OD" 6 /end MEASUREMENT
/begin MEASUREMENT xDiagMgm_AcClutch_PresRed_OD.u16CntReset "Current Number of diag Reset " UWORD NO_COMPU_METHOD 0 0 0 65000 ECU_ADDRESS 0x40001A00 SYMBOL_LINK "xDiagMgm_AcClutch_PresRed_OD" 2 /end MEASUREMENT
/begin MEASUREMENT xDiagMgm_AcClutch_PresRed_OD.u16ThrReset "Maximum number of diag Reset allowed (zero means NO DIAG enable)" UWORD NO_COMPU_METHOD 0 0 0 65000 ECU_ADDRESS 0x40001A06 SYMBOL_LINK "xDiagMgm_AcClutch_PresRed_OD" 8 /end MEASUREMENT
/begin MEASUREMENT xDiagMgm_BlowBy_OF.eDiagStatus "Diagnosis failure code" UBYTE eDiagStatus.Conversion 0 0 0 255 ECU_ADDRESS 0x40001A6C SYMBOL_LINK "xDiagMgm_BlowBy_OF" 0 /end MEASUREMENT
/begin MEASUREMENT xDiagMgm_BlowBy_OF.u16CntGenericError "Current Number of Generic Error" UWORD NO_COMPU_METHOD 0 0 0 65000 ECU_ADDRESS 0x40001A70 SYMBOL_LINK "xDiagMgm_BlowBy_OF" 4 /end MEASUREMENT
/begin MEASUREMENT xDiagMgm_BlowBy_OF.u16CntLoadEnableError "Current Number of Load Enable Error" UWORD NO_COMPU_METHOD 0 0 0 65000 ECU_ADDRESS 0x40001A72 SYMBOL_LINK "xDiagMgm_BlowBy_OF" 6 /end MEASUREMENT
/begin MEASUREMENT xDiagMgm_BlowBy_OF.u16CntReset "Current Number of diag Reset " UWORD NO_COMPU_METHOD 0 0 0 65000 ECU_ADDRESS 0x40001A6E SYMBOL_LINK "xDiagMgm_BlowBy_OF" 2 /end MEASUREMENT
/begin MEASUREMENT xDiagMgm_BlowBy_OF.u16ThrReset "Maximum number of diag Reset allowed (zero means NO DIAG enable)" UWORD NO_COMPU_METHOD 0 0 0 65000 ECU_ADDRESS 0x40001A74 SYMBOL_LINK "xDiagMgm_BlowBy_OF" 8 /end MEASUREMENT
/begin MEASUREMENT xDiagMgm_Can1.eDiagStatus "Diagnosis failure code" UBYTE eDiagStatus.Conversion 0 0 0 255 ECU_ADDRESS 0x40001990 SYMBOL_LINK "xDiagMgm_Can1" 0 /end MEASUREMENT
/begin MEASUREMENT xDiagMgm_Can1.u16CntGenericError "Current Number of Generic Error" UWORD NO_COMPU_METHOD 0 0 0 65000 ECU_ADDRESS 0x40001994 SYMBOL_LINK "xDiagMgm_Can1" 4 /end MEASUREMENT
/begin MEASUREMENT xDiagMgm_Can1.u16CntLoadEnableError "Current Number of Load Enable Error" UWORD NO_COMPU_METHOD 0 0 0 65000 ECU_ADDRESS 0x40001996 SYMBOL_LINK "xDiagMgm_Can1" 6 /end MEASUREMENT
/begin MEASUREMENT xDiagMgm_Can1.u16CntReset "Current Number of diag Reset " UWORD NO_COMPU_METHOD 0 0 0 65000 ECU_ADDRESS 0x40001992 SYMBOL_LINK "xDiagMgm_Can1" 2 /end MEASUREMENT
/begin MEASUREMENT xDiagMgm_Can1.u16ThrReset "Maximum number of diag Reset allowed (zero means NO DIAG enable)" UWORD NO_COMPU_METHOD 0 0 0 65000 ECU_ADDRESS 0x40001998 SYMBOL_LINK "xDiagMgm_Can1" 8 /end MEASUREMENT
/begin MEASUREMENT xDiagMgm_Can2.eDiagStatus "Diagnosis failure code" UBYTE eDiagStatus.Conversion 0 0 0 255 ECU_ADDRESS 0x40001986 SYMBOL_LINK "xDiagMgm_Can2" 0 /end MEASUREMENT
/begin MEASUREMENT xDiagMgm_Can2.u16CntGenericError "Current Number of Generic Error" UWORD NO_COMPU_METHOD 0 0 0 65000 ECU_ADDRESS 0x4000198A SYMBOL_LINK "xDiagMgm_Can2" 4 /end MEASUREMENT
/begin MEASUREMENT xDiagMgm_Can2.u16CntLoadEnableError "Current Number of Load Enable Error" UWORD NO_COMPU_METHOD 0 0 0 65000 ECU_ADDRESS 0x4000198C SYMBOL_LINK "xDiagMgm_Can2" 6 /end MEASUREMENT
/begin MEASUREMENT xDiagMgm_Can2.u16CntReset "Current Number of diag Reset " UWORD NO_COMPU_METHOD 0 0 0 65000 ECU_ADDRESS 0x40001988 SYMBOL_LINK "xDiagMgm_Can2" 2 /end MEASUREMENT
/begin MEASUREMENT xDiagMgm_Can2.u16ThrReset "Maximum number of diag Reset allowed (zero means NO DIAG enable)" UWORD NO_COMPU_METHOD 0 0 0 65000 ECU_ADDRESS 0x4000198E SYMBOL_LINK "xDiagMgm_Can2" 8 /end MEASUREMENT
/begin MEASUREMENT xDiagMgm_Can3.eDiagStatus "Diagnosis failure code" UBYTE eDiagStatus.Conversion 0 0 0 255 ECU_ADDRESS 0x4000197C SYMBOL_LINK "xDiagMgm_Can3" 0 /end MEASUREMENT
/begin MEASUREMENT xDiagMgm_Can3.u16CntGenericError "Current Number of Generic Error" UWORD NO_COMPU_METHOD 0 0 0 65000 ECU_ADDRESS 0x40001980 SYMBOL_LINK "xDiagMgm_Can3" 4 /end MEASUREMENT
/begin MEASUREMENT xDiagMgm_Can3.u16CntLoadEnableError "Current Number of Load Enable Error" UWORD NO_COMPU_METHOD 0 0 0 65000 ECU_ADDRESS 0x40001982 SYMBOL_LINK "xDiagMgm_Can3" 6 /end MEASUREMENT
/begin MEASUREMENT xDiagMgm_Can3.u16CntReset "Current Number of diag Reset " UWORD NO_COMPU_METHOD 0 0 0 65000 ECU_ADDRESS 0x4000197E SYMBOL_LINK "xDiagMgm_Can3" 2 /end MEASUREMENT
/begin MEASUREMENT xDiagMgm_Can3.u16ThrReset "Maximum number of diag Reset allowed (zero means NO DIAG enable)" UWORD NO_COMPU_METHOD 0 0 0 65000 ECU_ADDRESS 0x40001984 SYMBOL_LINK "xDiagMgm_Can3" 8 /end MEASUREMENT
/begin MEASUREMENT xDiagMgm_Can4.eDiagStatus "Diagnosis failure code" UBYTE eDiagStatus.Conversion 0 0 0 255 ECU_ADDRESS 0x40001972 SYMBOL_LINK "xDiagMgm_Can4" 0 /end MEASUREMENT
/begin MEASUREMENT xDiagMgm_Can4.u16CntGenericError "Current Number of Generic Error" UWORD NO_COMPU_METHOD 0 0 0 65000 ECU_ADDRESS 0x40001976 SYMBOL_LINK "xDiagMgm_Can4" 4 /end MEASUREMENT
/begin MEASUREMENT xDiagMgm_Can4.u16CntLoadEnableError "Current Number of Load Enable Error" UWORD NO_COMPU_METHOD 0 0 0 65000 ECU_ADDRESS 0x40001978 SYMBOL_LINK "xDiagMgm_Can4" 6 /end MEASUREMENT
/begin MEASUREMENT xDiagMgm_Can4.u16CntReset "Current Number of diag Reset " UWORD NO_COMPU_METHOD 0 0 0 65000 ECU_ADDRESS 0x40001974 SYMBOL_LINK "xDiagMgm_Can4" 2 /end MEASUREMENT
/begin MEASUREMENT xDiagMgm_Can4.u16ThrReset "Maximum number of diag Reset allowed (zero means NO DIAG enable)" UWORD NO_COMPU_METHOD 0 0 0 65000 ECU_ADDRESS 0x4000197A SYMBOL_LINK "xDiagMgm_Can4" 8 /end MEASUREMENT
/begin MEASUREMENT xDiagMgm_DumpValve_OF.eDiagStatus "Diagnosis failure code" UBYTE eDiagStatus.Conversion 0 0 0 255 ECU_ADDRESS 0x40001A62 SYMBOL_LINK "xDiagMgm_DumpValve_OF" 0 /end MEASUREMENT
/begin MEASUREMENT xDiagMgm_DumpValve_OF.u16CntGenericError "Current Number of Generic Error" UWORD NO_COMPU_METHOD 0 0 0 65000 ECU_ADDRESS 0x40001A66 SYMBOL_LINK "xDiagMgm_DumpValve_OF" 4 /end MEASUREMENT
/begin MEASUREMENT xDiagMgm_DumpValve_OF.u16CntLoadEnableError "Current Number of Load Enable Error" UWORD NO_COMPU_METHOD 0 0 0 65000 ECU_ADDRESS 0x40001A68 SYMBOL_LINK "xDiagMgm_DumpValve_OF" 6 /end MEASUREMENT
/begin MEASUREMENT xDiagMgm_DumpValve_OF.u16CntReset "Current Number of diag Reset " UWORD NO_COMPU_METHOD 0 0 0 65000 ECU_ADDRESS 0x40001A64 SYMBOL_LINK "xDiagMgm_DumpValve_OF" 2 /end MEASUREMENT
/begin MEASUREMENT xDiagMgm_DumpValve_OF.u16ThrReset "Maximum number of diag Reset allowed (zero means NO DIAG enable)" UWORD NO_COMPU_METHOD 0 0 0 65000 ECU_ADDRESS 0x40001A6A SYMBOL_LINK "xDiagMgm_DumpValve_OF" 8 /end MEASUREMENT
/begin MEASUREMENT xDiagMgm_EPMGEN_CAM.eDiagStatus "Diagnosis failure code" UBYTE eDiagStatus.Conversion 0 0 0 255 ECU_ADDRESS 0x400019CC SYMBOL_LINK "xDiagMgm_EPMGEN_CAM" 0 /end MEASUREMENT
/begin MEASUREMENT xDiagMgm_EPMGEN_CAM.u16CntGenericError "Current Number of Generic Error" UWORD NO_COMPU_METHOD 0 0 0 65000 ECU_ADDRESS 0x400019D0 SYMBOL_LINK "xDiagMgm_EPMGEN_CAM" 4 /end MEASUREMENT
/begin MEASUREMENT xDiagMgm_EPMGEN_CAM.u16CntLoadEnableError "Current Number of Load Enable Error" UWORD NO_COMPU_METHOD 0 0 0 65000 ECU_ADDRESS 0x400019D2 SYMBOL_LINK "xDiagMgm_EPMGEN_CAM" 6 /end MEASUREMENT
/begin MEASUREMENT xDiagMgm_EPMGEN_CAM.u16CntReset "Current Number of diag Reset " UWORD NO_COMPU_METHOD 0 0 0 65000 ECU_ADDRESS 0x400019CE SYMBOL_LINK "xDiagMgm_EPMGEN_CAM" 2 /end MEASUREMENT
/begin MEASUREMENT xDiagMgm_EPMGEN_CAM.u16ThrReset "Maximum number of diag Reset allowed (zero means NO DIAG enable)" UWORD NO_COMPU_METHOD 0 0 0 65000 ECU_ADDRESS 0x400019D4 SYMBOL_LINK "xDiagMgm_EPMGEN_CAM" 8 /end MEASUREMENT
/begin MEASUREMENT xDiagMgm_EPMGEN_CRK.eDiagStatus "Diagnosis failure code" UBYTE eDiagStatus.Conversion 0 0 0 255 ECU_ADDRESS 0x400019C2 SYMBOL_LINK "xDiagMgm_EPMGEN_CRK" 0 /end MEASUREMENT
/begin MEASUREMENT xDiagMgm_EPMGEN_CRK.u16CntGenericError "Current Number of Generic Error" UWORD NO_COMPU_METHOD 0 0 0 65000 ECU_ADDRESS 0x400019C6 SYMBOL_LINK "xDiagMgm_EPMGEN_CRK" 4 /end MEASUREMENT
/begin MEASUREMENT xDiagMgm_EPMGEN_CRK.u16CntLoadEnableError "Current Number of Load Enable Error" UWORD NO_COMPU_METHOD 0 0 0 65000 ECU_ADDRESS 0x400019C8 SYMBOL_LINK "xDiagMgm_EPMGEN_CRK" 6 /end MEASUREMENT
/begin MEASUREMENT xDiagMgm_EPMGEN_CRK.u16CntReset "Current Number of diag Reset " UWORD NO_COMPU_METHOD 0 0 0 65000 ECU_ADDRESS 0x400019C4 SYMBOL_LINK "xDiagMgm_EPMGEN_CRK" 2 /end MEASUREMENT
/begin MEASUREMENT xDiagMgm_EPMGEN_CRK.u16ThrReset "Maximum number of diag Reset allowed (zero means NO DIAG enable)" UWORD NO_COMPU_METHOD 0 0 0 65000 ECU_ADDRESS 0x400019CA SYMBOL_LINK "xDiagMgm_EPMGEN_CRK" 8 /end MEASUREMENT
/begin MEASUREMENT xDiagMgm_EngBrake_OF.eDiagStatus "Diagnosis failure code" UBYTE eDiagStatus.Conversion 0 0 0 255 ECU_ADDRESS 0x40001A58 SYMBOL_LINK "xDiagMgm_EngBrake_OF" 0 /end MEASUREMENT
/begin MEASUREMENT xDiagMgm_EngBrake_OF.u16CntGenericError "Current Number of Generic Error" UWORD NO_COMPU_METHOD 0 0 0 65000 ECU_ADDRESS 0x40001A5C SYMBOL_LINK "xDiagMgm_EngBrake_OF" 4 /end MEASUREMENT
/begin MEASUREMENT xDiagMgm_EngBrake_OF.u16CntLoadEnableError "Current Number of Load Enable Error" UWORD NO_COMPU_METHOD 0 0 0 65000 ECU_ADDRESS 0x40001A5E SYMBOL_LINK "xDiagMgm_EngBrake_OF" 6 /end MEASUREMENT
/begin MEASUREMENT xDiagMgm_EngBrake_OF.u16CntReset "Current Number of diag Reset " UWORD NO_COMPU_METHOD 0 0 0 65000 ECU_ADDRESS 0x40001A5A SYMBOL_LINK "xDiagMgm_EngBrake_OF" 2 /end MEASUREMENT
/begin MEASUREMENT xDiagMgm_EngBrake_OF.u16ThrReset "Maximum number of diag Reset allowed (zero means NO DIAG enable)" UWORD NO_COMPU_METHOD 0 0 0 65000 ECU_ADDRESS 0x40001A60 SYMBOL_LINK "xDiagMgm_EngBrake_OF" 8 /end MEASUREMENT
/begin MEASUREMENT xDiagMgm_Fan1_OF.eDiagStatus "Diagnosis failure code" UBYTE eDiagStatus.Conversion 0 0 0 255 ECU_ADDRESS 0x400019EA SYMBOL_LINK "xDiagMgm_Fan1_OF" 0 /end MEASUREMENT
/begin MEASUREMENT xDiagMgm_Fan1_OF.u16CntGenericError "Current Number of Generic Error" UWORD NO_COMPU_METHOD 0 0 0 65000 ECU_ADDRESS 0x400019EE SYMBOL_LINK "xDiagMgm_Fan1_OF" 4 /end MEASUREMENT
/begin MEASUREMENT xDiagMgm_Fan1_OF.u16CntLoadEnableError "Current Number of Load Enable Error" UWORD NO_COMPU_METHOD 0 0 0 65000 ECU_ADDRESS 0x400019F0 SYMBOL_LINK "xDiagMgm_Fan1_OF" 6 /end MEASUREMENT
/begin MEASUREMENT xDiagMgm_Fan1_OF.u16CntReset "Current Number of diag Reset " UWORD NO_COMPU_METHOD 0 0 0 65000 ECU_ADDRESS 0x400019EC SYMBOL_LINK "xDiagMgm_Fan1_OF" 2 /end MEASUREMENT
/begin MEASUREMENT xDiagMgm_Fan1_OF.u16ThrReset "Maximum number of diag Reset allowed (zero means NO DIAG enable)" UWORD NO_COMPU_METHOD 0 0 0 65000 ECU_ADDRESS 0x400019F2 SYMBOL_LINK "xDiagMgm_Fan1_OF" 8 /end MEASUREMENT
/begin MEASUREMENT xDiagMgm_Fan2_OD.eDiagStatus "Diagnosis failure code" UBYTE eDiagStatus.Conversion 0 0 0 255 ECU_ADDRESS 0x400019F4 SYMBOL_LINK "xDiagMgm_Fan2_OD" 0 /end MEASUREMENT
/begin MEASUREMENT xDiagMgm_Fan2_OD.u16CntGenericError "Current Number of Generic Error" UWORD NO_COMPU_METHOD 0 0 0 65000 ECU_ADDRESS 0x400019F8 SYMBOL_LINK "xDiagMgm_Fan2_OD" 4 /end MEASUREMENT
/begin MEASUREMENT xDiagMgm_Fan2_OD.u16CntLoadEnableError "Current Number of Load Enable Error" UWORD NO_COMPU_METHOD 0 0 0 65000 ECU_ADDRESS 0x400019FA SYMBOL_LINK "xDiagMgm_Fan2_OD" 6 /end MEASUREMENT
/begin MEASUREMENT xDiagMgm_Fan2_OD.u16CntReset "Current Number of diag Reset " UWORD NO_COMPU_METHOD 0 0 0 65000 ECU_ADDRESS 0x400019F6 SYMBOL_LINK "xDiagMgm_Fan2_OD" 2 /end MEASUREMENT
/begin MEASUREMENT xDiagMgm_Fan2_OD.u16ThrReset "Maximum number of diag Reset allowed (zero means NO DIAG enable)" UWORD NO_COMPU_METHOD 0 0 0 65000 ECU_ADDRESS 0x400019FC SYMBOL_LINK "xDiagMgm_Fan2_OD" 8 /end MEASUREMENT
/begin MEASUREMENT xDiagMgm_FuelPumpHs_OD.eDiagStatus "Diagnosis failure code" UBYTE eDiagStatus.Conversion 0 0 0 255 ECU_ADDRESS 0x40001A80 SYMBOL_LINK "xDiagMgm_FuelPumpHs_OD" 0 /end MEASUREMENT
/begin MEASUREMENT xDiagMgm_FuelPumpHs_OD.u16CntGenericError "Current Number of Generic Error" UWORD NO_COMPU_METHOD 0 0 0 65000 ECU_ADDRESS 0x40001A84 SYMBOL_LINK "xDiagMgm_FuelPumpHs_OD" 4 /end MEASUREMENT
/begin MEASUREMENT xDiagMgm_FuelPumpHs_OD.u16CntLoadEnableError "Current Number of Load Enable Error" UWORD NO_COMPU_METHOD 0 0 0 65000 ECU_ADDRESS 0x40001A86 SYMBOL_LINK "xDiagMgm_FuelPumpHs_OD" 6 /end MEASUREMENT
/begin MEASUREMENT xDiagMgm_FuelPumpHs_OD.u16CntReset "Current Number of diag Reset " UWORD NO_COMPU_METHOD 0 0 0 65000 ECU_ADDRESS 0x40001A82 SYMBOL_LINK "xDiagMgm_FuelPumpHs_OD" 2 /end MEASUREMENT
/begin MEASUREMENT xDiagMgm_FuelPumpHs_OD.u16ThrReset "Maximum number of diag Reset allowed (zero means NO DIAG enable)" UWORD NO_COMPU_METHOD 0 0 0 65000 ECU_ADDRESS 0x40001A88 SYMBOL_LINK "xDiagMgm_FuelPumpHs_OD" 8 /end MEASUREMENT
/begin MEASUREMENT xDiagMgm_FuelPumpLs_OF.eDiagStatus "Diagnosis failure code" UBYTE eDiagStatus.Conversion 0 0 0 255 ECU_ADDRESS 0x40001A4E SYMBOL_LINK "xDiagMgm_FuelPumpLs_OF" 0 /end MEASUREMENT
/begin MEASUREMENT xDiagMgm_FuelPumpLs_OF.u16CntGenericError "Current Number of Generic Error" UWORD NO_COMPU_METHOD 0 0 0 65000 ECU_ADDRESS 0x40001A52 SYMBOL_LINK "xDiagMgm_FuelPumpLs_OF" 4 /end MEASUREMENT
/begin MEASUREMENT xDiagMgm_FuelPumpLs_OF.u16CntLoadEnableError "Current Number of Load Enable Error" UWORD NO_COMPU_METHOD 0 0 0 65000 ECU_ADDRESS 0x40001A54 SYMBOL_LINK "xDiagMgm_FuelPumpLs_OF" 6 /end MEASUREMENT
/begin MEASUREMENT xDiagMgm_FuelPumpLs_OF.u16CntReset "Current Number of diag Reset " UWORD NO_COMPU_METHOD 0 0 0 65000 ECU_ADDRESS 0x40001A50 SYMBOL_LINK "xDiagMgm_FuelPumpLs_OF" 2 /end MEASUREMENT
/begin MEASUREMENT xDiagMgm_FuelPumpLs_OF.u16ThrReset "Maximum number of diag Reset allowed (zero means NO DIAG enable)" UWORD NO_COMPU_METHOD 0 0 0 65000 ECU_ADDRESS 0x40001A56 SYMBOL_LINK "xDiagMgm_FuelPumpLs_OF" 8 /end MEASUREMENT
/begin MEASUREMENT xDiagMgm_HBridgeCmdEgr_HB.eDiagStatus "Diagnosis failure code" UBYTE eDiagStatus.Conversion 0 0 0 255 ECU_ADDRESS 0x4000199A SYMBOL_LINK "xDiagMgm_HBridgeCmdEgr_HB" 0 /end MEASUREMENT
/begin MEASUREMENT xDiagMgm_HBridgeCmdEgr_HB.u16CntGenericError "Current Number of Generic Error" UWORD NO_COMPU_METHOD 0 0 0 65000 ECU_ADDRESS 0x4000199E SYMBOL_LINK "xDiagMgm_HBridgeCmdEgr_HB" 4 /end MEASUREMENT
/begin MEASUREMENT xDiagMgm_HBridgeCmdEgr_HB.u16CntLoadEnableError "Current Number of Load Enable Error" UWORD NO_COMPU_METHOD 0 0 0 65000 ECU_ADDRESS 0x400019A0 SYMBOL_LINK "xDiagMgm_HBridgeCmdEgr_HB" 6 /end MEASUREMENT
/begin MEASUREMENT xDiagMgm_HBridgeCmdEgr_HB.u16CntReset "Current Number of diag Reset " UWORD NO_COMPU_METHOD 0 0 0 65000 ECU_ADDRESS 0x4000199C SYMBOL_LINK "xDiagMgm_HBridgeCmdEgr_HB" 2 /end MEASUREMENT
/begin MEASUREMENT xDiagMgm_HBridgeCmdEgr_HB.u16ThrReset "Maximum number of diag Reset allowed (zero means NO DIAG enable)" UWORD NO_COMPU_METHOD 0 0 0 65000 ECU_ADDRESS 0x400019A2 SYMBOL_LINK "xDiagMgm_HBridgeCmdEgr_HB" 8 /end MEASUREMENT
/begin MEASUREMENT xDiagMgm_HBridgeCmdThrottle_HB.eDiagStatus "Diagnosis failure code" UBYTE eDiagStatus.Conversion 0 0 0 255 ECU_ADDRESS 0x400019A4 SYMBOL_LINK "xDiagMgm_HBridgeCmdThrottle_HB" 0 /end MEASUREMENT
/begin MEASUREMENT xDiagMgm_HBridgeCmdThrottle_HB.u16CntGenericError "Current Number of Generic Error" UWORD NO_COMPU_METHOD 0 0 0 65000 ECU_ADDRESS 0x400019A8 SYMBOL_LINK "xDiagMgm_HBridgeCmdThrottle_HB" 4 /end MEASUREMENT
/begin MEASUREMENT xDiagMgm_HBridgeCmdThrottle_HB.u16CntLoadEnableError "Current Number of Load Enable Error" UWORD NO_COMPU_METHOD 0 0 0 65000 ECU_ADDRESS 0x400019AA SYMBOL_LINK "xDiagMgm_HBridgeCmdThrottle_HB" 6 /end MEASUREMENT
/begin MEASUREMENT xDiagMgm_HBridgeCmdThrottle_HB.u16CntReset "Current Number of diag Reset " UWORD NO_COMPU_METHOD 0 0 0 65000 ECU_ADDRESS 0x400019A6 SYMBOL_LINK "xDiagMgm_HBridgeCmdThrottle_HB" 2 /end MEASUREMENT
/begin MEASUREMENT xDiagMgm_HBridgeCmdThrottle_HB.u16ThrReset "Maximum number of diag Reset allowed (zero means NO DIAG enable)" UWORD NO_COMPU_METHOD 0 0 0 65000 ECU_ADDRESS 0x400019AC SYMBOL_LINK "xDiagMgm_HBridgeCmdThrottle_HB" 8 /end MEASUREMENT
/begin MEASUREMENT xDiagMgm_IgnCmd01_OF.eDiagStatus "Diagnosis failure code" UBYTE eDiagStatus.Conversion 0 0 0 255 ECU_ADDRESS 0x40001B2A SYMBOL_LINK "xDiagMgm_IgnCmd01_OF" 0 /end MEASUREMENT
/begin MEASUREMENT xDiagMgm_IgnCmd01_OF.u16CntGenericError "Current Number of Generic Error" UWORD NO_COMPU_METHOD 0 0 0 65000 ECU_ADDRESS 0x40001B2E SYMBOL_LINK "xDiagMgm_IgnCmd01_OF" 4 /end MEASUREMENT
/begin MEASUREMENT xDiagMgm_IgnCmd01_OF.u16CntLoadEnableError "Current Number of Load Enable Error" UWORD NO_COMPU_METHOD 0 0 0 65000 ECU_ADDRESS 0x40001B30 SYMBOL_LINK "xDiagMgm_IgnCmd01_OF" 6 /end MEASUREMENT
/begin MEASUREMENT xDiagMgm_IgnCmd01_OF.u16CntReset "Current Number of diag Reset " UWORD NO_COMPU_METHOD 0 0 0 65000 ECU_ADDRESS 0x40001B2C SYMBOL_LINK "xDiagMgm_IgnCmd01_OF" 2 /end MEASUREMENT
/begin MEASUREMENT xDiagMgm_IgnCmd01_OF.u16ThrReset "Maximum number of diag Reset allowed (zero means NO DIAG enable)" UWORD NO_COMPU_METHOD 0 0 0 65000 ECU_ADDRESS 0x40001B32 SYMBOL_LINK "xDiagMgm_IgnCmd01_OF" 8 /end MEASUREMENT
/begin MEASUREMENT xDiagMgm_IgnCmd02_OF.eDiagStatus "Diagnosis failure code" UBYTE eDiagStatus.Conversion 0 0 0 255 ECU_ADDRESS 0x40001B20 SYMBOL_LINK "xDiagMgm_IgnCmd02_OF" 0 /end MEASUREMENT
/begin MEASUREMENT xDiagMgm_IgnCmd02_OF.u16CntGenericError "Current Number of Generic Error" UWORD NO_COMPU_METHOD 0 0 0 65000 ECU_ADDRESS 0x40001B24 SYMBOL_LINK "xDiagMgm_IgnCmd02_OF" 4 /end MEASUREMENT
/begin MEASUREMENT xDiagMgm_IgnCmd02_OF.u16CntLoadEnableError "Current Number of Load Enable Error" UWORD NO_COMPU_METHOD 0 0 0 65000 ECU_ADDRESS 0x40001B26 SYMBOL_LINK "xDiagMgm_IgnCmd02_OF" 6 /end MEASUREMENT
/begin MEASUREMENT xDiagMgm_IgnCmd02_OF.u16CntReset "Current Number of diag Reset " UWORD NO_COMPU_METHOD 0 0 0 65000 ECU_ADDRESS 0x40001B22 SYMBOL_LINK "xDiagMgm_IgnCmd02_OF" 2 /end MEASUREMENT
/begin MEASUREMENT xDiagMgm_IgnCmd02_OF.u16ThrReset "Maximum number of diag Reset allowed (zero means NO DIAG enable)" UWORD NO_COMPU_METHOD 0 0 0 65000 ECU_ADDRESS 0x40001B28 SYMBOL_LINK "xDiagMgm_IgnCmd02_OF" 8 /end MEASUREMENT
/begin MEASUREMENT xDiagMgm_IgnCmd03_OF.eDiagStatus "Diagnosis failure code" UBYTE eDiagStatus.Conversion 0 0 0 255 ECU_ADDRESS 0x40001B16 SYMBOL_LINK "xDiagMgm_IgnCmd03_OF" 0 /end MEASUREMENT
/begin MEASUREMENT xDiagMgm_IgnCmd03_OF.u16CntGenericError "Current Number of Generic Error" UWORD NO_COMPU_METHOD 0 0 0 65000 ECU_ADDRESS 0x40001B1A SYMBOL_LINK "xDiagMgm_IgnCmd03_OF" 4 /end MEASUREMENT
/begin MEASUREMENT xDiagMgm_IgnCmd03_OF.u16CntLoadEnableError "Current Number of Load Enable Error" UWORD NO_COMPU_METHOD 0 0 0 65000 ECU_ADDRESS 0x40001B1C SYMBOL_LINK "xDiagMgm_IgnCmd03_OF" 6 /end MEASUREMENT
/begin MEASUREMENT xDiagMgm_IgnCmd03_OF.u16CntReset "Current Number of diag Reset " UWORD NO_COMPU_METHOD 0 0 0 65000 ECU_ADDRESS 0x40001B18 SYMBOL_LINK "xDiagMgm_IgnCmd03_OF" 2 /end MEASUREMENT
/begin MEASUREMENT xDiagMgm_IgnCmd03_OF.u16ThrReset "Maximum number of diag Reset allowed (zero means NO DIAG enable)" UWORD NO_COMPU_METHOD 0 0 0 65000 ECU_ADDRESS 0x40001B1E SYMBOL_LINK "xDiagMgm_IgnCmd03_OF" 8 /end MEASUREMENT
/begin MEASUREMENT xDiagMgm_IgnCmd04_OF.eDiagStatus "Diagnosis failure code" UBYTE eDiagStatus.Conversion 0 0 0 255 ECU_ADDRESS 0x40001B0C SYMBOL_LINK "xDiagMgm_IgnCmd04_OF" 0 /end MEASUREMENT
/begin MEASUREMENT xDiagMgm_IgnCmd04_OF.u16CntGenericError "Current Number of Generic Error" UWORD NO_COMPU_METHOD 0 0 0 65000 ECU_ADDRESS 0x40001B10 SYMBOL_LINK "xDiagMgm_IgnCmd04_OF" 4 /end MEASUREMENT
/begin MEASUREMENT xDiagMgm_IgnCmd04_OF.u16CntLoadEnableError "Current Number of Load Enable Error" UWORD NO_COMPU_METHOD 0 0 0 65000 ECU_ADDRESS 0x40001B12 SYMBOL_LINK "xDiagMgm_IgnCmd04_OF" 6 /end MEASUREMENT
/begin MEASUREMENT xDiagMgm_IgnCmd04_OF.u16CntReset "Current Number of diag Reset " UWORD NO_COMPU_METHOD 0 0 0 65000 ECU_ADDRESS 0x40001B0E SYMBOL_LINK "xDiagMgm_IgnCmd04_OF" 2 /end MEASUREMENT
/begin MEASUREMENT xDiagMgm_IgnCmd04_OF.u16ThrReset "Maximum number of diag Reset allowed (zero means NO DIAG enable)" UWORD NO_COMPU_METHOD 0 0 0 65000 ECU_ADDRESS 0x40001B14 SYMBOL_LINK "xDiagMgm_IgnCmd04_OF" 8 /end MEASUREMENT
/begin MEASUREMENT xDiagMgm_IgnCmd05_OF.eDiagStatus "Diagnosis failure code" UBYTE eDiagStatus.Conversion 0 0 0 255 ECU_ADDRESS 0x40001B02 SYMBOL_LINK "xDiagMgm_IgnCmd05_OF" 0 /end MEASUREMENT
/begin MEASUREMENT xDiagMgm_IgnCmd05_OF.u16CntGenericError "Current Number of Generic Error" UWORD NO_COMPU_METHOD 0 0 0 65000 ECU_ADDRESS 0x40001B06 SYMBOL_LINK "xDiagMgm_IgnCmd05_OF" 4 /end MEASUREMENT
/begin MEASUREMENT xDiagMgm_IgnCmd05_OF.u16CntLoadEnableError "Current Number of Load Enable Error" UWORD NO_COMPU_METHOD 0 0 0 65000 ECU_ADDRESS 0x40001B08 SYMBOL_LINK "xDiagMgm_IgnCmd05_OF" 6 /end MEASUREMENT
/begin MEASUREMENT xDiagMgm_IgnCmd05_OF.u16CntReset "Current Number of diag Reset " UWORD NO_COMPU_METHOD 0 0 0 65000 ECU_ADDRESS 0x40001B04 SYMBOL_LINK "xDiagMgm_IgnCmd05_OF" 2 /end MEASUREMENT
/begin MEASUREMENT xDiagMgm_IgnCmd05_OF.u16ThrReset "Maximum number of diag Reset allowed (zero means NO DIAG enable)" UWORD NO_COMPU_METHOD 0 0 0 65000 ECU_ADDRESS 0x40001B0A SYMBOL_LINK "xDiagMgm_IgnCmd05_OF" 8 /end MEASUREMENT
/begin MEASUREMENT xDiagMgm_IgnCmd06_OF.eDiagStatus "Diagnosis failure code" UBYTE eDiagStatus.Conversion 0 0 0 255 ECU_ADDRESS 0x40001AF8 SYMBOL_LINK "xDiagMgm_IgnCmd06_OF" 0 /end MEASUREMENT
/begin MEASUREMENT xDiagMgm_IgnCmd06_OF.u16CntGenericError "Current Number of Generic Error" UWORD NO_COMPU_METHOD 0 0 0 65000 ECU_ADDRESS 0x40001AFC SYMBOL_LINK "xDiagMgm_IgnCmd06_OF" 4 /end MEASUREMENT
/begin MEASUREMENT xDiagMgm_IgnCmd06_OF.u16CntLoadEnableError "Current Number of Load Enable Error" UWORD NO_COMPU_METHOD 0 0 0 65000 ECU_ADDRESS 0x40001AFE SYMBOL_LINK "xDiagMgm_IgnCmd06_OF" 6 /end MEASUREMENT
/begin MEASUREMENT xDiagMgm_IgnCmd06_OF.u16CntReset "Current Number of diag Reset " UWORD NO_COMPU_METHOD 0 0 0 65000 ECU_ADDRESS 0x40001AFA SYMBOL_LINK "xDiagMgm_IgnCmd06_OF" 2 /end MEASUREMENT
/begin MEASUREMENT xDiagMgm_IgnCmd06_OF.u16ThrReset "Maximum number of diag Reset allowed (zero means NO DIAG enable)" UWORD NO_COMPU_METHOD 0 0 0 65000 ECU_ADDRESS 0x40001B00 SYMBOL_LINK "xDiagMgm_IgnCmd06_OF" 8 /end MEASUREMENT
/begin MEASUREMENT xDiagMgm_IgnCmd07_OF.eDiagStatus "Diagnosis failure code" UBYTE eDiagStatus.Conversion 0 0 0 255 ECU_ADDRESS 0x40001AEE SYMBOL_LINK "xDiagMgm_IgnCmd07_OF" 0 /end MEASUREMENT
/begin MEASUREMENT xDiagMgm_IgnCmd07_OF.u16CntGenericError "Current Number of Generic Error" UWORD NO_COMPU_METHOD 0 0 0 65000 ECU_ADDRESS 0x40001AF2 SYMBOL_LINK "xDiagMgm_IgnCmd07_OF" 4 /end MEASUREMENT
/begin MEASUREMENT xDiagMgm_IgnCmd07_OF.u16CntLoadEnableError "Current Number of Load Enable Error" UWORD NO_COMPU_METHOD 0 0 0 65000 ECU_ADDRESS 0x40001AF4 SYMBOL_LINK "xDiagMgm_IgnCmd07_OF" 6 /end MEASUREMENT
/begin MEASUREMENT xDiagMgm_IgnCmd07_OF.u16CntReset "Current Number of diag Reset " UWORD NO_COMPU_METHOD 0 0 0 65000 ECU_ADDRESS 0x40001AF0 SYMBOL_LINK "xDiagMgm_IgnCmd07_OF" 2 /end MEASUREMENT
/begin MEASUREMENT xDiagMgm_IgnCmd07_OF.u16ThrReset "Maximum number of diag Reset allowed (zero means NO DIAG enable)" UWORD NO_COMPU_METHOD 0 0 0 65000 ECU_ADDRESS 0x40001AF6 SYMBOL_LINK "xDiagMgm_IgnCmd07_OF" 8 /end MEASUREMENT
/begin MEASUREMENT xDiagMgm_IgnCmd08_OF.eDiagStatus "Diagnosis failure code" UBYTE eDiagStatus.Conversion 0 0 0 255 ECU_ADDRESS 0x40001AE4 SYMBOL_LINK "xDiagMgm_IgnCmd08_OF" 0 /end MEASUREMENT
/begin MEASUREMENT xDiagMgm_IgnCmd08_OF.u16CntGenericError "Current Number of Generic Error" UWORD NO_COMPU_METHOD 0 0 0 65000 ECU_ADDRESS 0x40001AE8 SYMBOL_LINK "xDiagMgm_IgnCmd08_OF" 4 /end MEASUREMENT
/begin MEASUREMENT xDiagMgm_IgnCmd08_OF.u16CntLoadEnableError "Current Number of Load Enable Error" UWORD NO_COMPU_METHOD 0 0 0 65000 ECU_ADDRESS 0x40001AEA SYMBOL_LINK "xDiagMgm_IgnCmd08_OF" 6 /end MEASUREMENT
/begin MEASUREMENT xDiagMgm_IgnCmd08_OF.u16CntReset "Current Number of diag Reset " UWORD NO_COMPU_METHOD 0 0 0 65000 ECU_ADDRESS 0x40001AE6 SYMBOL_LINK "xDiagMgm_IgnCmd08_OF" 2 /end MEASUREMENT
/begin MEASUREMENT xDiagMgm_IgnCmd08_OF.u16ThrReset "Maximum number of diag Reset allowed (zero means NO DIAG enable)" UWORD NO_COMPU_METHOD 0 0 0 65000 ECU_ADDRESS 0x40001AEC SYMBOL_LINK "xDiagMgm_IgnCmd08_OF" 8 /end MEASUREMENT
/begin MEASUREMENT xDiagMgm_InjCmd01_OF.eDiagStatus "Diagnosis failure code" UBYTE eDiagStatus.Conversion 0 0 0 255 ECU_ADDRESS 0x40001ADA SYMBOL_LINK "xDiagMgm_InjCmd01_OF" 0 /end MEASUREMENT
/begin MEASUREMENT xDiagMgm_InjCmd01_OF.u16CntGenericError "Current Number of Generic Error" UWORD NO_COMPU_METHOD 0 0 0 65000 ECU_ADDRESS 0x40001ADE SYMBOL_LINK "xDiagMgm_InjCmd01_OF" 4 /end MEASUREMENT
/begin MEASUREMENT xDiagMgm_InjCmd01_OF.u16CntLoadEnableError "Current Number of Load Enable Error" UWORD NO_COMPU_METHOD 0 0 0 65000 ECU_ADDRESS 0x40001AE0 SYMBOL_LINK "xDiagMgm_InjCmd01_OF" 6 /end MEASUREMENT
/begin MEASUREMENT xDiagMgm_InjCmd01_OF.u16CntReset "Current Number of diag Reset " UWORD NO_COMPU_METHOD 0 0 0 65000 ECU_ADDRESS 0x40001ADC SYMBOL_LINK "xDiagMgm_InjCmd01_OF" 2 /end MEASUREMENT
/begin MEASUREMENT xDiagMgm_InjCmd01_OF.u16ThrReset "Maximum number of diag Reset allowed (zero means NO DIAG enable)" UWORD NO_COMPU_METHOD 0 0 0 65000 ECU_ADDRESS 0x40001AE2 SYMBOL_LINK "xDiagMgm_InjCmd01_OF" 8 /end MEASUREMENT
/begin MEASUREMENT xDiagMgm_InjCmd02_OF.eDiagStatus "Diagnosis failure code" UBYTE eDiagStatus.Conversion 0 0 0 255 ECU_ADDRESS 0x40001AD0 SYMBOL_LINK "xDiagMgm_InjCmd02_OF" 0 /end MEASUREMENT
/begin MEASUREMENT xDiagMgm_InjCmd02_OF.u16CntGenericError "Current Number of Generic Error" UWORD NO_COMPU_METHOD 0 0 0 65000 ECU_ADDRESS 0x40001AD4 SYMBOL_LINK "xDiagMgm_InjCmd02_OF" 4 /end MEASUREMENT
/begin MEASUREMENT xDiagMgm_InjCmd02_OF.u16CntLoadEnableError "Current Number of Load Enable Error" UWORD NO_COMPU_METHOD 0 0 0 65000 ECU_ADDRESS 0x40001AD6 SYMBOL_LINK "xDiagMgm_InjCmd02_OF" 6 /end MEASUREMENT
/begin MEASUREMENT xDiagMgm_InjCmd02_OF.u16CntReset "Current Number of diag Reset " UWORD NO_COMPU_METHOD 0 0 0 65000 ECU_ADDRESS 0x40001AD2 SYMBOL_LINK "xDiagMgm_InjCmd02_OF" 2 /end MEASUREMENT
/begin MEASUREMENT xDiagMgm_InjCmd02_OF.u16ThrReset "Maximum number of diag Reset allowed (zero means NO DIAG enable)" UWORD NO_COMPU_METHOD 0 0 0 65000 ECU_ADDRESS 0x40001AD8 SYMBOL_LINK "xDiagMgm_InjCmd02_OF" 8 /end MEASUREMENT
/begin MEASUREMENT xDiagMgm_InjCmd03_OF.eDiagStatus "Diagnosis failure code" UBYTE eDiagStatus.Conversion 0 0 0 255 ECU_ADDRESS 0x40001AC6 SYMBOL_LINK "xDiagMgm_InjCmd03_OF" 0 /end MEASUREMENT
/begin MEASUREMENT xDiagMgm_InjCmd03_OF.u16CntGenericError "Current Number of Generic Error" UWORD NO_COMPU_METHOD 0 0 0 65000 ECU_ADDRESS 0x40001ACA SYMBOL_LINK "xDiagMgm_InjCmd03_OF" 4 /end MEASUREMENT
/begin MEASUREMENT xDiagMgm_InjCmd03_OF.u16CntLoadEnableError "Current Number of Load Enable Error" UWORD NO_COMPU_METHOD 0 0 0 65000 ECU_ADDRESS 0x40001ACC SYMBOL_LINK "xDiagMgm_InjCmd03_OF" 6 /end MEASUREMENT
/begin MEASUREMENT xDiagMgm_InjCmd03_OF.u16CntReset "Current Number of diag Reset " UWORD NO_COMPU_METHOD 0 0 0 65000 ECU_ADDRESS 0x40001AC8 SYMBOL_LINK "xDiagMgm_InjCmd03_OF" 2 /end MEASUREMENT
/begin MEASUREMENT xDiagMgm_InjCmd03_OF.u16ThrReset "Maximum number of diag Reset allowed (zero means NO DIAG enable)" UWORD NO_COMPU_METHOD 0 0 0 65000 ECU_ADDRESS 0x40001ACE SYMBOL_LINK "xDiagMgm_InjCmd03_OF" 8 /end MEASUREMENT
/begin MEASUREMENT xDiagMgm_InjCmd04_OF.eDiagStatus "Diagnosis failure code" UBYTE eDiagStatus.Conversion 0 0 0 255 ECU_ADDRESS 0x40001ABC SYMBOL_LINK "xDiagMgm_InjCmd04_OF" 0 /end MEASUREMENT
/begin MEASUREMENT xDiagMgm_InjCmd04_OF.u16CntGenericError "Current Number of Generic Error" UWORD NO_COMPU_METHOD 0 0 0 65000 ECU_ADDRESS 0x40001AC0 SYMBOL_LINK "xDiagMgm_InjCmd04_OF" 4 /end MEASUREMENT
/begin MEASUREMENT xDiagMgm_InjCmd04_OF.u16CntLoadEnableError "Current Number of Load Enable Error" UWORD NO_COMPU_METHOD 0 0 0 65000 ECU_ADDRESS 0x40001AC2 SYMBOL_LINK "xDiagMgm_InjCmd04_OF" 6 /end MEASUREMENT
/begin MEASUREMENT xDiagMgm_InjCmd04_OF.u16CntReset "Current Number of diag Reset " UWORD NO_COMPU_METHOD 0 0 0 65000 ECU_ADDRESS 0x40001ABE SYMBOL_LINK "xDiagMgm_InjCmd04_OF" 2 /end MEASUREMENT
/begin MEASUREMENT xDiagMgm_InjCmd04_OF.u16ThrReset "Maximum number of diag Reset allowed (zero means NO DIAG enable)" UWORD NO_COMPU_METHOD 0 0 0 65000 ECU_ADDRESS 0x40001AC4 SYMBOL_LINK "xDiagMgm_InjCmd04_OF" 8 /end MEASUREMENT
/begin MEASUREMENT xDiagMgm_InjCmd05_OF.eDiagStatus "Diagnosis failure code" UBYTE eDiagStatus.Conversion 0 0 0 255 ECU_ADDRESS 0x40001AB2 SYMBOL_LINK "xDiagMgm_InjCmd05_OF" 0 /end MEASUREMENT
/begin MEASUREMENT xDiagMgm_InjCmd05_OF.u16CntGenericError "Current Number of Generic Error" UWORD NO_COMPU_METHOD 0 0 0 65000 ECU_ADDRESS 0x40001AB6 SYMBOL_LINK "xDiagMgm_InjCmd05_OF" 4 /end MEASUREMENT
/begin MEASUREMENT xDiagMgm_InjCmd05_OF.u16CntLoadEnableError "Current Number of Load Enable Error" UWORD NO_COMPU_METHOD 0 0 0 65000 ECU_ADDRESS 0x40001AB8 SYMBOL_LINK "xDiagMgm_InjCmd05_OF" 6 /end MEASUREMENT
/begin MEASUREMENT xDiagMgm_InjCmd05_OF.u16CntReset "Current Number of diag Reset " UWORD NO_COMPU_METHOD 0 0 0 65000 ECU_ADDRESS 0x40001AB4 SYMBOL_LINK "xDiagMgm_InjCmd05_OF" 2 /end MEASUREMENT
/begin MEASUREMENT xDiagMgm_InjCmd05_OF.u16ThrReset "Maximum number of diag Reset allowed (zero means NO DIAG enable)" UWORD NO_COMPU_METHOD 0 0 0 65000 ECU_ADDRESS 0x40001ABA SYMBOL_LINK "xDiagMgm_InjCmd05_OF" 8 /end MEASUREMENT
/begin MEASUREMENT xDiagMgm_InjCmd06_OF.eDiagStatus "Diagnosis failure code" UBYTE eDiagStatus.Conversion 0 0 0 255 ECU_ADDRESS 0x40001AA8 SYMBOL_LINK "xDiagMgm_InjCmd06_OF" 0 /end MEASUREMENT
/begin MEASUREMENT xDiagMgm_InjCmd06_OF.u16CntGenericError "Current Number of Generic Error" UWORD NO_COMPU_METHOD 0 0 0 65000 ECU_ADDRESS 0x40001AAC SYMBOL_LINK "xDiagMgm_InjCmd06_OF" 4 /end MEASUREMENT
/begin MEASUREMENT xDiagMgm_InjCmd06_OF.u16CntLoadEnableError "Current Number of Load Enable Error" UWORD NO_COMPU_METHOD 0 0 0 65000 ECU_ADDRESS 0x40001AAE SYMBOL_LINK "xDiagMgm_InjCmd06_OF" 6 /end MEASUREMENT
/begin MEASUREMENT xDiagMgm_InjCmd06_OF.u16CntReset "Current Number of diag Reset " UWORD NO_COMPU_METHOD 0 0 0 65000 ECU_ADDRESS 0x40001AAA SYMBOL_LINK "xDiagMgm_InjCmd06_OF" 2 /end MEASUREMENT
/begin MEASUREMENT xDiagMgm_InjCmd06_OF.u16ThrReset "Maximum number of diag Reset allowed (zero means NO DIAG enable)" UWORD NO_COMPU_METHOD 0 0 0 65000 ECU_ADDRESS 0x40001AB0 SYMBOL_LINK "xDiagMgm_InjCmd06_OF" 8 /end MEASUREMENT
/begin MEASUREMENT xDiagMgm_InjCmd07_OF.eDiagStatus "Diagnosis failure code" UBYTE eDiagStatus.Conversion 0 0 0 255 ECU_ADDRESS 0x40001A9E SYMBOL_LINK "xDiagMgm_InjCmd07_OF" 0 /end MEASUREMENT
/begin MEASUREMENT xDiagMgm_InjCmd07_OF.u16CntGenericError "Current Number of Generic Error" UWORD NO_COMPU_METHOD 0 0 0 65000 ECU_ADDRESS 0x40001AA2 SYMBOL_LINK "xDiagMgm_InjCmd07_OF" 4 /end MEASUREMENT
/begin MEASUREMENT xDiagMgm_InjCmd07_OF.u16CntLoadEnableError "Current Number of Load Enable Error" UWORD NO_COMPU_METHOD 0 0 0 65000 ECU_ADDRESS 0x40001AA4 SYMBOL_LINK "xDiagMgm_InjCmd07_OF" 6 /end MEASUREMENT
/begin MEASUREMENT xDiagMgm_InjCmd07_OF.u16CntReset "Current Number of diag Reset " UWORD NO_COMPU_METHOD 0 0 0 65000 ECU_ADDRESS 0x40001AA0 SYMBOL_LINK "xDiagMgm_InjCmd07_OF" 2 /end MEASUREMENT
/begin MEASUREMENT xDiagMgm_InjCmd07_OF.u16ThrReset "Maximum number of diag Reset allowed (zero means NO DIAG enable)" UWORD NO_COMPU_METHOD 0 0 0 65000 ECU_ADDRESS 0x40001AA6 SYMBOL_LINK "xDiagMgm_InjCmd07_OF" 8 /end MEASUREMENT
/begin MEASUREMENT xDiagMgm_InjCmd08_OF.eDiagStatus "Diagnosis failure code" UBYTE eDiagStatus.Conversion 0 0 0 255 ECU_ADDRESS 0x40001A94 SYMBOL_LINK "xDiagMgm_InjCmd08_OF" 0 /end MEASUREMENT
/begin MEASUREMENT xDiagMgm_InjCmd08_OF.u16CntGenericError "Current Number of Generic Error" UWORD NO_COMPU_METHOD 0 0 0 65000 ECU_ADDRESS 0x40001A98 SYMBOL_LINK "xDiagMgm_InjCmd08_OF" 4 /end MEASUREMENT
/begin MEASUREMENT xDiagMgm_InjCmd08_OF.u16CntLoadEnableError "Current Number of Load Enable Error" UWORD NO_COMPU_METHOD 0 0 0 65000 ECU_ADDRESS 0x40001A9A SYMBOL_LINK "xDiagMgm_InjCmd08_OF" 6 /end MEASUREMENT
/begin MEASUREMENT xDiagMgm_InjCmd08_OF.u16CntReset "Current Number of diag Reset " UWORD NO_COMPU_METHOD 0 0 0 65000 ECU_ADDRESS 0x40001A96 SYMBOL_LINK "xDiagMgm_InjCmd08_OF" 2 /end MEASUREMENT
/begin MEASUREMENT xDiagMgm_InjCmd08_OF.u16ThrReset "Maximum number of diag Reset allowed (zero means NO DIAG enable)" UWORD NO_COMPU_METHOD 0 0 0 65000 ECU_ADDRESS 0x40001A9C SYMBOL_LINK "xDiagMgm_InjCmd08_OF" 8 /end MEASUREMENT
/begin MEASUREMENT xDiagMgm_LoadRelay_OD.eDiagStatus "Diagnosis failure code" UBYTE eDiagStatus.Conversion 0 0 0 255 ECU_ADDRESS 0x40001A26 SYMBOL_LINK "xDiagMgm_LoadRelay_OD" 0 /end MEASUREMENT
/begin MEASUREMENT xDiagMgm_LoadRelay_OD.u16CntGenericError "Current Number of Generic Error" UWORD NO_COMPU_METHOD 0 0 0 65000 ECU_ADDRESS 0x40001A2A SYMBOL_LINK "xDiagMgm_LoadRelay_OD" 4 /end MEASUREMENT
/begin MEASUREMENT xDiagMgm_LoadRelay_OD.u16CntLoadEnableError "Current Number of Load Enable Error" UWORD NO_COMPU_METHOD 0 0 0 65000 ECU_ADDRESS 0x40001A2C SYMBOL_LINK "xDiagMgm_LoadRelay_OD" 6 /end MEASUREMENT
/begin MEASUREMENT xDiagMgm_LoadRelay_OD.u16CntReset "Current Number of diag Reset " UWORD NO_COMPU_METHOD 0 0 0 65000 ECU_ADDRESS 0x40001A28 SYMBOL_LINK "xDiagMgm_LoadRelay_OD" 2 /end MEASUREMENT
/begin MEASUREMENT xDiagMgm_LoadRelay_OD.u16ThrReset "Maximum number of diag Reset allowed (zero means NO DIAG enable)" UWORD NO_COMPU_METHOD 0 0 0 65000 ECU_ADDRESS 0x40001A2E SYMBOL_LINK "xDiagMgm_LoadRelay_OD" 8 /end MEASUREMENT
/begin MEASUREMENT xDiagMgm_Mil_OD.eDiagStatus "Diagnosis failure code" UBYTE eDiagStatus.Conversion 0 0 0 255 ECU_ADDRESS 0x40001A1C SYMBOL_LINK "xDiagMgm_Mil_OD" 0 /end MEASUREMENT
/begin MEASUREMENT xDiagMgm_Mil_OD.u16CntGenericError "Current Number of Generic Error" UWORD NO_COMPU_METHOD 0 0 0 65000 ECU_ADDRESS 0x40001A20 SYMBOL_LINK "xDiagMgm_Mil_OD" 4 /end MEASUREMENT
/begin MEASUREMENT xDiagMgm_Mil_OD.u16CntLoadEnableError "Current Number of Load Enable Error" UWORD NO_COMPU_METHOD 0 0 0 65000 ECU_ADDRESS 0x40001A22 SYMBOL_LINK "xDiagMgm_Mil_OD" 6 /end MEASUREMENT
/begin MEASUREMENT xDiagMgm_Mil_OD.u16CntReset "Current Number of diag Reset " UWORD NO_COMPU_METHOD 0 0 0 65000 ECU_ADDRESS 0x40001A1E SYMBOL_LINK "xDiagMgm_Mil_OD" 2 /end MEASUREMENT
/begin MEASUREMENT xDiagMgm_Mil_OD.u16ThrReset "Maximum number of diag Reset allowed (zero means NO DIAG enable)" UWORD NO_COMPU_METHOD 0 0 0 65000 ECU_ADDRESS 0x40001A24 SYMBOL_LINK "xDiagMgm_Mil_OD" 8 /end MEASUREMENT
/begin MEASUREMENT xDiagMgm_PostCatHeater_OF.eDiagStatus "Diagnosis failure code" UBYTE eDiagStatus.Conversion 0 0 0 255 ECU_ADDRESS 0x400019AE SYMBOL_LINK "xDiagMgm_PostCatHeater_OF" 0 /end MEASUREMENT
/begin MEASUREMENT xDiagMgm_PostCatHeater_OF.u16CntGenericError "Current Number of Generic Error" UWORD NO_COMPU_METHOD 0 0 0 65000 ECU_ADDRESS 0x400019B2 SYMBOL_LINK "xDiagMgm_PostCatHeater_OF" 4 /end MEASUREMENT
/begin MEASUREMENT xDiagMgm_PostCatHeater_OF.u16CntLoadEnableError "Current Number of Load Enable Error" UWORD NO_COMPU_METHOD 0 0 0 65000 ECU_ADDRESS 0x400019B4 SYMBOL_LINK "xDiagMgm_PostCatHeater_OF" 6 /end MEASUREMENT
/begin MEASUREMENT xDiagMgm_PostCatHeater_OF.u16CntReset "Current Number of diag Reset " UWORD NO_COMPU_METHOD 0 0 0 65000 ECU_ADDRESS 0x400019B0 SYMBOL_LINK "xDiagMgm_PostCatHeater_OF" 2 /end MEASUREMENT
/begin MEASUREMENT xDiagMgm_PostCatHeater_OF.u16ThrReset "Maximum number of diag Reset allowed (zero means NO DIAG enable)" UWORD NO_COMPU_METHOD 0 0 0 65000 ECU_ADDRESS 0x400019B6 SYMBOL_LINK "xDiagMgm_PostCatHeater_OF" 8 /end MEASUREMENT
/begin MEASUREMENT xDiagMgm_PresRegValve_OF.eDiagStatus "Diagnosis failure code" UBYTE eDiagStatus.Conversion 0 0 0 255 ECU_ADDRESS 0x400019D6 SYMBOL_LINK "xDiagMgm_PresRegValve_OF" 0 /end MEASUREMENT
/begin MEASUREMENT xDiagMgm_PresRegValve_OF.u16CntGenericError "Current Number of Generic Error" UWORD NO_COMPU_METHOD 0 0 0 65000 ECU_ADDRESS 0x400019DA SYMBOL_LINK "xDiagMgm_PresRegValve_OF" 4 /end MEASUREMENT
/begin MEASUREMENT xDiagMgm_PresRegValve_OF.u16CntLoadEnableError "Current Number of Load Enable Error" UWORD NO_COMPU_METHOD 0 0 0 65000 ECU_ADDRESS 0x400019DC SYMBOL_LINK "xDiagMgm_PresRegValve_OF" 6 /end MEASUREMENT
/begin MEASUREMENT xDiagMgm_PresRegValve_OF.u16CntReset "Current Number of diag Reset " UWORD NO_COMPU_METHOD 0 0 0 65000 ECU_ADDRESS 0x400019D8 SYMBOL_LINK "xDiagMgm_PresRegValve_OF" 2 /end MEASUREMENT
/begin MEASUREMENT xDiagMgm_PresRegValve_OF.u16ThrReset "Maximum number of diag Reset allowed (zero means NO DIAG enable)" UWORD NO_COMPU_METHOD 0 0 0 65000 ECU_ADDRESS 0x400019DE SYMBOL_LINK "xDiagMgm_PresRegValve_OF" 8 /end MEASUREMENT
/begin MEASUREMENT xDiagMgm_RedLamp_OD.eDiagStatus "Diagnosis failure code" UBYTE eDiagStatus.Conversion 0 0 0 255 ECU_ADDRESS 0x40001A12 SYMBOL_LINK "xDiagMgm_RedLamp_OD" 0 /end MEASUREMENT
/begin MEASUREMENT xDiagMgm_RedLamp_OD.u16CntGenericError "Current Number of Generic Error" UWORD NO_COMPU_METHOD 0 0 0 65000 ECU_ADDRESS 0x40001A16 SYMBOL_LINK "xDiagMgm_RedLamp_OD" 4 /end MEASUREMENT
/begin MEASUREMENT xDiagMgm_RedLamp_OD.u16CntLoadEnableError "Current Number of Load Enable Error" UWORD NO_COMPU_METHOD 0 0 0 65000 ECU_ADDRESS 0x40001A18 SYMBOL_LINK "xDiagMgm_RedLamp_OD" 6 /end MEASUREMENT
/begin MEASUREMENT xDiagMgm_RedLamp_OD.u16CntReset "Current Number of diag Reset " UWORD NO_COMPU_METHOD 0 0 0 65000 ECU_ADDRESS 0x40001A14 SYMBOL_LINK "xDiagMgm_RedLamp_OD" 2 /end MEASUREMENT
/begin MEASUREMENT xDiagMgm_RedLamp_OD.u16ThrReset "Maximum number of diag Reset allowed (zero means NO DIAG enable)" UWORD NO_COMPU_METHOD 0 0 0 65000 ECU_ADDRESS 0x40001A1A SYMBOL_LINK "xDiagMgm_RedLamp_OD" 8 /end MEASUREMENT
/begin MEASUREMENT xDiagMgm_Rpm_OF.eDiagStatus "Diagnosis failure code" UBYTE eDiagStatus.Conversion 0 0 0 255 ECU_ADDRESS 0x400019E0 SYMBOL_LINK "xDiagMgm_Rpm_OF" 0 /end MEASUREMENT
/begin MEASUREMENT xDiagMgm_Rpm_OF.u16CntGenericError "Current Number of Generic Error" UWORD NO_COMPU_METHOD 0 0 0 65000 ECU_ADDRESS 0x400019E4 SYMBOL_LINK "xDiagMgm_Rpm_OF" 4 /end MEASUREMENT
/begin MEASUREMENT xDiagMgm_Rpm_OF.u16CntLoadEnableError "Current Number of Load Enable Error" UWORD NO_COMPU_METHOD 0 0 0 65000 ECU_ADDRESS 0x400019E6 SYMBOL_LINK "xDiagMgm_Rpm_OF" 6 /end MEASUREMENT
/begin MEASUREMENT xDiagMgm_Rpm_OF.u16CntReset "Current Number of diag Reset " UWORD NO_COMPU_METHOD 0 0 0 65000 ECU_ADDRESS 0x400019E2 SYMBOL_LINK "xDiagMgm_Rpm_OF" 2 /end MEASUREMENT
/begin MEASUREMENT xDiagMgm_Rpm_OF.u16ThrReset "Maximum number of diag Reset allowed (zero means NO DIAG enable)" UWORD NO_COMPU_METHOD 0 0 0 65000 ECU_ADDRESS 0x400019E8 SYMBOL_LINK "xDiagMgm_Rpm_OF" 8 /end MEASUREMENT
/begin MEASUREMENT xDiagMgm_StarterHs_OD.eDiagStatus "Diagnosis failure code" UBYTE eDiagStatus.Conversion 0 0 0 255 ECU_ADDRESS 0x40001A76 SYMBOL_LINK "xDiagMgm_StarterHs_OD" 0 /end MEASUREMENT
/begin MEASUREMENT xDiagMgm_StarterHs_OD.u16CntGenericError "Current Number of Generic Error" UWORD NO_COMPU_METHOD 0 0 0 65000 ECU_ADDRESS 0x40001A7A SYMBOL_LINK "xDiagMgm_StarterHs_OD" 4 /end MEASUREMENT
/begin MEASUREMENT xDiagMgm_StarterHs_OD.u16CntLoadEnableError "Current Number of Load Enable Error" UWORD NO_COMPU_METHOD 0 0 0 65000 ECU_ADDRESS 0x40001A7C SYMBOL_LINK "xDiagMgm_StarterHs_OD" 6 /end MEASUREMENT
/begin MEASUREMENT xDiagMgm_StarterHs_OD.u16CntReset "Current Number of diag Reset " UWORD NO_COMPU_METHOD 0 0 0 65000 ECU_ADDRESS 0x40001A78 SYMBOL_LINK "xDiagMgm_StarterHs_OD" 2 /end MEASUREMENT
/begin MEASUREMENT xDiagMgm_StarterHs_OD.u16ThrReset "Maximum number of diag Reset allowed (zero means NO DIAG enable)" UWORD NO_COMPU_METHOD 0 0 0 65000 ECU_ADDRESS 0x40001A7E SYMBOL_LINK "xDiagMgm_StarterHs_OD" 8 /end MEASUREMENT
/begin MEASUREMENT xDiagMgm_StarterLs_OD.eDiagStatus "Diagnosis failure code" UBYTE eDiagStatus.Conversion 0 0 0 255 ECU_ADDRESS 0x40001A8A SYMBOL_LINK "xDiagMgm_StarterLs_OD" 0 /end MEASUREMENT
/begin MEASUREMENT xDiagMgm_StarterLs_OD.u16CntGenericError "Current Number of Generic Error" UWORD NO_COMPU_METHOD 0 0 0 65000 ECU_ADDRESS 0x40001A8E SYMBOL_LINK "xDiagMgm_StarterLs_OD" 4 /end MEASUREMENT
/begin MEASUREMENT xDiagMgm_StarterLs_OD.u16CntLoadEnableError "Current Number of Load Enable Error" UWORD NO_COMPU_METHOD 0 0 0 65000 ECU_ADDRESS 0x40001A90 SYMBOL_LINK "xDiagMgm_StarterLs_OD" 6 /end MEASUREMENT
/begin MEASUREMENT xDiagMgm_StarterLs_OD.u16CntReset "Current Number of diag Reset " UWORD NO_COMPU_METHOD 0 0 0 65000 ECU_ADDRESS 0x40001A8C SYMBOL_LINK "xDiagMgm_StarterLs_OD" 2 /end MEASUREMENT
/begin MEASUREMENT xDiagMgm_StarterLs_OD.u16ThrReset "Maximum number of diag Reset allowed (zero means NO DIAG enable)" UWORD NO_COMPU_METHOD 0 0 0 65000 ECU_ADDRESS 0x40001A92 SYMBOL_LINK "xDiagMgm_StarterLs_OD" 8 /end MEASUREMENT
/begin MEASUREMENT xDiagMgm_TankValve1_OD.eDiagStatus "Diagnosis failure code" UBYTE eDiagStatus.Conversion 0 0 0 255 ECU_ADDRESS 0x40001A3A SYMBOL_LINK "xDiagMgm_TankValve1_OD" 0 /end MEASUREMENT
/begin MEASUREMENT xDiagMgm_TankValve1_OD.u16CntGenericError "Current Number of Generic Error" UWORD NO_COMPU_METHOD 0 0 0 65000 ECU_ADDRESS 0x40001A3E SYMBOL_LINK "xDiagMgm_TankValve1_OD" 4 /end MEASUREMENT
/begin MEASUREMENT xDiagMgm_TankValve1_OD.u16CntLoadEnableError "Current Number of Load Enable Error" UWORD NO_COMPU_METHOD 0 0 0 65000 ECU_ADDRESS 0x40001A40 SYMBOL_LINK "xDiagMgm_TankValve1_OD" 6 /end MEASUREMENT
/begin MEASUREMENT xDiagMgm_TankValve1_OD.u16CntReset "Current Number of diag Reset " UWORD NO_COMPU_METHOD 0 0 0 65000 ECU_ADDRESS 0x40001A3C SYMBOL_LINK "xDiagMgm_TankValve1_OD" 2 /end MEASUREMENT
/begin MEASUREMENT xDiagMgm_TankValve1_OD.u16ThrReset "Maximum number of diag Reset allowed (zero means NO DIAG enable)" UWORD NO_COMPU_METHOD 0 0 0 65000 ECU_ADDRESS 0x40001A42 SYMBOL_LINK "xDiagMgm_TankValve1_OD" 8 /end MEASUREMENT
/begin MEASUREMENT xDiagMgm_TankValve2_OD.eDiagStatus "Diagnosis failure code" UBYTE eDiagStatus.Conversion 0 0 0 255 ECU_ADDRESS 0x40001A30 SYMBOL_LINK "xDiagMgm_TankValve2_OD" 0 /end MEASUREMENT
/begin MEASUREMENT xDiagMgm_TankValve2_OD.u16CntGenericError "Current Number of Generic Error" UWORD NO_COMPU_METHOD 0 0 0 65000 ECU_ADDRESS 0x40001A34 SYMBOL_LINK "xDiagMgm_TankValve2_OD" 4 /end MEASUREMENT
/begin MEASUREMENT xDiagMgm_TankValve2_OD.u16CntLoadEnableError "Current Number of Load Enable Error" UWORD NO_COMPU_METHOD 0 0 0 65000 ECU_ADDRESS 0x40001A36 SYMBOL_LINK "xDiagMgm_TankValve2_OD" 6 /end MEASUREMENT
/begin MEASUREMENT xDiagMgm_TankValve2_OD.u16CntReset "Current Number of diag Reset " UWORD NO_COMPU_METHOD 0 0 0 65000 ECU_ADDRESS 0x40001A32 SYMBOL_LINK "xDiagMgm_TankValve2_OD" 2 /end MEASUREMENT
/begin MEASUREMENT xDiagMgm_TankValve2_OD.u16ThrReset "Maximum number of diag Reset allowed (zero means NO DIAG enable)" UWORD NO_COMPU_METHOD 0 0 0 65000 ECU_ADDRESS 0x40001A38 SYMBOL_LINK "xDiagMgm_TankValve2_OD" 8 /end MEASUREMENT
/begin MEASUREMENT xDiagMgm_Turbo_OF.eDiagStatus "Diagnosis failure code" UBYTE eDiagStatus.Conversion 0 0 0 255 ECU_ADDRESS 0x40001A44 SYMBOL_LINK "xDiagMgm_Turbo_OF" 0 /end MEASUREMENT
/begin MEASUREMENT xDiagMgm_Turbo_OF.u16CntGenericError "Current Number of Generic Error" UWORD NO_COMPU_METHOD 0 0 0 65000 ECU_ADDRESS 0x40001A48 SYMBOL_LINK "xDiagMgm_Turbo_OF" 4 /end MEASUREMENT
/begin MEASUREMENT xDiagMgm_Turbo_OF.u16CntLoadEnableError "Current Number of Load Enable Error" UWORD NO_COMPU_METHOD 0 0 0 65000 ECU_ADDRESS 0x40001A4A SYMBOL_LINK "xDiagMgm_Turbo_OF" 6 /end MEASUREMENT
/begin MEASUREMENT xDiagMgm_Turbo_OF.u16CntReset "Current Number of diag Reset " UWORD NO_COMPU_METHOD 0 0 0 65000 ECU_ADDRESS 0x40001A46 SYMBOL_LINK "xDiagMgm_Turbo_OF" 2 /end MEASUREMENT
/begin MEASUREMENT xDiagMgm_Turbo_OF.u16ThrReset "Maximum number of diag Reset allowed (zero means NO DIAG enable)" UWORD NO_COMPU_METHOD 0 0 0 65000 ECU_ADDRESS 0x40001A4C SYMBOL_LINK "xDiagMgm_Turbo_OF" 8 /end MEASUREMENT
/begin MEASUREMENT xDiagMgm_UegoHeater_OF.eDiagStatus "Diagnosis failure code" UBYTE eDiagStatus.Conversion 0 0 0 255 ECU_ADDRESS 0x400019B8 SYMBOL_LINK "xDiagMgm_UegoHeater_OF" 0 /end MEASUREMENT
/begin COMPU_METHOD bsFFShortFlTrim.Conversion "" LINEAR "%.3" "%" COEFFS_LINEAR 0.78125 -100 /end COMPU_METHOD
/begin COMPU_METHOD bsFFStatus.Conversion "" LINEAR "%.3" "adm" COEFFS_LINEAR 1 0 /end COMPU_METHOD
/begin COMPU_METHOD bsFFTAir.Conversion "" LINEAR "%.3" "degC" COEFFS_LINEAR 1 -40 /end COMPU_METHOD
/begin COMPU_METHOD bsFFTKat.Conversion "" LINEAR "%.3" "degC" COEFFS_LINEAR 0.1 -40 /end COMPU_METHOD
/begin COMPU_METHOD bsFFTOil.Conversion "" LINEAR "%.3" "degC" COEFFS_LINEAR 1 -40 /end COMPU_METHOD
/begin COMPU_METHOD bsFFTh2o.Conversion "" LINEAR "%.3" "degC" COEFFS_LINEAR 1 -40 /end COMPU_METHOD
/begin COMPU_METHOD bsFFTh2o_DM4.Conversion "" LINEAR "%.3" "degC" COEFFS_LINEAR 1 -40 /end COMPU_METHOD
/begin COMPU_METHOD bsFFTimeEngStart.Conversion "" LINEAR "%.3" "s" COEFFS_LINEAR 1 0 /end COMPU_METHOD
/begin COMPU_METHOD bsFFVBatt.Conversion "" LINEAR "%.3" "V" COEFFS_LINEAR 0.001 0 /end COMPU_METHOD
/begin COMPU_METHOD bsFFVehSpd.Conversion "" LINEAR "%.3" "km/h" COEFFS_LINEAR 1 0 /end COMPU_METHOD
/begin COMPU_METHOD bsFFVehSpd_DM4.Conversion "" LINEAR "%.3" "km/h" COEFFS_LINEAR 0.00390625 0 /end COMPU_METHOD
/begin COMPU_METHOD bsFan1Duty.Conversion "" LINEAR "%.3" "%" COEFFS_LINEAR 0.125 0 /end COMPU_METHOD
/begin COMPU_METHOD bsFan1Freq.Conversion "" LINEAR "%.3" "Hz" COEFFS_LINEAR 10 0 /end COMPU_METHOD
/begin COMPU_METHOD bsFan2Cmd.Conversion "" LINEAR "%.3" "adm" COEFFS_LINEAR 1 0 /end COMPU_METHOD
/begin COMPU_METHOD bsFuelTotConsHREe.Conversion "" LINEAR "%.3" "l" COEFFS_LINEAR 1E-06 0 /end COMPU_METHOD
/begin COMPU_METHOD bsHDSECU1_Tx_Enable.Conversion "" LINEAR "%.3" "adm" COEFFS_LINEAR 1 0 /end COMPU_METHOD
/begin COMPU_METHOD bsHDSECU2_Tx_Enable.Conversion "" LINEAR "%.3" "adm" COEFFS_LINEAR 1 0 /end COMPU_METHOD
/begin COMPU_METHOD bsIMMOLStatus.Conversion "" LINEAR "%.3" "adm" COEFFS_LINEAR 1 0 /end COMPU_METHOD
/begin COMPU_METHOD bsINLETCOND_Tx_Enable.Conversion "" LINEAR "%.3" "adm" COEFFS_LINEAR 1 0 /end COMPU_METHOD
/begin COMPU_METHOD bsInjFastDecayTime.Conversion "" LINEAR "%.3" "uSec" COEFFS_LINEAR 1 0 /end COMPU_METHOD
/begin COMPU_METHOD bsInjHoldCurrent.Conversion "" LINEAR "%.3" "mA" COEFFS_LINEAR 1 0 /end COMPU_METHOD
/begin COMPU_METHOD bsInjPeakCurrent.Conversion "" LINEAR "%.3" "mA" COEFFS_LINEAR 1 0 /end COMPU_METHOD
/begin COMPU_METHOD bsInjPeakTime.Conversion "" LINEAR "%.3" "uSec" COEFFS_LINEAR 1 0 /end COMPU_METHOD
/begin COMPU_METHOD bsLFC1_Tx_Enable.Conversion "" LINEAR "%.3" "adm" COEFFS_LINEAR 1 0 /end COMPU_METHOD
/begin COMPU_METHOD bsLFE1_Tx_Enable.Conversion "" LINEAR "%.3" "adm" COEFFS_LINEAR 1 0 /end COMPU_METHOD
/begin COMPU_METHOD bsLHDuty.Conversion "" LINEAR "%.3" "%" COEFFS_LINEAR 0.125 0 /end COMPU_METHOD
/begin COMPU_METHOD bsMAirReqEn.Conversion "" LINEAR "%.3" "adm" COEFFS_LINEAR 1 0 /end COMPU_METHOD
/begin COMPU_METHOD bsMILCmd.Conversion "" LINEAR "%.3" "adm" COEFFS_LINEAR 1 0 /end COMPU_METHOD
/begin COMPU_METHOD bsMILStatus.Conversion "" LINEAR "%.3" "adm" COEFFS_LINEAR 1 0 /end COMPU_METHOD
/begin COMPU_METHOD bsMVS_Tx_Enable.Conversion "" LINEAR "%.3" "adm" COEFFS_LINEAR 1 0 /end COMPU_METHOD
/begin COMPU_METHOD bsMilStatusCAN.Conversion "" LINEAR "%.3" "adm" COEFFS_LINEAR 1 0 /end COMPU_METHOD
/begin COMPU_METHOD bsPRVCmd.Conversion "" LINEAR "%.3" "adm" COEFFS_LINEAR 1 0 /end COMPU_METHOD
/begin COMPU_METHOD bsPWRel.Conversion "" LINEAR "%.3" "adm" COEFFS_LINEAR 1 0 /end COMPU_METHOD
/begin COMPU_METHOD bsPWRel.Conversion_Copy1 "" LINEAR "%.3" "adm" COEFFS_LINEAR 1 0 /end COMPU_METHOD
/begin COMPU_METHOD bsPercCmuIstAbs_GOBD.Conversion "" LINEAR "%.3" "%" COEFFS_LINEAR 0.5 0 /end COMPU_METHOD
/begin COMPU_METHOD bsPercCmuReqMgm_GOBD.Conversion "" LINEAR "%.3" "%" COEFFS_LINEAR 1 0 /end COMPU_METHOD
/begin COMPU_METHOD bsREDLCmd.Conversion "" LINEAR "%.3" "adm" COEFFS_LINEAR 1 0 /end COMPU_METHOD
/begin COMPU_METHOD bsREDLStatus.Conversion "" LINEAR "%.3" "adm" COEFFS_LINEAR 1 0 /end COMPU_METHOD
/begin COMPU_METHOD bsRET_CONF_Tx_Enable.Conversion "" LINEAR "%.3" "adm" COEFFS_LINEAR 1 0 /end COMPU_METHOD
/begin COMPU_METHOD bsRPM_GOBD.Conversion "" LINEAR "%.3" "rpm" COEFFS_LINEAR 40 0 /end COMPU_METHOD
/begin COMPU_METHOD bsSEP1_Tx_Enable.Conversion "" LINEAR "%.3" "adm" COEFFS_LINEAR 1 0 /end COMPU_METHOD
/begin COMPU_METHOD bsSHUTDOWN_Tx_Enable.Conversion "" LINEAR "%.3" "adm" COEFFS_LINEAR 1 0 /end COMPU_METHOD
/begin COMPU_METHOD bsSaf3PwrOnVect.Conversion "" LINEAR "%.3" "adm" COEFFS_LINEAR 1 0 /end COMPU_METHOD
/begin COMPU_METHOD bsSaf3RTFiltVect.Conversion "" LINEAR "%.3" "adm" COEFFS_LINEAR 1 0 /end COMPU_METHOD
/begin COMPU_METHOD bsSaf3RTImmVect.Conversion "" LINEAR "%.3" "adm" COEFFS_LINEAR 1 0 /end COMPU_METHOD
/begin COMPU_METHOD bsTH2OLStatus.Conversion "" LINEAR "%.3" "adm" COEFFS_LINEAR 1 0 /end COMPU_METHOD
/begin COMPU_METHOD bsTaskKey.Conversion "" LINEAR "%.3" "adm" COEFFS_LINEAR 1 0 /end COMPU_METHOD
/begin COMPU_METHOD bsTh2o.Conversion "" LINEAR "%.3" "degC" COEFFS_LINEAR 1 -40 /end COMPU_METHOD
/begin COMPU_METHOD bsTh2o_GOBD.Conversion "" LINEAR "%.3" "degC" COEFFS_LINEAR 1 -40 /end COMPU_METHOD
/begin COMPU_METHOD bsTimeDateFlag_GOBD.Conversion "" LINEAR "%.3" "adm" COEFFS_LINEAR 1 0 /end COMPU_METHOD
/begin COMPU_METHOD bsUegoHeaterDC.Conversion "" LINEAR "%.3" "%" COEFFS_LINEAR 0.0030517578125 0 /end COMPU_METHOD
/begin COMPU_METHOD bsVEP1_Tx_Enable.Conversion "" LINEAR "%.3" "adm" COEFFS_LINEAR 1 0 /end COMPU_METHOD
/begin COMPU_METHOD bsWRNLCmd.Conversion "" LINEAR "%.3" "adm" COEFFS_LINEAR 1 0 /end COMPU_METHOD
/begin COMPU_METHOD eCodErr.Conversion "" TAB_VERB "%.0" "" COMPU_TAB_REF eCodErr.Conversion /end COMPU_METHOD
/begin COMPU_METHOD eDiagStatus.Conversion "" TAB_VERB "%.0" "" COMPU_TAB_REF eDiagStatus.Conversion /end COMPU_METHOD
/begin COMPU_METHOD eErrSt.Conversion "" TAB_VERB "%.0" "" COMPU_TAB_REF eErrSt.Conversion /end COMPU_METHOD
/begin COMPU_METHOD s16MappaAdat.Conversion "" LINEAR "%.3" "adm" COEFFS_LINEAR 3.0517578125E-05 0 /end COMPU_METHOD
/begin COMPU_VTAB eCodErr.Conversion "" TAB_VERB 90 0 "NO_FAULT" 1 "SIGNAL_TOO_LOW" 2 "SIGNAL_TOO_BIG" 3 "SC_TO_BATTERY" 4 "SC_TO_GND" 5 "SIGNAL_NOT_PLAUSIBLE" 6 "OC_OR_SC_TO_BATTERY" 7 "OC_OR_SC_TO_GND" 8 "OC" 9 "NO_SIGNAL" 10 "SIGNAL_DELAYED" 11 "TRASMISSION_IMPOSSIBLE" 12 "COMPONENT_DAMAGED" 13 "CONDITION_NOT_CORRECT_" 14 "MECHANICAL_PROBLEM" 15 "GENERIC_FAULT" 16 "DERIVATIVE_TOO_HIGH" 17 "DERIVATIVE_TOO_LOW" 18 "CONTROL_ERROR" 19 "ALIM_KO" 20 "ADC_KO" 21 "CAN_OFF" 22 "AIRQCONTROL_ERROR" 23 "FBCONTROL_ERROR" 24 "RPCONTROL_ERROR" 25 "SAFETY_KO" 26 "SC_HS_LS" 27 "SC_TO_GND_HS" 28 "TPU_ERROR" 29 "OC_OR_SC_TO_GND_LS" 30 "SC_TO_BAT_LS" 31 "OVERTEMPERATURE" 32 "SC_TO_GND_LS" 33 "SC_TO_BAT_HS" 34 "CLOSED" 35 "OPEN" 36 "LOAD_DUMP" 37 "STUCK_OPEN" 38 "STUCK_CLOSED" 39 "UNKNOWN_STATE" 40 "UNDERVOLTAGE" 41 "STUCK_ON" 42 "STUCK_OFF" 43 "ON" 44 "OFF" 45 "THR_INCOHERENCE" 46 "PDL_INCOHERENCE" 47 "POT_2_FAULT" 48 "QAIR_UNDER_ESTIM" 49 "QAIR_OVER_ESTIM" 50 "RSCOPEN_ERROR" 51 "RSCWAIT_ERROR" 52 "RSCCLOSE_ERROR" 53 "OSCCLOSE_ERROR" 54 "OSCOPEN_ERROR" 55 "DTC_ERROR" 56 "NLP_ERROR" 57 "UMA_ERROR" 58 "TEMP_PREWARNING" 59 "TEMP_WARNING" 60 "THR_LRN_ERROR" 61 "COMM_ERROR" 62 "MMP_ERROR" 63 "SMP_ERROR" 64 "EOBD_ERROR" 65 "ENERGY_ERROR" 66 "GAIN_ERROR" 67 "KO2_HPRAIL_ERROR" 68 "KO2_LPRAIL_ERROR" 69 "OFFS_ERROR" 70 "SWT_INCOHERENCE" 71 "MFLV_INCOHERENCE" 72 "SET_PLUS_FAULT" 73 "SET_MINUS_FAULT" 74 "OFF_FAULT" 75 "SET_FAULT" 76 "RESUME_FAULT" 77 "HOLD_FAULT" 78 "STOP_CABIN_TILT_FAULT" 79 "START_CABIN_TILT_FAULT" 80 "STUCK_CLOSED_OR_OPEN_LOAD" 81 "OVERCURR" 82 "CAM_NTEETH_INCOHERENCE" 83 "CAM_POS_INCOHERENCE" 84 "SERIAL_ERROR" 85 "CHIP_FAULT" 86 "SC_PHASES" 87 "STACK_ERROR" 87 "NUMBER_OF_FAULT" 88 "ANY_FAULT" /end COMPU_VTAB
/begin COMPU_VTAB eDiagStatus.Conversion "" TAB_VERB 27 0 "DIAG_STATUS_OK" 1 "DIAG_GENERIC_FAULT" 2 "DIAG_SHORT_GND" 3 "DIAG_SHORT_VCC" 4 "DIAG_SHORT_OVER_LOAD" 5 "DIAG_SHORT_HS_VCC" 6 "DIAG_SHORT_LS_VCC" 7 "DIAG_SHORT_HS_GND" 8 "DIAG_SHORT_LS_GND" 9 "DIAG_SHORT_HS_LS" 10 "DIAG_SHORT_HS_LS_GND" 11 "DIAG_SHORT_HS_LS_VCC" 12 "DIAG_OPEN_LOAD" 13 "DIAG_SHORT_GND_OR_OPEN_LOAD" 14 "DIAG_SHORT_VCC_OR_OPEN_LOAD" 15 "DIAG_OPEN_SECONDARY" 16 "DIAG_OVER_LOAD" 17 "DIAG_OVER_LOAD_LS" 18 "DIAG_OVER_LOAD_HS" 19 "DIAG_OVER_CURRENT" 20 "DIAG_POWER_SUPPLY_FAIL" 21 "DIAG_TEMPERATURE_FAULT" 22 "DIAG_TEMPERATURE_WARNING" 23 "DIAG_CURRENT_LIMITATION" 24 "DIAG_UNDERVOLTAGE" 25 "DIAG_LOAD_ENABLE" 26 "DIAG_BUS_OFF" /end COMPU_VTAB
/begin COMPU_VTAB eErrSt.Conversion "" TAB_VERB 9 0 "NO_ERROR" 1 "FILTERING" 2 "VALIDATING" 4 "CONFIRMED" 8 "CONFIRMED_OLD" 16 "DEBOUNCING" 32 "DEVALIDATED" 64 "REFILTERING" 128 "REVALIDATING" /end COMPU_VTAB
/end MODULE
/end PROJECT
