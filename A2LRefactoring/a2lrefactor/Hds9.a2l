ASAP2_VERSION 1 70
/begin PROJECT XCPonCANFD "Generated for ETAS and Vector "
/begin MODULE XCPonCANFD "Generated for ETAS and Vector "
/begin MOD_COMMON "XCPonCANFD" BYTE_ORDER MSB_FIRST ALIGNMENT_BYTE 1 ALIGNMENT_WORD 2 ALIGNMENT_LONG 4 ALIGNMENT_FLOAT32_IEEE 4 ALIGNMENT_FLOAT64_IEEE 8 ALIGNMENT_INT64 8 /end MOD_COMMON
/begin CHARACTERISTIC ffAUTHOR_LIMITS_Value "[FIX] Fix sullo stato di saturazione della sonda" VALUE 0xFC4027 Scalar_BOOLEAN 0 LambdaPreTDC_CM_boolean_adm 0 1 /end CHARACTERISTIC
/begin CHARACTERISTIC ffCLOSED_LOOP_Enable "[FIX] Fix sul Flag Closed Loop attivo, funzione delle condizioni di abilitazione e dell`authority limit." VALUE 0xFC4026 Scalar_UBYTE 0 LambdaPreTDC_CM_FixEnableT 171 218 /end CHARACTERISTIC
/begin CHARACTERISTIC ffCLOSED_LOOP_Value "[FIX] Fix sul Flag Closed Loop attivo, funzione delle condizioni di abilitazione e dell`authority limit." VALUE 0xFC4025 Scalar_BOOLEAN 0 LambdaPreTDC_CM_boolean_adm 0 1 /end CHARACTERISTIC
/begin CHARACTERISTIC ffCL_EN_LAM_SM_Enable "[FIX] Fix sul Flag Closed Loop attivo per input motoristici." VALUE 0xFC4024 Scalar_UBYTE 0 LambdaPreTDC_CM_FixEnableT 171 218 /end CHARACTERISTIC
/begin CHARACTERISTIC ffCL_EN_LAM_SM_Value "[FIX] Fix sul Flag Closed Loop attivo per input motoristici." VALUE 0xFC4023 Scalar_BOOLEAN 0 LambdaPreTDC_CM_boolean_adm 0 1 /end CHARACTERISTIC
/begin CHARACTERISTIC ffCMD_EQ_RATIO_Enable "[FIX] Fix su Commanded Equivalence Ratio" VALUE 0xFC4022 Scalar_UBYTE 0 LambdaPreTDC_CM_FixEnableT 171 218 /end CHARACTERISTIC
/begin CHARACTERISTIC ffCMD_EQ_RATIO_Value "[FIX] Fix su Commanded Equivalence Ratio" VALUE 0xFC4020 Scalar_UWORD 0 LambdaPreTDC_CM_ufix16_S3p05en5_adm 0 1.9988175 /end CHARACTERISTIC
/begin CHARACTERISTIC ffDEW_POINT_Enable "[FIX] Fix on fsDewPointExc (Dew point exceeded feedback for UEGO sensor)" VALUE 0xFC47E0 Scalar_UBYTE 0 UEGOHeater4ms_CM_FixEnableT 171 218 /end CHARACTERISTIC
/begin CHARACTERISTIC ffDEW_POINT_Value "[FIX] Fix on fsDewPointExc (Dew point exceeded feedback for UEGO sensor)" VALUE 0xFC47DF Scalar_BOOLEAN 0 UEGOHeater4ms_CM_boolean_adm 0 1 /end CHARACTERISTIC
/begin CHARACTERISTIC ffFLAG_TRANS_Enable "[FIX] Fix sul flag dei transitori. Permette di bypassarlo nel calcolo del KO2" VALUE 0xFC401E Scalar_UBYTE 0 LambdaPreTDC_CM_FixEnableT 171 218 /end CHARACTERISTIC
/begin CHARACTERISTIC ffFLAG_TRANS_Value "[FIX] Fix sul flag dei transitori. Permette di bypassarlo nel calcolo del KO2" VALUE 0xFC401D Scalar_BOOLEAN 0 LambdaPreTDC_CM_boolean_adm 0 1 /end CHARACTERISTIC
/begin CHARACTERISTIC ffHEAT_DC1_Enable "[FIX] Vettore dei valori di duty-cycles di comando del riscaldatore sonda lambda - fase 1" VALUE 0xFC45DC Scalar_UBYTE 0 LambdaHeater100ms_CM_FixEnableT 171 218 /end CHARACTERISTIC
/begin CHARACTERISTIC ffHEAT_DC1_Value "[FIX] Vettore dei valori di duty-cycles di comando del riscaldatore sonda lambda - fase 1" VALUE 0xFC45DA Scalar_UWORD 0 LambdaHeater100ms_CM_uint16__ 0 100 /end CHARACTERISTIC
/begin CHARACTERISTIC ffHEAT_DC2_Enable "[FIX] Vettore dei valori di duty-cycles di comando del riscaldatore sonda lambda - fase 2" VALUE 0xFC45D8 Scalar_UBYTE 0 LambdaHeater100ms_CM_FixEnableT 171 218 /end CHARACTERISTIC
/begin CHARACTERISTIC ffHEAT_DC2_Value "[FIX] Vettore dei valori di duty-cycles di comando del riscaldatore sonda lambda - fase 2" VALUE 0xFC45D6 Scalar_UWORD 0 LambdaHeater100ms_CM_uint16__ 0 100 /end CHARACTERISTIC
/begin CHARACTERISTIC ffHEAT_DC3_Enable "[FIX] Vettore dei valori di duty-cycles di comando del riscaldatore sonda lambda - fase 3" VALUE 0xFC45D4 Scalar_UBYTE 0 LambdaHeater100ms_CM_FixEnableT 171 218 /end CHARACTERISTIC
/begin CHARACTERISTIC ffHEAT_DC3_Value "[FIX] Vettore dei valori di duty-cycles di comando del riscaldatore sonda lambda - fase 3" VALUE 0xFC45D2 Scalar_UWORD 0 LambdaHeater100ms_CM_uint16__ 0 100 /end CHARACTERISTIC
/begin CHARACTERISTIC ffHEAT_DC_Enable "[FIX] Tabella dei valori di duty-cycles di comando del riscaldatore sonda lambda dopo le tre fasi di preriscaldamento" VALUE 0xFC45D0 Scalar_UBYTE 0 LambdaHeater100ms_CM_FixEnableT 171 218 /end CHARACTERISTIC
/begin CHARACTERISTIC ffHEAT_DC_Value "[FIX] Tabella dei valori di duty-cycles di comando del riscaldatore sonda lambda dopo le tre fasi di preriscaldamento" VALUE 0xFC45CE Scalar_UWORD 0 LambdaHeater100ms_CM_uint16__ 0 100 /end CHARACTERISTIC
/begin CHARACTERISTIC ffHEAT_T1_Enable "[FIX] Vettore che calcola la durata attuazione del duty-cycles nella - fase 1" VALUE 0xFC45CC Scalar_UBYTE 0 LambdaHeater100ms_CM_FixEnableT 171 218 /end CHARACTERISTIC
/begin CHARACTERISTIC ffHEAT_T1_Value "[FIX] Vettore che calcola la durata attuazione del duty-cycles nella - fase 1" VALUE 0xFC45CA Scalar_UWORD 0 LambdaHeater100ms_CM_ufix16_Sp1_s 0 255 /end CHARACTERISTIC
/begin CHARACTERISTIC ffHEAT_T2_Enable "[FIX] Vettore che calcola la durata attuazione del duty-cycles nella - fase 2" VALUE 0xFC45C8 Scalar_UBYTE 0 LambdaHeater100ms_CM_FixEnableT 171 218 /end CHARACTERISTIC
/begin CHARACTERISTIC ffHEAT_T2_Value "[FIX] Vettore che calcola la durata attuazione del duty-cycles nella - fase 2" VALUE 0xFC45C6 Scalar_UWORD 0 LambdaHeater100ms_CM_ufix16_Sp1_s 0 255 /end CHARACTERISTIC
/begin CHARACTERISTIC ffHEAT_T3_Enable "[FIX] Vettore che calcola la durata attuazione del duty-cycles nella - fase 3" VALUE 0xFC45C4 Scalar_UBYTE 0 LambdaHeater100ms_CM_FixEnableT 171 218 /end CHARACTERISTIC
/begin CHARACTERISTIC ffHEAT_T3_Value "[FIX] Vettore che calcola la durata attuazione del duty-cycles nella - fase 3" VALUE 0xFC45C2 Scalar_UWORD 0 LambdaHeater100ms_CM_ufix16_Sp1_s 0 255 /end CHARACTERISTIC
/begin CHARACTERISTIC ffIP_LAM_CONV_Enable "[FIX] Array for mapping UEGO Ip into a lambdaValue" VALUE 0xFC401C Scalar_UBYTE 0 LambdaPreTDC_CM_FixEnableT 171 218 /end CHARACTERISTIC
/begin CHARACTERISTIC ffIP_LAM_CONV_Value "[FIX] Array for mapping UEGO Ip into a lambdaValue" VALUE 0xFC401A Scalar_UWORD 0 LambdaPreTDC_CM_ufix16_En10_adm 0 15 /end CHARACTERISTIC
/begin CHARACTERISTIC ffKI_ARR_Enable "[FIX] Tabella dei valori di KI in arricchimento" VALUE 0xFC4018 Scalar_UBYTE 0 LambdaPreTDC_CM_FixEnableT 171 218 /end CHARACTERISTIC
/begin CHARACTERISTIC ffKI_ARR_Value "[FIX] Tabella dei valori di KI in arricchimento" VALUE 0xFC4016 Scalar_UWORD 0 LambdaPreTDC_CM_ufix16_En7__ 0 0.5 /end CHARACTERISTIC
/begin CHARACTERISTIC ffKI_LAM_GAIN_Enable "[FIX] Array for gain on Ki for KO2 computation in function of Lambda Target" VALUE 0xFC4014 Scalar_UBYTE 0 LambdaPreTDC_CM_FixEnableT 171 218 /end CHARACTERISTIC
/begin CHARACTERISTIC ffKI_LAM_GAIN_Value "[FIX] Array for gain on Ki for KO2 computation in function of Lambda Target" VALUE 0xFC4012 Scalar_UWORD 0 LambdaPreTDC_CM_ufix16_En6__ 0 10 /end CHARACTERISTIC
/begin CHARACTERISTIC ffKI_SMA_Enable "[FIX] Tabella dei valori di KI in smagrimento" VALUE 0xFC4010 Scalar_UBYTE 0 LambdaPreTDC_CM_FixEnableT 171 218 /end CHARACTERISTIC
/begin CHARACTERISTIC ffKI_SMA_Value "[FIX] Tabella dei valori di KI in smagrimento" VALUE 0xFC400E Scalar_UWORD 0 LambdaPreTDC_CM_ufix16_En7__ 0 0.5 /end CHARACTERISTIC
/begin CHARACTERISTIC ffKO22 "[FIX] Fix sul valore del KO22" VALUE 0xFC405C Scalar_SWORD 0 LambdaPostTDC_Symbol_CM_sfix16_Sp01__ -25 25 /end CHARACTERISTIC
/begin CHARACTERISTIC ffKO22_EnFix "[FIX] Fix sul valore del KO22" VALUE 0xFC405A Scalar_SWORD 0 LambdaPostTDC_Symbol_CM_FixEnableT 171 218 /end CHARACTERISTIC
/begin CHARACTERISTIC ffKO2_Enable "[FIX] Fix sul valore finale Air/Fuel Control Feedback" VALUE 0xFC400D Scalar_UBYTE 0 LambdaPreTDC_CM_FixEnableT 171 218 /end CHARACTERISTIC
/begin CHARACTERISTIC ffKO2_FLAG_TRANS_Enable "[FIX] Fix sull`istante di ingresso nello ricco o magro della sonda lambda OR dei flag fsKO2Sat e fsTransition" VALUE 0xFC400C Scalar_UBYTE 0 LambdaPreTDC_CM_FixEnableT 171 218 /end CHARACTERISTIC
/begin CHARACTERISTIC ffKO2_FLAG_TRANS_Value "[FIX] Fix sull`istante di ingresso nello ricco o magro della sonda lambda OR dei flag fsKO2Sat e fsTransition" VALUE 0xFC400B Scalar_BOOLEAN 0 LambdaPreTDC_CM_boolean_adm 0 1 /end CHARACTERISTIC
/begin CHARACTERISTIC ffKO2_SAT_Enable "[FIX] Tabella dei valori di KP in arricchimento" VALUE 0xFC400A Scalar_UBYTE 0 LambdaPreTDC_CM_FixEnableT 171 218 /end CHARACTERISTIC
/begin CHARACTERISTIC ffKO2_SAT_Value "[FIX] Tabella dei valori di KP in arricchimento" VALUE 0xFC4008 Scalar_UWORD 0 LambdaPreTDC_CM_ufix16_En7__ 0 25 /end CHARACTERISTIC
/begin CHARACTERISTIC ffKO2_TRANS_Enable "[FIX] Fix sul valore finale Air/Fuel Control Feedback per autoadattatività" VALUE 0xFC4006 Scalar_UBYTE 0 LambdaPreTDC_CM_FixEnableT 171 218 /end CHARACTERISTIC
/begin CHARACTERISTIC ffKO2_TRANS_Value "[FIX] Fix sul valore finale Air/Fuel Control Feedback per autoadattatività" VALUE 0xFC4004 Scalar_UWORD 0 LambdaPreTDC_CM_ufix16_En15_adm 0.75 1.25 /end CHARACTERISTIC
/begin CHARACTERISTIC ffKO2_Value "[FIX] Fix sul valore finale Air/Fuel Control Feedback" VALUE 0xFC4002 Scalar_UWORD 0 LambdaPreTDC_CM_ufix16_En15_adm 0.75 1.25 /end CHARACTERISTIC
/begin CHARACTERISTIC ffKP2 "[FIX] Tabella per il calcolo del termine di controllo proporzionale secondo anello (TB_KP2)" VALUE 0xFC4052 Scalar_UWORD 0 LambdaPostTDC_Symbol_CM_ufix16_Sp01___mV 0 1 /end CHARACTERISTIC
/begin CHARACTERISTIC ffKP2_EnFix "[FIX] Tabella per il calcolo del termine di controllo proporzionale secondo anello (TB_KP2)" VALUE 0xFC4050 Scalar_UWORD 0 LambdaPostTDC_Symbol_CM_FixEnableT 171 218 /end CHARACTERISTIC
/begin CHARACTERISTIC ffKP_ARR_Enable "[FIX] Tabella dei valori di KP in arricchimento" VALUE 0xFC4000 Scalar_UBYTE 0 LambdaPreTDC_CM_FixEnableT 171 218 /end CHARACTERISTIC
/begin CHARACTERISTIC ffKP_ARR_Value "[FIX] Tabella dei valori di KP in arricchimento" VALUE 0xFC3FFE Scalar_UWORD 0 LambdaPreTDC_CM_ufix16_En4__ 0 10 /end CHARACTERISTIC
/begin CHARACTERISTIC ffKP_LAM_GAIN_Enable "[FIX] Array for gain on Kp for KO2 computation in function of Lambda Target" VALUE 0xFC3FFC Scalar_UBYTE 0 LambdaPreTDC_CM_FixEnableT 171 218 /end CHARACTERISTIC
/begin CHARACTERISTIC ffKP_LAM_GAIN_Value "[FIX] Array for gain on Kp for KO2 computation in function of Lambda Target" VALUE 0xFC3FFA Scalar_UWORD 0 LambdaPreTDC_CM_ufix16_En6__ 0 10 /end CHARACTERISTIC
/begin CHARACTERISTIC ffKP_SMA_Enable "[FIX] Tabella dei valori di KP in smagrimento" VALUE 0xFC3FF8 Scalar_UBYTE 0 LambdaPreTDC_CM_FixEnableT 171 218 /end CHARACTERISTIC
/begin CHARACTERISTIC ffKP_SMA_Value "[FIX] Tabella dei valori di KP in smagrimento" VALUE 0xFC3FF6 Scalar_UWORD 0 LambdaPreTDC_CM_ufix16_En4__ 0 10 /end CHARACTERISTIC
/begin CHARACTERISTIC ffLAMBDA_ENG_TSTART_Enable "[FIX] Fix sulla condizione di Tstart del riscaldatore " VALUE 0xFC45C0 Scalar_UBYTE 0 LambdaHeater100ms_CM_FixEnableT 171 218 /end CHARACTERISTIC
/begin CHARACTERISTIC ffLAMBDA_ENG_TSTART_Value "[FIX] Fix sulla condizione di Tstart del riscaldatore " VALUE 0xFC45BF Scalar_BOOLEAN 0 LambdaHeater100ms_CM_boolean_adm 0 1 /end CHARACTERISTIC
/begin CHARACTERISTIC ffLAMBDA_STATE_Enable "[FIX] Fix sullo stato corrente della macchina a stati della diagnosi lambda" VALUE 0xFC3FF4 Scalar_UBYTE 0 LambdaPreTDC_CM_FixEnableT 171 218 /end CHARACTERISTIC
/begin CHARACTERISTIC ffLAMBDA_STATE_Value "[FIX] Fix sullo stato corrente della macchina a stati della diagnosi lambda" VALUE 0xFC3FF3 Scalar_UBYTE 0 LambdaPreTDC_CM_uint8_adm 0 2 /end CHARACTERISTIC
/begin CHARACTERISTIC ffLAM_IST_Enable "[FIX] Fix sul valore istantaneo del lambda" VALUE 0xFC3FF2 Scalar_UBYTE 0 LambdaPreTDC_CM_FixEnableT 171 218 /end CHARACTERISTIC
/begin CHARACTERISTIC ffLAM_IST_Value "[FIX] Fix sul valore istantaneo del lambda" VALUE 0xFC3FF0 Scalar_UWORD 0 LambdaPreTDC_CM_ufix16_En8_adm 0.796875 1.3359375 /end CHARACTERISTIC
/begin CHARACTERISTIC ffLH_DUTY_RIF_Enable "[FIX] Fix sul valore finale del duty-cycles applicato al riscaldatore della sonda lambda" VALUE 0xFC45BE Scalar_UBYTE 0 LambdaHeater100ms_CM_FixEnableT 171 218 /end CHARACTERISTIC
/begin CHARACTERISTIC ffLH_DUTY_RIF_Value "[FIX] Fix sul valore finale del duty-cycles applicato al riscaldatore della sonda lambda" VALUE 0xFC45BC Scalar_UWORD 0 LambdaHeater100ms_CM_uint16__ 0 100 /end CHARACTERISTIC
/begin CHARACTERISTIC ffO2_CONC_OBT_Enable "[FIX] Array for assocition from target lambda ratio and oxigen concentration target" VALUE 0xFC3FEE Scalar_UBYTE 0 LambdaPreTDC_CM_FixEnableT 171 218 /end CHARACTERISTIC
/begin CHARACTERISTIC ffO2_CONC_OBT_Value "[FIX] Array for assocition from target lambda ratio and oxigen concentration target" VALUE 0xFC3FEC Scalar_SWORD 0 LambdaPreTDC_CM_sfix16_Sp01_Bn40p96__ -30 30 /end CHARACTERISTIC
/begin CHARACTERISTIC ffRT_ARR_Enable "[FIX] Tabella dei ritardi nella fase di arricchimento" VALUE 0xFC3FEA Scalar_UBYTE 0 LambdaPreTDC_CM_FixEnableT 171 218 /end CHARACTERISTIC
/begin CHARACTERISTIC ffRT_ARR_Value "[FIX] Tabella dei ritardi nella fase di arricchimento" VALUE 0xFC3FE8 Scalar_UWORD 0 LambdaPreTDC_CM_uint16_tdc 0 60000 /end CHARACTERISTIC
/begin CHARACTERISTIC ffRT_SMA_ARR_KO22_Enable "[FIX]  ???? Tabella per il calcolo della correzione del ritardo allo smagrimento/arricchimento dal secondo anello (TBRITVAL)" VALUE 0xFC3FE6 Scalar_UBYTE 0 LambdaPreTDC_CM_FixEnableT 171 218 /end CHARACTERISTIC
/begin CHARACTERISTIC ffRT_SMA_ARR_KO22_Value "[FIX]  ???? Tabella per il calcolo della correzione del ritardo allo smagrimento/arricchimento dal secondo anello (TBRITVAL)" VALUE 0xFC3FE4 Scalar_UWORD 0 LambdaPreTDC_CM_uint16_tdc 0 60000 /end CHARACTERISTIC
/begin CHARACTERISTIC ffRT_SMA_Enable "[FIX] Tabella dei ritardi nella fase di smagrimento" VALUE 0xFC3FE2 Scalar_UBYTE 0 LambdaPreTDC_CM_FixEnableT 171 218 /end CHARACTERISTIC
/begin CHARACTERISTIC ffRT_SMA_Value "[FIX] Tabella dei ritardi nella fase di smagrimento" VALUE 0xFC3FE0 Scalar_UWORD 0 LambdaPreTDC_CM_uint16_tdc 0 60000 /end CHARACTERISTIC
/begin CHARACTERISTIC ffSG_LAMBDA_Enable "[FIX] Fix su Soglia sonda Lambda" VALUE 0xFC3FDE Scalar_UBYTE 0 LambdaPreTDC_CM_FixEnableT 171 218 /end CHARACTERISTIC
/begin CHARACTERISTIC ffSG_LAMBDA_Value "[FIX] Fix su Soglia sonda Lambda" VALUE 0xFC3FDC Scalar_UWORD 0 LambdaPreTDC_CM_uint16_mV 0 1000 /end CHARACTERISTIC
/begin CHARACTERISTIC ffSO2_Enable "[FIX] Tabella dei valori della soglia di transizione" VALUE 0xFC3FDA Scalar_UBYTE 0 LambdaPreTDC_CM_FixEnableT 171 218 /end CHARACTERISTIC
/begin CHARACTERISTIC ffSO2_Value "[FIX] Tabella dei valori della soglia di transizione" VALUE 0xFC3FD8 Scalar_UWORD 0 LambdaPreTDC_CM_uint16_mV 0 1000 /end CHARACTERISTIC
/begin CHARACTERISTIC ffSV_TR "[FIX] Tabella per il calcolo della soglia di transizione sonda lambda post-catalizzatore (TB_VLTR2)" VALUE 0xFC404E Scalar_UWORD 0 LambdaPostTDC_Symbol_CM_uint16_mV 0 1000 /end CHARACTERISTIC
/begin CHARACTERISTIC ffSV_TR_EnFix "[FIX] Tabella per il calcolo della soglia di transizione sonda lambda post-catalizzatore (TB_VLTR2)" VALUE 0xFC404C Scalar_UWORD 0 LambdaPostTDC_Symbol_CM_FixEnableT 171 218 /end CHARACTERISTIC
/begin CHARACTERISTIC ffTD_SM_SV "[FIX] Tabella dei tempi di ritardo del gas di scarico fra le due sonde (TB_TD)" VALUE 0xFC404A Scalar_UWORD 0 LambdaPostTDC_Symbol_CM_uint16_PMS 1 10000 /end CHARACTERISTIC
/begin CHARACTERISTIC ffTD_SM_SV_EnFix "[FIX] Tabella dei tempi di ritardo del gas di scarico fra le due sonde (TB_TD)" VALUE 0xFC4048 Scalar_UWORD 0 LambdaPostTDC_Symbol_CM_FixEnableT 171 218 /end CHARACTERISTIC
/begin CHARACTERISTIC ffTH2O_TIME_UEGO_Enable "[FIX] Array indicates the time to wait to set on dew point exceeded feedback on UEGO sensor, starting from preheating signal on and in function of water temp" VALUE 0xFC47DE Scalar_UBYTE 0 UEGOHeater4ms_CM_FixEnableT 171 218 /end CHARACTERISTIC
/begin CHARACTERISTIC ffTH2O_TIME_UEGO_Value "[FIX] Array indicates the time to wait to set on dew point exceeded feedback on UEGO sensor, starting from preheating signal on and in function of water temp" VALUE 0xFC47DC Scalar_UWORD 0 UEGOHeater4ms_CM_ufix16_Sp1_sec 0 6500 /end CHARACTERISTIC
/begin CHARACTERISTIC ffTRANSITION_Enable "[FIX] Fix on Transition Flag" VALUE 0xFC3FD7 Scalar_UBYTE 0 LambdaPreTDC_CM_FixEnableT 171 218 /end CHARACTERISTIC
/begin CHARACTERISTIC ffTRANSITION_Value "[FIX] Fix on Transition Flag" VALUE 0xFC3FD6 Scalar_BOOLEAN 0 LambdaPreTDC_CM_boolean_adm 0 1 /end CHARACTERISTIC
/begin CHARACTERISTIC ffT_LAMBDA_OK_Enable "[FIX] Fix sulla operatività per temperatura della sonda lambda" VALUE 0xFC45BB Scalar_UBYTE 0 LambdaHeater100ms_CM_FixEnableT 171 218 /end CHARACTERISTIC
/begin CHARACTERISTIC ffT_LAMBDA_OK_Value "[FIX] Fix sulla operatività per temperatura della sonda lambda" VALUE 0xFC45BA Scalar_BOOLEAN 0 LambdaHeater100ms_CM_boolean_adm 0 1 /end CHARACTERISTIC
/begin CHARACTERISTIC ffUEGO_HEATER_CL_Enable "[FIX] Enable for Closed-Loop PID Control on UEGO heater" VALUE 0xFC47DA Scalar_UBYTE 0 UEGOHeater4ms_CM_FixEnableT 171 218 /end CHARACTERISTIC
/begin CHARACTERISTIC ffUEGO_HEATER_CL_Value "[FIX] Enable for Closed-Loop PID Control on UEGO heater" VALUE 0xFC47D9 Scalar_BOOLEAN 0 UEGOHeater4ms_CM_boolean 0 1 /end CHARACTERISTIC
/begin CHARACTERISTIC ffUEGO_HEATER_DC_PRE_Enable "[FIX] UEGO Heater PWM duty cycle" VALUE 0xFC47D8 Scalar_UBYTE 0 UEGOHeater4ms_CM_FixEnableT 171 218 /end CHARACTERISTIC
/begin CHARACTERISTIC ffUEGO_HEATER_DC_PRE_Value "[FIX] UEGO Heater PWM duty cycle" VALUE 0xFC47D4 Scalar_ULONG 0 UEGOHeater4ms_CM_ufix32_En24__ 0 100 /end CHARACTERISTIC
/begin CHARACTERISTIC ffUEGO_LAM_EMUL_Enable "[FIX] Array for mapping UEGO signal (normalized on target value) emulating Lambda signal (in mV)" VALUE 0xFC3FD5 Scalar_UBYTE 0 LambdaPreTDC_CM_FixEnableT 171 218 /end CHARACTERISTIC
/begin CHARACTERISTIC ffUEGO_LAM_EMUL_LSU_Enable "[FIX] Array for mapping UEGO Lambda LSU (normalized on target value) emulating Lambda signal (in mV)" VALUE 0xFC3FD4 Scalar_UBYTE 0 LambdaPreTDC_CM_FixEnableT 171 218 /end CHARACTERISTIC
/begin CHARACTERISTIC ffUEGO_LAM_EMUL_LSU_Value "[FIX] Array for mapping UEGO Lambda LSU (normalized on target value) emulating Lambda signal (in mV)" VALUE 0xFC3FD2 Scalar_UWORD 0 LambdaPreTDC_CM_uint16_mV 0 1000 /end CHARACTERISTIC
/begin CHARACTERISTIC ffUEGO_LAM_EMUL_Value "[FIX] Array for mapping UEGO signal (normalized on target value) emulating Lambda signal (in mV)" VALUE 0xFC3FD0 Scalar_UWORD 0 LambdaPreTDC_CM_uint16_mV 0 1000 /end CHARACTERISTIC
/begin CHARACTERISTIC ffUEGO_RES_TO_TEMP_Enable "[FIX] [OUT] Conversion map between UEGO heater resistance and UEGO temperature" VALUE 0xFC47D2 Scalar_UBYTE 0 UEGOHeater4ms_CM_FixEnableT 171 218 /end CHARACTERISTIC
/begin CHARACTERISTIC ffUEGO_RES_TO_TEMP_Value "[FIX] [OUT] Conversion map between UEGO heater resistance and UEGO temperature" VALUE 0xFC47D0 Scalar_UWORD 0 UEGOHeater4ms_CM_ufix16_En6_B600_degC 600 1480 /end CHARACTERISTIC
/begin AXIS_PTS fk2ETASP_8 "[YBK] Tabella dei valori di duty-cycles di comando del riscaldatore sonda lambda dopo le tre fasi di preriscaldamento" 0xFC45AA NO_INPUT_QUANTITY Lookup2D_X_UWORD 0 LambdaHeater_2_100ms_CM_ufix16_En10_adm 8 0 3 /end AXIS_PTS
/begin AXIS_PTS fk2RPM_9 "[XBK] Tabella dei valori di duty-cycles di comando del riscaldatore sonda lambda dopo le tre fasi di preriscaldamento" 0xFC459A NO_INPUT_QUANTITY Lookup2D_X_UWORD 0 LambdaHeater_2_100ms_CM_uint16_rpm 8 0 10000 /end AXIS_PTS
/begin AXIS_PTS fk2TH2O_1 "[XBK] Vettore dei valori di duty-cycles di comando del riscaldatore sonda lambda - fase 1" 0xFC458A NO_INPUT_QUANTITY Lookup1D_X_UWORD 0 LambdaHeater_2_100ms_CM_ufix16_Bn40_degC 8 -40 140 /end AXIS_PTS
/begin AXIS_PTS fk2TH2O_2 "[XBK] Vettore dei valori di duty-cycles di comando del riscaldatore sonda lambda - fase 2" 0xFC457A NO_INPUT_QUANTITY Lookup1D_X_UWORD 0 LambdaHeater_2_100ms_CM_ufix16_Bn40_degC 8 -40 140 /end AXIS_PTS
/begin AXIS_PTS fk2TH2O_3 "[XBK] Vettore dei valori di duty-cycles di comando del riscaldatore sonda lambda - fase 3" 0xFC456A NO_INPUT_QUANTITY Lookup1D_X_UWORD 0 LambdaHeater_2_100ms_CM_ufix16_Bn40_degC 8 -40 140 /end AXIS_PTS
/begin AXIS_PTS fk2TH2O_4 "[XBK] Vettore che calcola la durata attuazione del duty-cycles nella - fase 1" 0xFC455A NO_INPUT_QUANTITY Lookup1D_X_UWORD 0 LambdaHeater_2_100ms_CM_ufix16_Bn40_degC 8 -40 140 /end AXIS_PTS
/begin AXIS_PTS fk2TH2O_5 "[XBK] Vettore che calcola la durata attuazione del duty-cycles nella - fase 2" 0xFC454A NO_INPUT_QUANTITY Lookup1D_X_UWORD 0 LambdaHeater_2_100ms_CM_ufix16_Bn40_degC 8 -40 140 /end AXIS_PTS
/begin AXIS_PTS fk2TH2O_6 "[XBK] Vettore che calcola la durata attuazione del duty-cycles nella - fase 3" 0xFC453A NO_INPUT_QUANTITY Lookup1D_X_UWORD 0 LambdaHeater_2_100ms_CM_ufix16_Bn40_degC 8 -40 140 /end AXIS_PTS
/begin AXIS_PTS fkETASP_1 "[XBK] Tabella dei valori di KP in arricchimento" 0xFC3FB0 NO_INPUT_QUANTITY Lookup2D_X_UWORD 0 LambdaPreTDC_CM_ufix16_En10_adm 16 0 3 /end AXIS_PTS
/begin AXIS_PTS fkETASP_2 "[XBK] Tabella dei valori di KI in arricchimento" 0xFC3F90 NO_INPUT_QUANTITY Lookup2D_X_UWORD 0 LambdaPreTDC_CM_ufix16_En10_adm 16 0 3 /end AXIS_PTS
/begin AXIS_PTS fkETASP_3 "[XBK] Tabella dei ritardi nella fase di arricchimento" 0xFC3F70 NO_INPUT_QUANTITY Lookup2D_X_UWORD 0 LambdaPreTDC_CM_ufix16_En10_adm 16 0 3 /end AXIS_PTS
/begin AXIS_PTS fkETASP_4 "[XBK] Tabella dei valori di KP in smagrimento" 0xFC3F50 NO_INPUT_QUANTITY Lookup2D_X_UWORD 0 LambdaPreTDC_CM_ufix16_En10_adm 16 0 3 /end AXIS_PTS
/begin AXIS_PTS fkETASP_5 "[XBK] Tabella dei valori di KI in smagrimento" 0xFC3F30 NO_INPUT_QUANTITY Lookup2D_X_UWORD 0 LambdaPreTDC_CM_ufix16_En10_adm 16 0 3 /end AXIS_PTS
/begin AXIS_PTS fkETASP_6 "[XBK] Tabella dei ritardi nella fase di smagrimento" 0xFC3F10 NO_INPUT_QUANTITY Lookup2D_X_UWORD 0 LambdaPreTDC_CM_ufix16_En10_adm 16 0 3 /end AXIS_PTS
/begin AXIS_PTS fkETASP_7 "[YBK] Tabella dei valori di KP in arricchimento" 0xFC3EF0 NO_INPUT_QUANTITY Lookup2D_X_UWORD 0 LambdaPreTDC_CM_ufix16_En10_adm 16 0 3 /end AXIS_PTS
/begin AXIS_PTS fkETASP_8 "[YBK] Tabella dei valori di duty-cycles di comando del riscaldatore sonda lambda dopo le tre fasi di preriscaldamento" 0xFC452A NO_INPUT_QUANTITY Lookup2D_X_UWORD 0 LambdaHeater100ms_CM_ufix16_En10_adm 8 0 3 /end AXIS_PTS
/begin AXIS_PTS fkKP2_RPM "[XBK] Tabella per il calcolo del termine di controllo proporzionale secondo anello (TB_KP2)" 0xFC42DE NO_INPUT_QUANTITY Lookup2D_X_UWORD 0 LambdaPostTDC_Symbol_CM_uint16_rpm 8 0 3000 /end AXIS_PTS
/begin AXIS_PTS fkKP2_VL2 "[YBK] Tabella per il calcolo del termine di controllo proporzionale secondo anello (TB_KP2)" 0xFC42CE NO_INPUT_QUANTITY Lookup2D_X_UWORD 0 LambdaPostTDC_Symbol_CM_uint16_mV 8 0 1000 /end AXIS_PTS
/begin AXIS_PTS fkLAM_OBT "[XBK] Array for assocition from target lambda ratio and oxigen concentration target" 0xFC3ED0 NO_INPUT_QUANTITY Lookup1D_X_UWORD 0 LambdaPreTDC_CM_ufix16_En10_adm 16 0.015625 1.599609375 /end AXIS_PTS
/begin AXIS_PTS fkLAM_OBT_KI "[XBK] Array for gain on Ki for KO2 computation in function of Lambda Target" 0xFC3EB0 NO_INPUT_QUANTITY Lookup1D_X_UWORD 0 LambdaPreTDC_CM_ufix16_En10_adm 16 0.015625 1.599609375 /end AXIS_PTS
/begin AXIS_PTS fkLAM_OBT_KP "[XBK] Array for gain on Kp for KO2 computation in function of Lambda Target" 0xFC3E90 NO_INPUT_QUANTITY Lookup1D_X_UWORD 0 LambdaPreTDC_CM_ufix16_En10_adm 16 0.015625 1.599609375 /end AXIS_PTS
/begin AXIS_PTS fkO2CONC_DELTA "[XBK] Array for mapping UEGO signal (normalized on target value) emulating Lambda signal (in mV)" 0xFC3E70 NO_INPUT_QUANTITY Lookup1D_X_UWORD 0 LambdaPreTDC_CM_ufix16_Sp01_Bn40p96__ 16 -30 30 /end AXIS_PTS
/begin AXIS_PTS fkRPM_1 "[YBK] Tabella dei valori di KP in arricchimento" 0xFC3E50 NO_INPUT_QUANTITY Lookup2D_X_UWORD 0 LambdaPreTDC_CM_uint16_rpm 16 0 10000 /end AXIS_PTS
/begin AXIS_PTS fkRPM_2 "[YBK] Tabella dei valori di KI in arricchimento" 0xFC3E30 NO_INPUT_QUANTITY Lookup2D_X_UWORD 0 LambdaPreTDC_CM_uint16_rpm 16 0 10000 /end AXIS_PTS
/begin AXIS_PTS fkRPM_3 "[YBK] Tabella dei ritardi nella fase di arricchimento" 0xFC3E10 NO_INPUT_QUANTITY Lookup2D_X_UWORD 0 LambdaPreTDC_CM_uint16_rpm 16 0 10000 /end AXIS_PTS
/begin AXIS_PTS fkRPM_4 "[YBK] Tabella dei valori di KP in smagrimento" 0xFC3DF0 NO_INPUT_QUANTITY Lookup2D_X_UWORD 0 LambdaPreTDC_CM_uint16_rpm 16 0 10000 /end AXIS_PTS
/begin AXIS_PTS fkRPM_5 "[YBK] Tabella dei valori di KI in smagrimento" 0xFC3DD0 NO_INPUT_QUANTITY Lookup2D_X_UWORD 0 LambdaPreTDC_CM_uint16_rpm 16 0 10000 /end AXIS_PTS
/begin AXIS_PTS fkRPM_6 "[YBK] Tabella dei ritardi nella fase di smagrimento" 0xFC3DB0 NO_INPUT_QUANTITY Lookup2D_X_UWORD 0 LambdaPreTDC_CM_uint16_rpm 16 0 10000 /end AXIS_PTS
/begin AXIS_PTS fkRPM_7 "[XBK] Tabella dei valori di KP in arricchimento" 0xFC3D90 NO_INPUT_QUANTITY Lookup2D_X_UWORD 0 LambdaPreTDC_CM_uint16_rpm 16 0 10000 /end AXIS_PTS
/begin AXIS_PTS fkRPM_8 "[XBK] Tabella dei valori della soglia di transizione" 0xFC3D70 NO_INPUT_QUANTITY Lookup1D_X_UWORD 0 LambdaPreTDC_CM_uint16_rpm 16 0 10000 /end AXIS_PTS
/begin AXIS_PTS fkRPM_9 "[XBK] Tabella dei valori di duty-cycles di comando del riscaldatore sonda lambda dopo le tre fasi di preriscaldamento" 0xFC451A NO_INPUT_QUANTITY Lookup2D_X_UWORD 0 LambdaHeater100ms_CM_uint16_rpm 8 0 10000 /end AXIS_PTS
/begin AXIS_PTS fkRT_KO22_PERC "[YBK]  ???? Tabella per il calcolo della correzione del ritardo allo smagrimento/arricchimento dal secondo anello (TBRITVAL)" 0xFC3D60 NO_INPUT_QUANTITY Lookup2D_X_UWORD 0 LambdaPreTDC_CM_ufix16_En4_Bn100__ 8 -100 100 /end AXIS_PTS
/begin AXIS_PTS fkRT_KO22_RPM "[XBK]  ???? Tabella per il calcolo della correzione del ritardo allo smagrimento/arricchimento dal secondo anello (TBRITVAL)" 0xFC3D50 NO_INPUT_QUANTITY Lookup2D_X_UWORD 0 LambdaPreTDC_CM_uint16_rpm 8 0 3000 /end AXIS_PTS
/begin AXIS_PTS fkSVTR_ETASP "[XBK] Tabella per il calcolo della soglia di transizione sonda lambda post-catalizzatore (TB_VLTR2)" 0xFC42B6 NO_INPUT_QUANTITY Lookup2D_X_UWORD 0 LambdaPostTDC_Symbol_CM_ufix16_En10_adm 12 0 3 /end AXIS_PTS
/begin AXIS_PTS fkSVTR_RPM "[YBK] Tabella per il calcolo della soglia di transizione sonda lambda post-catalizzatore (TB_VLTR2)" 0xFC429E NO_INPUT_QUANTITY Lookup2D_X_UWORD 0 LambdaPostTDC_Symbol_CM_uint16_rpm 12 0 3000 /end AXIS_PTS
/begin AXIS_PTS fkTD_ETASP "[XBK] Tabella dei tempi di ritardo del gas di scarico fra le due sonde (TB_TD)" 0xFC428E NO_INPUT_QUANTITY Lookup2D_X_UWORD 0 LambdaPostTDC_Symbol_CM_ufix16_En10_adm 8 0 3 /end AXIS_PTS
/begin AXIS_PTS fkTD_RPM "[YBK] Tabella dei tempi di ritardo del gas di scarico fra le due sonde (TB_TD)" 0xFC427E NO_INPUT_QUANTITY Lookup2D_X_UWORD 0 LambdaPostTDC_Symbol_CM_uint16_rpm 8 0 3000 /end AXIS_PTS
/begin AXIS_PTS fkTH20_TIME_UEGO "[XBK] Array indicates the time to wait to set on dew point exceeded feedback on UEGO sensor, starting from preheating signal on and in function of water temp" 0xFC47C0 NO_INPUT_QUANTITY Lookup1D_X_UWORD 0 UEGOHeater4ms_CM_ufix16_Bn40_degC 8 -40 140 /end AXIS_PTS
/begin AXIS_PTS fkTH2O_1 "[XBK] Vettore dei valori di duty-cycles di comando del riscaldatore sonda lambda - fase 1" 0xFC450A NO_INPUT_QUANTITY Lookup1D_X_UWORD 0 LambdaHeater100ms_CM_ufix16_Bn40_degC 8 -40 140 /end AXIS_PTS
/begin AXIS_PTS fkTH2O_2 "[XBK] Vettore dei valori di duty-cycles di comando del riscaldatore sonda lambda - fase 2" 0xFC44FA NO_INPUT_QUANTITY Lookup1D_X_UWORD 0 LambdaHeater100ms_CM_ufix16_Bn40_degC 8 -40 140 /end AXIS_PTS
/begin AXIS_PTS fkTH2O_3 "[XBK] Vettore dei valori di duty-cycles di comando del riscaldatore sonda lambda - fase 3" 0xFC44EA NO_INPUT_QUANTITY Lookup1D_X_UWORD 0 LambdaHeater100ms_CM_ufix16_Bn40_degC 8 -40 140 /end AXIS_PTS
/begin AXIS_PTS fkTH2O_4 "[XBK] Vettore che calcola la durata attuazione del duty-cycles nella - fase 1" 0xFC44DA NO_INPUT_QUANTITY Lookup1D_X_UWORD 0 LambdaHeater100ms_CM_ufix16_Bn40_degC 8 -40 140 /end AXIS_PTS
/begin AXIS_PTS fkTH2O_5 "[XBK] Vettore che calcola la durata attuazione del duty-cycles nella - fase 2" 0xFC44CA NO_INPUT_QUANTITY Lookup1D_X_UWORD 0 LambdaHeater100ms_CM_ufix16_Bn40_degC 8 -40 140 /end AXIS_PTS
/begin AXIS_PTS fkTH2O_6 "[XBK] Vettore che calcola la durata attuazione del duty-cycles nella - fase 3" 0xFC44BA NO_INPUT_QUANTITY Lookup1D_X_UWORD 0 LambdaHeater100ms_CM_ufix16_Bn40_degC 8 -40 140 /end AXIS_PTS
/begin AXIS_PTS fkUEGO_HEATER_RES "[X_BKP] UEGO heater resistance" 0xFC4702 NO_INPUT_QUANTITY Lookup1D_X_UWORD 0 UEGOHeater4ms_CM_ufix16_En6_degC 95 51 1023 /end AXIS_PTS
/begin AXIS_PTS fkUEGO_IP "[XBK] Array for mapping UEGO Ip into a lambdaValue" 0xFC3D24 NO_INPUT_QUANTITY Lookup1D_X_UWORD 0 LambdaPreTDC_CM_ufix16_Sp0001_Bn3_mA 22 -3 3 /end AXIS_PTS
/begin AXIS_PTS fkUEGO_LAM_DELTA "[XBK] Array for mapping UEGO Lambda LSU (normalized on target value) emulating Lambda signal (in mV)" 0xFC3D0A NO_INPUT_QUANTITY Lookup1D_X_UWORD 0 LambdaPreTDC_CM_ufix16_En10_Bn2_adm 13 -2 2 /end AXIS_PTS
/begin MEASUREMENT fs2ClosedLoop "Flag Closed Loop attivo, funzione delle condizioni di abilitazione (engine+diagnosi)" UBYTE Ctit_LambdaCtrlTDC_CM_boolean_adm 0 0 0 1 ECU_ADDRESS 0x400023CA /end MEASUREMENT
/begin MEASUREMENT fs2GainBattDc "Test Point. Fattore che riduce il duty-cycles applicato in funz. di Vbatt" UWORD LambdaHeater_2_100ms_CM_ufix16_En14_adm 0 0 0.151245117188 1 ECU_ADDRESS 0x400025B2 /end MEASUREMENT
/begin CHARACTERISTIC fs2HEAT_DC_NORPM "Duty-cycle applicato se sono terminate le tre fasi di preriscaldamento e motore fermo" VALUE 0xFC44B8 Scalar_UWORD 0 LambdaHeater_2_100ms_CM_uint16__ 0 100 /end CHARACTERISTIC
/begin CHARACTERISTIC fs2LAMBDA_F3 "Flag attivazione riscaldatore tipo Fase 3" VALUE 0xFC44B6 Scalar_BOOLEAN 0 LambdaHeater_2_100ms_CM_boolean_adm 0 1 /end CHARACTERISTIC
/begin MEASUREMENT fs2LHDuty "Duty-cycle riscaldatore sonda lambda" UWORD Ctit_LambdaHeater100ms_CM_uint16__ 0 0 0 100 ECU_ADDRESS 0x40002516 /end MEASUREMENT
/begin MEASUREMENT fs2LHDutyRif "" UWORD LambdaHeater_2_100ms_CM_uint16__ 0 0 0 100 ECU_ADDRESS 0x400025B0 /end MEASUREMENT
/begin MEASUREMENT fs2LHDutyTmp "" UWORD LambdaHeater_2_100ms_CM_uint16__ 0 0 0 100 ECU_ADDRESS 0x400025AE /end MEASUREMENT
/begin CHARACTERISTIC fs2START_LAMBDA "Tempo di attesa prima di ritenere calda la sonda e chiudere il Loop sul KO2" VALUE 0xFC44B4 Scalar_UWORD 0 LambdaHeater_2_100ms_CM_ufix16_Sp1_s 0 3200 /end CHARACTERISTIC
/begin MEASUREMENT fs2TLambdaOK "Flag riscaldatore sonda lambda settato a 1 dopo le tre fasi di riscaldamento" UBYTE Ctit_LambdaHeater100ms_CM_boolean_adm 0 0 0 1 ECU_ADDRESS 0x4000250E /end MEASUREMENT
/begin MEASUREMENT fs2TLambdaOKTmp "" UBYTE LambdaHeater_2_100ms_CM_boolean_adm 0 0 0 1 ECU_ADDRESS 0x400025AC /end MEASUREMENT
/begin MEASUREMENT fs2heatDc "[OUT] Tabella dei valori di duty-cycles di comando del riscaldatore sonda lambda dopo le tre fasi di preriscaldamento" UWORD LambdaHeater_2_100ms_CM_uint16__ 0 0 0 100 ECU_ADDRESS 0x400025AA /end MEASUREMENT
/begin MEASUREMENT fs2heatDc1 "[OUT] Vettore dei valori di duty-cycles di comando del riscaldatore sonda lambda - fase 1" UWORD LambdaHeater_2_100ms_CM_uint16__ 0 0 0 100 ECU_ADDRESS 0x400025A8 /end MEASUREMENT
/begin MEASUREMENT fs2heatDc2 "[OUT] Vettore dei valori di duty-cycles di comando del riscaldatore sonda lambda - fase 2" UWORD LambdaHeater_2_100ms_CM_uint16__ 0 0 0 100 ECU_ADDRESS 0x400025A6 /end MEASUREMENT
/begin MEASUREMENT fs2heatDc3 "[OUT] Vettore dei valori di duty-cycles di comando del riscaldatore sonda lambda - fase 3" UWORD LambdaHeater_2_100ms_CM_uint16__ 0 0 0 100 ECU_ADDRESS 0x400025A4 /end MEASUREMENT
/begin MEASUREMENT fs2heatT1 "[OUT] Vettore che calcola la durata attuazione del duty-cycles nella - fase 1" UWORD LambdaHeater_2_100ms_CM_ufix16_Sp1_s 0 0 0 255 ECU_ADDRESS 0x400025A2 /end MEASUREMENT
/begin MEASUREMENT fs2heatT2 "[OUT] Vettore che calcola la durata attuazione del duty-cycles nella - fase 2" UWORD LambdaHeater_2_100ms_CM_ufix16_Sp1_s 0 0 0 255 ECU_ADDRESS 0x400025A0 /end MEASUREMENT
/begin MEASUREMENT fs2heatT3 "[OUT] Vettore che calcola la durata attuazione del duty-cycles nella - fase 3" UWORD LambdaHeater_2_100ms_CM_ufix16_Sp1_s 0 0 0 255 ECU_ADDRESS 0x4000259E /end MEASUREMENT
/begin CHARACTERISTIC fsALFA_IN_DB "Rapporto di riduzione della velocità del controllo nella banda morta (ALFADBI)" VALUE 0xFC4046 Scalar_UWORD 0 LambdaPostTDC_Symbol_CM_ufix16_Sp1_mV____PMS_ 1 20 /end CHARACTERISTIC
/begin CHARACTERISTIC fsALFA_OUT_DB "Rapporto di riduzione della velocità del controllo fuori dalla banda morta (ALFAENE)" VALUE 0xFC4044 Scalar_UWORD 0 LambdaPostTDC_Symbol_CM_ufix16_Sp1_mV____PMS_ 1 20 /end CHARACTERISTIC
/begin MEASUREMENT fsAuthorLimits "Indica se la sonda permane in uno stato di saturazione per un numero di TDC in calibrazione" UBYTE Ctit_LambdaCtrlTDC_CM_boolean_adm 0 0 0 1 ECU_ADDRESS 0x400023D1 /end MEASUREMENT
/begin MEASUREMENT fsCLEnLamSM "Closed Loop enable. Engine condition OK" UBYTE Ctit_LambdaCtrlTDC_CM_boolean_adm 0 0 0 1 ECU_ADDRESS 0x400023D0 /end MEASUREMENT
/begin MEASUREMENT fsClosedLoop "Flag Closed Loop attivo, funzione delle condizioni di abilitazione e dell`authority limit" UBYTE AutoTDC_CM_boolean_adm 0 0 0 1 ECU_ADDRESS 0x400023CC /end MEASUREMENT
/begin MEASUREMENT fsCmdEqRatio "ommanded Equivalence Ratio" UWORD Ctit_LambdaCtrlTDC_CM_ufix16_S3p05en5_adm 0 0 0 1.9988175 ECU_ADDRESS 0x400023DA /end MEASUREMENT
/begin MEASUREMENT fsCohCheckEn "Enable signal for lambda pre coherence check" UBYTE DiagLamTDC_CM_boolean_adm 0 0 0 1 ECU_ADDRESS 0x400023F6 /end MEASUREMENT
/begin CHARACTERISTIC fsDEAD_BAND_INF "Soglia di transizione negativa della banda morta lambda post-catalizzatore (DEADBN)" VALUE 0xFC4058 Scalar_SWORD 0 LambdaPostTDC_Symbol_CM_int16_mV -1000 0 /end CHARACTERISTIC
/begin CHARACTERISTIC fsDEAD_BAND_SUP "Soglia di transizione positiva della banda morta lambda post-catalizzatore (DEADBP)" VALUE 0xFC4042 Scalar_UWORD 0 LambdaPostTDC_Symbol_CM_uint16_mV 0 1000 /end CHARACTERISTIC
/begin MEASUREMENT fsDKo22 "Test Point. Correzione proporzionale del KO2 (GLCR2)" SWORD LambdaPreTDC_CM_sfix16_En4__ 0 0 -100 100 ECU_ADDRESS 0x40002504 /end MEASUREMENT
/begin MEASUREMENT fsDelayState "Test Point. Flag settato a 1 solo durante il ritardo Kpdelay successivo alla transizione (fsKO2 rimane costante)" UBYTE LambdaPreTDC_CM_boolean_adm 0 0 0 1 ECU_ADDRESS 0x40002502 /end MEASUREMENT
/begin MEASUREMENT fsDeltaErrLamPost "Delta errore di tensione lambda post-catalizzatore rispetto a VLTR2 (ERV2D)" SBYTE LambdaPostTDC_Symbol_CM_int8_mV 0 0 -25 25 ECU_ADDRESS 0x40002411 /end MEASUREMENT
/begin MEASUREMENT fsDeltaKO2 "Test Point. correzione sul KO2" SWORD LambdaPreTDC_CM_sfix16_En7_adm 0 0 -50 50 ECU_ADDRESS 0x40002500 /end MEASUREMENT
/begin MEASUREMENT fsDeltaKO22 "KO22 pre-saturazione (DKO22)" SLONG LambdaPostTDC_Symbol_CM_sfix32_Sp0001__ 0 0 -25 25 ECU_ADDRESS 0x40002420 /end MEASUREMENT
/begin MEASUREMENT fsDeltaKp_KO22 "Test Point. Correzione proporzionale del KO2" SWORD LambdaPreTDC_CM_sfix16_En4__ 0 0 -10 10 ECU_ADDRESS 0x400024FE /end MEASUREMENT
/begin MEASUREMENT fsDeltaSign "Cambiamento di segno nello stato della sonda lambda" SBYTE LambdaPreTDC_CM_int8_adm 0 0 -1 1 ECU_ADDRESS 0x400024FC /end MEASUREMENT
/begin MEASUREMENT fsDewPointExc "Dew point exceeded feedback for UEGO sensor" UBYTE Ctit_UEGOHeater4ms_CM_boolean_adm 0 0 0 1 ECU_ADDRESS 0x400025D8 /end MEASUREMENT
/begin CHARACTERISTIC fsEN_CORR_KO22 "Abilitazione alla correzione del KP e dei ritardi del primo anello da parte del secondo (AbCl2)" VALUE 0xFC3D08 Scalar_BOOLEAN 0 LambdaPreTDC_CM_boolean_adm 0 1 /end CHARACTERISTIC
/begin CHARACTERISTIC fsEN_WUP_CORR "Abilitazione del closed loop in presenza della correzione di Warm Up" VALUE 0xFC3D07 Scalar_BOOLEAN 0 LambdaPreTDC_CM_boolean_adm 0 1 /end CHARACTERISTIC
/begin MEASUREMENT fsErrLamPost "Errore di tensione lambda post-catalizzatore rispetto a VLTR2 (ERVL2)" SWORD LambdaPostTDC_Symbol_CM_int16_mV 0 0 -1000 1000 ECU_ADDRESS 0x4000241A /end MEASUREMENT
/begin CHARACTERISTIC fsGAIN_LAMBDA_POST "Guadagno authority lambda post-catalizzatore (ADLAMSV)" VALUE 0xFC3D06 Scalar_UBYTE 0 LambdaPreTDC_CM_ufix8_Sp008_adm 0 2 /end CHARACTERISTIC
/begin MEASUREMENT fsGainBattDc "Test Point. Fattore che riduce il duty-cycles applicato in funz. di Vbatt" UWORD LambdaHeater100ms_CM_ufix16_En14_adm 0 0 0.151234 1.3611111111 ECU_ADDRESS 0x40002566 /end MEASUREMENT
/begin CHARACTERISTIC fsHEATER_INIT_VOLTAGE "Init voltage [Vrms] for the heating ramp for UEGO heater" VALUE 0xFC4701 Scalar_UBYTE 0 UEGOHeater4ms_CM_ufix8_En4_Vrms 0 13 /end CHARACTERISTIC
/begin CHARACTERISTIC fsHEATER_MAX_VOLTAGE "Maximum voltage [Vrms] for UEGO heater" VALUE 0xFC4700 Scalar_UBYTE 0 UEGOHeater4ms_CM_ufix8_En4_Vrms 0 13 /end CHARACTERISTIC
/begin CHARACTERISTIC fsHEATER_TARGET_VOLTAGE "Desired target voltage [Vrms] for the heating ramp for UEGO heater" VALUE 0xFC46FF Scalar_UBYTE 0 UEGOHeater4ms_CM_ufix8_En4_Vrms 0 13 /end CHARACTERISTIC
/begin CHARACTERISTIC fsHEATER_TARGET_VOLTAGE_STEP "Ramp voltage solpe [Vrms/s] for the heating ramp for UEGO heater" VALUE 0xFC46FE Scalar_UBYTE 0 UEGOHeater4ms_CM_ufix8_En8_Vrms_s 0 0.4 /end CHARACTERISTIC
/begin CHARACTERISTIC fsHEATER_WAIT_TIME "Time to wait after the end of the heating ramp for the UEGO Heater" VALUE 0xFC46FC Scalar_UWORD 0 UEGOHeater4ms_CM_ufix16_Sp004_sec 0 60 /end CHARACTERISTIC
/begin CHARACTERISTIC fsHEAT_DC_NO_RPM "Duty-cycle applicato se sono terminate le tre fasi di preriscaldamento e il motore è fermo" VALUE 0xFC44B2 Scalar_UWORD 0 LambdaHeater100ms_CM_uint16__ 0 100 /end CHARACTERISTIC
/begin MEASUREMENT fsHeatDc "[OUT] Tabella dei valori di duty-cycles di comando del riscaldatore sonda lambda dopo le tre fasi di preriscaldamento" UWORD LambdaHeater100ms_CM_uint16__ 0 0 0 100 ECU_ADDRESS 0x40002564 /end MEASUREMENT
/begin MEASUREMENT fsHeatDc1 "[OUT] Vettore dei valori di duty-cycles di comando del riscaldatore sonda lambda - fase 1" UWORD LambdaHeater100ms_CM_uint16__ 0 0 0 100 ECU_ADDRESS 0x40002562 /end MEASUREMENT
/begin MEASUREMENT fsHeatDc2 "[OUT] Vettore dei valori di duty-cycles di comando del riscaldatore sonda lambda - fase 2" UWORD LambdaHeater100ms_CM_uint16__ 0 0 0 100 ECU_ADDRESS 0x40002560 /end MEASUREMENT
/begin MEASUREMENT fsHeatDc3 "[OUT] Vettore dei valori di duty-cycles di comando del riscaldatore sonda lambda - fase 3" UWORD LambdaHeater100ms_CM_uint16__ 0 0 0 100 ECU_ADDRESS 0x4000255E /end MEASUREMENT
/begin MEASUREMENT fsHeatT1 "[OUT] Vettore che calcola la durata attuazione del duty-cycles nella - fase 1" UWORD LambdaHeater100ms_CM_ufix16_Sp1_s 0 0 0 255 ECU_ADDRESS 0x4000255C /end MEASUREMENT
/begin MEASUREMENT fsHeatT2 "[OUT] Vettore che calcola la durata attuazione del duty-cycles nella - fase 2" UWORD LambdaHeater100ms_CM_ufix16_Sp1_s 0 0 0 255 ECU_ADDRESS 0x4000255A /end MEASUREMENT
/begin MEASUREMENT fsHeatT3 "[OUT] Vettore che calcola la durata attuazione del duty-cycles nella - fase 3" UWORD LambdaHeater100ms_CM_ufix16_Sp1_s 0 0 0 255 ECU_ADDRESS 0x40002558 /end MEASUREMENT
/begin MEASUREMENT fsHeatingControlEn "UEGO Heater Control enable considering diagnosis Error State on IDN_SUO, IDN_UDP, IDN_UHR" UBYTE UEGOHeater4ms_CM_boolean_adm 0 0 0 1 ECU_ADDRESS 0x40002640 /end MEASUREMENT
/begin CHARACTERISTIC fsINIT_KO2 "Fattore moltiplicativo KI nell integrale veloce" VALUE 0xFC3D04 Scalar_UWORD 0 LambdaPreTDC_CM_ufix16_En15_adm 0.75 1.25 /end CHARACTERISTIC
/begin CHARACTERISTIC fsIST_INIT_O2 "Isteresi sulla soglia di transizione alla inizializzazione" VALUE 0xFC3D02 Scalar_UWORD 0 LambdaPreTDC_CM_uint16_mV 0 1000 /end CHARACTERISTIC
/begin CHARACTERISTIC fsIST_O2 "Isteresi sulla soglia di transizione" VALUE 0xFC3D00 Scalar_UWORD 0 LambdaPreTDC_CM_uint16_mV 0 1000 /end CHARACTERISTIC
/begin CHARACTERISTIC fsIV_MIN "Numero di PMS per attivazione integrale rapido al minimo" VALUE 0xFC3CFE Scalar_UWORD 0 LambdaPreTDC_CM_uint16_tdc 0 250 /end CHARACTERISTIC
/begin CHARACTERISTIC fsIV_REG "Numero di PMS per attivazione integrale rapido fuori dal minimo" VALUE 0xFC3CFC Scalar_UWORD 0 LambdaPreTDC_CM_uint16_tdc 0 250 /end CHARACTERISTIC
/begin MEASUREMENT fsIVtot "Test Point. Contributo dell`integrale rapido" UWORD LambdaPreTDC_CM_ufix16_En7__ 0 0 0 50 ECU_ADDRESS 0x400024FA /end MEASUREMENT
/begin MEASUREMENT fsIstO2 "steresi sulla soglia di transizione" UWORD Ctit_LambdaCtrlTDC_CM_uint16_mV 0 0 0 1000 ECU_ADDRESS 0x400023E4 /end MEASUREMENT
/begin CHARACTERISTIC fsKFHW_KO22 "Coefficiente di filtraggio K_O22 (CFILKO22/1000)" VALUE 0xFC4040 Scalar_UWORD 0 LambdaPostTDC_Symbol_CM_ufix16_En10_adm 0 1 /end CHARACTERISTIC
/begin CHARACTERISTIC fsKFHW_UEGO_RIE "Filtering constatn for the LowPass filter on the UEGO Heater resistance" VALUE 0xFC46FA Scalar_UWORD 0 UEGOHeater4ms_CM_ufix16_En10_adm 0 1 /end CHARACTERISTIC
/begin CHARACTERISTIC fsKI2_EN "Flag di abilitazione dell`uso del contributo integrale [Forza valore nullo fuori dalla banda morta. Aggiunto su richiesta per Fase 4] (KI2DISAB)" VALUE 0xFC4036 Scalar_BOOLEAN 0 LambdaPostTDC_Symbol_CM_boolean_adm 0 1 /end CHARACTERISTIC
/begin CHARACTERISTIC fsKI_ARR_MIN "Costante integrativa al minimo in arricchimento" VALUE 0xFC3CFA Scalar_UWORD 0 LambdaPreTDC_CM_ufix16_En7__ 0 0.5 /end CHARACTERISTIC
/begin CHARACTERISTIC fsKI_SMA_MIN "Costante integrativa in smagrimento al minimo" VALUE 0xFC3CF8 Scalar_UWORD 0 LambdaPreTDC_CM_ufix16_En7__ 0 0.5 /end CHARACTERISTIC
/begin MEASUREMENT fsKO2 "Air/Fuel Control Feedback" UWORD Ctit_LambdaCtrlTDC_CM_ufix16_En15_adm 0 0 0.75 1.25 ECU_ADDRESS 0x400023E0 /end MEASUREMENT
/begin MEASUREMENT fsKO22 "KO22" SWORD Ctit_LambdaCtrlTDC_CM_sfix16_Sp01__ 0 0 -25 25 ECU_ADDRESS 0x400023D6 /end MEASUREMENT
/begin MEASUREMENT fsKO22Filt "KO22 Filtrato" SWORD Ctit_LambdaCtrlTDC_CM_sfix16_Sp01__ 0 0 -25 25 ECU_ADDRESS 0x400023D8 /end MEASUREMENT
/begin CHARACTERISTIC fsKO22_EN "Abilitazione calcolo K_O22 (AbKO22)" VALUE 0xFC4035 Scalar_BOOLEAN 0 LambdaPostTDC_Symbol_CM_boolean_adm 0 1 /end CHARACTERISTIC
/begin CHARACTERISTIC fsKO22_EN_COMM_SM "Soglia di transizioni sonda lambda pre-catalizzatore per abilitazione secondo anello (COMMTIT2)" VALUE 0xFC4034 Scalar_UBYTE 0 LambdaPostTDC_Symbol_CM_uint8_adm 0 250 /end CHARACTERISTIC
/begin CHARACTERISTIC fsKO22_EN_MAP_MAX "Soglia superiore pressione collettore per abilitazione anello chiuso lambda post-catalizzatore (CL2MAPMAX)" VALUE 0xFC403E Scalar_UWORD 0 LambdaPostTDC_Symbol_CM_uint16_mbar 150 2500 /end CHARACTERISTIC
/begin CHARACTERISTIC fsKO22_EN_MAP_MIN "Soglia inferiore pressione collettore per abilitazione anello chiuso lambda post-catalizzatore (CL2MAPMIN)" VALUE 0xFC403C Scalar_UWORD 0 LambdaPostTDC_Symbol_CM_uint16_mbar 150 2000 /end CHARACTERISTIC
/begin CHARACTERISTIC fsKO22_EN_RPM_MAX "Soglia superiore giri per abilitazione anello chiuso lambda post-catalizzatore (CL2GIRMAX)" VALUE 0xFC403A Scalar_UWORD 0 LambdaPostTDC_Symbol_CM_uint16_rpm 0 3000 /end CHARACTERISTIC
/begin CHARACTERISTIC fsKO22_EN_RPM_MIN "Soglia inferiore giri per abilitazione anello chiuso lambda post-catalizzatore (CL2GIRMIN)" VALUE 0xFC4038 Scalar_UWORD 0 LambdaPostTDC_Symbol_CM_uint16_rpm 0 3000 /end CHARACTERISTIC
/begin MEASUREMENT fsKO22_Old "KO22 precedente (KO22_OLD)" SLONG LambdaPostTDC_Symbol_CM_sfix32_Sp0001__ 0 0 -25 25 ECU_ADDRESS 0x4000241C /end MEASUREMENT
/begin MEASUREMENT fsKO2FlagTrans "Istante di ingresso nello stato ricco o magro della sonda lambda OR dei flag fsKO2Sat e fsTransition" UBYTE AutoTDC_CM_boolean_adm 0 0 0 1 ECU_ADDRESS 0x400023CD /end MEASUREMENT
/begin MEASUREMENT fsKO2SatFlag "Test Point. Flag che indica se il KO2 è saturato" UBYTE LambdaPreTDC_CM_boolean_adm 0 0 0 1 ECU_ADDRESS 0x400024F8 /end MEASUREMENT
/begin MEASUREMENT fsKO2Saturate "Test Point. Valore del KO2 saturato" SWORD LambdaPreTDC_CM_sfix16_En7_adm 0 0 -25 25 ECU_ADDRESS 0x400024F6 /end MEASUREMENT
/begin MEASUREMENT fsKO2Tmp1 "Test Point. Valore del KO2 prima della saturazione" SWORD LambdaPreTDC_CM_sfix16_En7_adm 0 0 -25 25 ECU_ADDRESS 0x400024F4 /end MEASUREMENT
/begin MEASUREMENT fsKO2Tmp1Old "Test Point. Valore del KO2 prima della saturazione al ciclo precedente." SWORD LambdaPreTDC_CM_sfix16_En7_adm 0 0 -25 25 ECU_ADDRESS 0x400024F2 /end MEASUREMENT
/begin MEASUREMENT fsKO2Trans "Air/Fuel Control Feedback for adaptive control" UWORD AutoTDC_CM_ufix16_En15_adm 0 0 0.75 1.25 ECU_ADDRESS 0x400023DE /end MEASUREMENT
/begin CHARACTERISTIC fsKP_ARR_MIN "Costante proporzionale al minimo in arricchimento" VALUE 0xFC3CF6 Scalar_UWORD 0 LambdaPreTDC_CM_ufix16_En4__ 0 10 /end CHARACTERISTIC
/begin CHARACTERISTIC fsKP_SMA_MIN "Costante proporzionale al minimo in smagrimento" VALUE 0xFC3CF4 Scalar_UWORD 0 LambdaPreTDC_CM_ufix16_En4__ 0 10 /end CHARACTERISTIC
/begin MEASUREMENT fsKi "Test Point. Correzione integrale del KO2" UWORD LambdaPreTDC_CM_ufix16_En7__ 0 0 0 0.5 ECU_ADDRESS 0x400024F0 /end MEASUREMENT
/begin MEASUREMENT fsKi2 "Contributo integrale al calcolo di KO22 (KI2Ft)" SWORD LambdaPostTDC_Symbol_CM_sfix16_Sp0001___mV 0 0 -0.2 0.2 ECU_ADDRESS 0x40002418 /end MEASUREMENT
/begin MEASUREMENT fsKiArr "[OUT] Tabella dei valori di KI in arricchimento" UWORD LambdaPreTDC_CM_ufix16_En7__ 0 0 0 0.5 ECU_ADDRESS 0x400024EE /end MEASUREMENT
/begin MEASUREMENT fsKiLamGain "[OUT] Array for gain on Ki for KO2 computation in function of Lambda Target" UWORD LambdaPreTDC_CM_ufix16_En6__ 0 0 0 10 ECU_ADDRESS 0x400024EC /end MEASUREMENT
/begin MEASUREMENT fsKiRICorr "Test Point. Ki corretto (aumenta la pendenza) per la fase con l`integrale rapido" UWORD LambdaPreTDC_CM_ufix16_En7__ 0 0 0 50 ECU_ADDRESS 0x400024EA /end MEASUREMENT
/begin MEASUREMENT fsKiSma "[OUT] Tabella dei valori di KI in smagrimento" UWORD LambdaPreTDC_CM_ufix16_En7__ 0 0 0 0.5 ECU_ADDRESS 0x400024E8 /end MEASUREMENT
/begin MEASUREMENT fsKo2Sat "[OUT] Tabella dei valori di KP in arricchimento" UWORD LambdaPreTDC_CM_ufix16_En7__ 0 0 0 25 ECU_ADDRESS 0x400024E6 /end MEASUREMENT
/begin MEASUREMENT fsKp "Test Point. Correzione proporzionale del KO2" UWORD LambdaPreTDC_CM_ufix16_En4__ 0 0 0 10 ECU_ADDRESS 0x400024E4 /end MEASUREMENT
/begin MEASUREMENT fsKp2 "[OUT] Tabella per il calcolo del termine di controllo proporzionale secondo anello (TB_KP2)" UWORD LambdaPostTDC_Symbol_CM_ufix16_Sp01___mV 0 0 0 1 ECU_ADDRESS 0x40002416 /end MEASUREMENT
/begin MEASUREMENT fsKp2_tmp "Termine di controllo proporzionale secondo anello (KP2_tmp)" UBYTE LambdaPostTDC_Symbol_CM_ufix8_Sp01___mV 0 0 0 1 ECU_ADDRESS 0x40002410 /end MEASUREMENT
/begin MEASUREMENT fsKpArr "[OUT] Tabella dei valori di KP in arricchimento" UWORD LambdaPreTDC_CM_ufix16_En4__ 0 0 0 10 ECU_ADDRESS 0x400024E2 /end MEASUREMENT
/begin MEASUREMENT fsKpDelay "Test Point. Ritardo alla correzione del KO2" UWORD LambdaPreTDC_CM_uint16_tdc 0 0 0 60000 ECU_ADDRESS 0x400024E0 /end MEASUREMENT
/begin MEASUREMENT fsKpDelay_KO22 "Test Point. Ritardo alla correzione del KO2 post correzione K022" ULONG LambdaPreTDC_CM_uint32_tdc 0 0 0 60000 ECU_ADDRESS 0x400024DC /end MEASUREMENT
/begin MEASUREMENT fsKpLamGain "[OUT] Array for gain on Kp for KO2 computation in function of Lambda Target" UWORD LambdaPreTDC_CM_ufix16_En6__ 0 0 0 10 ECU_ADDRESS 0x400024DA /end MEASUREMENT
/begin MEASUREMENT fsKpRICorr "Test Point. Kp corretto per le transizioni successive alla fase con l`integrale rapido" UWORD LambdaPreTDC_CM_ufix16_En7__ 0 0 0 50 ECU_ADDRESS 0x400024D8 /end MEASUREMENT
/begin MEASUREMENT fsKpSma "[OUT] Tabella dei valori di KP in smagrimento" UWORD LambdaPreTDC_CM_ufix16_En4__ 0 0 0 10 ECU_ADDRESS 0x400024D6 /end MEASUREMENT
/begin MEASUREMENT fsKp_KO22 "Test Point. Correzione proporzionale del KO2 post correzione K022" SWORD LambdaPreTDC_CM_sfix16_En4__ 0 0 0 10 ECU_ADDRESS 0x400024D4 /end MEASUREMENT
/begin CHARACTERISTIC fsLAMBDA_F3 "Flag attivazione riscaldatore tipo Fase 3" VALUE 0xFC44B0 Scalar_BOOLEAN 0 LambdaHeater100ms_CM_boolean_adm 0 1 /end CHARACTERISTIC
/begin CHARACTERISTIC fsLAMBDA_PRE_DEFAULT "Default value for the selection related to zsLambdaPre signal" VALUE 0xFC3CF2 Scalar_UWORD 0 LambdaPreTDC_CM_uint16_mV 0 1000 /end CHARACTERISTIC
/begin CHARACTERISTIC fsLAMBDA_PRE_SELECT "Selector for lambda pre signal: (1 - HEGO; 2 - UEGO CAN; 3 - UEGO cj135)" VALUE 0xFC3CF0 Scalar_UBYTE 0 LambdaPreTDC_CM_uint8_adm 1 4 /end CHARACTERISTIC
/begin CHARACTERISTIC fsLAM_LEAN_TDC "TDC MAX in Reach mode" VALUE 0xFC3CEE Scalar_UWORD 0 LambdaPreTDC_CM_uint16_tdc 0 25000 /end CHARACTERISTIC
/begin CHARACTERISTIC fsLAM_RICH_TDC "TDC MAX in Leanh mode" VALUE 0xFC3CEC Scalar_UWORD 0 LambdaPreTDC_CM_uint16_tdc 0 25000 /end CHARACTERISTIC
/begin MEASUREMENT fsLHDuty "EGO heater PWM DC" UWORD Ctit_LambdaHeater100ms_CM_uint16__ 0 0 0 100 ECU_ADDRESS 0x40002518 /end MEASUREMENT
/begin MEASUREMENT fsLHDutyRif "" UWORD LambdaHeater100ms_CM_uint16__ 0 0 0 100 ECU_ADDRESS 0x40002556 /end MEASUREMENT
/begin MEASUREMENT fsLHDutyTmp "" UWORD LambdaHeater100ms_CM_uint16__ 0 0 0 100 ECU_ADDRESS 0x40002554 /end MEASUREMENT
/begin MEASUREMENT fsLamIst "Valore istantaneo del lambda" UWORD Ctit_LambdaCtrlTDC_CM_ufix16_En8_adm 0 0 0.796875 1.3359375 ECU_ADDRESS 0x400023DC /end MEASUREMENT
/begin MEASUREMENT fsLambdaState "Stato corrente della macchina a stati di controllo della sonda lambda" UBYTE Ctit_LambdaCtrlTDC_CM_uint8_adm 0 0 0 2 ECU_ADDRESS 0x400023D3 /end MEASUREMENT
/begin CHARACTERISTIC fsMAX_PMS_SAT "Numero massimo di PMS in saturazione" VALUE 0xFC3CEA Scalar_UWORD 0 LambdaPreTDC_CM_uint16_tdc 0 250 /end CHARACTERISTIC
/begin CHARACTERISTIC fsMOLTIP_KI_IV "Fattore moltiplicativo KI nell integrale veloce" VALUE 0xFC3CE8 Scalar_UWORD 0 LambdaPreTDC_CM_ufix16_En2_adm 1 100 /end CHARACTERISTIC
/begin MEASUREMENT fsO2ConcenObt "[OUT] Array for assocition from target lambda ratio and oxigen concentration target" SWORD LambdaPreTDC_CM_sfix16_Sp01_Bn40p96__ 0 0 -30 30 ECU_ADDRESS 0x400024D2 /end MEASUREMENT
/begin CHARACTERISTIC fsPERC_CORR_KP2 "Fattore correttivo della correzione secondo anello in proporzione al KP attuale (PERCKP2)" VALUE 0xFC3CE6 Scalar_UBYTE 0 LambdaPreTDC_CM_ufix8_Sp01_adm 0 1 /end CHARACTERISTIC
/begin CHARACTERISTIC fsPMS_RC_NC "Soglia sul numero di PMS dal cut-off" VALUE 0xFC3CE4 Scalar_UWORD 0 LambdaPreTDC_CM_uint16_tdc 0 250 /end CHARACTERISTIC
/begin CHARACTERISTIC fsPMS_TN_NC "Soglia sul numero di PMS dal transitorio di carico" VALUE 0xFC3CE2 Scalar_UWORD 0 LambdaPreTDC_CM_uint16_tdc 0 250 /end CHARACTERISTIC
/begin CHARACTERISTIC fsPRE_HEATER_VOLTAGE "Desired voltage [Vrms] during pre heater phase" VALUE 0xFC46F9 Scalar_UBYTE 0 UEGOHeater4ms_CM_ufix8_En4_Vrms 0 13 /end CHARACTERISTIC
/begin CHARACTERISTIC fsPRE_HEATING_EN "Enable for UEGO Heater Pre Heating before DewPoint." VALUE 0xFC46F8 Scalar_BOOLEAN 0 UEGOHeater4ms_CM_boolean 0 1 /end CHARACTERISTIC
/begin MEASUREMENT fsPreheatingUego "Pre-heater switch on feedback for UEGO sensor" UBYTE Ctit_UEGOHeater4ms_CM_boolean_adm 0 0 0 1 ECU_ADDRESS 0x400025D9 /end MEASUREMENT
/begin CHARACTERISTIC fsRIE_LW_LIM "Lower limit for UEGO heater resistance to switch in Closed-Loop control" VALUE 0xFC46F6 Scalar_UWORD 0 UEGOHeater4ms_CM_ufix16_En6_Ohm 51 1023 /end CHARACTERISTIC
/begin CHARACTERISTIC fsRIE_UP_LIM "Upper limit for UEGO heater resistance to switch in Closed-Loop control" VALUE 0xFC46F4 Scalar_UWORD 0 UEGOHeater4ms_CM_ufix16_En6_Ohm 51 1023 /end CHARACTERISTIC
/begin MEASUREMENT fsRapidIntegral "Test Point. Flag di attivazione della fase con integrale rapido" UBYTE LambdaPreTDC_CM_boolean_adm 0 0 0 1 ECU_ADDRESS 0x400024D1 /end MEASUREMENT
/begin MEASUREMENT fsRich "Flag di sonda lambda nello stato ricco" UBYTE LambdaPreTDC_CM_boolean_adm 0 0 0 1 ECU_ADDRESS 0x400024D0 /end MEASUREMENT
/begin MEASUREMENT fsRtArr "[OUT] Tabella dei ritardi nella fase di arricchimento" UWORD LambdaPreTDC_CM_uint16_tdc 0 0 0 60000 ECU_ADDRESS 0x400024CE /end MEASUREMENT
/begin MEASUREMENT fsRtSma "[OUT] Tabella dei ritardi nella fase di smagrimento" UWORD LambdaPreTDC_CM_uint16_tdc 0 0 0 60000 ECU_ADDRESS 0x400024CC /end MEASUREMENT
/begin MEASUREMENT fsRtSmaArrKo22 "[OUT]  ???? Tabella per il calcolo della correzione del ritardo allo smagrimento/arricchimento dal secondo anello (TBRITVAL)" UWORD LambdaPreTDC_CM_uint16_tdc 0 0 0 60000 ECU_ADDRESS 0x400024CA /end MEASUREMENT
/begin CHARACTERISTIC fsSG_LAMDBA_INIT "Soglia di transizione verso nello stato ricco alla inizializzazione" VALUE 0xFC3CE0 Scalar_UWORD 0 LambdaPreTDC_CM_uint16_mV 0 1000 /end CHARACTERISTIC
/begin CHARACTERISTIC fsSO2_IDLE "Soglia di transizione al minimo" VALUE 0xFC3CDE Scalar_UWORD 0 LambdaPreTDC_CM_uint16_mV 0 1000 /end CHARACTERISTIC
/begin CHARACTERISTIC fsSO2_WU "Soglia di transizione in Warm Up" VALUE 0xFC3CDC Scalar_UWORD 0 LambdaPreTDC_CM_uint16_mV 0 1000 /end CHARACTERISTIC
/begin CHARACTERISTIC fsSTART_LAMBDA "Tempo di attesa prima di ritenere calda la sonda e chiudere il Loop sul KO2" VALUE 0xFC44AE Scalar_UWORD 0 LambdaHeater100ms_CM_ufix16_Sp1_s 0 3200 /end CHARACTERISTIC
/begin MEASUREMENT fsSgLambda "oglia sonda Lambda" UWORD Ctit_LambdaCtrlTDC_CM_uint16_mV 0 0 0 1000 ECU_ADDRESS 0x400023E6 /end MEASUREMENT
/begin MEASUREMENT fsSo2 "[OUT] Tabella dei valori della soglia di transizione" UWORD LambdaPreTDC_CM_uint16_mV 0 0 0 1000 ECU_ADDRESS 0x400024C8 /end MEASUREMENT
/begin MEASUREMENT fsSvTr "[OUT] Tabella per il calcolo della soglia di transizione sonda lambda post-catalizzatore (TB_VLTR2)" UWORD LambdaPostTDC_Symbol_CM_uint16_mV 0 0 0 1000 ECU_ADDRESS 0x40002414 /end MEASUREMENT
/begin MEASUREMENT fsTLambdaOK "Flag riscaldatore sonda lambda settato a 1 dopo la fase di riscaldamento" UBYTE Ctit_LambdaHeater100ms_CM_boolean_adm 0 0 0 1 ECU_ADDRESS 0x4000250F /end MEASUREMENT
/begin MEASUREMENT fsTLambdaOKTmp "" UBYTE LambdaHeater100ms_CM_boolean_adm 0 0 0 1 ECU_ADDRESS 0x40002552 /end MEASUREMENT
/begin MEASUREMENT fsTdSmSv "[OUT] Tabella dei tempi di ritardo del gas di scarico fra le due sonde (TB_TD)" UWORD LambdaPostTDC_Symbol_CM_uint16_PMS 0 0 1 10000 ECU_ADDRESS 0x40002412 /end MEASUREMENT
/begin MEASUREMENT fsTh2oTimeUEGO "[OUT] Array indicates the time to wait to set on dew point exceeded feedback on UEGO sensor, starting from preheating signal on and in function of water temp" UWORD UEGOHeater4ms_CM_ufix16_Sp1_sec 0 0 0 6500 ECU_ADDRESS 0x4000263E /end MEASUREMENT
/begin MEASUREMENT fsTrDel "Test Point. Variabile di scelta dell`attuazione tra fattore proporzione e fattore integrale" UBYTE LambdaPreTDC_CM_boolean_adm 0 0 0 1 ECU_ADDRESS 0x400024C6 /end MEASUREMENT
/begin MEASUREMENT fsTransition "Transition Flag" UBYTE Ctit_LambdaCtrlTDC_CM_boolean_adm 0 0 0 1 ECU_ADDRESS 0x400023CE /end MEASUREMENT
/begin CHARACTERISTIC fsUEGO_PID_KD "Kd of UEGO heater control PID" VALUE 0xFC46F0 Scalar_ULONG 0 UEGOHeater4ms_CM_ufix32_En24 0 100 /end CHARACTERISTIC
/begin CHARACTERISTIC fsUEGO_PID_KD_N "N of differentiator of Kd of UEGO heater control PID" VALUE 0xFC46EC Scalar_UBYTE 0 UEGOHeater4ms_CM_uint8 0 100 /end CHARACTERISTIC
/begin CHARACTERISTIC fsUEGO_PID_KI "Ki of UEGO heater control PID" VALUE 0xFC46E8 Scalar_ULONG 0 UEGOHeater4ms_CM_ufix32_En24 0 100 /end CHARACTERISTIC
/begin CHARACTERISTIC fsUEGO_PID_KI_INIT "Init value of Integrative network of UEGO heater control PID" VALUE 0xFC46E4 Scalar_LONG 0 UEGOHeater4ms_CM_sfix32_En24__ 0 100 /end CHARACTERISTIC
/begin CHARACTERISTIC fsUEGO_PID_KP "Kp of UEGO heater control PID" VALUE 0xFC46E0 Scalar_ULONG 0 UEGOHeater4ms_CM_ufix32_En24 0 100 /end CHARACTERISTIC
/begin CHARACTERISTIC fsUEGO_PID_SAT_H "High saturation of UEGO heater control PID" VALUE 0xFC46DC Scalar_LONG 0 UEGOHeater4ms_CM_sfix32_En24 0 100 /end CHARACTERISTIC
/begin CHARACTERISTIC fsUEGO_PID_SAT_L "Low saturation of UEGO heater control PID" VALUE 0xFC46D8 Scalar_LONG 0 UEGOHeater4ms_CM_sfix32_En24 0 100 /end CHARACTERISTIC
/begin CHARACTERISTIC fsUEGO_VOLTAGE_REF "Reference voltage for UEGO PID Control" VALUE 0xFC46D6 Scalar_UWORD 0 UEGOHeater4ms_CM_ufix16_Sp05_V 12 36 /end CHARACTERISTIC
/begin MEASUREMENT fsUegoHeaterCLActive "Active Closed-Loop control for UEGO Heater " UBYTE UEGOHeater4ms_CM_boolean 0 0 0 1 ECU_ADDRESS 0x4000263C /end MEASUREMENT
/begin MEASUREMENT fsUegoHeaterControlDC "UEGO Heater PWM duty cycle after the DewPoint" ULONG UEGOHeater4ms_CM_ufix32_En24__ 0 0 0 100 ECU_ADDRESS 0x40002638 /end MEASUREMENT
/begin MEASUREMENT fsUegoHeaterDC "UEGO Heater PWM duty cycle" ULONG Ctit_UEGOHeater4ms_CM_ufix32_En24__ 0 0 0 100 ECU_ADDRESS 0x400025E0 /end MEASUREMENT
/begin MEASUREMENT fsUegoLamEmul "[OUT] Array for mapping UEGO signal (normalized on target value) emulating Lambda signal (in mV)" UWORD LambdaPreTDC_CM_uint16_mV 0 0 0 1000 ECU_ADDRESS 0x400024C4 /end MEASUREMENT
/begin MEASUREMENT fsUegoLamEmulLSU "[OUT] Array for mapping UEGO Lambda LSU (normalized on target value) emulating Lambda signal (in mV)" UWORD LambdaPreTDC_CM_uint16_mV 0 0 0 1000 ECU_ADDRESS 0x400024C2 /end MEASUREMENT
/begin MEASUREMENT fsUegoLambda "[OUT] Array for mapping UEGO Ip into a lambdaValue" UWORD LambdaPreTDC_CM_ufix16_En10_adm 0 0 0 15 ECU_ADDRESS 0x400024C0 /end MEASUREMENT
/begin MEASUREMENT fsUegoPreHeaterDC "UEGO Pre Heater PWM duty cycle" ULONG UEGOHeater4ms_CM_ufix32_En24__ 0 0 0 100 ECU_ADDRESS 0x40002634 /end MEASUREMENT
/begin MEASUREMENT fsUegoResToTemp "[OUT] Conversion map between UEGO heater resistance and UEGO temperature" UWORD UEGOHeater4ms_CM_ufix16_En6_B600_degC 0 0 600 1480 ECU_ADDRESS 0x4000262E MATRIX_DIM 2 /end MEASUREMENT
/begin MEASUREMENT fsUegoRie "UEGO heater resistance" UWORD UEGOHeater4ms_CM_ufix16_En6_Ohm 0 0 51 1023 ECU_ADDRESS 0x4000262C /end MEASUREMENT
/begin MEASUREMENT fsUegoRieError "UEGO heater resistance error" SLONG UEGOHeater4ms_CM_sfix17_En6 0 0 -972 972 ECU_ADDRESS 0x40002628 /end MEASUREMENT
/begin MEASUREMENT fsUegoTemp "UEGO temperature" UWORD Ctit_UEGOHeater4ms_CM_ufix16_En6_B600_degC 0 0 600 1480 ECU_ADDRESS 0x400025DC /end MEASUREMENT
/begin MEASUREMENT fsUegoTempErr "UEGO temperature error (Ttarget - Tmeasured)" SLONG UEGOHeater4ms_CM_sfix17_En6_degC 0 0 -880 880 ECU_ADDRESS 0x40002624 /end MEASUREMENT
/begin MEASUREMENT fsUegoTempTarget "UEGO Target temperature" UWORD UEGOHeater4ms_CM_ufix16_En6_B600_degC 0 0 600 1480 ECU_ADDRESS 0x40002620 /end MEASUREMENT
/begin CHARACTERISTIC ft2HEAT_DC "Tabella dei valori di duty-cycles di comando del riscaldatore sonda lambda dopo le tre fasi di preriscaldamento" MAP 0xFC442E Lookup2D_UWORD 0 LambdaHeater_2_100ms_CM_uint16__ 0 100
 /begin AXIS_DESCR COM_AXIS NO_INPUT_QUANTITY LambdaHeater_2_100ms_CM_ufix16_En10_adm 8 0 3 AXIS_PTS_REF fk2ETASP_8 /end AXIS_DESCR
 /begin AXIS_DESCR COM_AXIS NO_INPUT_QUANTITY LambdaHeater_2_100ms_CM_uint16_rpm 8 0 10000 AXIS_PTS_REF fk2RPM_9 /end AXIS_DESCR
/end CHARACTERISTIC
/begin CHARACTERISTIC ftHEAT_DC "Tabella dei valori di duty-cycles di comando del riscaldatore sonda lambda dopo le tre fasi di preriscaldamento" MAP 0xFC43AE Lookup2D_UWORD 0 LambdaHeater100ms_CM_uint16__ 0 100
 /begin AXIS_DESCR COM_AXIS NO_INPUT_QUANTITY LambdaHeater100ms_CM_ufix16_En10_adm 8 0 3 AXIS_PTS_REF fkETASP_8 /end AXIS_DESCR
 /begin AXIS_DESCR COM_AXIS NO_INPUT_QUANTITY LambdaHeater100ms_CM_uint16_rpm 8 0 10000 AXIS_PTS_REF fkRPM_9 /end AXIS_DESCR
/end CHARACTERISTIC
/begin CHARACTERISTIC ftKI_ARR "Tabella dei valori di KI in arricchimento" MAP 0xFC3ADC Lookup2D_UWORD 0 LambdaPreTDC_CM_ufix16_En7__ 0 0.5
 /begin AXIS_DESCR COM_AXIS NO_INPUT_QUANTITY LambdaPreTDC_CM_uint16_rpm 16 0 10000 AXIS_PTS_REF fkRPM_2 /end AXIS_DESCR
 /begin AXIS_DESCR COM_AXIS NO_INPUT_QUANTITY LambdaPreTDC_CM_ufix16_En10_adm 16 0 3 AXIS_PTS_REF fkETASP_2 /end AXIS_DESCR
/end CHARACTERISTIC
/begin CHARACTERISTIC ftKI_SMA "Tabella dei valori di KI in smagrimento" MAP 0xFC38DC Lookup2D_UWORD 0 LambdaPreTDC_CM_ufix16_En7__ 0 0.5
 /begin AXIS_DESCR COM_AXIS NO_INPUT_QUANTITY LambdaPreTDC_CM_uint16_rpm 16 0 10000 AXIS_PTS_REF fkRPM_5 /end AXIS_DESCR
 /begin AXIS_DESCR COM_AXIS NO_INPUT_QUANTITY LambdaPreTDC_CM_ufix16_En10_adm 16 0 3 AXIS_PTS_REF fkETASP_5 /end AXIS_DESCR
/end CHARACTERISTIC
/begin CHARACTERISTIC ftKO2_SAT "Tabella dei valori di KP in arricchimento" MAP 0xFC36DC Lookup2D_UWORD 0 LambdaPreTDC_CM_ufix16_En7__ 0 25
 /begin AXIS_DESCR COM_AXIS NO_INPUT_QUANTITY LambdaPreTDC_CM_ufix16_En10_adm 16 0 3 AXIS_PTS_REF fkETASP_7 /end AXIS_DESCR
 /begin AXIS_DESCR COM_AXIS NO_INPUT_QUANTITY LambdaPreTDC_CM_uint16_rpm 16 0 10000 AXIS_PTS_REF fkRPM_7 /end AXIS_DESCR
/end CHARACTERISTIC
/begin CHARACTERISTIC ftKP2 "Tabella per il calcolo del termine di controllo proporzionale secondo anello (TB_KP2)" MAP 0xFC41FE Lookup2DSF_UWORD 0 LambdaPostTDC_Symbol_CM_ufix16_Sp01___mV 0 1
 /begin AXIS_DESCR COM_AXIS NO_INPUT_QUANTITY LambdaPostTDC_Symbol_CM_uint16_mV 8 0 1000 AXIS_PTS_REF fkKP2_VL2 /end AXIS_DESCR
 /begin AXIS_DESCR COM_AXIS NO_INPUT_QUANTITY LambdaPostTDC_Symbol_CM_uint16_rpm 8 0 3000 AXIS_PTS_REF fkKP2_RPM /end AXIS_DESCR
/end CHARACTERISTIC
/begin CHARACTERISTIC ftKP_ARR "Tabella dei valori di KP in arricchimento" MAP 0xFC34DC Lookup2D_UWORD 0 LambdaPreTDC_CM_ufix16_En4__ 0 10
 /begin AXIS_DESCR COM_AXIS NO_INPUT_QUANTITY LambdaPreTDC_CM_uint16_rpm 16 0 10000 AXIS_PTS_REF fkRPM_1 /end AXIS_DESCR
 /begin AXIS_DESCR COM_AXIS NO_INPUT_QUANTITY LambdaPreTDC_CM_ufix16_En10_adm 16 0 3 AXIS_PTS_REF fkETASP_1 /end AXIS_DESCR
/end CHARACTERISTIC
/begin CHARACTERISTIC ftKP_SMA "Tabella dei valori di KP in smagrimento" MAP 0xFC32DC Lookup2D_UWORD 0 LambdaPreTDC_CM_ufix16_En4__ 0 10
 /begin AXIS_DESCR COM_AXIS NO_INPUT_QUANTITY LambdaPreTDC_CM_uint16_rpm 16 0 10000 AXIS_PTS_REF fkRPM_4 /end AXIS_DESCR
 /begin AXIS_DESCR COM_AXIS NO_INPUT_QUANTITY LambdaPreTDC_CM_ufix16_En10_adm 16 0 3 AXIS_PTS_REF fkETASP_4 /end AXIS_DESCR
/end CHARACTERISTIC
/begin CHARACTERISTIC ftRT_ARR "Tabella dei ritardi nella fase di arricchimento" MAP 0xFC30DC Lookup2D_UWORD 0 LambdaPreTDC_CM_uint16_tdc 0 60000
 /begin AXIS_DESCR COM_AXIS NO_INPUT_QUANTITY LambdaPreTDC_CM_uint16_rpm 16 0 10000 AXIS_PTS_REF fkRPM_3 /end AXIS_DESCR
 /begin AXIS_DESCR COM_AXIS NO_INPUT_QUANTITY LambdaPreTDC_CM_ufix16_En10_adm 16 0 3 AXIS_PTS_REF fkETASP_3 /end AXIS_DESCR
/end CHARACTERISTIC
/begin CHARACTERISTIC ftRT_SMA "Tabella dei ritardi nella fase di smagrimento" MAP 0xFC2EDC Lookup2D_UWORD 0 LambdaPreTDC_CM_uint16_tdc 0 60000
 /begin AXIS_DESCR COM_AXIS NO_INPUT_QUANTITY LambdaPreTDC_CM_uint16_rpm 16 0 10000 AXIS_PTS_REF fkRPM_6 /end AXIS_DESCR
 /begin AXIS_DESCR COM_AXIS NO_INPUT_QUANTITY LambdaPreTDC_CM_ufix16_En10_adm 16 0 3 AXIS_PTS_REF fkETASP_6 /end AXIS_DESCR
/end CHARACTERISTIC
/begin CHARACTERISTIC ftRT_SMA_ARR_KO22 " ???? Tabella per il calcolo della correzione del ritardo allo smagrimento/arricchimento dal secondo anello (TBRITVAL)" MAP 0xFC2E5C Lookup2D_UWORD 0 LambdaPreTDC_CM_uint16_tdc 0 60000
 /begin AXIS_DESCR COM_AXIS NO_INPUT_QUANTITY LambdaPreTDC_CM_ufix16_En4_Bn100__ 8 -100 100 AXIS_PTS_REF fkRT_KO22_PERC /end AXIS_DESCR
 /begin AXIS_DESCR COM_AXIS NO_INPUT_QUANTITY LambdaPreTDC_CM_uint16_rpm 8 0 3000 AXIS_PTS_REF fkRT_KO22_RPM /end AXIS_DESCR
/end CHARACTERISTIC
/begin CHARACTERISTIC ftSV_TR "Tabella per il calcolo della soglia di transizione sonda lambda post-catalizzatore (TB_VLTR2)" MAP 0xFC40DE Lookup2DSF_UWORD 0 LambdaPostTDC_Symbol_CM_uint16_mV 0 1000
 /begin AXIS_DESCR COM_AXIS NO_INPUT_QUANTITY LambdaPostTDC_Symbol_CM_uint16_rpm 12 0 3000 AXIS_PTS_REF fkSVTR_RPM /end AXIS_DESCR
 /begin AXIS_DESCR COM_AXIS NO_INPUT_QUANTITY LambdaPostTDC_Symbol_CM_ufix16_En10_adm 12 0 3 AXIS_PTS_REF fkSVTR_ETASP /end AXIS_DESCR
/end CHARACTERISTIC
/begin CHARACTERISTIC ftTD_SM_SV "Tabella dei tempi di ritardo del gas di scarico fra le due sonde (TB_TD)" MAP 0xFC405E Lookup2DSF_UWORD 0 LambdaPostTDC_Symbol_CM_uint16_PMS 1 10000
 /begin AXIS_DESCR COM_AXIS NO_INPUT_QUANTITY LambdaPostTDC_Symbol_CM_uint16_rpm 8 0 3000 AXIS_PTS_REF fkTD_RPM /end AXIS_DESCR
 /begin AXIS_DESCR COM_AXIS NO_INPUT_QUANTITY LambdaPostTDC_Symbol_CM_ufix16_En10_adm 8 0 3 AXIS_PTS_REF fkTD_ETASP /end AXIS_DESCR
/end CHARACTERISTIC
/begin CHARACTERISTIC fv2HEAT_DC1 "Vettore dei valori di duty-cycles di comando del riscaldatore sonda lambda - fase 1" CURVE 0xFC439E Lookup1D_UWORD 0 LambdaHeater_2_100ms_CM_uint16__ 0 100
 /begin AXIS_DESCR COM_AXIS NO_INPUT_QUANTITY LambdaHeater_2_100ms_CM_ufix16_Bn40_degC 8 -40 140 AXIS_PTS_REF fk2TH2O_1 /end AXIS_DESCR
/end CHARACTERISTIC
/begin CHARACTERISTIC fv2HEAT_DC2 "Vettore dei valori di duty-cycles di comando del riscaldatore sonda lambda - fase 2" CURVE 0xFC438E Lookup1D_UWORD 0 LambdaHeater_2_100ms_CM_uint16__ 0 100
 /begin AXIS_DESCR COM_AXIS NO_INPUT_QUANTITY LambdaHeater_2_100ms_CM_ufix16_Bn40_degC 8 -40 140 AXIS_PTS_REF fk2TH2O_2 /end AXIS_DESCR
/end CHARACTERISTIC
/begin CHARACTERISTIC fv2HEAT_DC3 "Vettore dei valori di duty-cycles di comando del riscaldatore sonda lambda - fase 3" CURVE 0xFC437E Lookup1D_UWORD 0 LambdaHeater_2_100ms_CM_uint16__ 0 100
 /begin AXIS_DESCR COM_AXIS NO_INPUT_QUANTITY LambdaHeater_2_100ms_CM_ufix16_Bn40_degC 8 -40 140 AXIS_PTS_REF fk2TH2O_3 /end AXIS_DESCR
/end CHARACTERISTIC
/begin CHARACTERISTIC fv2HEAT_T1 "Vettore che calcola la durata attuazione del duty-cycles nella - fase 1" CURVE 0xFC436E Lookup1D_UWORD 0 LambdaHeater_2_100ms_CM_ufix16_Sp1_s 0 255
 /begin AXIS_DESCR COM_AXIS NO_INPUT_QUANTITY LambdaHeater_2_100ms_CM_ufix16_Bn40_degC 8 -40 140 AXIS_PTS_REF fk2TH2O_4 /end AXIS_DESCR
/end CHARACTERISTIC
/begin CHARACTERISTIC fv2HEAT_T2 "Vettore che calcola la durata attuazione del duty-cycles nella - fase 2" CURVE 0xFC435E Lookup1D_UWORD 0 LambdaHeater_2_100ms_CM_ufix16_Sp1_s 0 255
 /begin AXIS_DESCR COM_AXIS NO_INPUT_QUANTITY LambdaHeater_2_100ms_CM_ufix16_Bn40_degC 8 -40 140 AXIS_PTS_REF fk2TH2O_5 /end AXIS_DESCR
/end CHARACTERISTIC
/begin CHARACTERISTIC fv2HEAT_T3 "Vettore che calcola la durata attuazione del duty-cycles nella - fase 3" CURVE 0xFC434E Lookup1D_UWORD 0 LambdaHeater_2_100ms_CM_ufix16_Sp1_s 0 255
 /begin AXIS_DESCR COM_AXIS NO_INPUT_QUANTITY LambdaHeater_2_100ms_CM_ufix16_Bn40_degC 8 -40 140 AXIS_PTS_REF fk2TH2O_6 /end AXIS_DESCR
/end CHARACTERISTIC
/begin CHARACTERISTIC fvHEAT_DC1 "Vettore dei valori di duty-cycles di comando del riscaldatore sonda lambda - fase 1" CURVE 0xFC433E Lookup1D_UWORD 0 LambdaHeater100ms_CM_uint16__ 0 100
 /begin AXIS_DESCR COM_AXIS NO_INPUT_QUANTITY LambdaHeater100ms_CM_ufix16_Bn40_degC 8 -40 140 AXIS_PTS_REF fkTH2O_1 /end AXIS_DESCR
/end CHARACTERISTIC
/begin CHARACTERISTIC fvHEAT_DC2 "Vettore dei valori di duty-cycles di comando del riscaldatore sonda lambda - fase 2" CURVE 0xFC432E Lookup1D_UWORD 0 LambdaHeater100ms_CM_uint16__ 0 100
 /begin AXIS_DESCR COM_AXIS NO_INPUT_QUANTITY LambdaHeater100ms_CM_ufix16_Bn40_degC 8 -40 140 AXIS_PTS_REF fkTH2O_2 /end AXIS_DESCR
/end CHARACTERISTIC
/begin CHARACTERISTIC fvHEAT_DC3 "Vettore dei valori di duty-cycles di comando del riscaldatore sonda lambda - fase 3" CURVE 0xFC431E Lookup1D_UWORD 0 LambdaHeater100ms_CM_uint16__ 0 100
 /begin AXIS_DESCR COM_AXIS NO_INPUT_QUANTITY LambdaHeater100ms_CM_ufix16_Bn40_degC 8 -40 140 AXIS_PTS_REF fkTH2O_3 /end AXIS_DESCR
/end CHARACTERISTIC
/begin CHARACTERISTIC fvHEAT_T1 "Vettore che calcola la durata attuazione del duty-cycles nella - fase 1" CURVE 0xFC430E Lookup1D_UWORD 0 LambdaHeater100ms_CM_ufix16_Sp1_s 0 255
 /begin AXIS_DESCR COM_AXIS NO_INPUT_QUANTITY LambdaHeater100ms_CM_ufix16_Bn40_degC 8 -40 140 AXIS_PTS_REF fkTH2O_4 /end AXIS_DESCR
/end CHARACTERISTIC
/begin CHARACTERISTIC fvHEAT_T2 "Vettore che calcola la durata attuazione del duty-cycles nella - fase 2" CURVE 0xFC42FE Lookup1D_UWORD 0 LambdaHeater100ms_CM_ufix16_Sp1_s 0 255
 /begin AXIS_DESCR COM_AXIS NO_INPUT_QUANTITY LambdaHeater100ms_CM_ufix16_Bn40_degC 8 -40 140 AXIS_PTS_REF fkTH2O_5 /end AXIS_DESCR
/end CHARACTERISTIC
/begin CHARACTERISTIC fvHEAT_T3 "Vettore che calcola la durata attuazione del duty-cycles nella - fase 3" CURVE 0xFC42EE Lookup1D_UWORD 0 LambdaHeater100ms_CM_ufix16_Sp1_s 0 255
 /begin AXIS_DESCR COM_AXIS NO_INPUT_QUANTITY LambdaHeater100ms_CM_ufix16_Bn40_degC 8 -40 140 AXIS_PTS_REF fkTH2O_6 /end AXIS_DESCR
/end CHARACTERISTIC
/begin CHARACTERISTIC fvIP_LAM_CONV "Array for mapping UEGO Ip into a lambdaValue" CURVE 0xFC2E30 Lookup1D_UWORD 0 LambdaPreTDC_CM_ufix16_En10_adm 0 15
 /begin AXIS_DESCR COM_AXIS NO_INPUT_QUANTITY LambdaPreTDC_CM_ufix16_Sp0001_Bn3_mA 22 -3 3 AXIS_PTS_REF fkUEGO_IP /end AXIS_DESCR
/end CHARACTERISTIC
/begin CHARACTERISTIC fvKI_LAM_GAIN "Array for gain on Ki for KO2 computation in function of Lambda Target" CURVE 0xFC2E10 Lookup1D_UWORD 0 LambdaPreTDC_CM_ufix16_En6__ 0 10
 /begin AXIS_DESCR COM_AXIS NO_INPUT_QUANTITY LambdaPreTDC_CM_ufix16_En10_adm 16 0.015625 1.599609375 AXIS_PTS_REF fkLAM_OBT_KI /end AXIS_DESCR
/end CHARACTERISTIC
/begin CHARACTERISTIC fvKP_LAM_GAIN "Array for gain on Kp for KO2 computation in function of Lambda Target" CURVE 0xFC2DF0 Lookup1D_UWORD 0 LambdaPreTDC_CM_ufix16_En6__ 0 10
 /begin AXIS_DESCR COM_AXIS NO_INPUT_QUANTITY LambdaPreTDC_CM_ufix16_En10_adm 16 0.015625 1.599609375 AXIS_PTS_REF fkLAM_OBT_KP /end AXIS_DESCR
/end CHARACTERISTIC
/begin CHARACTERISTIC fvO2_CONC_OBT "Array for assocition from target lambda ratio and oxigen concentration target" CURVE 0xFC2DD0 Lookup1D_WORD 0 LambdaPreTDC_CM_sfix16_Sp01_Bn40p96__ -30 30
 /begin AXIS_DESCR COM_AXIS NO_INPUT_QUANTITY LambdaPreTDC_CM_ufix16_En10_adm 16 0.015625 1.599609375 AXIS_PTS_REF fkLAM_OBT /end AXIS_DESCR
/end CHARACTERISTIC
/begin CHARACTERISTIC fvSO2 "Tabella dei valori della soglia di transizione" CURVE 0xFC2DB0 Lookup1D_UWORD 0 LambdaPreTDC_CM_uint16_mV 0 1000
 /begin AXIS_DESCR COM_AXIS NO_INPUT_QUANTITY LambdaPreTDC_CM_uint16_rpm 16 0 10000 AXIS_PTS_REF fkRPM_8 /end AXIS_DESCR
/end CHARACTERISTIC
/begin CHARACTERISTIC fvTH20_TIME_UEGO "Array indicates the time to wait to set on dew point exceeded feedback on UEGO sensor, starting from preheating signal on and in function of water temp" CURVE 0xFC46C6 Lookup1D_UWORD 0 UEGOHeater4ms_CM_ufix16_Sp1_sec 0 6500
 /begin AXIS_DESCR COM_AXIS NO_INPUT_QUANTITY UEGOHeater4ms_CM_ufix16_Bn40_degC 8 -40 140 AXIS_PTS_REF fkTH20_TIME_UEGO /end AXIS_DESCR
/end CHARACTERISTIC
/begin CHARACTERISTIC fvUEGO_LAM_EMUL "Array for mapping UEGO signal (normalized on target value) emulating Lambda signal (in mV)" CURVE 0xFC2D90 Lookup1D_UWORD 0 LambdaPreTDC_CM_uint16_mV 0 1000
 /begin AXIS_DESCR COM_AXIS NO_INPUT_QUANTITY LambdaPreTDC_CM_ufix16_Sp01_Bn40p96__ 16 -30 30 AXIS_PTS_REF fkO2CONC_DELTA /end AXIS_DESCR
/end CHARACTERISTIC
/begin CHARACTERISTIC fvUEGO_LAM_EMUL_LSU "Array for mapping UEGO Lambda LSU (normalized on target value) emulating Lambda signal (in mV)" CURVE 0xFC2D76 Lookup1D_UWORD 0 LambdaPreTDC_CM_uint16_mV 0 1000
 /begin AXIS_DESCR COM_AXIS NO_INPUT_QUANTITY LambdaPreTDC_CM_ufix16_En10_Bn2_adm 13 -2 2 AXIS_PTS_REF fkUEGO_LAM_DELTA /end AXIS_DESCR
/end CHARACTERISTIC
/begin CHARACTERISTIC fvUEGO_RES_TO_TEMP "Conversion map between UEGO heater resistance and UEGO temperature" CURVE 0xFC4608 Lookup1D_UWORD 0 UEGOHeater4ms_CM_ufix16_En6_B600_degC 600 1480
 /begin AXIS_DESCR COM_AXIS NO_INPUT_QUANTITY UEGOHeater4ms_CM_ufix16_En6_degC 95 51 1023 AXIS_PTS_REF fkUEGO_HEATER_RES /end AXIS_DESCR
/end CHARACTERISTIC
/begin CHARACTERISTIC gfDRV_PED_PERC "[FIX] Fix su richiesta del driver riscalata sui valori autoadattativi" VALUE 0xFCAC6C Scalar_UWORD 0 TE_DrivePedal4ms_Symbol_CM_ufix8_Sp392__ 0 99.96 /end CHARACTERISTIC
/begin CHARACTERISTIC gfDRV_PED_PERC_EnFix "[FIX] Fix su richiesta del driver riscalata sui valori autoadattativi" VALUE 0xFCAC6A Scalar_UWORD 0 TE_DrivePedal4ms_Symbol_CM_FixEnableT 171 218 /end CHARACTERISTIC
/begin CHARACTERISTIC gfIDLE_REF "[FIX] Apprendimento del riferimento minimo sul pedale acceleratore" VALUE 0xFCAC68 Scalar_UWORD 0 TE_DrivePedal4ms_Symbol_CM_ufix16_En4__ 0 30 /end CHARACTERISTIC
/begin CHARACTERISTIC gfIDLE_REF_EnFix "[FIX] Apprendimento del riferimento minimo sul pedale acceleratore" VALUE 0xFCAC66 Scalar_UWORD 0 TE_DrivePedal4ms_Symbol_CM_FixEnableT 171 218 /end CHARACTERISTIC
/begin CHARACTERISTIC gfKICK_REF "[FIX] Apprendimento del riferimento massimo sul pedale acceleratore" VALUE 0xFCAC64 Scalar_UWORD 0 TE_DrivePedal4ms_Symbol_CM_ufix16_En4__ 70 100 /end CHARACTERISTIC
/begin CHARACTERISTIC gfKICK_REF_EnFix "[FIX] Apprendimento del riferimento massimo sul pedale acceleratore" VALUE 0xFCAC62 Scalar_UWORD 0 TE_DrivePedal4ms_Symbol_CM_FixEnableT 171 218 /end CHARACTERISTIC
/begin CHARACTERISTIC gfPDL_RUN_REQ "[FIX] Mappa di guidabilità che trasforma la % pedale filtrata in % di prestazione massima " VALUE 0xFCAC60 Scalar_UWORD 0 TE_DrivePedal4ms_Symbol_CM_ufix16_En4__ 0 100 /end CHARACTERISTIC
/begin CHARACTERISTIC gfPDL_RUN_REQ_EnFix "[FIX] Mappa di guidabilità che trasforma la % pedale filtrata in % di prestazione massima " VALUE 0xFCAC5E Scalar_UWORD 0 TE_DrivePedal4ms_Symbol_CM_FixEnableT 171 218 /end CHARACTERISTIC
/begin AXIS_PTS gkDRV_PDL_PERC "[XBK] Mappa di guidabilità che trasforma la % pedale filtrata in % di prestazione massima " 0xFCAE8E NO_INPUT_QUANTITY Lookup2D_X_UWORD 0 TE_DrivePedal4ms_Symbol_CM_ufix16_En4__ 16 0 100 /end AXIS_PTS
/begin AXIS_PTS gkRPM_1 "[YBK] Mappa di guidabilità che trasforma la % pedale filtrata in % di prestazione massima " 0xFCAE6E NO_INPUT_QUANTITY Lookup2D_X_UWORD 0 TE_DrivePedal4ms_Symbol_CM_uint16_rpm 16 0 5000 /end AXIS_PTS
/begin CHARACTERISTIC gsCLUTCH_RED "Ulteriore limitazione quando il motore è disaccoppiato" VALUE 0xFCAC5C Scalar_UWORD 0 TE_DrivePedal4ms_Symbol_CM_ufix16_En4_adm 0 1 /end CHARACTERISTIC
/begin MEASUREMENT gsDrivePercF "Richiesta finale del driver a valle del riscalamento, raccordo e smoothing" UWORD TE_DrivePedal4ms_Symbol_CM_ufix16_En4__ 0 0 0 100 ECU_ADDRESS 0x40003F90 /end MEASUREMENT
/begin MEASUREMENT gsDrivePercR "Richiesta del driver riscalata sui valori autoadattativi" UWORD TE_DrivePedal4ms_Symbol_CM_ufix16_En4__ 0 0 0 100 ECU_ADDRESS 0x40003F8E /end MEASUREMENT
/begin MEASUREMENT gsDrvPedPerc "ichiesta del driver riscalata sui valori autoadattativi" UBYTE DiagSym100ms_CM_ufix8_Sp392__ 0 0 0 99.96 ECU_ADDRESS 0x40003F57 /end MEASUREMENT
/begin CHARACTERISTIC gsIDLE_RANGE "Range di attivazione della strategia adattativa della posizione di Idle" VALUE 0xFCAC5A Scalar_UWORD 0 TE_DrivePedal4ms_Symbol_CM_ufix16_En4__ 0 30 /end CHARACTERISTIC
/begin MEASUREMENT gsIdleRef "Tensione di riferimento per la posizione di idle" UWORD Pacc4ms_CM_ufix16_En4__ 0 0 0 30 ECU_ADDRESS 0x40003F6A /end MEASUREMENT
/begin CHARACTERISTIC gsKD_MAX_SLOPE "Max positive incremental slope of driver request when KickDown switch is on" VALUE 0xFCAC58 Scalar_UWORD 0 TE_DrivePedal4ms_Symbol_CM_ufix16_En4___4ms 0 100 /end CHARACTERISTIC
/begin CHARACTERISTIC gsKICK_RANGE "Range di attivazione della strategia adattativa della posizione di KickDown" VALUE 0xFCAC56 Scalar_UWORD 0 TE_DrivePedal4ms_Symbol_CM_ufix16_En4__ 70 100 /end CHARACTERISTIC
/begin MEASUREMENT gsKickRef "Tensione di riferimento per la posizione di kick down" UWORD Pacc4ms_CM_ufix16_En4__ 0 0 70 100 ECU_ADDRESS 0x40003F68 /end MEASUREMENT
/begin CHARACTERISTIC gsPDL_IDLESW_DIS "Flag che disabilita la dipendenza dalla Switch pedale nella strategia adattativa" VALUE 0xFCAC4B Scalar_BOOLEAN 0 TE_DrivePedal4ms_Symbol_CM_boolean_adm 0 1 /end CHARACTERISTIC
/begin CHARACTERISTIC gsPDL_IDLE_LSB "LSB di aggiornamento della strategia adattativa su posizione di Idle" VALUE 0xFCAC54 Scalar_UWORD 0 TE_DrivePedal4ms_Symbol_CM_ufix16_En4__ 0 10 /end CHARACTERISTIC
/begin CHARACTERISTIC gsPDL_KICKSW_DIS "Flag che disabilita la dipendenza dalla Switch pedale nella strategia adattativa" VALUE 0xFCAC4A Scalar_BOOLEAN 0 TE_DrivePedal4ms_Symbol_CM_boolean_adm 0 1 /end CHARACTERISTIC
/begin CHARACTERISTIC gsPDL_KICK_LSB "LSB di aggiornamento della strategia adattativa su posizione di KickDown" VALUE 0xFCAC52 Scalar_UWORD 0 TE_DrivePedal4ms_Symbol_CM_ufix16_En4__ 0 10 /end CHARACTERISTIC
/begin CHARACTERISTIC gsPDL_MAX_SLOPE "Max positive incremental slope of driver request" VALUE 0xFCAC50 Scalar_UWORD 0 TE_DrivePedal4ms_Symbol_CM_ufix16_En4___4ms 0 100 /end CHARACTERISTIC
/begin CHARACTERISTIC gsPDL_SLOPE_STEP "Contributo fisso al passo di incremento del raccordo della posizione pedale" VALUE 0xFCAED0 Scalar_UWORD 0 TE_PotenzAccSensor_4ms_Symbol_CM_uint16_adm 1 1000 /end CHARACTERISTIC
/begin MEASUREMENT gsPdlPerfReq "Richiesta del pedale acceleratore sulla percentuale di prestazione massima" UWORD DiagSym100ms_CM_ufix16_En4__ 0 0 0 100 ECU_ADDRESS 0x40003F6C /end MEASUREMENT
/begin MEASUREMENT gsPdlRunReq "[OUT] Mappa di guidabilità che trasforma la % pedale filtrata in % di prestazione massima " UWORD TE_DrivePedal4ms_Symbol_CM_ufix16_En4__ 0 0 0 100 ECU_ADDRESS 0x40003F8C /end MEASUREMENT
/begin CHARACTERISTIC gsTIME_IDLE_ADAP "Intervallo di aggiornamento della strategia autoadattativa" VALUE 0xFCAC4E Scalar_UWORD 0 TE_DrivePedal4ms_Symbol_CM_ufix16_En2_s 0 1000 /end CHARACTERISTIC
/begin CHARACTERISTIC gsTIME_KICK_ADAP "Intervallo di aggiornamento della strategia autoadattativa" VALUE 0xFCAC4C Scalar_UWORD 0 TE_DrivePedal4ms_Symbol_CM_ufix16_En2_s 0 1000 /end CHARACTERISTIC
/begin CHARACTERISTIC gtPDL_RUN_REQ "Mappa di guidabilità che trasforma la % pedale filtrata in % di prestazione massima " MAP 0xFCAC6E Lookup2DSF_UWORD 0 TE_DrivePedal4ms_Symbol_CM_ufix16_En4__ 0 100
 /begin AXIS_DESCR COM_AXIS NO_INPUT_QUANTITY TE_DrivePedal4ms_Symbol_CM_uint16_rpm 16 0 5000 AXIS_PTS_REF gkRPM_1 /end AXIS_DESCR
 /begin AXIS_DESCR COM_AXIS NO_INPUT_QUANTITY TE_DrivePedal4ms_Symbol_CM_ufix16_En4__ 16 0 100 AXIS_PTS_REF gkDRV_PDL_PERC /end AXIS_DESCR
/end CHARACTERISTIC
/begin CHARACTERISTIC hfAVV_ENABLE_Enable "[FIX] Fix di inibizione avviamento in Wait per errori learning" VALUE 0xFC5780 Scalar_UBYTE 0 ETCLearning4ms_CM_FixEnableT 171 218 /end CHARACTERISTIC
/begin CHARACTERISTIC hfAVV_ENABLE_Value "[FIX] Fix di inibizione avviamento in Wait per errori learning" VALUE 0xFC577F Scalar_BOOLEAN 0 ETCLearning4ms_CM_boolean_adm 0 1 /end CHARACTERISTIC
/begin CHARACTERISTIC hfDELTA_QAIR_MAX_Enable "[FIX] Delta aria massima (vs. curva teorica) disponibile a un dato regime" VALUE 0xFCB46C Scalar_UBYTE 0 TE_TM_CtrlThrotMgm4ms_CM_FixEnableT 171 218 /end CHARACTERISTIC
/begin CHARACTERISTIC hfDELTA_QAIR_MAX_Value "[FIX] Delta aria massima (vs. curva teorica) disponibile a un dato regime" VALUE 0xFCB46A Scalar_UWORD 0 TE_TM_CtrlThrotMgm4ms_CM_ufix16_En4_Bn100_kg_h -100 100 /end CHARACTERISTIC
/begin CHARACTERISTIC hfDIR_SIGNAL_Enable "[FIX] Fix sul comando in direzione verso il TLE6209 (dipende dalla modalità di funzioamento FAST/SLOW DECAY)" VALUE 0xFC56D6 Scalar_UBYTE 0 TE_TM_ThrottleCtrl4ms_CM_FixEnableT 171 218 /end CHARACTERISTIC
/begin CHARACTERISTIC hfDIR_SIGNAL_Value "[FIX] Fix sul comando in direzione verso il TLE6209 (dipende dalla modalità di funzioamento FAST/SLOW DECAY)" VALUE 0xFC56D5 Scalar_BOOLEAN 0 TE_TM_ThrottleCtrl4ms_CM_boolean_adm 0 1 /end CHARACTERISTIC
/begin CHARACTERISTIC hfDIS_PW_STAGE_Enable "[FIX] Fix sulla disabilitazione del controllore" VALUE 0xFC56D4 Scalar_UBYTE 0 TE_TM_ThrottleCtrl4ms_CM_FixEnableT 171 218 /end CHARACTERISTIC
/begin CHARACTERISTIC hfDIS_PW_STAGE_Value "[FIX] Fix sulla disabilitazione del controllore" VALUE 0xFC56D3 Scalar_BOOLEAN 0 TE_TM_ThrottleCtrl4ms_CM_boolean_adm 0 1 /end CHARACTERISTIC
/begin CHARACTERISTIC hfDTC_ERROR_Enable "[FIX] Fix sul flag di errore nel test DTC della procedura di learning" VALUE 0xFC577E Scalar_UBYTE 0 ETCLearning4ms_CM_FixEnableT 171 218 /end CHARACTERISTIC
/begin CHARACTERISTIC hfDTC_ERROR_Value "[FIX] Fix sul flag di errore nel test DTC della procedura di learning" VALUE 0xFC577D Scalar_BOOLEAN 0 ETCLearning4ms_CM_boolean_adm 0 1 /end CHARACTERISTIC
/begin CHARACTERISTIC hfEEPROMSTATE_Enable "[FIX] Fix sulla variabile di stato della eeprom" VALUE 0xFC577C Scalar_UBYTE 0 ETCLearning4ms_CM_FixEnableT 171 218 /end CHARACTERISTIC
/begin CHARACTERISTIC hfEEPROMSTATE_Value "[FIX] Fix sulla variabile di stato della eeprom" VALUE 0xFC577B Scalar_BOOLEAN 0 ETCLearning4ms_CM_boolean_adm 0 1 /end CHARACTERISTIC
/begin CHARACTERISTIC hfENAB_COND_THRST_Enable "[FIX] Fix sulla abilitazione generale della diagnosi THRST" VALUE 0xFC56D2 Scalar_UBYTE 0 TE_TM_CndAbilTHRST4ms_CM_FixEnableT 171 218 /end CHARACTERISTIC
/begin CHARACTERISTIC hfENAB_COND_THRST_Value "[FIX] Fix sulla abilitazione generale della diagnosi THRST" VALUE 0xFC56D1 Scalar_BOOLEAN 0 TE_TM_CndAbilTHRST4ms_CM_boolean_adm 0 1 /end CHARACTERISTIC
/begin CHARACTERISTIC hfEN_OLD_THRST_MGM "[FIX] Fix sulla soglia in percentuale per passaggio da Medium Throttle a Closed Throttle" VALUE 0xFCB4BA Scalar_UWORD 0 ThrottleState4ms_Symbol_CM_boolean_adm 0 1 /end CHARACTERISTIC
/begin CHARACTERISTIC hfEN_OLD_THRST_MGM_EnFix "[FIX] Fix sulla soglia in percentuale per passaggio da Medium Throttle a Closed Throttle" VALUE 0xFCB4B8 Scalar_UWORD 0 ThrottleState4ms_Symbol_CM_FixEnableT 171 218 /end CHARACTERISTIC
/begin CHARACTERISTIC hfFORCE_DEV_LRN_Enable "[FIX] Fix sulla richiesta di forzare la devalidazione della linea LRN01" VALUE 0xFC577A Scalar_UBYTE 0 ETCLearning4ms_CM_FixEnableT 171 218 /end CHARACTERISTIC
/begin CHARACTERISTIC hfFORCE_DEV_LRN_Value "[FIX] Fix sulla richiesta di forzare la devalidazione della linea LRN01" VALUE 0xFC5779 Scalar_BOOLEAN 0 ETCLearning4ms_CM_boolean_adm 0 1 /end CHARACTERISTIC
/begin CHARACTERISTIC hfFULL_LOAD "[FIX] Fix sulla apertura farfalla totale" VALUE 0xFCB4B6 Scalar_UWORD 0 ThrottleState4ms_Symbol_CM_boolean_adm 0 1 /end CHARACTERISTIC
/begin CHARACTERISTIC hfFULL_LOAD_EnFix "[FIX] Fix sulla apertura farfalla totale" VALUE 0xFCB4B4 Scalar_UWORD 0 ThrottleState4ms_Symbol_CM_FixEnableT 171 218 /end CHARACTERISTIC
/begin CHARACTERISTIC hfGLOBAL_LRN_REQ_Enable "[FIX] Fix di richiesta di apprendimento lungo al trip successivo" VALUE 0xFC5778 Scalar_UBYTE 0 ETCLearning4ms_CM_FixEnableT 171 218 /end CHARACTERISTIC
/begin CHARACTERISTIC hfGLOBAL_LRN_REQ_Value "[FIX] Fix di richiesta di apprendimento lungo al trip successivo" VALUE 0xFC5777 Scalar_BOOLEAN 0 ETCLearning4ms_CM_boolean_adm 0 1 /end CHARACTERISTIC
/begin CHARACTERISTIC hfGLOB_REQ_RAM_Enable "[FIX] Fix sulla richiesta apprendimento lungo al trip successivo" VALUE 0xFC5776 Scalar_UBYTE 0 ETCLearning4ms_CM_FixEnableT 171 218 /end CHARACTERISTIC
/begin CHARACTERISTIC hfGLOB_REQ_RAM_Value "[FIX] Fix sulla richiesta apprendimento lungo al trip successivo" VALUE 0xFC5775 Scalar_BOOLEAN 0 ETCLearning4ms_CM_boolean_adm 0 1 /end CHARACTERISTIC
/begin CHARACTERISTIC hfINT_FREEZE_Enable "[FIX] Fix di richiesta di congelamento integrale nel blocco controllo farfalla motorizzata" VALUE 0xFC5774 Scalar_UBYTE 0 ETCLearning4ms_CM_FixEnableT 171 218 /end CHARACTERISTIC
/begin CHARACTERISTIC hfINT_FREEZE_Value "[FIX] Fix di richiesta di congelamento integrale nel blocco controllo farfalla motorizzata" VALUE 0xFC5773 Scalar_BOOLEAN 0 ETCLearning4ms_CM_boolean_adm 0 1 /end CHARACTERISTIC
/begin CHARACTERISTIC hfLOAD_DIS_Enable "[FIX] Fix sulla disabilitazione del controllore per carichi disabilitati" VALUE 0xFC56D0 Scalar_UBYTE 0 TE_TM_ThrottleCtrl4ms_CM_FixEnableT 171 218 /end CHARACTERISTIC
/begin CHARACTERISTIC hfLOAD_DIS_Value "[FIX] Fix sulla disabilitazione del controllore per carichi disabilitati" VALUE 0xFC56CF Scalar_BOOLEAN 0 TE_TM_ThrottleCtrl4ms_CM_boolean_adm 0 1 /end CHARACTERISTIC
/begin CHARACTERISTIC hfLRN_CNTRL_REQ_Enable "[FIX] Fix di richiesta Learning di sostituire gli obiettivi di controllo farfalla impostati nel blocco di controllo" VALUE 0xFC5772 Scalar_UBYTE 0 ETCLearning4ms_CM_FixEnableT 171 218 /end CHARACTERISTIC
/begin CHARACTERISTIC hfLRN_CNTRL_REQ_Value "[FIX] Fix di richiesta Learning di sostituire gli obiettivi di controllo farfalla impostati nel blocco di controllo" VALUE 0xFC5771 Scalar_BOOLEAN 0 ETCLearning4ms_CM_boolean_adm 0 1 /end CHARACTERISTIC
/begin CHARACTERISTIC hfLRN_DIS_REQ_Enable "[FIX] Fix di richiesta Learning di disabilitazione del driver TLE6209R" VALUE 0xFC5770 Scalar_UBYTE 0 ETCLearning4ms_CM_FixEnableT 171 218 /end CHARACTERISTIC
/begin CHARACTERISTIC hfLRN_DIS_REQ_Value "[FIX] Fix di richiesta Learning di disabilitazione del driver TLE6209R" VALUE 0xFC576F Scalar_BOOLEAN 0 ETCLearning4ms_CM_boolean_adm 0 1 /end CHARACTERISTIC
/begin CHARACTERISTIC hfLRN_EN_Enable "[FIX] Fix di abilitazione della strategia di Learning" VALUE 0xFC576E Scalar_UBYTE 0 ETCLearning4ms_CM_FixEnableT 171 218 /end CHARACTERISTIC
/begin CHARACTERISTIC hfLRN_EN_Value "[FIX] Fix di abilitazione della strategia di Learning" VALUE 0xFC576D Scalar_BOOLEAN 0 ETCLearning4ms_CM_boolean_adm 0 1 /end CHARACTERISTIC
/begin CHARACTERISTIC hfLRN_STATE_Enable "[FIX] Fix sulla stato della procedura di apprendimento prametri ETC" VALUE 0xFC576C Scalar_UBYTE 0 ETCLearning4ms_CM_FixEnableT 171 218 /end CHARACTERISTIC
/begin CHARACTERISTIC hfLRN_STATE_Value "[FIX] Fix sulla stato della procedura di apprendimento prametri ETC" VALUE 0xFC576B Scalar_UBYTE 0 ETCLearning4ms_CM_uint8_adm 0 255 /end CHARACTERISTIC
/begin CHARACTERISTIC hfLRN_TARG_Enable "[FIX] Fix di percentuale obiettivo farfalla impostata nel blocco di Self Learning" VALUE 0xFC576A Scalar_UBYTE 0 ETCLearning4ms_CM_FixEnableT 171 218 /end CHARACTERISTIC
/begin CHARACTERISTIC hfLRN_TARG_Value "[FIX] Fix di percentuale obiettivo farfalla impostata nel blocco di Self Learning" VALUE 0xFC5768 Scalar_SWORD 0 ETCLearning4ms_CM_sfix16_En8__ -100 100 /end CHARACTERISTIC
/begin CHARACTERISTIC hfMEAN_POT_EN_Enable "[FIX] Fix sulla abilitazione al blocco di media" VALUE 0xFC5766 Scalar_UBYTE 0 ETCLearning4ms_CM_FixEnableT 171 218 /end CHARACTERISTIC
/begin CHARACTERISTIC hfMEAN_POT_EN_Value "[FIX] Fix sulla abilitazione al blocco di media" VALUE 0xFC5765 Scalar_BOOLEAN 0 ETCLearning4ms_CM_boolean_adm 0 1 /end CHARACTERISTIC
/begin CHARACTERISTIC hfNLP_LEARNED_Enable "[FIX] Fix sul flag di apprendimento NLP" VALUE 0xFC5764 Scalar_UBYTE 0 ETCLearning4ms_CM_FixEnableT 171 218 /end CHARACTERISTIC
/begin CHARACTERISTIC hfNLP_LEARNED_Value "[FIX] Fix sul flag di apprendimento NLP" VALUE 0xFC5763 Scalar_BOOLEAN 0 ETCLearning4ms_CM_boolean_adm 0 1 /end CHARACTERISTIC
/begin CHARACTERISTIC hfNUM_FORCE_Enable "[FIX] Fix sul numero di attivazioni della procedura di forzatura della farfalla" VALUE 0xFC5762 Scalar_UBYTE 0 ETCLearning4ms_CM_FixEnableT 171 218 /end CHARACTERISTIC
/begin CHARACTERISTIC hfNUM_FORCE_Value "[FIX] Fix sul numero di attivazioni della procedura di forzatura della farfalla" VALUE 0xFC5761 Scalar_UBYTE 0 ETCLearning4ms_CM_uint8_adm 0 255 /end CHARACTERISTIC
/begin CHARACTERISTIC hfOFF_P_EGR_Enable "[FIX] Offset su Pobj per gas residui (EGR interno)" VALUE 0xFCB468 Scalar_UBYTE 0 TE_TM_CtrlThrotMgm4ms_CM_FixEnableT 171 218 /end CHARACTERISTIC
/begin CHARACTERISTIC hfOFF_P_EGR_Value "[FIX] Offset su Pobj per gas residui (EGR interno)" VALUE 0xFCB466 Scalar_UWORD 0 TE_TM_CtrlThrotMgm4ms_CM_uint16_mbar 0 2500 /end CHARACTERISTIC
/begin CHARACTERISTIC hfOSCC_ERROR_Enable "[FIX] Fix sul flag di errore nel test OSCC della procedura di learning" VALUE 0xFC5760 Scalar_UBYTE 0 ETCLearning4ms_CM_FixEnableT 171 218 /end CHARACTERISTIC
/begin CHARACTERISTIC hfOSCC_ERROR_Value "[FIX] Fix sul flag di errore nel test OSCC della procedura di learning" VALUE 0xFC575F Scalar_BOOLEAN 0 ETCLearning4ms_CM_boolean_adm 0 1 /end CHARACTERISTIC
/begin CHARACTERISTIC hfOSCO_ERROR_Enable "[FIX] Fix sul flag di errore nel test OSCO della procedura di learning" VALUE 0xFC575E Scalar_UBYTE 0 ETCLearning4ms_CM_FixEnableT 171 218 /end CHARACTERISTIC
/begin CHARACTERISTIC hfOSCO_ERROR_Value "[FIX] Fix sul flag di errore nel test OSCO della procedura di learning" VALUE 0xFC575D Scalar_BOOLEAN 0 ETCLearning4ms_CM_boolean_adm 0 1 /end CHARACTERISTIC
/begin CHARACTERISTIC hfPCOLL_REQ_DEF_Enable "[FIX] Fix sulla pressione obiettivo" VALUE 0xFCB464 Scalar_UBYTE 0 TE_TM_CtrlThrotMgm4ms_CM_FixEnableT 171 218 /end CHARACTERISTIC
/begin CHARACTERISTIC hfPCOLL_REQ_DEF_Value "[FIX] Fix sulla pressione obiettivo" VALUE 0xFCB462 Scalar_UWORD 0 TE_TM_CtrlThrotMgm4ms_CM_uint16_mbar 0 2500 /end CHARACTERISTIC
/begin CHARACTERISTIC hfPERC_THROT_MAX_Enable "[FIX] Valore della percentuale di apertura farfalla a cui si ha la Qair massima a regime fissato" VALUE 0xFCB460 Scalar_UBYTE 0 TE_TM_CtrlThrotMgm4ms_CM_FixEnableT 171 218 /end CHARACTERISTIC
/begin CHARACTERISTIC hfPERC_THROT_MAX_Value "[FIX] Valore della percentuale di apertura farfalla a cui si ha la Qair massima a regime fissato" VALUE 0xFCB45E Scalar_UWORD 0 TE_TM_CtrlThrotMgm4ms_CM_ufix16_En4__ 0 100 /end CHARACTERISTIC
/begin CHARACTERISTIC hfPOBJ_CARAT_THR_Enable "[FIX] Carattaristica attuatore nel Ctrl Farfalla f(Pcoll_Obj)" VALUE 0xFCB45C Scalar_UBYTE 0 TE_TM_CtrlThrotMgm4ms_CM_FixEnableT 171 218 /end CHARACTERISTIC
/begin CHARACTERISTIC hfPOBJ_CARAT_THR_Value "[FIX] Carattaristica attuatore nel Ctrl Farfalla f(Pcoll_Obj)" VALUE 0xFCB45A Scalar_UWORD 0 TE_TM_CtrlThrotMgm4ms_CM_ufix16_En4__ 0 100 /end CHARACTERISTIC
/begin CHARACTERISTIC hfPON_MIN_PED_REQ_Enable "[FIX] Fix su limitazione inferiore allo obiettivo farfalla da pedale in PowerOn" VALUE 0xFCB458 Scalar_UBYTE 0 TE_TM_CtrlThrotMgm4ms_CM_FixEnableT 171 218 /end CHARACTERISTIC
/begin CHARACTERISTIC hfPON_MIN_PED_REQ_Value "[FIX] Fix su limitazione inferiore allo obiettivo farfalla da pedale in PowerOn" VALUE 0xFCB456 Scalar_UWORD 0 TE_TM_CtrlThrotMgm4ms_CM_ufix16_En4__ 0 100 /end CHARACTERISTIC
/begin CHARACTERISTIC hfPTAIR_GAIN_THR_Enable "[FIX] Normalizzazione nel Ctrl Farfalla f(Pcoll_Obj)" VALUE 0xFCB454 Scalar_UBYTE 0 TE_TM_CtrlThrotMgm4ms_CM_FixEnableT 171 218 /end CHARACTERISTIC
/begin CHARACTERISTIC hfPTAIR_GAIN_THR_Value "[FIX] Normalizzazione nel Ctrl Farfalla f(Pcoll_Obj)" VALUE 0xFCB452 Scalar_UWORD 0 TE_TM_CtrlThrotMgm4ms_CM_ufix16_En10_adm 0 10 /end CHARACTERISTIC
/begin CHARACTERISTIC hfPWM_SIGNAL_Enable "[FIX] Fix sul PWM di pilotaggio del TLE6209" VALUE 0xFC56CE Scalar_UBYTE 0 TE_TM_ThrottleCtrl4ms_CM_FixEnableT 171 218 /end CHARACTERISTIC
/begin CHARACTERISTIC hfPWM_SIGNAL_Value "[FIX] Fix sul PWM di pilotaggio del TLE6209" VALUE 0xFC56CC Scalar_UWORD 0 TE_TM_ThrottleCtrl4ms_CM_ufix16_En3_adm 0 100 /end CHARACTERISTIC
/begin CHARACTERISTIC hfQAIR_REQ_CORR_Enable "[FIX] Air quantity correction in function of RPM and Lambda target value" VALUE 0xFCB450 Scalar_UBYTE 0 TE_TM_CtrlThrotMgm4ms_CM_FixEnableT 171 218 /end CHARACTERISTIC
/begin CHARACTERISTIC hfQAIR_REQ_CORR_Value "[FIX] Air quantity correction in function of RPM and Lambda target value" VALUE 0xFCB44E Scalar_UWORD 0 TE_TM_CtrlThrotMgm4ms_CM_ufix16_En10_adm 0.5 1.5 /end CHARACTERISTIC
/begin CHARACTERISTIC hfQAIR_TEST_THR_Enable "[FIX] Fix su Qair richiesta in ingresso al modello farfalla Qobj" VALUE 0xFCB44C Scalar_UBYTE 0 TE_TM_CtrlThrotMgm4ms_CM_FixEnableT 171 218 /end CHARACTERISTIC
/begin CHARACTERISTIC hfQAIR_TEST_THR_Value "[FIX] Fix su Qair richiesta in ingresso al modello farfalla Qobj" VALUE 0xFCB44A Scalar_UWORD 0 TE_TM_CtrlThrotMgm4ms_CM_ufix16_En4_kg_h 0 3200 /end CHARACTERISTIC
/begin CHARACTERISTIC hfRANG_CONSTR_Enable "[FIX] Fix su Range di riferimento per la farfalla" VALUE 0xFCB448 Scalar_UBYTE 0 TE_TM_CtrlThrotMgm4ms_CM_FixEnableT 171 218 /end CHARACTERISTIC
/begin CHARACTERISTIC hfRANG_CONSTR_Value "[FIX] Fix su Range di riferimento per la farfalla" VALUE 0xFCB446 Scalar_UWORD 0 TE_TM_CtrlThrotMgm4ms_CM_ufix16_En9_deg 63 94.5 /end CHARACTERISTIC
/begin CHARACTERISTIC hfRSCC_ERROR_Enable "[FIX] Fix sul flag di errore nel test RSCC della procedura di learning" VALUE 0xFC575C Scalar_UBYTE 0 ETCLearning4ms_CM_FixEnableT 171 218 /end CHARACTERISTIC
/begin CHARACTERISTIC hfRSCC_ERROR_Value "[FIX] Fix sul flag di errore nel test RSCC della procedura di learning" VALUE 0xFC575B Scalar_BOOLEAN 0 ETCLearning4ms_CM_boolean_adm 0 1 /end CHARACTERISTIC
/begin CHARACTERISTIC hfRSCO_ERROR_Enable "[FIX] Fix sul flag di errore nel test RSCO della procedura di learning" VALUE 0xFC575A Scalar_UBYTE 0 ETCLearning4ms_CM_FixEnableT 171 218 /end CHARACTERISTIC
/begin CHARACTERISTIC hfRSCO_ERROR_Value "[FIX] Fix sul flag di errore nel test RSCO della procedura di learning" VALUE 0xFC5759 Scalar_BOOLEAN 0 ETCLearning4ms_CM_boolean_adm 0 1 /end CHARACTERISTIC
/begin CHARACTERISTIC hfRSCW_ERROR_Enable "[FIX] Fix sul flag di errore nel test RSCW della procedura di learning" VALUE 0xFC5758 Scalar_UBYTE 0 ETCLearning4ms_CM_FixEnableT 171 218 /end CHARACTERISTIC
/begin CHARACTERISTIC hfRSCW_ERROR_Value "[FIX] Fix sul flag di errore nel test RSCW della procedura di learning" VALUE 0xFC5757 Scalar_BOOLEAN 0 ETCLearning4ms_CM_boolean_adm 0 1 /end CHARACTERISTIC
/begin CHARACTERISTIC hfSELF_LRN_EN_Enable "[FIX] Fix sulla abilitazione automa di apprendimento" VALUE 0xFC5756 Scalar_UBYTE 0 ETCLearning4ms_CM_FixEnableT 171 218 /end CHARACTERISTIC
/begin CHARACTERISTIC hfSELF_LRN_EN_Value "[FIX] Fix sulla abilitazione automa di apprendimento" VALUE 0xFC5755 Scalar_BOOLEAN 0 ETCLearning4ms_CM_boolean_adm 0 1 /end CHARACTERISTIC
/begin CHARACTERISTIC hfSPD_CTRL2ENG_MOD_Enable "[FIX] Fix su informazione Controllo di giri (PTO) attivo per togliere le limitazioni alla farfalla" VALUE 0xFCB444 Scalar_UBYTE 0 TE_TM_CtrlThrotMgm4ms_CM_FixEnableT 171 218 /end CHARACTERISTIC
/begin CHARACTERISTIC hfSPD_CTRL2ENG_MOD_Value "[FIX] Fix su informazione Controllo di giri (PTO) attivo per togliere le limitazioni alla farfalla" VALUE 0xFCB443 Scalar_BOOLEAN 0 TE_TM_CtrlThrotMgm4ms_CM_boolean_adm 0 1 /end CHARACTERISTIC
/begin CHARACTERISTIC hfSTICK_SLIP_Enable "[FIX] Fix sulla abilitazione dello integrale rapido" VALUE 0xFC56CA Scalar_UBYTE 0 TE_TM_ThrottleCtrl4ms_CM_FixEnableT 171 218 /end CHARACTERISTIC
/begin CHARACTERISTIC hfSTICK_SLIP_Value "[FIX] Fix sulla abilitazione dello integrale rapido" VALUE 0xFC56C9 Scalar_BOOLEAN 0 TE_TM_ThrottleCtrl4ms_CM_boolean_adm 0 1 /end CHARACTERISTIC
/begin CHARACTERISTIC hfST_THROT "[FIX] Fix sullo stato farfalla" VALUE 0xFCB4B2 Scalar_UWORD 0 ThrottleState4ms_Symbol_CM_uint8_adm 0 2 /end CHARACTERISTIC
/begin CHARACTERISTIC hfST_THROT_EnFix "[FIX] Fix sullo stato farfalla" VALUE 0xFCB4B0 Scalar_UWORD 0 ThrottleState4ms_Symbol_CM_FixEnableT 171 218 /end CHARACTERISTIC
/begin CHARACTERISTIC hfTBDELTAFOPT "[FIX] Tabella full open throttle" VALUE 0xFCB4AE Scalar_UWORD 0 ThrottleState4ms_Symbol_CM_ufix16_En10_adm 0.0009765625 3 /end CHARACTERISTIC
/begin CHARACTERISTIC hfTBDELTAFOPT_EnFix "[FIX] Tabella full open throttle" VALUE 0xFCB4AC Scalar_UWORD 0 ThrottleState4ms_Symbol_CM_FixEnableT 171 218 /end CHARACTERISTIC
/begin CHARACTERISTIC hfTBFOPTI "[FIX] Tabella full open throttle init" VALUE 0xFCB4AA Scalar_UWORD 0 ThrottleState4ms_Symbol_CM_ufix16_En10_adm 0 3 /end CHARACTERISTIC
/begin CHARACTERISTIC hfTBFOPTI_EnFix "[FIX] Tabella full open throttle init" VALUE 0xFCB4A8 Scalar_UWORD 0 ThrottleState4ms_Symbol_CM_FixEnableT 171 218 /end CHARACTERISTIC
/begin CHARACTERISTIC hfTHRO_REF_PER_Enable "[FIX] Fix su effettivo comando di apertura della farfalla" VALUE 0xFCB442 Scalar_UBYTE 0 TE_TM_CtrlThrotMgm4ms_CM_FixEnableT 171 218 /end CHARACTERISTIC
/begin CHARACTERISTIC hfTHRO_REF_PER_Value "[FIX] Fix su effettivo comando di apertura della farfalla" VALUE 0xFCB440 Scalar_SWORD 0 TE_TM_CtrlThrotMgm4ms_CM_sfix16_En8__ -10 100 /end CHARACTERISTIC
/begin CHARACTERISTIC hfTQ_REQ_INT_Enable "[FIX] Fix sul contributo integrale nel controllore ETC" VALUE 0xFC56C8 Scalar_UBYTE 0 TE_TM_ThrottleCtrl4ms_CM_FixEnableT 171 218 /end CHARACTERISTIC
/begin CHARACTERISTIC hfTQ_REQ_INT_Value "[FIX] Fix sul contributo integrale nel controllore ETC" VALUE 0xFC56C6 Scalar_SWORD 0 TE_TM_ThrottleCtrl4ms_CM_sfix16_En12_Nm -5 5 /end CHARACTERISTIC
/begin CHARACTERISTIC hfUMA_LEARNED_Enable "[FIX] Fix sul flag di apprendimento UMA" VALUE 0xFC5754 Scalar_UBYTE 0 ETCLearning4ms_CM_FixEnableT 171 218 /end CHARACTERISTIC
/begin CHARACTERISTIC hfUMA_LEARNED_Value "[FIX] Fix sul flag di apprendimento UMA" VALUE 0xFC5753 Scalar_BOOLEAN 0 ETCLearning4ms_CM_boolean_adm 0 1 /end CHARACTERISTIC
/begin CHARACTERISTIC hfVCYL_RIF_Enable "[FIX] Fix su cilindrata effettiva unitaria" VALUE 0xFCB43E Scalar_UBYTE 0 TE_TM_CtrlThrotMgm4ms_CM_FixEnableT 171 218 /end CHARACTERISTIC
/begin CHARACTERISTIC hfVCYL_RIF_Value "[FIX] Fix su cilindrata effettiva unitaria" VALUE 0xFCB43C Scalar_UWORD 0 TE_TM_CtrlThrotMgm4ms_CM_ufix16_En4_cc 409.5 4095 /end CHARACTERISTIC
/begin CHARACTERISTIC hfVNLP_TMP_Enable "[FIX] Fix sulla tensione NLP su cui viene fatto il test di fuori range di plausibilità" VALUE 0xFC5752 Scalar_UBYTE 0 ETCLearning4ms_CM_FixEnableT 171 218 /end CHARACTERISTIC
/begin CHARACTERISTIC hfVNLP_TMP_Value "[FIX] Fix sulla tensione NLP su cui viene fatto il test di fuori range di plausibilità" VALUE 0xFC5750 Scalar_UWORD 0 ETCLearning4ms_CM_ufix16_En10_V 0 5 /end CHARACTERISTIC
/begin CHARACTERISTIC hfVUMA_TMP_Enable "[FIX] Fix sulla tensione UMA su cui viene fatto il test di fuori range di plausibilità" VALUE 0xFC574E Scalar_UBYTE 0 ETCLearning4ms_CM_FixEnableT 171 218 /end CHARACTERISTIC
/begin CHARACTERISTIC hfVUMA_TMP_Value "[FIX] Fix sulla tensione UMA su cui viene fatto il test di fuori range di plausibilità" VALUE 0xFC574C Scalar_UWORD 0 ETCLearning4ms_CM_ufix16_En10_V 0 5 /end CHARACTERISTIC
/begin CHARACTERISTIC hfV_NLP_Enable "[FIX] Fix di tensione NLP" VALUE 0xFC574B Scalar_UBYTE 0 ETCLearning4ms_CM_FixEnableT 171 218 /end CHARACTERISTIC
/begin CHARACTERISTIC hfV_NLP_RAM_Enable "[FIX] Fix sulla tensione NLP memorizzata in RAM" VALUE 0xFC574A Scalar_UBYTE 0 ETCLearning4ms_CM_FixEnableT 171 218 /end CHARACTERISTIC
/begin CHARACTERISTIC hfV_NLP_RAM_Value "[FIX] Fix sulla tensione NLP memorizzata in RAM" VALUE 0xFC5748 Scalar_UWORD 0 ETCLearning4ms_CM_ufix16_En10_V 0 5 /end CHARACTERISTIC
/begin CHARACTERISTIC hfV_NLP_Value "[FIX] Fix di tensione NLP" VALUE 0xFC5746 Scalar_UWORD 0 ETCLearning4ms_CM_ufix16_En10_V 0 5 /end CHARACTERISTIC
/begin CHARACTERISTIC hfV_UMA_Enable "[FIX] Fix di tensione UMA" VALUE 0xFC5745 Scalar_UBYTE 0 ETCLearning4ms_CM_FixEnableT 171 218 /end CHARACTERISTIC
/begin CHARACTERISTIC hfV_UMA_RAM_Enable "[FIX] Fix sulla tensione UMA memorizzata in RAM" VALUE 0xFC5744 Scalar_UBYTE 0 ETCLearning4ms_CM_FixEnableT 171 218 /end CHARACTERISTIC
/begin CHARACTERISTIC hfV_UMA_RAM_Value "[FIX] Fix sulla tensione UMA memorizzata in RAM" VALUE 0xFC5742 Scalar_UWORD 0 ETCLearning4ms_CM_ufix16_En10_V 0 5 /end CHARACTERISTIC
/begin CHARACTERISTIC hfV_UMA_Value "[FIX] Fix di tensione UMA" VALUE 0xFC5740 Scalar_UWORD 0 ETCLearning4ms_CM_ufix16_En10_V 0 5 /end CHARACTERISTIC
/begin AXIS_PTS hkBKPRPM1 "[XBK] Tabella full open throttle" 0xFCB54E NO_INPUT_QUANTITY Lookup1D_X_UWORD 0 ThrottleState4ms_Symbol_CM_uint16_rpm 24 0 10000 /end AXIS_PTS
/begin AXIS_PTS hkBKPRPM2 "[XBK] Tabella full open throttle init" 0xFCB51E NO_INPUT_QUANTITY Lookup1D_X_UWORD 0 ThrottleState4ms_Symbol_CM_uint16_rpm 24 0 10000 /end AXIS_PTS
/begin AXIS_PTS hkDELTA_QAIR_MAX "[XBK] Delta aria massima (vs. curva teorica) disponibile a un dato regime" 0xFCB41C NO_INPUT_QUANTITY Lookup1D_X_UWORD 0 TE_TM_CtrlThrotMgm4ms_CM_uint16_rpm 16 0 10000 /end AXIS_PTS
/begin AXIS_PTS hkLAMOBT "[YBK] Air quantity correction in function of RPM and Lambda target value" 0xFCB408 NO_INPUT_QUANTITY Lookup2D_X_UWORD 0 TE_TM_CtrlThrotMgm4ms_CM_ufix16_En10_adm 10 0.015625 1.599609375 /end AXIS_PTS
/begin AXIS_PTS hkPOBJ_CARATHR_B "[YBK] Carattaristica attuatore nel Ctrl Farfalla f(Pcoll_Obj)" 0xFCB3F4 NO_INPUT_QUANTITY Lookup2D_X_UWORD 0 TE_TM_CtrlThrotMgm4ms_CM_ufix16_En14_adm 10 0 1 /end AXIS_PTS
/begin AXIS_PTS hkPOBJ_CARATHR_Q "[XBK] Carattaristica attuatore nel Ctrl Farfalla f(Pcoll_Obj)" 0xFCB3D4 NO_INPUT_QUANTITY Lookup2D_X_UWORD 0 TE_TM_CtrlThrotMgm4ms_CM_ufix16_En4_kg_h 16 0 4095 /end AXIS_PTS
/begin AXIS_PTS hkPTAIR_GAINTHRP "[XBK] Normalizzazione nel Ctrl Farfalla f(Pcoll_Obj)" 0xFCB3C4 NO_INPUT_QUANTITY Lookup2D_X_UWORD 0 TE_TM_CtrlThrotMgm4ms_CM_uint16_mbar 8 400 6000 /end AXIS_PTS
/begin AXIS_PTS hkPTAIR_GAINTHRT "[YBK] Normalizzazione nel Ctrl Farfalla f(Pcoll_Obj)" 0xFCB3B4 NO_INPUT_QUANTITY Lookup2D_X_UWORD 0 TE_TM_CtrlThrotMgm4ms_CM_ufix16_Bn40_degC 8 -40 130 /end AXIS_PTS
/begin AXIS_PTS hkRPM_8 "[XBK] Valore della percentuale di apertura farfalla a cui si ha la Qair massima a regime fissato" 0xFCB394 NO_INPUT_QUANTITY Lookup1D_X_UWORD 0 TE_TM_CtrlThrotMgm4ms_CM_uint16_rpm 16 0 10000 /end AXIS_PTS
/begin AXIS_PTS hkRPM_9 "[XBK] Air quantity correction in function of RPM and Lambda target value" 0xFCB374 NO_INPUT_QUANTITY Lookup2D_X_UWORD 0 TE_TM_CtrlThrotMgm4ms_CM_uint16_rpm 16 0 10000 /end AXIS_PTS
/begin MEASUREMENT hsAlphThrotLtDer "Limitazione derivata percentuale apertura farfalla" UWORD TE_TM_CtrlThrotMgm4ms_CM_ufix16_En8__ 0 0 0 100 ECU_ADDRESS 0x40004160 /end MEASUREMENT
/begin MEASUREMENT hsAlphaThrotLtd "Percentuale apertura farfalla calcolato con filtraggio derivata e limitazione superiore e inferiore" UWORD TE_TM_CtrlThrotMgm4ms_CM_ufix16_En8__ 0 0 0 95 ECU_ADDRESS 0x4000415E /end MEASUREMENT
/begin MEASUREMENT hsAvvEnable "Flag di consenso all`avviamento" UBYTE Crkc4ms_CM_boolean_adm 0 0 0 1 ECU_ADDRESS 0x40002D29 /end MEASUREMENT
/begin MEASUREMENT hsAvvEnableTmp "Learning Avv Enable test point" UBYTE ETCLearning4ms_CM_boolean_adm 0 0 0 1 ECU_ADDRESS 0x40002DD2 /end MEASUREMENT
/begin MEASUREMENT hsBauden "Richiesta di apertura farfalla in legge meccanica" UWORD TE_TM_CtrlThrotMgm4ms_CM_ufix16_En4__ 0 0 0 100 ECU_ADDRESS 0x4000415C /end MEASUREMENT
/begin MEASUREMENT hsBeta "Rapporto fra Map e Pboost" UWORD Thrp4ms_CM_ufix16_En14_adm 0 0 0 1 ECU_ADDRESS 0x40004102 /end MEASUREMENT
/begin MEASUREMENT hsBitMode "6° Bit di configurazione per il TLE6209 (0 =>SLOW DECAY  1=>FAST DECAY)" UBYTE Ethrc4ms_CM_boolean_adm 0 0 0 1 ECU_ADDRESS 0x40002C5B /end MEASUREMENT
/begin MEASUREMENT hsChgZone "Flag di variazione della zona di funzionamento" UBYTE TE_TM_ThrottleCtrl4ms_CM_boolean_adm 0 0 0 1 ECU_ADDRESS 0x40002D10 /end MEASUREMENT
/begin MEASUREMENT hsCurrOffset "Offset di corrente legato alle forze di attrito del motore elettrico." FLOAT32_IEEE TE_TM_ThrottleCtrl4ms_CM_single_adm 0 0 -1 1 ECU_ADDRESS 0x40002D0C /end MEASUREMENT
/begin CHARACTERISTIC hsDELTA_DTC "Delta riconoscimento DTC" VALUE 0xFC573E Scalar_UWORD 0 ETCLearning4ms_CM_ufix16_En8__ 0 100 /end CHARACTERISTIC
/begin CHARACTERISTIC hsDELTA_NLP "Delta per riconoscimento corpo farfallato" VALUE 0xFC573C Scalar_UWORD 0 ETCLearning4ms_CM_ufix16_En10_V 0 5 /end CHARACTERISTIC
/begin CHARACTERISTIC hsDELTA_NLP_NOM "Valore in percentuale del semi-range di NLP" VALUE 0xFC56C4 Scalar_UWORD 0 TE_TM_ThrottleCtrl4ms_CM_ufix16_En8__ 0 10 /end CHARACTERISTIC
/begin CHARACTERISTIC hsDELTA_PCOLL_4INJ_INF "Delta negativo su PcollReqDef per Iniezione per rate limiter" VALUE 0xFCB372 Scalar_UWORD 0 TE_TM_CtrlThrotMgm4ms_CM_uint16_mbar 0 2500 /end CHARACTERISTIC
/begin CHARACTERISTIC hsDELTA_PCOLL_4INJ_SUP "Delta positivo su PcollReqDef per Iniezione per rate limiter" VALUE 0xFCB370 Scalar_UWORD 0 TE_TM_CtrlThrotMgm4ms_CM_uint16_mbar 0 2500 /end CHARACTERISTIC
/begin CHARACTERISTIC hsDELTA_PCOLL_4THR_INF "Delta negativo su PcollReqDef per farfalla per rate limiter" VALUE 0xFCB36E Scalar_UWORD 0 TE_TM_CtrlThrotMgm4ms_CM_uint16_mbar 0 2500 /end CHARACTERISTIC
/begin CHARACTERISTIC hsDELTA_PCOLL_4THR_SUP "Delta positivo su PcollReqDef per farfalla per rate limiter" VALUE 0xFCB36C Scalar_UWORD 0 TE_TM_CtrlThrotMgm4ms_CM_uint16_mbar 0 2500 /end CHARACTERISTIC
/begin CHARACTERISTIC hsDELTA_PERC_CMF "Delta sulla percentuale di coppia di friction" VALUE 0xFCB4BC Scalar_SWORD 0 ThrottleState4ms_Symbol_CM_sfix16_En4__ -100 100 /end CHARACTERISTIC
/begin CHARACTERISTIC hsDELTA_TROT_ERR "Valore in percentuale da sommare a hsMIN_TROT_ERR al di sopra del quale si disabilita il Ki2" VALUE 0xFC56C2 Scalar_UWORD 0 TE_TM_ThrottleCtrl4ms_CM_ufix16_En8__ 0 110 /end CHARACTERISTIC
/begin MEASUREMENT hsDTCError "Flag di errore nel test DTC della procedura di learning" UBYTE Ethrl4ms_CM_boolean_adm 0 0 0 1 ECU_ADDRESS 0x40002D22 /end MEASUREMENT
/begin MEASUREMENT hsDTCErrorTmp "Flag di errore nel test DTC della procedura di learning" UBYTE ETCLearning4ms_CM_boolean_adm 0 0 0 1 ECU_ADDRESS 0x40002DD1 /end MEASUREMENT
/begin CHARACTERISTIC hsDTC_DELAY "Ritardo massimo nel raggiungimento UMADTC" VALUE 0xFC573A Scalar_UWORD 0 ETCLearning4ms_CM_ufix16_Sp004_s 0 260 /end CHARACTERISTIC
/begin MEASUREMENT hsDegThrObjTmp "Apertura farfalla intermedia calcolata in centesimi di grado" ULONG TE_TM_CtrlThrotMgm4ms_CM_ufix32_En4_cdeg 0 0 0 9000 ECU_ADDRESS 0x40004158 /end MEASUREMENT
/begin MEASUREMENT hsDeltaPotenzThr "Variazione della posizione farfalla" FLOAT32_IEEE TE_TM_ThrottleCtrl4ms_CM_single__ 0 0 -110 110 ECU_ADDRESS 0x40002D08 /end MEASUREMENT
/begin MEASUREMENT hsDeltaQairMax "[OUT] Delta aria massima (vs. curva teorica) disponibile a un dato regime" UWORD TE_TM_CtrlThrotMgm4ms_CM_ufix16_En4_Bn100_kg_h 0 0 -100 100 ECU_ADDRESS 0x40004156 /end MEASUREMENT
/begin MEASUREMENT hsDirSignal "Comando in direzione verso il TLE6209 (dipende dalla modalità di funzionamento FAST/SLOW DECAY)" UBYTE Ethrc4ms_CM_boolean_adm 0 0 0 1 ECU_ADDRESS 0x40002C5C /end MEASUREMENT
/begin MEASUREMENT hsDisPwm "[PRE FIX] Segnale di disabilitazione del controllore farfalla motorizzata" UBYTE TE_TM_ThrottleCtrl4ms_CM_boolean_adm 0 0 0 1 ECU_ADDRESS 0x40002D05 /end MEASUREMENT
/begin MEASUREMENT hsDisSignal "Richiesta di disabilitazione del TLE6209" UBYTE Ethrc4ms_CM_boolean_adm 0 0 0 1 ECU_ADDRESS 0x40002C5A /end MEASUREMENT
/begin CHARACTERISTIC hsEN_BAUDEN "Flag che abilita (0 default) la richiesta di apertura farfalla in legge meccanica (Bauden comandato da richieste esterne)" VALUE 0xFCB36A Scalar_BOOLEAN 0 TE_TM_CtrlThrotMgm4ms_CM_boolean_adm 0 1 /end CHARACTERISTIC
/begin MEASUREMENT hsEnLow "Learning Enabling Low test point" UBYTE ETCLearning4ms_CM_boolean_adm 0 0 0 1 ECU_ADDRESS 0x40002DD0 /end MEASUREMENT
/begin MEASUREMENT hsErrorTarg "Potenziometro della farfalla motorizzata NLP" FLOAT32_IEEE ETCLearning4ms_CM_single__ 0 0 -110 210 ECU_ADDRESS 0x40002DCC /end MEASUREMENT
/begin CHARACTERISTIC hsFORCE_DOWN "Percentuale obiettivo sotto NLP in fase di sblocco farfalla" VALUE 0xFC5738 Scalar_UWORD 0 ETCLearning4ms_CM_ufix16_En8__ 0 100 /end CHARACTERISTIC
/begin CHARACTERISTIC hsFORCE_TIME "Intervallo di tempo su cui viene forzata un posizione prossima a UMA o OMA" VALUE 0xFC5736 Scalar_UWORD 0 ETCLearning4ms_CM_ufix16_Sp004_s 0 260 /end CHARACTERISTIC
/begin CHARACTERISTIC hsFORCE_UP "Percentuale obiettivo sopra NLP in fase di sblocco farfalla" VALUE 0xFC5734 Scalar_UWORD 0 ETCLearning4ms_CM_ufix16_En8__ 0 100 /end CHARACTERISTIC
/begin MEASUREMENT hsForceCntr "FSM Learning internal Test Point - Force Control Status" UBYTE ETCLearning4ms_CM_uint8_adm 0 0 0 255 ECU_ADDRESS 0x40002DCB /end MEASUREMENT
/begin MEASUREMENT hsForceDevLrn "Flag di richiesta forzare la devalidazione della linea di diagnosi LRN01" UBYTE Ethrc4ms_CM_boolean_adm 0 0 0 1 ECU_ADDRESS 0x40002D28 /end MEASUREMENT
/begin MEASUREMENT hsForceDevLrnEn "Flag di richiesta forzare la devalidazione della linea di diagnosi LRN01 - Condizione di enable set ADIA_ForceDevalidC - \r\n      hsForceDevLrnEn(i) = TRUE   if (hsForceDevLrn(i)==TRUE)&&(hsForceDevLrn(i-1)==FALSE)" UBYTE ETCLearning4ms_CM_boolean_adm 0 0 0 1 ECU_ADDRESS 0x40002DCA /end MEASUREMENT
/begin MEASUREMENT hsFreeze "Flag di freeze integrale" UBYTE TE_TM_ThrottleCtrl4ms_CM_boolean_adm 0 0 0 1 ECU_ADDRESS 0x40002D04 /end MEASUREMENT
/begin MEASUREMENT hsFreezeStatus "Memorizza 1e eventuali attivazioni del comando Freeze" UBYTE Ethrc4ms_CM_boolean_adm 0 0 0 1 ECU_ADDRESS 0x40002C59 /end MEASUREMENT
/begin MEASUREMENT hsFullLoad "Condizione di pieno carico" UBYTE Ctit_LambdaCtrlTDC_CM_boolean_adm 0 0 0 1 ECU_ADDRESS 0x400040F1 /end MEASUREMENT
/begin CHARACTERISTIC hsGAIN_NCYL_VCC "Guadagno per adattare ai nr. Cyl e Vcyl il Ctrl Farfalla f(Pcoll_Obj)" VALUE 0xFCB368 Scalar_UWORD 0 TE_TM_CtrlThrotMgm4ms_CM_ufix16_En10_adm 0 10 /end CHARACTERISTIC
/begin MEASUREMENT hsGlobReq1 "FSM Learning internal Test Point - Richiesta di apprendimento lungo al trip successivo -  " UBYTE ETCLearning4ms_CM_boolean_adm 0 0 0 1 ECU_ADDRESS 0x40002DC9 /end MEASUREMENT
/begin MEASUREMENT hsGlobalLrnReq "Richiesta di apprendimento lungo al trip successivo" UBYTE Ethrl4ms_CM_boolean_adm 0 0 0 1 ECU_ADDRESS 0x40002D2C /end MEASUREMENT
/begin CHARACTERISTIC hsHOLD_CURR "Valore limite di corrente continua su cui parte il temporizzatore" VALUE 0xFC56C0 Scalar_UBYTE 0 TE_TM_ThrottleCtrl4ms_CM_ufix8_En4_A 0 10 /end CHARACTERISTIC
/begin CHARACTERISTIC hsHOLD_CURR_TIME "Tempo massimo di attuazione per corrente superiore a hsHOLD_CURR" VALUE 0xFC56BE Scalar_UWORD 0 TE_TM_ThrottleCtrl4ms_CM_uint16_ms 0 5000 /end CHARACTERISTIC
/begin CHARACTERISTIC hsIAH_FREEZE "Blocco integrale per superamento della corrente di mantenimento" VALUE 0xFC56BC Scalar_BOOLEAN 0 TE_TM_ThrottleCtrl4ms_CM_boolean_adm 0 1 /end CHARACTERISTIC
/begin CHARACTERISTIC hsIAP_FREEZE "Blocco integrale per superamento della corrente di picco" VALUE 0xFC56BB Scalar_BOOLEAN 0 TE_TM_ThrottleCtrl4ms_CM_boolean_adm 0 1 /end CHARACTERISTIC
/begin MEASUREMENT hsIa "Corrente totale calcolata dal controllo" SWORD Ethrc4ms_CM_sfix16_En10_A 0 0 -10 10 ECU_ADDRESS 0x40002C62 /end MEASUREMENT
/begin MEASUREMENT hsIaCtrl "Corrente totale calcolata dal controllo prima della NoLoadCurrent" FLOAT32_IEEE TE_TM_ThrottleCtrl4ms_CM_single_A 0 0 -512 512 ECU_ADDRESS 0x40002D00 /end MEASUREMENT
/begin MEASUREMENT hsIntFreeze "Richiesta di congelamento integrale nel blocco controllo farfalla motorizzata" UBYTE Ethrc4ms_CM_boolean_adm 0 0 0 1 ECU_ADDRESS 0x40002D2B /end MEASUREMENT
/begin MEASUREMENT hsIntFreezeTmp "ichiesta di congelamento integrale nel blocco controllo farfalla motorizzata in uscita FSM" UBYTE ETCLearning4ms_CM_boolean_adm 0 0 0 1 ECU_ADDRESS 0x40002DC8 /end MEASUREMENT
/begin CHARACTERISTIC hsKI2_FREEZE_RESET "Switch per secegliere se KI2 deve essere congelato o resettato in apprendimento UMA (0: reset; 1: freeze)" VALUE 0xFC56BA Scalar_BOOLEAN 0 TE_TM_ThrottleCtrl4ms_CM_boolean_adm 0 1 /end CHARACTERISTIC
/begin CHARACTERISTIC hsKI2_NLP_OVER "Coefficiente del controllo integrale AntiStick nella zona OVER NLP" VALUE 0xFC56B8 Scalar_UWORD 0 TE_TM_ThrottleCtrl4ms_CM_ufix16_En13_Nm__s 0 7 /end CHARACTERISTIC
/begin CHARACTERISTIC hsKI2_NLP_UNDER "Coefficiente del controllo integrale AntiStick nella zona UNDER NLP" VALUE 0xFC56B6 Scalar_UWORD 0 TE_TM_ThrottleCtrl4ms_CM_ufix16_En13_Nm__s 0 7 /end CHARACTERISTIC
/begin CHARACTERISTIC hsKI2_SAT_INF "Soglia di saturazione inferiore dello integrale rapido" VALUE 0xFC56B4 Scalar_UWORD 0 TE_TM_ThrottleCtrl4ms_CM_ufix16_S1p53en5_Bn1_Nm -0.9999927 0 /end CHARACTERISTIC
/begin CHARACTERISTIC hsKI2_SAT_SUP "Soglia di saturazione superiore dello integrale rapido" VALUE 0xFC56B2 Scalar_UWORD 0 TE_TM_ThrottleCtrl4ms_CM_ufix16_S1p53en5_Nm 0 0.9999927 /end CHARACTERISTIC
/begin CHARACTERISTIC hsKI_MAX "Valore massimo del contributo integrale nel controllo farfalla" VALUE 0xFC56B0 Scalar_UWORD 0 TE_TM_ThrottleCtrl4ms_CM_ufix16_En12_Nm 0 1 /end CHARACTERISTIC
/begin CHARACTERISTIC hsKI_NLP_INF "Coefficiente del controllo integrale nella zona NLP Inf" VALUE 0xFC56AE Scalar_UWORD 0 TE_TM_ThrottleCtrl4ms_CM_ufix16_En14_Nm__s 0 1.90002441406 /end CHARACTERISTIC
/begin CHARACTERISTIC hsKI_NLP_OVER "Coefficiente del controllo integrale nella zona OVER NLP" VALUE 0xFC56AC Scalar_UWORD 0 TE_TM_ThrottleCtrl4ms_CM_ufix16_En14_Nm__s 0 1.90002441406 /end CHARACTERISTIC
/begin CHARACTERISTIC hsKI_NLP_SUP "Coefficiente del controllo integrale nella zona NLP Sup" VALUE 0xFC56AA Scalar_UWORD 0 TE_TM_ThrottleCtrl4ms_CM_ufix16_En14_Nm__s 0 1.90002441406 /end CHARACTERISTIC
/begin CHARACTERISTIC hsKI_NLP_UNDER "Coefficiente del controllo integrale nella zona UNDER NLP" VALUE 0xFC56A8 Scalar_UWORD 0 TE_TM_ThrottleCtrl4ms_CM_ufix16_En14_Nm__s 0 1.90002441406 /end CHARACTERISTIC
/begin CHARACTERISTIC hsKP_NLP_INF "Coefficiente del controllo proporzionale nella zona NLP Inf" VALUE 0xFC56A6 Scalar_UWORD 0 TE_TM_ThrottleCtrl4ms_CM_ufix16_En14_Nm__ 0 1.90002441406 /end CHARACTERISTIC
/begin CHARACTERISTIC hsKP_NLP_OVER "Coefficiente del controllo proporzionale nella zona OVER NLP" VALUE 0xFC56A4 Scalar_UWORD 0 TE_TM_ThrottleCtrl4ms_CM_ufix16_En14_Nm__ 0 1.90002441406 /end CHARACTERISTIC
/begin CHARACTERISTIC hsKP_NLP_SUP "Coefficiente del controllo proporzionale nella zona NLP Sup" VALUE 0xFC56A2 Scalar_UWORD 0 TE_TM_ThrottleCtrl4ms_CM_ufix16_En14_Nm__ 0 1.90002441406 /end CHARACTERISTIC
/begin CHARACTERISTIC hsKP_NLP_UNDER "Coefficiente del controllo proporzionale nella zona UNDER NLP ([20]*2^-14)" VALUE 0xFC56A0 Scalar_UWORD 0 TE_TM_ThrottleCtrl4ms_CM_ufix16_En14_Nm__ 0 1.90002441406 /end CHARACTERISTIC
/begin CHARACTERISTIC hsKT "Rapporto di trasmissione corpo farfallato" VALUE 0xFC569E Scalar_UWORD 0 TE_TM_ThrottleCtrl4ms_CM_ufix16_En14_Nm_A 0.0009765625 0.25 /end CHARACTERISTIC
/begin MEASUREMENT hsKi2ThrCtrl "Valore del Ki2" UWORD TE_TM_ThrottleCtrl4ms_CM_ufix16_En13_Nm__s 0 0 0 7 ECU_ADDRESS 0x40002CFC /end MEASUREMENT
/begin MEASUREMENT hsKi2_TqReq "Contributo integrale del controllore farfalla motorizzata per azione di antistick" FLOAT32_IEEE TE_TM_ThrottleCtrl4ms_CM_single_Nm 0 0 -1 1 ECU_ADDRESS 0x40002CF8 /end MEASUREMENT
/begin MEASUREMENT hsKiThrCtrl "Valore del Ki" UWORD TE_TM_ThrottleCtrl4ms_CM_ufix16_En14_Nm__s 0 0 0 1.90002441406 ECU_ADDRESS 0x40002CF4 /end MEASUREMENT
/begin MEASUREMENT hsKi_TqReq "Contributo integrale del controllore farfalla motorizzata" FLOAT32_IEEE TE_TM_ThrottleCtrl4ms_CM_single_Nm 0 0 -1 1 ECU_ADDRESS 0x40002CF0 /end MEASUREMENT
/begin MEASUREMENT hsKpThrCtrl "Valore del Kp" UWORD TE_TM_ThrottleCtrl4ms_CM_ufix16_En14_Nm__ 0 0 0 1.90002441406 ECU_ADDRESS 0x40002CEC /end MEASUREMENT
/begin MEASUREMENT hsKp_TqReq "Contributo proporzionale del controllore farfalla motorizzata" FLOAT32_IEEE TE_TM_ThrottleCtrl4ms_CM_single_Nm 0 0 -1 1 ECU_ADDRESS 0x40002CE8 /end MEASUREMENT
/begin MEASUREMENT hsLEARNCounter "FSM Learning internal Test Point - Learning steps counter" UBYTE ETCLearning4ms_CM_uint8_adm 0 0 0 255 ECU_ADDRESS 0x40002DC7 /end MEASUREMENT
/begin CHARACTERISTIC hsLONGLRNEN_TIME "Tempo di attesa da key on oltre il quale si abilita apprendimento NLP, UMA ed il test OSC" VALUE 0xFC5732 Scalar_UWORD 0 ETCLearning4ms_CM_ufix16_Sp004_s 0 260 /end CHARACTERISTIC
/begin CHARACTERISTIC hsLRN_ENABLE "Abilitazione al Self Learning" VALUE 0xFC5731 Scalar_BOOLEAN 0 ETCLearning4ms_CM_boolean_adm 0 1 /end CHARACTERISTIC
/begin CHARACTERISTIC hsLRN_TQ_CHOICE "Switch per scegliere tra uso di solo integrale o contributo PID per identificazione UMA (0: integrale; 1: PID)" VALUE 0xFC569C Scalar_BOOLEAN 0 TE_TM_ThrottleCtrl4ms_CM_boolean_adm 0 1 /end CHARACTERISTIC
/begin MEASUREMENT hsLoadDis "Segnale di disabilitazione del controllore se carichi disabilitati" UBYTE TE_TM_ThrottleCtrl4ms_CM_boolean_adm 0 0 0 1 ECU_ADDRESS 0x40002CE6 /end MEASUREMENT
/begin MEASUREMENT hsLrnCntrlReq "Richiesta Learning di sostituire gli obiettivi di controllo farfalla impostati nel blocco di controllo" UBYTE Ethrl4ms_CM_boolean_adm 0 0 0 1 ECU_ADDRESS 0x40002D2E /end MEASUREMENT
/begin MEASUREMENT hsLrnCntrlReqTmp "ichiesta Learning di sostituire gli obiettivi di controllo farfalla impostati nel blocco di controllo in uscita FSM" UBYTE ETCLearning4ms_CM_boolean_adm 0 0 0 1 ECU_ADDRESS 0x40002DC6 /end MEASUREMENT
/begin MEASUREMENT hsLrnDCMotDisReq "Richiesta Learning di disabilitazione del driver TLE6209R in uscita FSM" UBYTE ETCLearning4ms_CM_boolean_adm 0 0 0 1 ECU_ADDRESS 0x40002DC5 /end MEASUREMENT
/begin MEASUREMENT hsLrnDisReq "Richiesta Learning di disabilitazione del driver TLE6209R" UBYTE Ethrc4ms_CM_boolean_adm 0 0 0 1 ECU_ADDRESS 0x40002D2D /end MEASUREMENT
/begin MEASUREMENT hsLrnEnPre "Testpoint sulla abilitazione ECU self learning (pre FIX)" UBYTE ETCLearning4ms_CM_boolean_adm 0 0 0 1 ECU_ADDRESS 0x40002DC4 /end MEASUREMENT
/begin MEASUREMENT hsLrnState "Stato della procedura di apprendimento parametri ETC" UBYTE Ethrl4ms_CM_uint8_adm 0 0 0 255 ECU_ADDRESS 0x40002D30 /end MEASUREMENT
/begin MEASUREMENT hsLrnStateTmp "Stato della procedura di apprendimento parametri ETC" UBYTE ETCLearning4ms_CM_uint8_adm 0 0 0 255 ECU_ADDRESS 0x40002DC3 /end MEASUREMENT
/begin MEASUREMENT hsLrnStep "Learning step test point" UBYTE ETCLearning4ms_CM_uint8_adm 0 0 0 255 ECU_ADDRESS 0x40002DC2 /end MEASUREMENT
/begin MEASUREMENT hsLrnTarg "Percentuale obiettivo farfalla impostata nel blocco di Self Learning" SWORD Ethrl4ms_CM_sfix16_En8__ 0 0 -10 100 ECU_ADDRESS 0x40002D32 /end MEASUREMENT
/begin MEASUREMENT hsLrnTargTmp "Percentuale obiettivo farfalla impostata nel blocco di Self Learning in uscita FSM" SWORD ETCLearning4ms_CM_sfix16_En8__ 0 0 -10 100 ECU_ADDRESS 0x40002DC0 /end MEASUREMENT
/begin CHARACTERISTIC hsMAX_CURR "Saturazione sulla max corrente di picco" VALUE 0xFC569A Scalar_UWORD 0 TE_TM_ThrottleCtrl4ms_CM_ufix16_En10_A 0 9 /end CHARACTERISTIC
/begin CHARACTERISTIC hsMAX_TORQUE "Saturazione sulla max coppia" VALUE 0xFC5698 Scalar_UWORD 0 TE_TM_ThrottleCtrl4ms_CM_ufix16_En12_Nm 0 0.5 /end CHARACTERISTIC
/begin CHARACTERISTIC hsMIN_TROT_ERR "Valore in percentuale al di sotto del quale si considera errore di posizione nullo" VALUE 0xFC5696 Scalar_UWORD 0 TE_TM_ThrottleCtrl4ms_CM_ufix16_En8__ 0 10 /end CHARACTERISTIC
/begin MEASUREMENT hsMeanPotEn "Flag di abilitazione alla media valori potenziometro in uscita FSM" UBYTE ETCLearning4ms_CM_boolean_adm 0 0 0 1 ECU_ADDRESS 0x40002DBE /end MEASUREMENT
/begin MEASUREMENT hsMeasThrotZone "Zona di funzionamento -misurata-" UBYTE TE_TM_ThrottleCtrl4ms_CM_uint8_adm 0 0 1 3 ECU_ADDRESS 0x40002CE5 /end MEASUREMENT
/begin MEASUREMENT hsMemoReq "Learning Memo test point" UBYTE ETCLearning4ms_CM_boolean_adm 0 0 0 1 ECU_ADDRESS 0x40002DBD /end MEASUREMENT
/begin MEASUREMENT hsMemoReq1 "estpoint sulla richiesta apprendimento lungo al trip successivo dal modulo di learning in Wait" UBYTE ETCLearning4ms_CM_boolean_adm 0 0 0 1 ECU_ADDRESS 0x40002DBC /end MEASUREMENT
/begin MEASUREMENT hsNLPForcingTime "Internal Learning FSM - NLP Forcing time (4 ms) " ULONG ETCLearning4ms_CM_ufix32_Sp004_s 0 0 0 17179869.18 ECU_ADDRESS 0x40002DB8 /end MEASUREMENT
/begin MEASUREMENT hsNLP_DisCtrl " Flag di disabilitazione del controllo nella zona NLP" UBYTE TE_TM_ThrottleCtrl4ms_CM_boolean_adm 0 0 0 1 ECU_ADDRESS 0x40002CE4 /end MEASUREMENT
/begin CHARACTERISTIC hsNLP_EN "Richiesta svolgimento seconda fase Open Spring Check" VALUE 0xFC5730 Scalar_BOOLEAN 0 ETCLearning4ms_CM_boolean_adm 0 1 /end CHARACTERISTIC
/begin CHARACTERISTIC hsNLP_TIME_MEAN "Intervallo di tempo su cui viene calcolata la media delle tensioni NLP" VALUE 0xFC572E Scalar_UWORD 0 ETCLearning4ms_CM_ufix16_Sp004_s 0 10 /end CHARACTERISTIC
/begin CHARACTERISTIC hsNLP_TIME_STAB "Intervallo di tempo in cui si attende una stabilizzazione in posizione NLP" VALUE 0xFC572C Scalar_UWORD 0 ETCLearning4ms_CM_ufix16_Sp004_s 0 260 /end CHARACTERISTIC
/begin CHARACTERISTIC hsNO_LOAD_CURR "Offset di corrente legato alle forze di attrito del motore elettrico" VALUE 0xFC5694 Scalar_UWORD 0 TE_TM_ThrottleCtrl4ms_CM_ufix16_En10_A 0 1 /end CHARACTERISTIC
/begin MEASUREMENT hsNlpLearned "Flag di apprendimento NLP avvenuto" UBYTE Ethrl4ms_CM_boolean_adm 0 0 0 1 ECU_ADDRESS 0x40002D27 /end MEASUREMENT
/begin MEASUREMENT hsNlpLearnedTmp "Flag di apprendimento NLP avvenuto" UBYTE ETCLearning4ms_CM_boolean_adm 0 0 0 1 ECU_ADDRESS 0x40002DB6 /end MEASUREMENT
/begin MEASUREMENT hsNumForce "Contatore del numero di attivazioni della procedura di forzatura della farfalla" UBYTE Ethrl4ms_CM_uint8_adm 0 0 0 255 ECU_ADDRESS 0x40002D2F /end MEASUREMENT
/begin MEASUREMENT hsNumForceTmp "FSM Learning internal Test Point - Force req counter" UBYTE ETCLearning4ms_CM_uint8_adm 0 0 0 255 ECU_ADDRESS 0x40002DB5 /end MEASUREMENT
/begin CHARACTERISTIC hsOFF_BAUDEN "Percentuale di apertura farfalla per trafilamento minimo in legge meccanica" VALUE 0xFCB366 Scalar_SWORD 0 TE_TM_CtrlThrotMgm4ms_CM_sfix16_En4__ -10 10 /end CHARACTERISTIC
/begin MEASUREMENT hsOSCCError "Flag di errore nel test DTC della procedura di learning" UBYTE Ethrl4ms_CM_boolean_adm 0 0 0 1 ECU_ADDRESS 0x40002D21 /end MEASUREMENT
/begin MEASUREMENT hsOSCCErrorTmp "Flag di errore nel test DTC della procedura di learning" UBYTE ETCLearning4ms_CM_boolean_adm 0 0 0 1 ECU_ADDRESS 0x40002DB4 /end MEASUREMENT
/begin MEASUREMENT hsOSCClosingTime "Internal Learning FSM - OSCO Closing time (4 ms) " ULONG ETCLearning4ms_CM_ufix32_Sp004_s 0 0 0 17179869.18 ECU_ADDRESS 0x40002DB0 /end MEASUREMENT
/begin MEASUREMENT hsOSCOError "Flag di errore nel test DTC della procedura di learning" UBYTE Ethrl4ms_CM_boolean_adm 0 0 0 1 ECU_ADDRESS 0x40002D23 /end MEASUREMENT
/begin MEASUREMENT hsOSCOErrorTmp "Flag di errore nel test DTC della procedura di learning" UBYTE ETCLearning4ms_CM_boolean_adm 0 0 0 1 ECU_ADDRESS 0x40002DAC /end MEASUREMENT
/begin MEASUREMENT hsOSCOpeningTime "Internal Learning FSM - OSCO Opening time (4 ms) " ULONG ETCLearning4ms_CM_ufix32_Sp004_s 0 0 0 17179869.18 ECU_ADDRESS 0x40002DA8 /end MEASUREMENT
/begin CHARACTERISTIC hsOSC_CLOSE_PERC "Delta percentuale rispetto alla posizione di NLP per cui si considera raggiunto hsUMA_WORST" VALUE 0xFC572A Scalar_UWORD 0 ETCLearning4ms_CM_ufix16_En8__ 0 100 /end CHARACTERISTIC
/begin CHARACTERISTIC hsOSC_CLOS_DELAY "Tempo oltre il quale è considerato fallito OSCC test" VALUE 0xFC5728 Scalar_UWORD 0 ETCLearning4ms_CM_ufix16_Sp004_s 0 260 /end CHARACTERISTIC
/begin CHARACTERISTIC hsOSC_DELTA_PERC "Delta percentuale rispetto alla posizione di NLP per cui si considera raggiunto NLP in OSC" VALUE 0xFC5726 Scalar_UWORD 0 ETCLearning4ms_CM_ufix16_En8__ 0 100 /end CHARACTERISTIC
/begin CHARACTERISTIC hsOSC_EN "Richiesta svolgimento OSC learning" VALUE 0xFC5724 Scalar_BOOLEAN 0 ETCLearning4ms_CM_boolean_adm 0 1 /end CHARACTERISTIC
/begin CHARACTERISTIC hsOSC_OPEN_DELAY "Tempo oltre il quale è considerato fallito OSCO test" VALUE 0xFC5722 Scalar_UWORD 0 ETCLearning4ms_CM_ufix16_Sp004_s 0 260 /end CHARACTERISTIC
/begin CHARACTERISTIC hsPCOLL_REQ_DEF_MIN "Saturazione inferiore del valore di PCollReqDef" VALUE 0xFCB364 Scalar_UWORD 0 TE_TM_CtrlThrotMgm4ms_CM_uint16_mbar 0 2500 /end CHARACTERISTIC
/begin CHARACTERISTIC hsPERC_UP_NLP "Percentuale obiettivo nel return Spring Check" VALUE 0xFC5720 Scalar_UWORD 0 ETCLearning4ms_CM_ufix16_En8__ 0 100 /end CHARACTERISTIC
/begin CHARACTERISTIC hsPON_PED_REQ_EN "Abilitazione mobilitazione farfalla da pedale al Power-On" VALUE 0xFCB363 Scalar_BOOLEAN 0 TE_TM_CtrlThrotMgm4ms_CM_boolean_adm 0 1 /end CHARACTERISTIC
/begin CHARACTERISTIC hsPON_TIME "Tempo dopo il quale viene verificata abilitazione learning ECU" VALUE 0xFC571C Scalar_ULONG 0 ETCLearning4ms_CM_ufix32_Sp004_s 0.016 60 /end CHARACTERISTIC
/begin CHARACTERISTIC hsPRELOAD_OVER "Precarico delle molle nella zona OVER NLP" VALUE 0xFC5692 Scalar_SWORD 0 TE_TM_ThrottleCtrl4ms_CM_sfix16_En14_Nm 0 1.90002441406 /end CHARACTERISTIC
/begin CHARACTERISTIC hsPRELOAD_UNDER "Precarico delle molle nella zona UNDER NLP" VALUE 0xFC5690 Scalar_SWORD 0 TE_TM_ThrottleCtrl4ms_CM_sfix16_En14_Nm -1.90002441406 0 /end CHARACTERISTIC
/begin CHARACTERISTIC hsPWM_FREQ "Offset di corrente legato alle forze di attrito del motore elettrico" VALUE 0xFC568E Scalar_UWORD 0 TE_TM_ThrottleCtrl4ms_CM_ufix16_S1000_Hz 1000 40000 /end CHARACTERISTIC
/begin CHARACTERISTIC hsPWM_MODE "Sceltra pilotaggio farfalla in Fast Decay PWM (1) o Slow Decay PWM (0)" VALUE 0xFC568C Scalar_BOOLEAN 0 TE_TM_ThrottleCtrl4ms_CM_boolean_adm 0 1 /end CHARACTERISTIC
/begin CHARACTERISTIC hsPWM_SIGNAL_SAT "Valore limite di protezione per il PWM" VALUE 0xFC568A Scalar_UWORD 0 TE_TM_ThrottleCtrl4ms_CM_ufix16_En8__ 0 100 /end CHARACTERISTIC
/begin MEASUREMENT hsPcollReRefTst "Richiesta di riferimento (norm. 6 Cyl 7800 cc) di pressione obiettivo nel Ctrl Farfalla f(Pcoll_Obj) " UWORD TE_TM_CtrlThrotMgm4ms_CM_uint16_mbar 0 0 0 2500 ECU_ADDRESS 0x40004154 /end MEASUREMENT
/begin MEASUREMENT hsPcollReqDef "ichiesta definitiva di pressione obiettivo nel Ctrl Farfalla f(Pcoll_Obj)" UWORD Airq4ms_CM_uint16_mbar 0 0 0 2500 ECU_ADDRESS 0x40004118 /end MEASUREMENT
/begin MEASUREMENT hsPercThrBetaDef "Percentuale apertura farfalla definitivo calcolato (prima di filraggio e limitazione)" UWORD TE_TM_CtrlThrotMgm4ms_CM_ufix16_En8__ 0 0 0 95 ECU_ADDRESS 0x40004152 /end MEASUREMENT
/begin MEASUREMENT hsPercThrBetaTmp "Percentuale apertura farfalla temporanea primitiva" UWORD TE_TM_CtrlThrotMgm4ms_CM_ufix16_En4__ 0 0 0 100 ECU_ADDRESS 0x40004150 /end MEASUREMENT
/begin MEASUREMENT hsPercThrotMax "[OUT] Valore della percentuale di apertura farfalla a cui si ha la Qair massima a regime fissato" UWORD TE_TM_CtrlThrotMgm4ms_CM_ufix16_En4__ 0 0 0 100 ECU_ADDRESS 0x4000414E /end MEASUREMENT
/begin MEASUREMENT hsPobjCaratThr "[OUT] Carattaristica attuatore nel Ctrl Farfalla f(Pcoll_Obj)" UWORD TE_TM_CtrlThrotMgm4ms_CM_ufix16_En4__ 0 0 0 100 ECU_ADDRESS 0x4000414C /end MEASUREMENT
/begin MEASUREMENT hsPobj_Thr_Tst "Richiesta apertura farfalla in funzione della pressione obiettivo nel collettore" UWORD TE_TM_CtrlThrotMgm4ms_CM_ufix16_En4__ 0 0 0 100 ECU_ADDRESS 0x4000414A /end MEASUREMENT
/begin MEASUREMENT hsPreloadActual "Valore corrente del precarico molle" SWORD TE_TM_ThrottleCtrl4ms_CM_sfix16_En14_Nm 0 0 -1.90002441406 1.90002441406 ECU_ADDRESS 0x40002CE2 /end MEASUREMENT
/begin MEASUREMENT hsPtairGainThr "[OUT] Normalizzazione nel Ctrl Farfalla f(Pcoll_Obj)" UWORD TE_TM_CtrlThrotMgm4ms_CM_ufix16_En10_adm 0 0 0 10 ECU_ADDRESS 0x40004148 /end MEASUREMENT
/begin MEASUREMENT hsPwmFreq "Frequenza di pilotaggio del TLE6209" UWORD Ethrc4ms_CM_uint16_Hz 0 0 1000 40000 ECU_ADDRESS 0x40002C68 /end MEASUREMENT
/begin MEASUREMENT hsPwmSignal "Comando in PWM verso il TLE6209 (dipende dalla modalità di funzioamento FAST/SLOW DECAY)" UWORD Ethrc4ms_CM_ufix16_En3_adm 0 0 0 100 ECU_ADDRESS 0x40002C66 /end MEASUREMENT
/begin CHARACTERISTIC hsQAIR_OFFSET "Offset di Qair sul Ctrl Farfalla f(Pcoll_Obj)" VALUE 0xFCB362 Scalar_BYTE 0 TE_TM_CtrlThrotMgm4ms_CM_int8_kg_h -127 127 /end CHARACTERISTIC
/begin MEASUREMENT hsQAir_Req_Corr "[OUT] Air quantity correction in function of RPM and Lambda target value" UWORD TE_TM_CtrlThrotMgm4ms_CM_ufix16_En10_adm 0 0 0.5 1.5 ECU_ADDRESS 0x40004146 /end MEASUREMENT
/begin MEASUREMENT hsQAir_Request "Aria richiesta al motore senza Torque Reduction" UWORD Boost_CtrlMgmt50ms_CM_ufix16_En4_kg_h 0 0 0 3200 ECU_ADDRESS 0x40004110 /end MEASUREMENT
/begin MEASUREMENT hsQairMaxAvaiOut "Aria massima disponibile a un dato regime" UWORD Thrp4ms_CM_ufix16_En4_kg_h 0 0 0 3200 ECU_ADDRESS 0x40004112 /end MEASUREMENT
/begin MEASUREMENT hsQairMaxFullTorq "Aria (kg/h) istantanea massima disponibile quando la Torque è 100%" UWORD Thrp4ms_CM_ufix16_En4_kg_h 0 0 0 4095 ECU_ADDRESS 0x4000410E /end MEASUREMENT
/begin CHARACTERISTIC hsRA "Rapporto di trasmissione corpo farfallato" VALUE 0xFC5688 Scalar_UWORD 0 TE_TM_ThrottleCtrl4ms_CM_ufix16_En10_ohm 1 4 /end CHARACTERISTIC
/begin MEASUREMENT hsRSCCError "Flag di errore nel test DTC della procedura di learning" UBYTE Ethrl4ms_CM_boolean_adm 0 0 0 1 ECU_ADDRESS 0x40002D24 /end MEASUREMENT
/begin MEASUREMENT hsRSCCErrorTmp "Flag di errore nel test DTC della procedura di learning" UBYTE ETCLearning4ms_CM_boolean_adm 0 0 0 1 ECU_ADDRESS 0x40002DA4 /end MEASUREMENT
/begin MEASUREMENT hsRSCClosingTime "Internal Learning FSM - RSCC Closing time (4 ms) " ULONG ETCLearning4ms_CM_ufix32_Sp004_s 0 0 0 17179869.18 ECU_ADDRESS 0x40002DA0 /end MEASUREMENT
/begin MEASUREMENT hsRSCOError "Flag di errore nel test DTC della procedura di learning" UBYTE Ethrl4ms_CM_boolean_adm 0 0 0 1 ECU_ADDRESS 0x40002D26 /end MEASUREMENT
/begin MEASUREMENT hsRSCOErrorTmp "Flag di errore nel test DTC della procedura di learning" UBYTE ETCLearning4ms_CM_boolean_adm 0 0 0 1 ECU_ADDRESS 0x40002D9C /end MEASUREMENT
/begin MEASUREMENT hsRSCOpeningTime "Internal Learning FSM - RSCO Opening time (4 ms) " ULONG ETCLearning4ms_CM_ufix32_Sp004_s 0 0 0 17179869.18 ECU_ADDRESS 0x40002D98 /end MEASUREMENT
/begin MEASUREMENT hsRSCWError "Flag di errore nel test DTC della procedura di learning" UBYTE Ethrl4ms_CM_boolean_adm 0 0 0 1 ECU_ADDRESS 0x40002D25 /end MEASUREMENT
/begin MEASUREMENT hsRSCWErrorTmp "Flag di errore nel test DTC della procedura di learning" UBYTE ETCLearning4ms_CM_boolean_adm 0 0 0 1 ECU_ADDRESS 0x40002D94 /end MEASUREMENT
/begin MEASUREMENT hsRSCWaitingTime "Internal Learning FSM - RSC Waiting time (4 ms) " ULONG ETCLearning4ms_CM_ufix32_Sp004_s 0 0 0 17179869.18 ECU_ADDRESS 0x40002D90 /end MEASUREMENT
/begin CHARACTERISTIC hsRSC_CLOS_DELAY "Tempo oltre il quale è considerato fallito RSCC test" VALUE 0xFC5718 Scalar_UWORD 0 ETCLearning4ms_CM_ufix16_Sp004_s 0 260 /end CHARACTERISTIC
/begin CHARACTERISTIC hsRSC_DELTA_PERC "Delta percentuale rispetto alla posizione di NLP per cui si considera raggiunto NLP" VALUE 0xFC5716 Scalar_UWORD 0 ETCLearning4ms_CM_ufix16_En8__ 0 100 /end CHARACTERISTIC
/begin CHARACTERISTIC hsRSC_EN "Richiesta svolgimento Return Spring Check" VALUE 0xFC5714 Scalar_BOOLEAN 0 ETCLearning4ms_CM_boolean_adm 0 1 /end CHARACTERISTIC
/begin CHARACTERISTIC hsRSC_OPEN_DELAY "Tempo oltre il quale è considerato fallito RSCO test" VALUE 0xFC5712 Scalar_UWORD 0 ETCLearning4ms_CM_ufix16_Sp004_s 0 260 /end CHARACTERISTIC
/begin CHARACTERISTIC hsRSC_OPEN_PERC "Delta Percentuale da sommare alla percentuale di NLP per cui si ritiene raggiunto hsPERC_UP_NLP" VALUE 0xFC5710 Scalar_UWORD 0 ETCLearning4ms_CM_ufix16_En8__ 0 100 /end CHARACTERISTIC
/begin CHARACTERISTIC hsRSC_WAIT_DELAY "Tempo massimo di attesa raggiungimento stabile obiettivo RSC" VALUE 0xFC570E Scalar_UWORD 0 ETCLearning4ms_CM_ufix16_Sp004_s 0 260 /end CHARACTERISTIC
/begin MEASUREMENT hsRefThrotZone "Zona di funzionamento -richiesta-" UBYTE TE_TM_ThrottleCtrl4ms_CM_uint8_adm 0 0 1 3 ECU_ADDRESS 0x40002CE0 /end MEASUREMENT
/begin MEASUREMENT hsReqCtrl "Normalizzazione del comando del controllo" FLOAT32_IEEE TE_TM_ThrottleCtrl4ms_CM_single_adm 0 0 -1 1 ECU_ADDRESS 0x40002CDC /end MEASUREMENT
/begin CHARACTERISTIC hsSTICK_DELTA "Valore in percentuale al di sotto del quale si considera piattello farfalla inpuntato" VALUE 0xFC5686 Scalar_UWORD 0 TE_TM_ThrottleCtrl4ms_CM_ufix16_En4__ 0 100 /end CHARACTERISTIC
/begin MEASUREMENT hsSelfLrnEn "Testpoint sulla abilitazione self learning" UBYTE ETCLearning4ms_CM_boolean_adm 0 0 0 1 ECU_ADDRESS 0x40002D8D /end MEASUREMENT
/begin MEASUREMENT hsSelfLrnEnCond "Learning enabling conditions test point" UBYTE ETCLearning4ms_CM_uint8_adm 0 0 0 32 ECU_ADDRESS 0x40002D8C /end MEASUREMENT
/begin MEASUREMENT hsStThrot "Stato della farfalla. 0=Closed, 1=Medium, 2=Open" UBYTE EgmdTDC_CM_eTHRP_adm 0 0 0 2 ECU_ADDRESS 0x400040EB /end MEASUREMENT
/begin MEASUREMENT hsStThrotTmp "Stato della farfalla in uscita FSM" UBYTE ThrottleState4ms_Symbol_CM_uint8_adm 0 0 0 2 ECU_ADDRESS 0x40004198 /end MEASUREMENT
/begin MEASUREMENT hsStickSlip "Abilitazione azione antistick" UBYTE TE_TM_ThrottleCtrl4ms_CM_boolean_adm 0 0 0 1 ECU_ADDRESS 0x40002CDB /end MEASUREMENT
/begin CHARACTERISTIC hsTHROT_CL2MD_DELTA "Delta per identificare la soglia in percentuale per passaggio da Closed Throttle a Medium Throttle" VALUE 0xFCB4A6 Scalar_UWORD 0 ThrottleState4ms_Symbol_CM_ufix16_En4__ 0 100 /end CHARACTERISTIC
/begin CHARACTERISTIC hsTHROT_H_LIM "Limitazione a soglia del massimo incremento farfalla per derivata positiva" VALUE 0xFCB360 Scalar_UWORD 0 TE_TM_CtrlThrotMgm4ms_CM_ufix16_En4___4ms 0 100 /end CHARACTERISTIC
/begin CHARACTERISTIC hsTHROT_H_RANGE "Soglia per limitazione al massimo decremento farfalla per derivata positiva" VALUE 0xFCB35E Scalar_UWORD 0 TE_TM_CtrlThrotMgm4ms_CM_ufix16_En4__ 0 100 /end CHARACTERISTIC
/begin CHARACTERISTIC hsTHROT_H_STD "Limitazione standard incremento farfalla per derivata positiva" VALUE 0xFCB35C Scalar_UWORD 0 TE_TM_CtrlThrotMgm4ms_CM_ufix16_En4___4ms 0 100 /end CHARACTERISTIC
/begin CHARACTERISTIC hsTHROT_L_LIM "Limitazione a soglia del massimo decremento farfalla per derivata negativa" VALUE 0xFCB35A Scalar_UWORD 0 TE_TM_CtrlThrotMgm4ms_CM_ufix16_En4___4ms 0 100 /end CHARACTERISTIC
/begin CHARACTERISTIC hsTHROT_L_RANGE "Soglia per limitazione al massimo decremento farfalla per derivata negativa" VALUE 0xFCB358 Scalar_UWORD 0 TE_TM_CtrlThrotMgm4ms_CM_ufix16_En4__ 0 100 /end CHARACTERISTIC
/begin CHARACTERISTIC hsTHROT_L_STD "Limitazione standard decremento farfalla per derivata negativa" VALUE 0xFCB356 Scalar_UWORD 0 TE_TM_CtrlThrotMgm4ms_CM_ufix16_En4___4ms 0 100 /end CHARACTERISTIC
/begin CHARACTERISTIC hsTHROT_MD2CL "Soglia in percentuale per passaggio da Medium Throttle a Closed Throttle" VALUE 0xFCB4A4 Scalar_UWORD 0 ThrottleState4ms_Symbol_CM_ufix16_En4__ 0 100 /end CHARACTERISTIC
/begin CHARACTERISTIC hsTHROT_MD2OP_DELTA "Soglia in percentuale per passaggio da Medium Throttle a Open Throttle" VALUE 0xFCB4A2 Scalar_UWORD 0 ThrottleState4ms_Symbol_CM_ufix16_En4__ 0 100 /end CHARACTERISTIC
/begin CHARACTERISTIC hsTHROT_OFFSET "Offset di Trafilamento sul Ctrl Farfalla f(Pcoll_Obj)" VALUE 0xFCB354 Scalar_SWORD 0 TE_TM_CtrlThrotMgm4ms_CM_sfix16_En4__ -10 10 /end CHARACTERISTIC
/begin CHARACTERISTIC hsTHROT_OP2MD "Soglia in percentuale per passaggio da Open Throttle a Medium Throttle" VALUE 0xFCB4A0 Scalar_UWORD 0 ThrottleState4ms_Symbol_CM_ufix16_En4__ 0 100 /end CHARACTERISTIC
/begin CHARACTERISTIC hsTHRVBATT "Soglia inferiore tensione batteria per cui viene svolto il Long Learning ETC" VALUE 0xFC570C Scalar_UWORD 0 ETCLearning4ms_CM_ufix16_S50_mV 12000 36000 /end CHARACTERISTIC
/begin CHARACTERISTIC hsTHR_LTD_DOWN "Limitazione inferiore apertura farfalla" VALUE 0xFCB352 Scalar_UWORD 0 TE_TM_CtrlThrotMgm4ms_CM_ufix16_En8__ 0 50 /end CHARACTERISTIC
/begin CHARACTERISTIC hsTHR_LTD_UP "Limitazione superiore apertura farfalla" VALUE 0xFCB350 Scalar_UWORD 0 TE_TM_CtrlThrotMgm4ms_CM_ufix16_En8__ 50 95 /end CHARACTERISTIC
/begin CHARACTERISTIC hsTHR_TMOT_MAX "Soglia superiore temperatura acqua motore per svolgimento self learning" VALUE 0xFC570A Scalar_UWORD 0 ETCLearning4ms_CM_ufix16_Bn40_degC -40 140 /end CHARACTERISTIC
/begin CHARACTERISTIC hsTHR_TMOT_MIN "Soglia inferiore temperatura acqua motore per svolgimento self learning" VALUE 0xFC5708 Scalar_UWORD 0 ETCLearning4ms_CM_ufix16_Bn40_degC -40 140 /end CHARACTERISTIC
/begin CHARACTERISTIC hsTHR_VEL_VEIC "Soglia superiore di velocitá di veicolo" VALUE 0xFC5706 Scalar_UWORD 0 ETCLearning4ms_CM_uint16_km_h 0 250 /end CHARACTERISTIC
/begin CHARACTERISTIC hsTQ_FREEZE "Blocca integrale per superamento della coppia massima" VALUE 0xFC5684 Scalar_BOOLEAN 0 TE_TM_ThrottleCtrl4ms_CM_boolean_adm 0 1 /end CHARACTERISTIC
/begin CHARACTERISTIC hsTRANSM_RED "Rapporto di trasmissione corpo farfallato" VALUE 0xFC5682 Scalar_UWORD 0 TE_TM_ThrottleCtrl4ms_CM_ufix16_Sp01_adm 0 1 /end CHARACTERISTIC
/begin MEASUREMENT hsTair_KelvinTst "Tair in Kelvin" UWORD TE_TM_CtrlThrotMgm4ms_CM_uint16_K 0 0 233 403 ECU_ADDRESS 0x40004144 /end MEASUREMENT
/begin MEASUREMENT hsTbdeltafopt "[OUT] Tabella full open throttle" UWORD ThrottleState4ms_Symbol_CM_ufix16_En10_adm 0 0 0.0009765625 3 ECU_ADDRESS 0x4000419C /end MEASUREMENT
/begin MEASUREMENT hsTbfopti "[OUT] Tabella full open throttle init" UWORD ThrottleState4ms_Symbol_CM_ufix16_En10_adm 0 0 0 3 ECU_ADDRESS 0x4000419A /end MEASUREMENT
/begin MEASUREMENT hsThrDir "[PRE FIX] Comando in direzione verso il TLE6209 (dipende dalla modalità di funzionamento FAST/SLOW DECAY)" UBYTE TE_TM_ThrottleCtrl4ms_CM_boolean_adm 0 0 0 1 ECU_ADDRESS 0x40002CDA /end MEASUREMENT
/begin MEASUREMENT hsThrPwm "Comando in PWM verso il TLE6209 (dipende dalla modalità di funzioamento FAST/SLOW DECAY)" UWORD TE_TM_ThrottleCtrl4ms_CM_ufix16_En3_adm 0 0 0 100 ECU_ADDRESS 0x40002CD8 /end MEASUREMENT
/begin MEASUREMENT hsThrTorqCurr "Richiesta di coppia/corrente effettiva su rotore farfalla." FLOAT32_IEEE TE_TM_ThrottleCtrl4ms_CM_single_adm 0 0 -512 512 ECU_ADDRESS 0x40002CD4 /end MEASUREMENT
/begin MEASUREMENT hsThrotErr "Errore percentuale tra obiettivo e misura" SWORD TE_TM_ThrottleCtrl4ms_CM_sfix16_En8__ 0 0 -110 110 ECU_ADDRESS 0x40002CD2 /end MEASUREMENT
/begin MEASUREMENT hsThrotRefPerc "Effettivo comando di apertura della farfalla" SWORD Airq_CtrlMgmtTDC_CM_sfix16_En8__ 0 0 -10 100 ECU_ADDRESS 0x40004116 /end MEASUREMENT
/begin MEASUREMENT hsTimerTmp "Internal Learning FSM timer (4 ms) " ULONG ETCLearning4ms_CM_ufix32_Sp004_s 0 0 0 17179869.18 ECU_ADDRESS 0x40002D88 /end MEASUREMENT
/begin MEASUREMENT hsTqReqInt "[PRE FIX] Contributo integrale nel controllore ETC" SWORD TE_TM_ThrottleCtrl4ms_CM_sfix16_En12_Nm 0 0 -5 5 ECU_ADDRESS 0x40002CD0 /end MEASUREMENT
/begin MEASUREMENT hsTqReqIntegral "Contributo integrale nel controllore ETC" SWORD Ethrc4ms_CM_sfix16_En12_Nm 0 0 -5 5 ECU_ADDRESS 0x40002C64 /end MEASUREMENT
/begin MEASUREMENT hsTqReqTot "Coppia totale ( Tq_Kp + Tq_Ki + Tq_Ki2 )" FLOAT32_IEEE TE_TM_ThrottleCtrl4ms_CM_single_Nm 0 0 -3 3 ECU_ADDRESS 0x40002CCC /end MEASUREMENT
/begin MEASUREMENT hsTypeLrn "FSM Learning internal Test Point - Short o long learning type" UBYTE ETCLearning4ms_CM_boolean_adm 0 0 0 1 ECU_ADDRESS 0x40002D84 /end MEASUREMENT
/begin MEASUREMENT hsUMADtcTime "Internal Learning FSM - UMA DTC timer (4 ms) " ULONG ETCLearning4ms_CM_ufix32_Sp004_s 0 0 0 17179869.18 ECU_ADDRESS 0x40002D80 /end MEASUREMENT
/begin CHARACTERISTIC hsUMAOSC_EN "Richiesta svolgimento Uma Learning e Open Spring Check" VALUE 0xFC5704 Scalar_BOOLEAN 0 ETCLearning4ms_CM_boolean_adm 0 1 /end CHARACTERISTIC
/begin CHARACTERISTIC hsUMA_DTC "Delta obiettivo rispetto alla posizione di UMA nel test DTC" VALUE 0xFC5702 Scalar_UWORD 0 ETCLearning4ms_CM_ufix16_En8__ 0 100 /end CHARACTERISTIC
/begin CHARACTERISTIC hsUMA_DTC_EN "Richiesta svolgimento test distaccamento da UMA" VALUE 0xFC5700 Scalar_BOOLEAN 0 ETCLearning4ms_CM_boolean_adm 0 1 /end CHARACTERISTIC
/begin CHARACTERISTIC hsUMA_INT_MAX "Soglia valore assoluto uscita controllore per riconoscimento UMA" VALUE 0xFC56FE Scalar_SWORD 0 ETCLearning4ms_CM_sfix16_En12_Nm -0.56005859375 0.56005859375 /end CHARACTERISTIC
/begin CHARACTERISTIC hsUMA_TIME_MEAN "Intervallo di tempo su cui viene calcolata la media delle tensioni UMA" VALUE 0xFC56FC Scalar_UWORD 0 ETCLearning4ms_CM_ufix16_Sp004_s 0 10 /end CHARACTERISTIC
/begin CHARACTERISTIC hsUMA_WORST "Percentuale obiettivo iniziale nel test di apprendimento UMA" VALUE 0xFC56FA Scalar_UWORD 0 ETCLearning4ms_CM_ufix16_En8__ 0 100 /end CHARACTERISTIC
/begin MEASUREMENT hsUmaLearned "Flag di apprendimento UMA avvenuto" UBYTE Ethrl4ms_CM_boolean_adm 0 0 0 1 ECU_ADDRESS 0x40002D2A /end MEASUREMENT
/begin MEASUREMENT hsUmaLearnedTmp "lag di apprendimento UMA avvenuto in uscita FSM" UBYTE ETCLearning4ms_CM_boolean_adm 0 0 0 1 ECU_ADDRESS 0x40002D7C /end MEASUREMENT
/begin CHARACTERISTIC hsVA_FREEZE "Blocco integrale per superamento della tensione massima" VALUE 0xFC5680 Scalar_BOOLEAN 0 TE_TM_ThrottleCtrl4ms_CM_boolean_adm 0 1 /end CHARACTERISTIC
/begin CHARACTERISTIC hsVEL_UMA_LRN "Velocità di avvicinamento posizione di UMA" VALUE 0xFC56F8 Scalar_UWORD 0 ETCLearning4ms_CM_ufix16_En8__ 0 100 /end CHARACTERISTIC
/begin MEASUREMENT hsVNLPTmp "Tensione NLP su cui viene fatto il test di fuori range di plausibilità" UWORD Ethrl4ms_CM_ufix16_En10_V 0 0 0 5 ECU_ADDRESS 0x40002D38 /end MEASUREMENT
/begin MEASUREMENT hsVNLPTmp1 "Tensione NLP su cui viene fatto il test di fuori range di plausibilità" UWORD ETCLearning4ms_CM_ufix16_En10_V 0 0 0 5 ECU_ADDRESS 0x40002D7A /end MEASUREMENT
/begin MEASUREMENT hsVNlpAct "Tensione NLP su cui viene fatto il test di fuori range di plausibilità" UWORD ETCLearning4ms_CM_ufix16_En10_V 0 0 0 5 ECU_ADDRESS 0x40002D78 /end MEASUREMENT
/begin MEASUREMENT hsVUMATmp "Tensione UMA su cui viene fatto il test di fuori range di plausibilità" UWORD Ethrl4ms_CM_ufix16_En10_V 0 0 0 5 ECU_ADDRESS 0x40002D36 /end MEASUREMENT
/begin MEASUREMENT hsVUMATmp1 "Tensione UMA su cui viene fatto il test di fuori range di plausibilità" UWORD ETCLearning4ms_CM_ufix16_En10_V 0 0 0 5 ECU_ADDRESS 0x40002D76 /end MEASUREMENT
/begin MEASUREMENT hsVUmaAct "Tensione Uma calcolata nel modulo di learning" UWORD ETCLearning4ms_CM_ufix16_En10_V 0 0 0 5 ECU_ADDRESS 0x40002D74 /end MEASUREMENT
/begin MEASUREMENT hsVUmaActNorm "ensione Uma calcolata nel modulo di learning in Wait" UWORD ETCLearning4ms_CM_ufix16_En10_V 0 0 0 4.9990234375 ECU_ADDRESS 0x40002D72 /end MEASUREMENT
/begin MEASUREMENT hsV_Nlp "Tensione NLP letta sul potenziometro principale e fornita dal blocco di self learning" UWORD Ethrl4ms_CM_ufix16_En10_V 0 0 0 5 ECU_ADDRESS 0x40002D3A /end MEASUREMENT
/begin MEASUREMENT hsV_Nlp1 "Tensione NLP letta sul potenziometro principale e fornita dal blocco di self learning" UWORD ETCLearning4ms_CM_ufix16_En10_V 0 0 0 5 ECU_ADDRESS 0x40002D70 /end MEASUREMENT
/begin MEASUREMENT hsV_Uma "Tensione UMA letta sul potenziometro principale e fornita dal blocco di self learning" UWORD Ethrl4ms_CM_ufix16_En10_V 0 0 0 5 ECU_ADDRESS 0x40002D3C /end MEASUREMENT
/begin MEASUREMENT hsVaCtrl "Tensione prima della normalizzazione" FLOAT32_IEEE TE_TM_ThrottleCtrl4ms_CM_single_V 0 0 -80 80 ECU_ADDRESS 0x40002CC8 /end MEASUREMENT
/begin MEASUREMENT hsVmedOld "Testpoint sulla tensione media calcolata nel blocco di media ritardata di un passo" UWORD ETCLearning4ms_CM_ufix16_En10_V 0 0 0 5 ECU_ADDRESS 0x40002D6E /end MEASUREMENT
/begin MEASUREMENT hsWOTFullPerc "Percentage of WOT" UBYTE Thrp4ms_CM_ufix8_En7_adm 0 0 0 1 ECU_ADDRESS 0x400040EA /end MEASUREMENT
/begin CHARACTERISTIC hsWOT_FULL_LOAD_EN "Abilitazione del calcolo percetentuale WOT e condizione di pieno carico" VALUE 0xFCB49E Scalar_BOOLEAN 0 ThrottleState4ms_Symbol_CM_boolean_adm 0 1 /end CHARACTERISTIC
/begin CHARACTERISTIC htPOBJ_CARAT_THR "Carattaristica attuatore nel Ctrl Farfalla f(Pcoll_Obj)" MAP 0xFCB210 Lookup2D_UWORD 0 TE_TM_CtrlThrotMgm4ms_CM_ufix16_En4__ 0 100
 /begin AXIS_DESCR COM_AXIS NO_INPUT_QUANTITY TE_TM_CtrlThrotMgm4ms_CM_ufix16_En14_adm 10 0 1 AXIS_PTS_REF hkPOBJ_CARATHR_B /end AXIS_DESCR
 /begin AXIS_DESCR COM_AXIS NO_INPUT_QUANTITY TE_TM_CtrlThrotMgm4ms_CM_ufix16_En4_kg_h 16 0 4095 AXIS_PTS_REF hkPOBJ_CARATHR_Q /end AXIS_DESCR
/end CHARACTERISTIC
/begin CHARACTERISTIC htPTAIR_GAIN_THR "Normalizzazione nel Ctrl Farfalla f(Pcoll_Obj)" MAP 0xFCB190 Lookup2D_UWORD 0 TE_TM_CtrlThrotMgm4ms_CM_ufix16_En10_adm 0 10
 /begin AXIS_DESCR COM_AXIS NO_INPUT_QUANTITY TE_TM_CtrlThrotMgm4ms_CM_ufix16_Bn40_degC 8 -40 130 AXIS_PTS_REF hkPTAIR_GAINTHRT /end AXIS_DESCR
 /begin AXIS_DESCR COM_AXIS NO_INPUT_QUANTITY TE_TM_CtrlThrotMgm4ms_CM_uint16_mbar 8 400 6000 AXIS_PTS_REF hkPTAIR_GAINTHRP /end AXIS_DESCR
/end CHARACTERISTIC
/begin CHARACTERISTIC htQAIR_REQ_CORR "Air quantity correction in function of RPM and Lambda target value" MAP 0xFCB050 Lookup2D_UWORD 0 TE_TM_CtrlThrotMgm4ms_CM_ufix16_En10_adm 0.5 1.5
 /begin AXIS_DESCR COM_AXIS NO_INPUT_QUANTITY TE_TM_CtrlThrotMgm4ms_CM_ufix16_En10_adm 10 0.015625 1.599609375 AXIS_PTS_REF hkLAMOBT /end AXIS_DESCR
 /begin AXIS_DESCR COM_AXIS NO_INPUT_QUANTITY TE_TM_CtrlThrotMgm4ms_CM_uint16_rpm 16 0 10000 AXIS_PTS_REF hkRPM_9 /end AXIS_DESCR
/end CHARACTERISTIC
/begin CHARACTERISTIC hvDELTA_QAIR_MAX "Delta aria massima (vs. curva teorica) disponibile a un dato regime" CURVE 0xFCB030 Lookup1D_UWORD 0 TE_TM_CtrlThrotMgm4ms_CM_ufix16_En4_Bn100_kg_h -100 100
 /begin AXIS_DESCR COM_AXIS NO_INPUT_QUANTITY TE_TM_CtrlThrotMgm4ms_CM_uint16_rpm 16 0 10000 AXIS_PTS_REF hkDELTA_QAIR_MAX /end AXIS_DESCR
/end CHARACTERISTIC
/begin CHARACTERISTIC hvPERC_THROT_MAX "Valore della percentuale di apertura farfalla a cui si ha la Qair massima a regime fissato" CURVE 0xFCB010 Lookup1D_UWORD 0 TE_TM_CtrlThrotMgm4ms_CM_ufix16_En4__ 0 100
 /begin AXIS_DESCR COM_AXIS NO_INPUT_QUANTITY TE_TM_CtrlThrotMgm4ms_CM_uint16_rpm 16 0 10000 AXIS_PTS_REF hkRPM_8 /end AXIS_DESCR
/end CHARACTERISTIC
/begin CHARACTERISTIC hvTBDELTAFOPT "Tabella full open throttle" CURVE 0xFCB4EE Lookup1D_UWORD 0 ThrottleState4ms_Symbol_CM_ufix16_En10_adm 0.0009765625 3
 /begin AXIS_DESCR COM_AXIS NO_INPUT_QUANTITY ThrottleState4ms_Symbol_CM_uint16_rpm 24 0 10000 AXIS_PTS_REF hkBKPRPM1 /end AXIS_DESCR
/end CHARACTERISTIC
/begin CHARACTERISTIC hvTBFOPTI "Tabella full open throttle init" CURVE 0xFCB4BE Lookup1D_UWORD 0 ThrottleState4ms_Symbol_CM_ufix16_En10_adm 0 3
 /begin AXIS_DESCR COM_AXIS NO_INPUT_QUANTITY ThrottleState4ms_Symbol_CM_uint16_rpm 24 0 10000 AXIS_PTS_REF hkBKPRPM2 /end AXIS_DESCR
/end CHARACTERISTIC
/begin CHARACTERISTIC ifABILITA_PD_AD "[FIX] Fix per abilitare PD su Anticipo" VALUE 0xFC5B76 Scalar_UWORD 0 TE_TM_Adv_Ctrl4ms_Symbol_CM_boolean_adm 0 1 /end CHARACTERISTIC
/begin CHARACTERISTIC ifABILITA_PD_AD_EnFix "[FIX] Fix per abilitare PD su Anticipo" VALUE 0xFC5B74 Scalar_UWORD 0 TE_TM_Adv_Ctrl4ms_Symbol_CM_FixEnableT 171 218 /end CHARACTERISTIC
/begin CHARACTERISTIC ifABILITA_PID "[FIX] Fix per abilitare PID sulla Coppia per Controllo Low Idle" VALUE 0xFC5BB4 Scalar_UWORD 0 TE_TM_Cmu_Ctrl4ms_Symbol_CM_boolean_adm 0 1 /end CHARACTERISTIC
/begin CHARACTERISTIC ifABILITA_PID_EnFix "[FIX] Fix per abilitare PID sulla Coppia per Controllo Low Idle" VALUE 0xFC5BB2 Scalar_UWORD 0 TE_TM_Cmu_Ctrl4ms_Symbol_CM_FixEnableT 171 218 /end CHARACTERISTIC
/begin CHARACTERISTIC ifADV_REF_IDLE "[FIX] Angolo di Anticipo di riferimento per dare o togliere percentuale di Anticipo col PD" VALUE 0xFC5B72 Scalar_UWORD 0 TE_TM_Adv_Ctrl4ms_Symbol_CM_ufix16_En4_degE 0 20 /end CHARACTERISTIC
/begin CHARACTERISTIC ifADV_REF_IDLE_EnFix "[FIX] Angolo di Anticipo di riferimento per dare o togliere percentuale di Anticipo col PD" VALUE 0xFC5B70 Scalar_UWORD 0 TE_TM_Adv_Ctrl4ms_Symbol_CM_FixEnableT 171 218 /end CHARACTERISTIC
/begin CHARACTERISTIC ifANTI_WUP_H "[FIX] Fix on Upper Anti Wind Up (MaxTorq - |FFW|)" VALUE 0xFC5BB0 Scalar_UWORD 0 TE_TM_Cmu_Ctrl4ms_Symbol_CM_ufix16_En4__ 0 100 /end CHARACTERISTIC
/begin CHARACTERISTIC ifANTI_WUP_H_EnFix "[FIX] Fix on Upper Anti Wind Up (MaxTorq - |FFW|)" VALUE 0xFC5BAE Scalar_UWORD 0 TE_TM_Cmu_Ctrl4ms_Symbol_CM_FixEnableT 171 218 /end CHARACTERISTIC
/begin CHARACTERISTIC ifANTI_WUP_L "[FIX] Fix on Lower Anti Wind Up (-|FFW|)" VALUE 0xFC5BC0 Scalar_SWORD 0 TE_TM_Cmu_Ctrl4ms_Symbol_CM_sfix16_En4__ -100 0 /end CHARACTERISTIC
/begin CHARACTERISTIC ifANTI_WUP_L_EnFix "[FIX] Fix on Lower Anti Wind Up (-|FFW|)" VALUE 0xFC5BBE Scalar_SWORD 0 TE_TM_Cmu_Ctrl4ms_Symbol_CM_FixEnableT 171 218 /end CHARACTERISTIC
/begin CHARACTERISTIC ifBYP_SPD_CTRL_PID "[FIX] Fix per bypassare la disabilitazione Low Idle per Speed Control PID" VALUE 0xFC5D9A Scalar_UWORD 0 TE_TM_Enable_Idle4ms_Symbol_CM_boolean_adm 0 1 /end CHARACTERISTIC
/begin CHARACTERISTIC ifBYP_SPD_CTRL_PID_EnFix "[FIX] Fix per bypassare la disabilitazione Low Idle per Speed Control PID" VALUE 0xFC5D98 Scalar_UWORD 0 TE_TM_Enable_Idle4ms_Symbol_CM_FixEnableT 171 218 /end CHARACTERISTIC
/begin CHARACTERISTIC ifFEEDFW_CM_OFF "[FIX] Feed Forward sulla percentuale di coppia di friction attesa al regime obiettivo" VALUE 0xFC5DC2 Scalar_UWORD 0 TE_TM_FFW4ms_Symbol_CM_ufix16_En4__ 0 100 /end CHARACTERISTIC
/begin CHARACTERISTIC ifFEEDFW_CM_OFF_EnFix "[FIX] Feed Forward sulla percentuale di coppia di friction attesa al regime obiettivo" VALUE 0xFC5DC0 Scalar_UWORD 0 TE_TM_FFW4ms_Symbol_CM_FixEnableT 171 218 /end CHARACTERISTIC
/begin CHARACTERISTIC ifFREEZE_KI_C "[FIX] Fix per congelare integrale del PID in coppia" VALUE 0xFC5BAC Scalar_UWORD 0 TE_TM_Cmu_Ctrl4ms_Symbol_CM_boolean_adm 0 1 /end CHARACTERISTIC
/begin CHARACTERISTIC ifFREEZE_KI_C_EnFix "[FIX] Fix per congelare integrale del PID in coppia" VALUE 0xFC5BAA Scalar_UWORD 0 TE_TM_Cmu_Ctrl4ms_Symbol_CM_FixEnableT 171 218 /end CHARACTERISTIC
/begin CHARACTERISTIC ifINIT_KI "[FIX] Fix on Init of iintegral part (from previous PID w/Speed Ctrl)" VALUE 0xFC5BBC Scalar_SWORD 0 TE_TM_Cmu_Ctrl4ms_Symbol_CM_sfix16_En4__ -100 100 /end CHARACTERISTIC
/begin CHARACTERISTIC ifINIT_KI_EnFix "[FIX] Fix on Init of iintegral part (from previous PID w/Speed Ctrl)" VALUE 0xFC5BBA Scalar_SWORD 0 TE_TM_Cmu_Ctrl4ms_Symbol_CM_FixEnableT 171 218 /end CHARACTERISTIC
/begin CHARACTERISTIC ifKDSPD_CM_CTRL "[FIX] Contributo KD sulla percentuale di Coppia" VALUE 0xFC5BA8 Scalar_UWORD 0 TE_TM_Cmu_Ctrl4ms_Symbol_CM_ufix16_En15__s_rpm 0 1.953125 /end CHARACTERISTIC
/begin CHARACTERISTIC ifKDSPD_CM_CTRL_EnFix "[FIX] Contributo KD sulla percentuale di Coppia" VALUE 0xFC5BA6 Scalar_UWORD 0 TE_TM_Cmu_Ctrl4ms_Symbol_CM_FixEnableT 171 218 /end CHARACTERISTIC
/begin CHARACTERISTIC ifKD_LOW_GOV "[FIX] Vettore per setting della durezza del controllo del Low Idle" VALUE 0xFC5AB0 Scalar_UWORD 0 TE_TM_LowIdle_Gov_100ms_Symbol_CM_ufix16_En10_adm 0 10 /end CHARACTERISTIC
/begin CHARACTERISTIC ifKD_LOW_GOV_EnFix "[FIX] Vettore per setting della durezza del controllo del Low Idle" VALUE 0xFC5AAE Scalar_UWORD 0 TE_TM_LowIdle_Gov_100ms_Symbol_CM_FixEnableT 171 218 /end CHARACTERISTIC
/begin CHARACTERISTIC ifKI1_ANTIW_UP_H "[FIX] AntiWindUp superiore del KI" VALUE 0xFC5BA4 Scalar_UWORD 0 TE_TM_Cmu_Ctrl4ms_Symbol_CM_ufix16_En4__ 0 100 /end CHARACTERISTIC
/begin CHARACTERISTIC ifKI1_ANTIW_UP_H_EnFix "[FIX] AntiWindUp superiore del KI" VALUE 0xFC5BA2 Scalar_UWORD 0 TE_TM_Cmu_Ctrl4ms_Symbol_CM_FixEnableT 171 218 /end CHARACTERISTIC
/begin CHARACTERISTIC ifKI1_ANTIW_UP_L "[FIX] AntiWindUp inferiore del KI" VALUE 0xFC5BB8 Scalar_SWORD 0 TE_TM_Cmu_Ctrl4ms_Symbol_CM_sfix16_En4__ -100 0 /end CHARACTERISTIC
/begin CHARACTERISTIC ifKI1_ANTIW_UP_L_EnFix "[FIX] AntiWindUp inferiore del KI" VALUE 0xFC5BB6 Scalar_SWORD 0 TE_TM_Cmu_Ctrl4ms_Symbol_CM_FixEnableT 171 218 /end CHARACTERISTIC
/begin CHARACTERISTIC ifKISPD_CM_CTRL "[FIX] Contributo KI sulla percentuale di Coppia" VALUE 0xFC5BA0 Scalar_UWORD 0 TE_TM_Cmu_Ctrl4ms_Symbol_CM_ufix16_En15___srpm 0 1.953125 /end CHARACTERISTIC
/begin CHARACTERISTIC ifKISPD_CM_CTRL_EnFix "[FIX] Contributo KI sulla percentuale di Coppia" VALUE 0xFC5B9E Scalar_UWORD 0 TE_TM_Cmu_Ctrl4ms_Symbol_CM_FixEnableT 171 218 /end CHARACTERISTIC
/begin CHARACTERISTIC ifKI_LOW_GOV "[FIX] Vettore per setting della durezza del controllo del Low Idle" VALUE 0xFC5AAC Scalar_UWORD 0 TE_TM_LowIdle_Gov_100ms_Symbol_CM_ufix16_En10_adm 0 10 /end CHARACTERISTIC
/begin CHARACTERISTIC ifKI_LOW_GOV_EnFix "[FIX] Vettore per setting della durezza del controllo del Low Idle" VALUE 0xFC5AAA Scalar_UWORD 0 TE_TM_LowIdle_Gov_100ms_Symbol_CM_FixEnableT 171 218 /end CHARACTERISTIC
/begin CHARACTERISTIC ifKPSPD_CM_CTRL "[FIX] Contributo KP sulla percentuale di Coppia" VALUE 0xFC5B9C Scalar_UWORD 0 TE_TM_Cmu_Ctrl4ms_Symbol_CM_ufix16_En15___rpm 0 1.953125 /end CHARACTERISTIC
/begin CHARACTERISTIC ifKPSPD_CM_CTRL_EnFix "[FIX] Contributo KP sulla percentuale di Coppia" VALUE 0xFC5B9A Scalar_UWORD 0 TE_TM_Cmu_Ctrl4ms_Symbol_CM_FixEnableT 171 218 /end CHARACTERISTIC
/begin CHARACTERISTIC ifKP_LOW_GOV "[FIX] Vettore per setting della durezza del controllo del Low Idle" VALUE 0xFC5AA8 Scalar_UWORD 0 TE_TM_LowIdle_Gov_100ms_Symbol_CM_ufix16_En10_adm 0 10 /end CHARACTERISTIC
/begin CHARACTERISTIC ifKP_LOW_GOV_EnFix "[FIX] Vettore per setting della durezza del controllo del Low Idle" VALUE 0xFC5AA6 Scalar_UWORD 0 TE_TM_LowIdle_Gov_100ms_Symbol_CM_FixEnableT 171 218 /end CHARACTERISTIC
/begin CHARACTERISTIC ifOFF_C_AUT_NGVV "[FIX] Tabella Offset di richiesta Coppia con Cambio Automatico Accoppiato" VALUE 0xFC5DCA Scalar_SWORD 0 TE_TM_FFW4ms_Symbol_CM_sfix16_En4__ -100 100 /end CHARACTERISTIC
/begin CHARACTERISTIC ifOFF_C_AUT_NGVV_EnFix "[FIX] Tabella Offset di richiesta Coppia con Cambio Automatico Accoppiato" VALUE 0xFC5DC8 Scalar_SWORD 0 TE_TM_FFW4ms_Symbol_CM_FixEnableT 171 218 /end CHARACTERISTIC
/begin CHARACTERISTIC ifOFF_REQ_GEAR "[FIX] Tabella Offset di richiesta Coppia con Cambio Manuale Accoppiato" VALUE 0xFC5DBE Scalar_UWORD 0 TE_TM_FFW4ms_Symbol_CM_ufix16_En4__ 0 100 /end CHARACTERISTIC
/begin CHARACTERISTIC ifOFF_REQ_GEAR_EnFix "[FIX] Tabella Offset di richiesta Coppia con Cambio Manuale Accoppiato" VALUE 0xFC5DBC Scalar_UWORD 0 TE_TM_FFW4ms_Symbol_CM_FixEnableT 171 218 /end CHARACTERISTIC
/begin CHARACTERISTIC ifOFF_RE_G_C_AUT "[FIX] Tabella Offset di richiesta Coppia con Cambio Automatico Accoppiato" VALUE 0xFC5DBA Scalar_UWORD 0 TE_TM_FFW4ms_Symbol_CM_ufix16_En4__ 0 100 /end CHARACTERISTIC
/begin CHARACTERISTIC ifOFF_RE_G_C_AUT_EnFix "[FIX] Tabella Offset di richiesta Coppia con Cambio Automatico Accoppiato" VALUE 0xFC5DB8 Scalar_UWORD 0 TE_TM_FFW4ms_Symbol_CM_FixEnableT 171 218 /end CHARACTERISTIC
/begin CHARACTERISTIC ifRESET_KD "[FIX] Tabella zone di reset del KD" VALUE 0xFC5B98 Scalar_UWORD 0 TE_TM_Cmu_Ctrl4ms_Symbol_CM_uint16_adm 0 1 /end CHARACTERISTIC
/begin CHARACTERISTIC ifRESET_KD_EnFix "[FIX] Tabella zone di reset del KD" VALUE 0xFC5B96 Scalar_UWORD 0 TE_TM_Cmu_Ctrl4ms_Symbol_CM_FixEnableT 171 218 /end CHARACTERISTIC
/begin CHARACTERISTIC ifRPM_DELTA_VBAT_Enable "[FIX]   Idle speed control nominal RPM  " VALUE 0xFC5B66 Scalar_UBYTE 0 TE_TM_Target4ms_CM_FixEnableT 171 218 /end CHARACTERISTIC
/begin CHARACTERISTIC ifRPM_DELTA_VBAT_Value "[FIX]   Idle speed control nominal RPM  " VALUE 0xFC5B64 Scalar_UWORD 0 TE_TM_Target4ms_CM_uint16_RPM 0 2000 /end CHARACTERISTIC
/begin CHARACTERISTIC ifRPM_IDLE_NOM_Enable "[FIX] Idle speed control nominal RPM target" VALUE 0xFC5B62 Scalar_UBYTE 0 TE_TM_Target4ms_CM_FixEnableT 171 218 /end CHARACTERISTIC
/begin CHARACTERISTIC ifRPM_IDLE_NOM_Value "[FIX] Idle speed control nominal RPM target" VALUE 0xFC5B60 Scalar_UWORD 0 TE_TM_Target4ms_CM_uint16_RPM 0 2000 /end CHARACTERISTIC
/begin CHARACTERISTIC ifRPM_REG_MAX_Enable "[FIX] Soglia superiore RPM regolati dal Ctrl Low Idle" VALUE 0xFC5B5E Scalar_UBYTE 0 TE_TM_Target4ms_CM_FixEnableT 171 218 /end CHARACTERISTIC
/begin CHARACTERISTIC ifRPM_REG_MAX_Value "[FIX] Soglia superiore RPM regolati dal Ctrl Low Idle" VALUE 0xFC5B5C Scalar_UWORD 0 TE_TM_Target4ms_CM_uint16_rpm 0 2000 /end CHARACTERISTIC
/begin CHARACTERISTIC ifRPM_REG_MIN_Enable "[FIX] Soglia inferiore RPM regolati dal Ctrl Low Idle" VALUE 0xFC5B5A Scalar_UBYTE 0 TE_TM_Target4ms_CM_FixEnableT 171 218 /end CHARACTERISTIC
/begin CHARACTERISTIC ifRPM_REG_MIN_Value "[FIX] Soglia inferiore RPM regolati dal Ctrl Low Idle" VALUE 0xFC5B58 Scalar_UWORD 0 TE_TM_Target4ms_CM_uint16_rpm 0 2000 /end CHARACTERISTIC
/begin CHARACTERISTIC ifSYS_GAIN_C_TOIL "[FIX]  " VALUE 0xFC5B94 Scalar_UWORD 0 TE_TM_Cmu_Ctrl4ms_Symbol_CM_ufix16_En10_adm 0 10 /end CHARACTERISTIC
/begin CHARACTERISTIC ifSYS_GAIN_C_TOIL_EnFix "[FIX]  " VALUE 0xFC5B92 Scalar_UWORD 0 TE_TM_Cmu_Ctrl4ms_Symbol_CM_FixEnableT 171 218 /end CHARACTERISTIC
/begin CHARACTERISTIC ifSYS_GAIN_GEARC "[FIX] Guadagno controllo in Coppia in funzione della marcia" VALUE 0xFC5B90 Scalar_UWORD 0 TE_TM_Cmu_Ctrl4ms_Symbol_CM_ufix16_En10_adm 0 10 /end CHARACTERISTIC
/begin CHARACTERISTIC ifSYS_GAIN_GEARC_EnFix "[FIX] Guadagno controllo in Coppia in funzione della marcia" VALUE 0xFC5B8E Scalar_UWORD 0 TE_TM_Cmu_Ctrl4ms_Symbol_CM_FixEnableT 171 218 /end CHARACTERISTIC
/begin CHARACTERISTIC ifVEHIC_CMU_OFF "[FIX] Fix su percentuale di Cmu per Offset su PID Coppia dovuto ad accoppiamento motore - veicolo" VALUE 0xFC5DB6 Scalar_UWORD 0 TE_TM_FFW4ms_Symbol_CM_ufix16_En4__ 0 100 /end CHARACTERISTIC
/begin CHARACTERISTIC ifVEHIC_CMU_OFF_EnFix "[FIX] Fix su percentuale di Cmu per Offset su PID Coppia dovuto ad accoppiamento motore - veicolo" VALUE 0xFC5DB4 Scalar_UWORD 0 TE_TM_FFW4ms_Symbol_CM_FixEnableT 171 218 /end CHARACTERISTIC
/begin CHARACTERISTIC isAIR_DELTA_RPM "Delta giri di recovery per riconoscimento di carenza aria rispetto alla richiesta" VALUE 0xFC5B26 Scalar_UWORD 0 TE_TM_Target4ms_CM_uint16_rpm 0 2000 /end CHARACTERISTIC
/begin MEASUREMENT isAirCondReq "Cool Conditioning ON (1)" UBYTE Idle4ms_CM_boolean_adm 0 0 0 1 ECU_ADDRESS 0x40002FA9 /end MEASUREMENT
/begin CHARACTERISTIC isDEADBND_H_D50MS "Limite superiore della banda morta sulla derivata RPM a 50 ms" VALUE 0xFC5FFC Scalar_UWORD 0 TE_TM_DerRPM_50ms_CM_uint16_rpm_s 0 32000 /end CHARACTERISTIC
/begin CHARACTERISTIC isDEADBND_L_D50MS "Limite inferiore della banda morta sulla derivata RPM a 50 ms" VALUE 0xFC5FFA Scalar_UWORD 0 TE_TM_DerRPM_50ms_CM_ufix16_Bn32000_rpm_s -32000 0 /end CHARACTERISTIC
/begin CHARACTERISTIC isDECR_INIT_INTEGR "Nr step_4ms of decrement for initialization of idle integral inherited from PTO" VALUE 0xFC5FF4 Scalar_UBYTE 0 TE_TM_InitIntegrIdl4ms_Symbol_CM_uint8_4ms 1 255 /end CHARACTERISTIC
/begin CHARACTERISTIC isDELT_RPM_NO_IDLE "Delta RPM per la quale il controllo Idle si disattiva con veicolo in movimento" VALUE 0xFC5D96 Scalar_UWORD 0 TE_TM_Enable_Idle4ms_Symbol_CM_uint16_rpm 0 10000 /end CHARACTERISTIC
/begin CHARACTERISTIC isDELT_UNDER_IDL "Delta giri (rispetto a obiettivo statico) sotto il quale (o sopra se positivo) forzare Enable del Low Idle" VALUE 0xFC5D9C Scalar_SWORD 0 TE_TM_Enable_Idle4ms_Symbol_CM_int16_rpm -10000 10000 /end CHARACTERISTIC
/begin CHARACTERISTIC isDER_DEADBND_KI "Banda morta su derivata giri per AntiWindUp su KI" VALUE 0xFC5B8C Scalar_UWORD 0 TE_TM_Cmu_Ctrl4ms_Symbol_CM_uint16_rpm_s 0 32000 /end CHARACTERISTIC
/begin CHARACTERISTIC isDER_DEAD_BND "Banda morta su derivata giri per KD" VALUE 0xFC5B8A Scalar_UWORD 0 TE_TM_Cmu_Ctrl4ms_Symbol_CM_uint16_rpm_s 0 32000 /end CHARACTERISTIC
/begin MEASUREMENT isDer_RPM_50ms "Derivata degli RPM calcolata ogni 50 ms" SWORD Idle4ms_CM_int16_rpm_s 0 0 -32000 32000 ECU_ADDRESS 0x4000309A /end MEASUREMENT
/begin CHARACTERISTIC isEN_FAST_DER_CM "Flag di scelta della Derivata (a 50 o a 100 ms) per il contributo KD del Controllo Cmu in Idle" VALUE 0xFC5B79 Scalar_BOOLEAN 0 TE_TM_Cmu_Ctrl4ms_Symbol_CM_boolean_adm 0 1 /end CHARACTERISTIC
/begin CHARACTERISTIC isEN_OBJ_LIN_EXP "Abilitazione raccordo lineare (1) anzichè eesponenziale (0) tra Rpm e Target Statico" VALUE 0xFC5B24 Scalar_BOOLEAN 0 TE_TM_Target4ms_CM_boolean_adm 0 1 /end CHARACTERISTIC
/begin CHARACTERISTIC isEN_PID_CM_OBJF "Flag di scelta obiettivo dinamico oppure statico di giri in Low Idle per PID su Coppia" VALUE 0xFC5B78 Scalar_BOOLEAN 0 TE_TM_Cmu_Ctrl4ms_Symbol_CM_boolean_adm 0 1 /end CHARACTERISTIC
/begin CHARACTERISTIC isERR_DEADBND_KI "Banda morta su errore giri per AntiWindUp su KI" VALUE 0xFC5B88 Scalar_UWORD 0 TE_TM_Cmu_Ctrl4ms_Symbol_CM_uint16_rpm 0 10000 /end CHARACTERISTIC
/begin CHARACTERISTIC isERR_DEAD_BND_D "Banda morta su errore per resettare Integrale KI2" VALUE 0xFC5B86 Scalar_UWORD 0 TE_TM_Cmu_Ctrl4ms_Symbol_CM_uint16_rpm 0 10000 /end CHARACTERISTIC
/begin MEASUREMENT isERpmSignAdvCtrl "Errore di giri per il copntrollo PD di Delta Anticipo" SWORD TE_TM_Adv_Ctrl4ms_Symbol_CM_int16_rpm 0 0 -2000 2000 ECU_ADDRESS 0x40002FD2 /end MEASUREMENT
/begin COMPU_METHOD Airq4ms_CM_uint16_mbar "Q = V" RAT_FUNC "%5.0" "mbar" COEFFS 0 1 0 0 0 1 /end COMPU_METHOD
/begin COMPU_METHOD Airq_CtrlMgmtTDC_CM_sfix16_En8__ "Q = V*256.000000" RAT_FUNC "%11.8" "%" COEFFS 0 256 0 0 0 1 /end COMPU_METHOD
/begin COMPU_METHOD AutoTDC_CM_boolean_adm "Q = V" RAT_FUNC "%1.0" "adm" COEFFS 0 1 0 0 0 1 /end COMPU_METHOD
/begin COMPU_METHOD AutoTDC_CM_ufix16_En15_adm "Q = V*32768.000000" RAT_FUNC "%16.15" "adm" COEFFS 0 32768 0 0 0 1 /end COMPU_METHOD
/begin COMPU_METHOD Boost_CtrlMgmt50ms_CM_ufix16_En4_kg_h "Q = V*16.000000" RAT_FUNC "%8.4" "kg/h" COEFFS 0 16 0 0 0 1 /end COMPU_METHOD
/begin COMPU_METHOD Crkc4ms_CM_boolean_adm "Q = V" RAT_FUNC "%1.0" "adm" COEFFS 0 1 0 0 0 1 /end COMPU_METHOD
/begin COMPU_METHOD Ctit_LambdaCtrlTDC_CM_boolean_adm "Q = V" RAT_FUNC "%1.0" "adm" COEFFS 0 1 0 0 0 1 /end COMPU_METHOD
/begin COMPU_METHOD Ctit_LambdaCtrlTDC_CM_sfix16_Sp01__ "Q = V*100.000000" RAT_FUNC "%0.6" "%" COEFFS 0 100 0 0 0 1 /end COMPU_METHOD
/begin COMPU_METHOD Ctit_LambdaCtrlTDC_CM_ufix16_En15_adm "Q = V*32768.000000" RAT_FUNC "%16.15" "adm" COEFFS 0 32768 0 0 0 1 /end COMPU_METHOD
/begin COMPU_METHOD Ctit_LambdaCtrlTDC_CM_ufix16_En8_adm "Q = V*256.000000" RAT_FUNC "%11.8" "adm" COEFFS 0 256 0 0 0 1 /end COMPU_METHOD
/begin COMPU_METHOD Ctit_LambdaCtrlTDC_CM_ufix16_S3p05en5_adm "Q = V*32786.885246" RAT_FUNC "%0.6" "adm" COEFFS 0 32786.885246 0 0 0 1 /end COMPU_METHOD
/begin COMPU_METHOD Ctit_LambdaCtrlTDC_CM_uint16_mV "Q = V" RAT_FUNC "%5.0" "mV" COEFFS 0 1 0 0 0 1 /end COMPU_METHOD
/begin COMPU_METHOD Ctit_LambdaCtrlTDC_CM_uint8_adm "Q = V" RAT_FUNC "%3.0" "adm" COEFFS 0 1 0 0 0 1 /end COMPU_METHOD
/begin COMPU_METHOD Ctit_LambdaHeater100ms_CM_boolean_adm "Q = V" RAT_FUNC "%1.0" "adm" COEFFS 0 1 0 0 0 1 /end COMPU_METHOD
/begin COMPU_METHOD Ctit_LambdaHeater100ms_CM_uint16__ "Q = V" RAT_FUNC "%5.0" "%" COEFFS 0 1 0 0 0 1 /end COMPU_METHOD
/begin COMPU_METHOD Ctit_UEGOHeater4ms_CM_boolean_adm "Q = V" RAT_FUNC "%1.0" "adm" COEFFS 0 1 0 0 0 1 /end COMPU_METHOD
/begin COMPU_METHOD Ctit_UEGOHeater4ms_CM_ufix16_En6_B600_degC "Q = (V-600.000000)*64.000000" RAT_FUNC "%0.6" "degC" COEFFS 0 64 -38400 0 0 1 /end COMPU_METHOD
/begin COMPU_METHOD Ctit_UEGOHeater4ms_CM_ufix32_En24__ "Q = V*16777216.000000" RAT_FUNC "%26.16" "%" COEFFS 0 16777216 0 0 0 1 /end COMPU_METHOD
/begin COMPU_METHOD DiagLamTDC_CM_boolean_adm "Q = V" RAT_FUNC "%1.0" "adm" COEFFS 0 1 0 0 0 1 /end COMPU_METHOD
/begin COMPU_METHOD DiagSym100ms_CM_ufix16_En4__ "Q = V*16.000000" RAT_FUNC "%8.4" "%" COEFFS 0 16 0 0 0 1 /end COMPU_METHOD
/begin COMPU_METHOD DiagSym100ms_CM_ufix8_Sp392__ "Q = V*2.551020" RAT_FUNC "%0.6" "%" COEFFS 0 2.55102 0 0 0 1 /end COMPU_METHOD
/begin COMPU_METHOD ETCLearning4ms_CM_FixEnableT "Enumerated data type: FixEnableT" TAB_VERB "%0.6" "" COMPU_TAB_REF VTAB_FOR_ETCLearning4ms_CM_FixEnableT /end COMPU_METHOD
/begin COMPU_METHOD ETCLearning4ms_CM_boolean_adm "Q = V" RAT_FUNC "%1.0" "adm" COEFFS 0 1 0 0 0 1 /end COMPU_METHOD
/begin COMPU_METHOD ETCLearning4ms_CM_sfix16_En12_Nm "Q = V*4096.000000" RAT_FUNC "%14.12" "Nm" COEFFS 0 4096 0 0 0 1 /end COMPU_METHOD
/begin COMPU_METHOD ETCLearning4ms_CM_sfix16_En8__ "Q = V*256.000000" RAT_FUNC "%11.8" "%" COEFFS 0 256 0 0 0 1 /end COMPU_METHOD
/begin COMPU_METHOD ETCLearning4ms_CM_single__ "Q = V" RAT_FUNC "%8.6" "%" COEFFS 0 1 0 0 0 1 /end COMPU_METHOD
/begin COMPU_METHOD ETCLearning4ms_CM_ufix16_Bn40_degC "Q = (V+40.000000)/1.000000" RAT_FUNC "%0.6" "degC" COEFFS 0 1 40 0 0 1 /end COMPU_METHOD
/begin COMPU_METHOD ETCLearning4ms_CM_ufix16_En10_V "Q = V*1024.000000" RAT_FUNC "%12.10" "V" COEFFS 0 1024 0 0 0 1 /end COMPU_METHOD
/begin COMPU_METHOD ETCLearning4ms_CM_ufix16_En8__ "Q = V*256.000000" RAT_FUNC "%11.8" "%" COEFFS 0 256 0 0 0 1 /end COMPU_METHOD
/begin COMPU_METHOD ETCLearning4ms_CM_ufix16_S50_mV "Q = V/50.000000" RAT_FUNC "%0.6" "mV" COEFFS 0 1 0 0 0 50 /end COMPU_METHOD
/begin COMPU_METHOD ETCLearning4ms_CM_ufix16_Sp004_s "Q = V*250.000000" RAT_FUNC "%0.6" "s" COEFFS 0 250 0 0 0 1 /end COMPU_METHOD
/begin COMPU_METHOD ETCLearning4ms_CM_ufix32_Sp004_s "Q = V*250.000000" RAT_FUNC "%0.6" "s" COEFFS 0 250 0 0 0 1 /end COMPU_METHOD
/begin COMPU_METHOD ETCLearning4ms_CM_uint16_km_h "Q = V" RAT_FUNC "%5.0" "km/h" COEFFS 0 1 0 0 0 1 /end COMPU_METHOD
/begin COMPU_METHOD ETCLearning4ms_CM_uint8_adm "Q = V" RAT_FUNC "%3.0" "adm" COEFFS 0 1 0 0 0 1 /end COMPU_METHOD
/begin COMPU_METHOD EgmdTDC_CM_eTHRP_adm "Enumerated data type: eTHRP" TAB_VERB "%0.6" "adm" COMPU_TAB_REF VTAB_FOR_EgmdTDC_CM_eTHRP_adm /end COMPU_METHOD
/begin COMPU_METHOD Ethrc4ms_CM_boolean_adm "Q = V" RAT_FUNC "%1.0" "adm" COEFFS 0 1 0 0 0 1 /end COMPU_METHOD
/begin COMPU_METHOD Ethrc4ms_CM_sfix16_En10_A "Q = V*1024.000000" RAT_FUNC "%12.10" "A" COEFFS 0 1024 0 0 0 1 /end COMPU_METHOD
/begin COMPU_METHOD Ethrc4ms_CM_sfix16_En12_Nm "Q = V*4096.000000" RAT_FUNC "%14.12" "Nm" COEFFS 0 4096 0 0 0 1 /end COMPU_METHOD
/begin COMPU_METHOD Ethrc4ms_CM_ufix16_En3_adm "Q = V*8.000000" RAT_FUNC "%7.3" "adm" COEFFS 0 8 0 0 0 1 /end COMPU_METHOD
/begin COMPU_METHOD Ethrc4ms_CM_uint16_Hz "Q = V" RAT_FUNC "%5.0" "Hz" COEFFS 0 1 0 0 0 1 /end COMPU_METHOD
/begin COMPU_METHOD Ethrl4ms_CM_boolean_adm "Q = V" RAT_FUNC "%1.0" "adm" COEFFS 0 1 0 0 0 1 /end COMPU_METHOD
/begin COMPU_METHOD Ethrl4ms_CM_sfix16_En8__ "Q = V*256.000000" RAT_FUNC "%11.8" "%" COEFFS 0 256 0 0 0 1 /end COMPU_METHOD
/begin COMPU_METHOD Ethrl4ms_CM_ufix16_En10_V "Q = V*1024.000000" RAT_FUNC "%12.10" "V" COEFFS 0 1024 0 0 0 1 /end COMPU_METHOD
/begin COMPU_METHOD Ethrl4ms_CM_uint8_adm "Q = V" RAT_FUNC "%3.0" "adm" COEFFS 0 1 0 0 0 1 /end COMPU_METHOD
/begin COMPU_METHOD Idle4ms_CM_boolean_adm "Q = V" RAT_FUNC "%1.0" "adm" COEFFS 0 1 0 0 0 1 /end COMPU_METHOD
/begin COMPU_METHOD Idle4ms_CM_int16_rpm_s "Q = V" RAT_FUNC "%5.0" "rpm/s" COEFFS 0 1 0 0 0 1 /end COMPU_METHOD
/begin COMPU_METHOD J1939dl_Tx4ms_CM_ufix16_En8_kg_hour "Q = V*256.000000" RAT_FUNC "%11.8" "kg/hour" COEFFS 0 256 0 0 0 1 /end COMPU_METHOD
/begin COMPU_METHOD J1939dl_Tx4ms_CM_uint16_mbar "Q = V" RAT_FUNC "%5.0" "mbar" COEFFS 0 1 0 0 0 1 /end COMPU_METHOD
/begin COMPU_METHOD J1939dl_Tx50ms_CM_eEGMD_adm "Enumerated data type: eEGMD" TAB_VERB "%0.6" "adm" COMPU_TAB_REF VTAB_FOR_J1939dl_Tx50ms_CM_eEGMD_adm /end COMPU_METHOD
/begin COMPU_METHOD J1939dl_Tx50ms_CM_eEGST_adm "Enumerated data type: eEGST" TAB_VERB "%0.6" "adm" COMPU_TAB_REF VTAB_FOR_J1939dl_Tx50ms_CM_eEGST_adm /end COMPU_METHOD
/begin COMPU_METHOD J1939dl_Tx50ms_CM_sfix16_En4__ "Q = V*16.000000" RAT_FUNC "%8.4" "%" COEFFS 0 16 0 0 0 1 /end COMPU_METHOD
/begin COMPU_METHOD J1939dl_Tx50ms_CM_sfix16_En4_degree "Q = V*16.000000" RAT_FUNC "%8.4" "degree" COEFFS 0 16 0 0 0 1 /end COMPU_METHOD
/begin COMPU_METHOD J1939dl_Tx50ms_CM_sfix16_En8__ "Q = V*256.000000" RAT_FUNC "%11.8" "%" COEFFS 0 256 0 0 0 1 /end COMPU_METHOD
/begin COMPU_METHOD J1939dl_Tx50ms_CM_tFault_adm "Enumerated data type: tFault" TAB_VERB "%0.6" "adm" COMPU_TAB_REF VTAB_FOR_J1939dl_Tx50ms_CM_tFault_adm /end COMPU_METHOD
/begin COMPU_METHOD J1939dl_Tx50ms_CM_ufix16_Bn40_degC "Q = (V+40.000000)/1.000000" RAT_FUNC "%0.6" "degC" COEFFS 0 1 40 0 0 1 /end COMPU_METHOD
/begin COMPU_METHOD J1939dl_Tx50ms_CM_ufix16_E4_us "Q = V/16.000000" RAT_FUNC "%5.0" "us" COEFFS 0 1 0 0 0 16 /end COMPU_METHOD
/begin COMPU_METHOD J1939dl_Tx50ms_CM_ufix16_En15_adm "Q = V*32768.000000" RAT_FUNC "%16.15" "adm" COEFFS 0 32768 0 0 0 1 /end COMPU_METHOD
/begin COMPU_METHOD J1939dl_Tx50ms_CM_ufix16_En3__ "Q = V*8.000000" RAT_FUNC "%7.3" "%" COEFFS 0 8 0 0 0 1 /end COMPU_METHOD
/begin COMPU_METHOD J1939dl_Tx50ms_CM_ufix16_En4_kg_h "Q = V*16.000000" RAT_FUNC "%8.4" "kg/h" COEFFS 0 16 0 0 0 1 /end COMPU_METHOD
/begin COMPU_METHOD J1939dl_Tx50ms_CM_uint16_mV "Q = V" RAT_FUNC "%5.0" "mV" COEFFS 0 1 0 0 0 1 /end COMPU_METHOD
/begin COMPU_METHOD J1939dl_Tx50ms_CM_uint16_mbar "Q = V" RAT_FUNC "%5.0" "mbar" COEFFS 0 1 0 0 0 1 /end COMPU_METHOD
/begin COMPU_METHOD KnockTDC_CM_eEGMD_adm "Enumerated data type: eEGMD" TAB_VERB "%0.6" "adm" COMPU_TAB_REF VTAB_FOR_KnockTDC_CM_eEGMD_adm /end COMPU_METHOD
/begin COMPU_METHOD KnockTDC_CM_int16_rpm_s "Q = V" RAT_FUNC "%5.0" "rpm/s" COEFFS 0 1 0 0 0 1 /end COMPU_METHOD
/begin COMPU_METHOD KnockTDC_CM_sfix16_En4_degree "Q = V*16.000000" RAT_FUNC "%8.4" "degree" COEFFS 0 16 0 0 0 1 /end COMPU_METHOD
/begin COMPU_METHOD KnockTDC_CM_ufix16_En10_adm "Q = V*1024.000000" RAT_FUNC "%12.10" "adm" COEFFS 0 1024 0 0 0 1 /end COMPU_METHOD
/begin COMPU_METHOD LambdaHeater100ms_CM_FixEnableT "Enumerated data type: FixEnableT" TAB_VERB "%0.6" "" COMPU_TAB_REF VTAB_FOR_LambdaHeater100ms_CM_FixEnableT /end COMPU_METHOD
/begin COMPU_METHOD LambdaHeater100ms_CM_boolean_adm "Q = V" RAT_FUNC "%1.0" "adm" COEFFS 0 1 0 0 0 1 /end COMPU_METHOD
/begin COMPU_METHOD LambdaHeater100ms_CM_ufix16_Bn40_degC "Q = (V+40.000000)/1.000000" RAT_FUNC "%0.6" "degC" COEFFS 0 1 40 0 0 1 /end COMPU_METHOD
/begin COMPU_METHOD LambdaHeater100ms_CM_ufix16_En10_adm "Q = V*1024.000000" RAT_FUNC "%12.10" "adm" COEFFS 0 1024 0 0 0 1 /end COMPU_METHOD
/begin COMPU_METHOD LambdaHeater100ms_CM_ufix16_En14_adm "Q = V*16384.000000" RAT_FUNC "%15.14" "adm" COEFFS 0 16384 0 0 0 1 /end COMPU_METHOD
/begin COMPU_METHOD LambdaHeater100ms_CM_ufix16_Sp1_s "Q = V*10.000000" RAT_FUNC "%0.6" "s" COEFFS 0 10 0 0 0 1 /end COMPU_METHOD
/begin COMPU_METHOD LambdaHeater100ms_CM_uint16__ "Q = V" RAT_FUNC "%5.0" "%" COEFFS 0 1 0 0 0 1 /end COMPU_METHOD
/begin COMPU_METHOD LambdaHeater100ms_CM_uint16_rpm "Q = V" RAT_FUNC "%5.0" "rpm" COEFFS 0 1 0 0 0 1 /end COMPU_METHOD
/begin COMPU_METHOD LambdaHeater_2_100ms_CM_boolean_adm "Q = V" RAT_FUNC "%1.0" "adm" COEFFS 0 1 0 0 0 1 /end COMPU_METHOD
/begin COMPU_METHOD LambdaHeater_2_100ms_CM_ufix16_Bn40_degC "Q = (V+40.000000)/1.000000" RAT_FUNC "%0.6" "degC" COEFFS 0 1 40 0 0 1 /end COMPU_METHOD
/begin COMPU_METHOD LambdaHeater_2_100ms_CM_ufix16_En10_adm "Q = V*1024.000000" RAT_FUNC "%12.10" "adm" COEFFS 0 1024 0 0 0 1 /end COMPU_METHOD
/begin COMPU_METHOD LambdaHeater_2_100ms_CM_ufix16_En14_adm "Q = V*16384.000000" RAT_FUNC "%15.14" "adm" COEFFS 0 16384 0 0 0 1 /end COMPU_METHOD
/begin COMPU_METHOD LambdaHeater_2_100ms_CM_ufix16_Sp1_s "Q = V*10.000000" RAT_FUNC "%0.6" "s" COEFFS 0 10 0 0 0 1 /end COMPU_METHOD
/begin COMPU_METHOD LambdaHeater_2_100ms_CM_uint16__ "Q = V" RAT_FUNC "%5.0" "%" COEFFS 0 1 0 0 0 1 /end COMPU_METHOD
/begin COMPU_METHOD LambdaHeater_2_100ms_CM_uint16_rpm "Q = V" RAT_FUNC "%5.0" "rpm" COEFFS 0 1 0 0 0 1 /end COMPU_METHOD
/begin COMPU_METHOD LambdaPostTDC_Symbol_CM_FixEnableT "Enumerated data type: FixEnableT" TAB_VERB "%0.6" "" COMPU_TAB_REF VTAB_FOR_LambdaPostTDC_Symbol_CM_FixEnableT /end COMPU_METHOD
/begin COMPU_METHOD LambdaPostTDC_Symbol_CM_boolean_adm "Q = V" RAT_FUNC "%1.0" "adm" COEFFS 0 1 0 0 0 1 /end COMPU_METHOD
/begin COMPU_METHOD LambdaPostTDC_Symbol_CM_int16_mV "Q = V" RAT_FUNC "%5.0" "mV" COEFFS 0 1 0 0 0 1 /end COMPU_METHOD
/begin COMPU_METHOD LambdaPostTDC_Symbol_CM_int8_mV "Q = V" RAT_FUNC "%3.0" "mV" COEFFS 0 1 0 0 0 1 /end COMPU_METHOD
/begin COMPU_METHOD LambdaPostTDC_Symbol_CM_sfix16_Sp0001___mV "Q = V*10000.000000" RAT_FUNC "%0.6" "%/mV" COEFFS 0 10000 0 0 0 1 /end COMPU_METHOD
/begin COMPU_METHOD LambdaPostTDC_Symbol_CM_sfix16_Sp01__ "Q = V*100.000000" RAT_FUNC "%0.6" "%" COEFFS 0 100 0 0 0 1 /end COMPU_METHOD
/begin COMPU_METHOD LambdaPostTDC_Symbol_CM_sfix32_Sp0001__ "Q = V*10000.000000" RAT_FUNC "%0.6" "%" COEFFS 0 10000 0 0 0 1 /end COMPU_METHOD
/begin COMPU_METHOD LambdaPostTDC_Symbol_CM_ufix16_En10_adm "Q = V*1024.000000" RAT_FUNC "%12.10" "adm" COEFFS 0 1024 0 0 0 1 /end COMPU_METHOD
/begin COMPU_METHOD LambdaPostTDC_Symbol_CM_ufix16_Sp01___mV "Q = V*100.000000" RAT_FUNC "%0.6" "%/mV" COEFFS 0 100 0 0 0 1 /end COMPU_METHOD
/begin COMPU_METHOD LambdaPostTDC_Symbol_CM_ufix16_Sp1_mV____PMS_ "Q = V*10.000000" RAT_FUNC "%0.6" "mV/(%*PMS)" COEFFS 0 10 0 0 0 1 /end COMPU_METHOD
/begin COMPU_METHOD LambdaPostTDC_Symbol_CM_ufix8_Sp01___mV "Q = V*100.000000" RAT_FUNC "%0.6" "%/mV" COEFFS 0 100 0 0 0 1 /end COMPU_METHOD
/begin COMPU_METHOD LambdaPostTDC_Symbol_CM_uint16_PMS "Q = V" RAT_FUNC "%5.0" "PMS" COEFFS 0 1 0 0 0 1 /end COMPU_METHOD
/begin COMPU_METHOD LambdaPostTDC_Symbol_CM_uint16_mV "Q = V" RAT_FUNC "%5.0" "mV" COEFFS 0 1 0 0 0 1 /end COMPU_METHOD
/begin COMPU_METHOD LambdaPostTDC_Symbol_CM_uint16_mbar "Q = V" RAT_FUNC "%5.0" "mbar" COEFFS 0 1 0 0 0 1 /end COMPU_METHOD
/begin COMPU_METHOD LambdaPostTDC_Symbol_CM_uint16_rpm "Q = V" RAT_FUNC "%5.0" "rpm" COEFFS 0 1 0 0 0 1 /end COMPU_METHOD
/begin COMPU_METHOD LambdaPostTDC_Symbol_CM_uint8_adm "Q = V" RAT_FUNC "%3.0" "adm" COEFFS 0 1 0 0 0 1 /end COMPU_METHOD
/begin COMPU_METHOD LambdaPreTDC_CM_FixEnableT "Enumerated data type: FixEnableT" TAB_VERB "%0.6" "" COMPU_TAB_REF VTAB_FOR_LambdaPreTDC_CM_FixEnableT /end COMPU_METHOD
/begin COMPU_METHOD LambdaPreTDC_CM_boolean_adm "Q = V" RAT_FUNC "%1.0" "adm" COEFFS 0 1 0 0 0 1 /end COMPU_METHOD
/begin COMPU_METHOD LambdaPreTDC_CM_int8_adm "Q = V" RAT_FUNC "%3.0" "adm" COEFFS 0 1 0 0 0 1 /end COMPU_METHOD
/begin COMPU_METHOD LambdaPreTDC_CM_sfix16_En4__ "Q = V*16.000000" RAT_FUNC "%8.4" "%" COEFFS 0 16 0 0 0 1 /end COMPU_METHOD
/begin COMPU_METHOD LambdaPreTDC_CM_sfix16_En7_adm "Q = V*128.000000" RAT_FUNC "%10.7" "adm" COEFFS 0 128 0 0 0 1 /end COMPU_METHOD
/begin COMPU_METHOD LambdaPreTDC_CM_sfix16_Sp01_Bn40p96__ "Q = (V+40.960000)*100.000000" RAT_FUNC "%0.6" "%" COEFFS 0 100 4096 0 0 1 /end COMPU_METHOD
/begin COMPU_METHOD LambdaPreTDC_CM_ufix16_En10_Bn2_adm "Q = (V+2.000000)*1024.000000" RAT_FUNC "%0.6" "adm" COEFFS 0 1024 2048 0 0 1 /end COMPU_METHOD
/begin COMPU_METHOD LambdaPreTDC_CM_ufix16_En10_adm "Q = V*1024.000000" RAT_FUNC "%12.10" "adm" COEFFS 0 1024 0 0 0 1 /end COMPU_METHOD
/begin COMPU_METHOD LambdaPreTDC_CM_ufix16_En15_adm "Q = V*32768.000000" RAT_FUNC "%16.15" "adm" COEFFS 0 32768 0 0 0 1 /end COMPU_METHOD
/begin COMPU_METHOD LambdaPreTDC_CM_ufix16_En2_adm "Q = V*4.000000" RAT_FUNC "%7.2" "adm" COEFFS 0 4 0 0 0 1 /end COMPU_METHOD
/begin COMPU_METHOD LambdaPreTDC_CM_ufix16_En4_Bn100__ "Q = (V+100.000000)*16.000000" RAT_FUNC "%0.6" "%" COEFFS 0 16 1600 0 0 1 /end COMPU_METHOD
/begin COMPU_METHOD LambdaPreTDC_CM_ufix16_En4__ "Q = V*16.000000" RAT_FUNC "%8.4" "%" COEFFS 0 16 0 0 0 1 /end COMPU_METHOD
/begin COMPU_METHOD LambdaPreTDC_CM_ufix16_En6__ "Q = V*64.000000" RAT_FUNC "%10.6" "%" COEFFS 0 64 0 0 0 1 /end COMPU_METHOD
/begin COMPU_METHOD LambdaPreTDC_CM_ufix16_En7__ "Q = V*128.000000" RAT_FUNC "%10.7" "%" COEFFS 0 128 0 0 0 1 /end COMPU_METHOD
/begin COMPU_METHOD LambdaPreTDC_CM_ufix16_En8_adm "Q = V*256.000000" RAT_FUNC "%11.8" "adm" COEFFS 0 256 0 0 0 1 /end COMPU_METHOD
/begin COMPU_METHOD LambdaPreTDC_CM_ufix16_S3p05en5_adm "Q = V*32786.885246" RAT_FUNC "%0.6" "adm" COEFFS 0 32786.885246 0 0 0 1 /end COMPU_METHOD
/begin COMPU_METHOD LambdaPreTDC_CM_ufix16_Sp0001_Bn3_mA "Q = (V+3.000000)*10000.000000" RAT_FUNC "%0.6" "mA" COEFFS 0 10000 30000 0 0 1 /end COMPU_METHOD
/begin COMPU_METHOD LambdaPreTDC_CM_ufix16_Sp01_Bn40p96__ "Q = (V+40.960000)*100.000000" RAT_FUNC "%0.6" "%" COEFFS 0 100 4096 0 0 1 /end COMPU_METHOD
/begin COMPU_METHOD LambdaPreTDC_CM_ufix8_Sp008_adm "Q = V*125.000000" RAT_FUNC "%0.6" "adm" COEFFS 0 125 0 0 0 1 /end COMPU_METHOD
/begin COMPU_METHOD LambdaPreTDC_CM_ufix8_Sp01_adm "Q = V*100.000000" RAT_FUNC "%0.6" "adm" COEFFS 0 100 0 0 0 1 /end COMPU_METHOD
/begin COMPU_METHOD LambdaPreTDC_CM_uint16_mV "Q = V" RAT_FUNC "%5.0" "mV" COEFFS 0 1 0 0 0 1 /end COMPU_METHOD
/begin COMPU_METHOD LambdaPreTDC_CM_uint16_rpm "Q = V" RAT_FUNC "%5.0" "rpm" COEFFS 0 1 0 0 0 1 /end COMPU_METHOD
/begin COMPU_METHOD LambdaPreTDC_CM_uint16_tdc "Q = V" RAT_FUNC "%5.0" "tdc" COEFFS 0 1 0 0 0 1 /end COMPU_METHOD
/begin COMPU_METHOD LambdaPreTDC_CM_uint32_tdc "Q = V" RAT_FUNC "%10.0" "tdc" COEFFS 0 1 0 0 0 1 /end COMPU_METHOD
/begin COMPU_METHOD LambdaPreTDC_CM_uint8_adm "Q = V" RAT_FUNC "%3.0" "adm" COEFFS 0 1 0 0 0 1 /end COMPU_METHOD
/begin COMPU_METHOD Lamm4ms_CM_ufix16_Sp0001_Bn3_mA "Q = (V+3.000000)*10000.000000" RAT_FUNC "%0.6" "mA" COEFFS 0 10000 30000 0 0 1 /end COMPU_METHOD
/begin COMPU_METHOD Lamm4ms_CM_uint16_mV "Q = V" RAT_FUNC "%5.0" "mV" COEFFS 0 1 0 0 0 1 /end COMPU_METHOD
/begin COMPU_METHOD Lamp100ms_CM_ufix16_Bn40_degC "Q = (V+40.000000)/1.000000" RAT_FUNC "%0.6" "degC" COEFFS 0 1 40 0 0 1 /end COMPU_METHOD
/begin COMPU_METHOD Lamp100ms_CM_ufix16_S50_mV "Q = V/50.000000" RAT_FUNC "%0.6" "mV" COEFFS 0 1 0 0 0 50 /end COMPU_METHOD
/begin COMPU_METHOD Lamp100ms_CM_uint16_mbar "Q = V" RAT_FUNC "%5.0" "mbar" COEFFS 0 1 0 0 0 1 /end COMPU_METHOD
/begin COMPU_METHOD MairTDC_CM_boolean_adm "Q = V" RAT_FUNC "%1.0" "adm" COEFFS 0 1 0 0 0 1 /end COMPU_METHOD
/begin COMPU_METHOD MairTDC_CM_sfix16_En4_deg "Q = V*16.000000" RAT_FUNC "%8.4" "deg" COEFFS 0 16 0 0 0 1 /end COMPU_METHOD
/begin COMPU_METHOD MairTDC_CM_ufix16_En4_cc "Q = V*16.000000" RAT_FUNC "%8.4" "cc" COEFFS 0 16 0 0 0 1 /end COMPU_METHOD
/begin COMPU_METHOD MairTDC_CM_ufix16_En4_degree "Q = V*16.000000" RAT_FUNC "%8.4" "degree" COEFFS 0 16 0 0 0 1 /end COMPU_METHOD
/begin COMPU_METHOD MairTDC_CM_ufix16_En4_kg_h "Q = V*16.000000" RAT_FUNC "%8.4" "kg/h" COEFFS 0 16 0 0 0 1 /end COMPU_METHOD
/begin COMPU_METHOD MairTDC_CM_ufix16_En8_adm "Q = V*256.000000" RAT_FUNC "%11.8" "adm" COEFFS 0 256 0 0 0 1 /end COMPU_METHOD
/begin COMPU_METHOD MairTDC_CM_uint16_degM "Q = V" RAT_FUNC "%5.0" "degM" COEFFS 0 1 0 0 0 1 /end COMPU_METHOD
/begin COMPU_METHOD MairTDC_CM_uint16_mbar "Q = V" RAT_FUNC "%5.0" "mbar" COEFFS 0 1 0 0 0 1 /end COMPU_METHOD
/begin COMPU_METHOD MisfdTDC_CM_eEGMD_adm "Enumerated data type: eEGMD" TAB_VERB "%0.6" "adm" COMPU_TAB_REF VTAB_FOR_MisfdTDC_CM_eEGMD_adm /end COMPU_METHOD
/begin COMPU_METHOD MisfdTDC_CM_ufix16_Bn40_degC "Q = (V+40.000000)/1.000000" RAT_FUNC "%0.6" "degC" COEFFS 0 1 40 0 0 1 /end COMPU_METHOD
/begin COMPU_METHOD MisfdTDC_CM_ufix16_En3_degF "Q = V*8.000000" RAT_FUNC "%7.3" "degF" COEFFS 0 8 0 0 0 1 /end COMPU_METHOD
/begin COMPU_METHOD MisfdTDC_CM_ufix16_En3_mg_cc "Q = V*8.000000" RAT_FUNC "%7.3" "mg/cc" COEFFS 0 8 0 0 0 1 /end COMPU_METHOD
/begin COMPU_METHOD MisfdTDC_CM_uint16_km_h "Q = V" RAT_FUNC "%5.0" "km/h" COEFFS 0 1 0 0 0 1 /end COMPU_METHOD
/begin COMPU_METHOD Pacc4ms_CM_ufix16_En4__ "Q = V*16.000000" RAT_FUNC "%8.4" "%" COEFFS 0 16 0 0 0 1 /end COMPU_METHOD
/begin COMPU_METHOD TE_DrivePedal4ms_Symbol_CM_FixEnableT "Enumerated data type: FixEnableT" TAB_VERB "%0.6" "" COMPU_TAB_REF VTAB_FOR_TE_DrivePedal4ms_Symbol_CM_FixEnableT /end COMPU_METHOD
/begin COMPU_METHOD TE_DrivePedal4ms_Symbol_CM_boolean_adm "Q = V" RAT_FUNC "%1.0" "adm" COEFFS 0 1 0 0 0 1 /end COMPU_METHOD
/begin COMPU_METHOD TE_DrivePedal4ms_Symbol_CM_ufix16_En2_s "Q = V*4.000000" RAT_FUNC "%7.2" "s" COEFFS 0 4 0 0 0 1 /end COMPU_METHOD
/begin COMPU_METHOD TE_DrivePedal4ms_Symbol_CM_ufix16_En4__ "Q = V*16.000000" RAT_FUNC "%8.4" "%" COEFFS 0 16 0 0 0 1 /end COMPU_METHOD
/begin COMPU_METHOD TE_DrivePedal4ms_Symbol_CM_ufix16_En4___4ms "Q = V*16.000000" RAT_FUNC "%8.4" "%/4ms" COEFFS 0 16 0 0 0 1 /end COMPU_METHOD
/begin COMPU_METHOD TE_DrivePedal4ms_Symbol_CM_ufix16_En4_adm "Q = V*16.000000" RAT_FUNC "%8.4" "adm" COEFFS 0 16 0 0 0 1 /end COMPU_METHOD
/begin COMPU_METHOD TE_DrivePedal4ms_Symbol_CM_ufix8_Sp392__ "Q = V*2.551020" RAT_FUNC "%0.6" "%" COEFFS 0 2.55102 0 0 0 1 /end COMPU_METHOD
/begin COMPU_METHOD TE_DrivePedal4ms_Symbol_CM_uint16_rpm "Q = V" RAT_FUNC "%5.0" "rpm" COEFFS 0 1 0 0 0 1 /end COMPU_METHOD
/begin COMPU_METHOD TE_PotenzAccSensor_4ms_Symbol_CM_uint16_adm "Q = V" RAT_FUNC "%5.0" "adm" COEFFS 0 1 0 0 0 1 /end COMPU_METHOD
/begin COMPU_METHOD TE_TM_Adv_Ctrl4ms_Symbol_CM_FixEnableT "Enumerated data type: FixEnableT" TAB_VERB "%0.6" "" COMPU_TAB_REF VTAB_FOR_TE_TM_Adv_Ctrl4ms_Symbol_CM_FixEnableT /end COMPU_METHOD
/begin COMPU_METHOD TE_TM_Adv_Ctrl4ms_Symbol_CM_boolean_adm "Q = V" RAT_FUNC "%1.0" "adm" COEFFS 0 1 0 0 0 1 /end COMPU_METHOD
/begin COMPU_METHOD TE_TM_Adv_Ctrl4ms_Symbol_CM_int16_rpm "Q = V" RAT_FUNC "%5.0" "rpm" COEFFS 0 1 0 0 0 1 /end COMPU_METHOD
/begin COMPU_METHOD TE_TM_Adv_Ctrl4ms_Symbol_CM_ufix16_En4_degE "Q = V*16.000000" RAT_FUNC "%8.4" "degE" COEFFS 0 16 0 0 0 1 /end COMPU_METHOD
/begin COMPU_METHOD TE_TM_Cmu_Ctrl4ms_Symbol_CM_FixEnableT "Enumerated data type: FixEnableT" TAB_VERB "%0.6" "" COMPU_TAB_REF VTAB_FOR_TE_TM_Cmu_Ctrl4ms_Symbol_CM_FixEnableT /end COMPU_METHOD
/begin COMPU_METHOD TE_TM_Cmu_Ctrl4ms_Symbol_CM_boolean_adm "Q = V" RAT_FUNC "%1.0" "adm" COEFFS 0 1 0 0 0 1 /end COMPU_METHOD
/begin COMPU_METHOD TE_TM_Cmu_Ctrl4ms_Symbol_CM_sfix16_En4__ "Q = V*16.000000" RAT_FUNC "%8.4" "%" COEFFS 0 16 0 0 0 1 /end COMPU_METHOD
/begin COMPU_METHOD TE_TM_Cmu_Ctrl4ms_Symbol_CM_ufix16_En10_adm "Q = V*1024.000000" RAT_FUNC "%12.10" "adm" COEFFS 0 1024 0 0 0 1 /end COMPU_METHOD
/begin COMPU_METHOD TE_TM_Cmu_Ctrl4ms_Symbol_CM_ufix16_En15___rpm "Q = V*32768.000000" RAT_FUNC "%16.15" "%/rpm" COEFFS 0 32768 0 0 0 1 /end COMPU_METHOD
/begin COMPU_METHOD TE_TM_Cmu_Ctrl4ms_Symbol_CM_ufix16_En15___srpm "Q = V*32768.000000" RAT_FUNC "%16.15" "%/srpm" COEFFS 0 32768 0 0 0 1 /end COMPU_METHOD
/begin COMPU_METHOD TE_TM_Cmu_Ctrl4ms_Symbol_CM_ufix16_En15__s_rpm "Q = V*32768.000000" RAT_FUNC "%16.15" "%s/rpm" COEFFS 0 32768 0 0 0 1 /end COMPU_METHOD
/begin COMPU_METHOD TE_TM_Cmu_Ctrl4ms_Symbol_CM_ufix16_En4__ "Q = V*16.000000" RAT_FUNC "%8.4" "%" COEFFS 0 16 0 0 0 1 /end COMPU_METHOD
/begin COMPU_METHOD TE_TM_Cmu_Ctrl4ms_Symbol_CM_uint16_adm "Q = V" RAT_FUNC "%5.0" "adm" COEFFS 0 1 0 0 0 1 /end COMPU_METHOD
/begin COMPU_METHOD TE_TM_Cmu_Ctrl4ms_Symbol_CM_uint16_rpm "Q = V" RAT_FUNC "%5.0" "rpm" COEFFS 0 1 0 0 0 1 /end COMPU_METHOD
/begin COMPU_METHOD TE_TM_Cmu_Ctrl4ms_Symbol_CM_uint16_rpm_s "Q = V" RAT_FUNC "%5.0" "rpm/s" COEFFS 0 1 0 0 0 1 /end COMPU_METHOD
/begin COMPU_METHOD TE_TM_CndAbilTHRST4ms_CM_FixEnableT "Enumerated data type: FixEnableT" TAB_VERB "%0.6" "" COMPU_TAB_REF VTAB_FOR_TE_TM_CndAbilTHRST4ms_CM_FixEnableT /end COMPU_METHOD
/begin COMPU_METHOD TE_TM_CndAbilTHRST4ms_CM_boolean_adm "Q = V" RAT_FUNC "%1.0" "adm" COEFFS 0 1 0 0 0 1 /end COMPU_METHOD
/begin COMPU_METHOD TE_TM_CtrlThrotMgm4ms_CM_FixEnableT "Enumerated data type: FixEnableT" TAB_VERB "%0.6" "" COMPU_TAB_REF VTAB_FOR_TE_TM_CtrlThrotMgm4ms_CM_FixEnableT /end COMPU_METHOD
/begin COMPU_METHOD TE_TM_CtrlThrotMgm4ms_CM_boolean_adm "Q = V" RAT_FUNC "%1.0" "adm" COEFFS 0 1 0 0 0 1 /end COMPU_METHOD
/begin COMPU_METHOD TE_TM_CtrlThrotMgm4ms_CM_int8_kg_h "Q = V" RAT_FUNC "%3.0" "kg/h" COEFFS 0 1 0 0 0 1 /end COMPU_METHOD
/begin COMPU_METHOD TE_TM_CtrlThrotMgm4ms_CM_sfix16_En4__ "Q = V*16.000000" RAT_FUNC "%8.4" "%" COEFFS 0 16 0 0 0 1 /end COMPU_METHOD
/begin COMPU_METHOD TE_TM_CtrlThrotMgm4ms_CM_sfix16_En8__ "Q = V*256.000000" RAT_FUNC "%11.8" "%" COEFFS 0 256 0 0 0 1 /end COMPU_METHOD
/begin COMPU_METHOD TE_TM_CtrlThrotMgm4ms_CM_ufix16_Bn40_degC "Q = (V+40.000000)/1.000000" RAT_FUNC "%0.6" "degC" COEFFS 0 1 40 0 0 1 /end COMPU_METHOD
/begin COMPU_METHOD TE_TM_CtrlThrotMgm4ms_CM_ufix16_En10_adm "Q = V*1024.000000" RAT_FUNC "%12.10" "adm" COEFFS 0 1024 0 0 0 1 /end COMPU_METHOD
/begin COMPU_METHOD TE_TM_CtrlThrotMgm4ms_CM_ufix16_En14_adm "Q = V*16384.000000" RAT_FUNC "%15.14" "adm" COEFFS 0 16384 0 0 0 1 /end COMPU_METHOD
/begin COMPU_METHOD TE_TM_CtrlThrotMgm4ms_CM_ufix16_En4_Bn100_kg_h "Q = (V+100.000000)*16.000000" RAT_FUNC "%0.6" "kg/h" COEFFS 0 16 1600 0 0 1 /end COMPU_METHOD
/begin COMPU_METHOD TE_TM_CtrlThrotMgm4ms_CM_ufix16_En4__ "Q = V*16.000000" RAT_FUNC "%8.4" "%" COEFFS 0 16 0 0 0 1 /end COMPU_METHOD
/begin COMPU_METHOD TE_TM_CtrlThrotMgm4ms_CM_ufix16_En4___4ms "Q = V*16.000000" RAT_FUNC "%8.4" "%/4ms" COEFFS 0 16 0 0 0 1 /end COMPU_METHOD
/begin COMPU_METHOD TE_TM_CtrlThrotMgm4ms_CM_ufix16_En4_cc "Q = V*16.000000" RAT_FUNC "%8.4" "cc" COEFFS 0 16 0 0 0 1 /end COMPU_METHOD
/begin COMPU_METHOD TE_TM_CtrlThrotMgm4ms_CM_ufix16_En4_kg_h "Q = V*16.000000" RAT_FUNC "%8.4" "kg/h" COEFFS 0 16 0 0 0 1 /end COMPU_METHOD
/begin COMPU_METHOD TE_TM_CtrlThrotMgm4ms_CM_ufix16_En8__ "Q = V*256.000000" RAT_FUNC "%11.8" "%" COEFFS 0 256 0 0 0 1 /end COMPU_METHOD
/begin COMPU_METHOD TE_TM_CtrlThrotMgm4ms_CM_ufix16_En9_deg "Q = V*512.000000" RAT_FUNC "%12.9" "deg" COEFFS 0 512 0 0 0 1 /end COMPU_METHOD
/begin COMPU_METHOD TE_TM_CtrlThrotMgm4ms_CM_ufix32_En4_cdeg "Q = V*16.000000" RAT_FUNC "%13.4" "cdeg" COEFFS 0 16 0 0 0 1 /end COMPU_METHOD
/begin COMPU_METHOD TE_TM_CtrlThrotMgm4ms_CM_uint16_K "Q = V" RAT_FUNC "%5.0" "K" COEFFS 0 1 0 0 0 1 /end COMPU_METHOD
/begin COMPU_METHOD TE_TM_CtrlThrotMgm4ms_CM_uint16_mbar "Q = V" RAT_FUNC "%5.0" "mbar" COEFFS 0 1 0 0 0 1 /end COMPU_METHOD
/begin COMPU_METHOD TE_TM_CtrlThrotMgm4ms_CM_uint16_rpm "Q = V" RAT_FUNC "%5.0" "rpm" COEFFS 0 1 0 0 0 1 /end COMPU_METHOD
/begin COMPU_METHOD TE_TM_DerRPM_50ms_CM_ufix16_Bn32000_rpm_s "Q = (V+32000.000000)/1.000000" RAT_FUNC "%0.6" "rpm/s" COEFFS 0 1 32000 0 0 1 /end COMPU_METHOD
/begin COMPU_METHOD TE_TM_DerRPM_50ms_CM_uint16_rpm_s "Q = V" RAT_FUNC "%5.0" "rpm/s" COEFFS 0 1 0 0 0 1 /end COMPU_METHOD
/begin COMPU_METHOD TE_TM_Enable_Idle4ms_Symbol_CM_FixEnableT "Enumerated data type: FixEnableT" TAB_VERB "%0.6" "" COMPU_TAB_REF VTAB_FOR_TE_TM_Enable_Idle4ms_Symbol_CM_FixEnableT /end COMPU_METHOD
/begin COMPU_METHOD TE_TM_Enable_Idle4ms_Symbol_CM_boolean_adm "Q = V" RAT_FUNC "%1.0" "adm" COEFFS 0 1 0 0 0 1 /end COMPU_METHOD
/begin COMPU_METHOD TE_TM_Enable_Idle4ms_Symbol_CM_int16_rpm "Q = V" RAT_FUNC "%5.0" "rpm" COEFFS 0 1 0 0 0 1 /end COMPU_METHOD
/begin COMPU_METHOD TE_TM_Enable_Idle4ms_Symbol_CM_uint16_rpm "Q = V" RAT_FUNC "%5.0" "rpm" COEFFS 0 1 0 0 0 1 /end COMPU_METHOD
/begin COMPU_METHOD TE_TM_FFW4ms_Symbol_CM_FixEnableT "Enumerated data type: FixEnableT" TAB_VERB "%0.6" "" COMPU_TAB_REF VTAB_FOR_TE_TM_FFW4ms_Symbol_CM_FixEnableT /end COMPU_METHOD
/begin COMPU_METHOD TE_TM_FFW4ms_Symbol_CM_sfix16_En4__ "Q = V*16.000000" RAT_FUNC "%8.4" "%" COEFFS 0 16 0 0 0 1 /end COMPU_METHOD
/begin COMPU_METHOD TE_TM_FFW4ms_Symbol_CM_ufix16_En4__ "Q = V*16.000000" RAT_FUNC "%8.4" "%" COEFFS 0 16 0 0 0 1 /end COMPU_METHOD
/begin COMPU_METHOD TE_TM_InitIntegrIdl4ms_Symbol_CM_uint8_4ms "Q = V" RAT_FUNC "%3.0" "4ms" COEFFS 0 1 0 0 0 1 /end COMPU_METHOD
/begin COMPU_METHOD TE_TM_LowIdle_Gov_100ms_Symbol_CM_FixEnableT "Enumerated data type: FixEnableT" TAB_VERB "%0.6" "" COMPU_TAB_REF VTAB_FOR_TE_TM_LowIdle_Gov_100ms_Symbol_CM_FixEnableT /end COMPU_METHOD
/begin COMPU_METHOD TE_TM_LowIdle_Gov_100ms_Symbol_CM_ufix16_En10_adm "Q = V*1024.000000" RAT_FUNC "%12.10" "adm" COEFFS 0 1024 0 0 0 1 /end COMPU_METHOD
/begin COMPU_METHOD TE_TM_Target4ms_CM_FixEnableT "Enumerated data type: FixEnableT" TAB_VERB "%0.6" "" COMPU_TAB_REF VTAB_FOR_TE_TM_Target4ms_CM_FixEnableT /end COMPU_METHOD
/begin COMPU_METHOD TE_TM_Target4ms_CM_boolean_adm "Q = V" RAT_FUNC "%1.0" "adm" COEFFS 0 1 0 0 0 1 /end COMPU_METHOD
/begin COMPU_METHOD TE_TM_Target4ms_CM_uint16_RPM "Q = V" RAT_FUNC "%5.0" "RPM" COEFFS 0 1 0 0 0 1 /end COMPU_METHOD
/begin COMPU_METHOD TE_TM_Target4ms_CM_uint16_rpm "Q = V" RAT_FUNC "%5.0" "rpm" COEFFS 0 1 0 0 0 1 /end COMPU_METHOD
/begin COMPU_METHOD TE_TM_ThrottleCtrl4ms_CM_FixEnableT "Enumerated data type: FixEnableT" TAB_VERB "%0.6" "" COMPU_TAB_REF VTAB_FOR_TE_TM_ThrottleCtrl4ms_CM_FixEnableT /end COMPU_METHOD
/begin COMPU_METHOD TE_TM_ThrottleCtrl4ms_CM_boolean_adm "Q = V" RAT_FUNC "%1.0" "adm" COEFFS 0 1 0 0 0 1 /end COMPU_METHOD
/begin COMPU_METHOD TE_TM_ThrottleCtrl4ms_CM_sfix16_En12_Nm "Q = V*4096.000000" RAT_FUNC "%14.12" "Nm" COEFFS 0 4096 0 0 0 1 /end COMPU_METHOD
/begin COMPU_METHOD TE_TM_ThrottleCtrl4ms_CM_sfix16_En14_Nm "Q = V*16384.000000" RAT_FUNC "%15.14" "Nm" COEFFS 0 16384 0 0 0 1 /end COMPU_METHOD
/begin COMPU_METHOD TE_TM_ThrottleCtrl4ms_CM_sfix16_En8__ "Q = V*256.000000" RAT_FUNC "%11.8" "%" COEFFS 0 256 0 0 0 1 /end COMPU_METHOD
/begin COMPU_METHOD TE_TM_ThrottleCtrl4ms_CM_single_A "Q = V" RAT_FUNC "%8.6" "A" COEFFS 0 1 0 0 0 1 /end COMPU_METHOD
/begin COMPU_METHOD TE_TM_ThrottleCtrl4ms_CM_single_Nm "Q = V" RAT_FUNC "%8.6" "Nm" COEFFS 0 1 0 0 0 1 /end COMPU_METHOD
/begin COMPU_METHOD TE_TM_ThrottleCtrl4ms_CM_single_V "Q = V" RAT_FUNC "%8.6" "V" COEFFS 0 1 0 0 0 1 /end COMPU_METHOD
/begin COMPU_METHOD TE_TM_ThrottleCtrl4ms_CM_single__ "Q = V" RAT_FUNC "%8.6" "%" COEFFS 0 1 0 0 0 1 /end COMPU_METHOD
/begin COMPU_METHOD TE_TM_ThrottleCtrl4ms_CM_single_adm "Q = V" RAT_FUNC "%8.6" "adm" COEFFS 0 1 0 0 0 1 /end COMPU_METHOD
/begin COMPU_METHOD TE_TM_ThrottleCtrl4ms_CM_ufix16_En10_A "Q = V*1024.000000" RAT_FUNC "%12.10" "A" COEFFS 0 1024 0 0 0 1 /end COMPU_METHOD
/begin COMPU_METHOD TE_TM_ThrottleCtrl4ms_CM_ufix16_En10_ohm "Q = V*1024.000000" RAT_FUNC "%12.10" "ohm" COEFFS 0 1024 0 0 0 1 /end COMPU_METHOD
/begin COMPU_METHOD TE_TM_ThrottleCtrl4ms_CM_ufix16_En12_Nm "Q = V*4096.000000" RAT_FUNC "%14.12" "Nm" COEFFS 0 4096 0 0 0 1 /end COMPU_METHOD
/begin COMPU_METHOD TE_TM_ThrottleCtrl4ms_CM_ufix16_En13_Nm__s "Q = V*8192.000000" RAT_FUNC "%14.13" "Nm/%s" COEFFS 0 8192 0 0 0 1 /end COMPU_METHOD
/begin COMPU_METHOD TE_TM_ThrottleCtrl4ms_CM_ufix16_En14_Nm_A "Q = V*16384.000000" RAT_FUNC "%15.14" "Nm/A" COEFFS 0 16384 0 0 0 1 /end COMPU_METHOD
/begin COMPU_METHOD TE_TM_ThrottleCtrl4ms_CM_ufix16_En14_Nm__ "Q = V*16384.000000" RAT_FUNC "%15.14" "Nm/%" COEFFS 0 16384 0 0 0 1 /end COMPU_METHOD
/begin COMPU_METHOD TE_TM_ThrottleCtrl4ms_CM_ufix16_En14_Nm__s "Q = V*16384.000000" RAT_FUNC "%15.14" "Nm/%s" COEFFS 0 16384 0 0 0 1 /end COMPU_METHOD
/begin COMPU_METHOD TE_TM_ThrottleCtrl4ms_CM_ufix16_En3_adm "Q = V*8.000000" RAT_FUNC "%7.3" "adm" COEFFS 0 8 0 0 0 1 /end COMPU_METHOD
/begin COMPU_METHOD TE_TM_ThrottleCtrl4ms_CM_ufix16_En4__ "Q = V*16.000000" RAT_FUNC "%8.4" "%" COEFFS 0 16 0 0 0 1 /end COMPU_METHOD
/begin COMPU_METHOD TE_TM_ThrottleCtrl4ms_CM_ufix16_En8__ "Q = V*256.000000" RAT_FUNC "%11.8" "%" COEFFS 0 256 0 0 0 1 /end COMPU_METHOD
/begin COMPU_METHOD TE_TM_ThrottleCtrl4ms_CM_ufix16_S1000_Hz "Q = V/1000.000000" RAT_FUNC "%0.6" "Hz" COEFFS 0 1 0 0 0 1000 /end COMPU_METHOD
/begin COMPU_METHOD TE_TM_ThrottleCtrl4ms_CM_ufix16_S1p53en5_Bn1_Nm "Q = (V+1.000000)*65359.477124" RAT_FUNC "%0.6" "Nm" COEFFS 0 65359.477124 65359.477124 0 0 1 /end COMPU_METHOD
/begin COMPU_METHOD TE_TM_ThrottleCtrl4ms_CM_ufix16_S1p53en5_Nm "Q = V*65359.477124" RAT_FUNC "%0.6" "Nm" COEFFS 0 65359.477124 0 0 0 1 /end COMPU_METHOD
/begin COMPU_METHOD TE_TM_ThrottleCtrl4ms_CM_ufix16_Sp01_adm "Q = V*100.000000" RAT_FUNC "%0.6" "adm" COEFFS 0 100 0 0 0 1 /end COMPU_METHOD
/begin COMPU_METHOD TE_TM_ThrottleCtrl4ms_CM_ufix8_En4_A "Q = V*16.000000" RAT_FUNC "%6.4" "A" COEFFS 0 16 0 0 0 1 /end COMPU_METHOD
/begin COMPU_METHOD TE_TM_ThrottleCtrl4ms_CM_uint16_ms "Q = V" RAT_FUNC "%5.0" "ms" COEFFS 0 1 0 0 0 1 /end COMPU_METHOD
/begin COMPU_METHOD TE_TM_ThrottleCtrl4ms_CM_uint8_adm "Q = V" RAT_FUNC "%3.0" "adm" COEFFS 0 1 0 0 0 1 /end COMPU_METHOD
/begin COMPU_METHOD ThrottleState4ms_Symbol_CM_FixEnableT "Enumerated data type: FixEnableT" TAB_VERB "%0.6" "" COMPU_TAB_REF VTAB_FOR_ThrottleState4ms_Symbol_CM_FixEnableT /end COMPU_METHOD
/begin COMPU_METHOD ThrottleState4ms_Symbol_CM_boolean_adm "Q = V" RAT_FUNC "%1.0" "adm" COEFFS 0 1 0 0 0 1 /end COMPU_METHOD
/begin COMPU_METHOD ThrottleState4ms_Symbol_CM_sfix16_En4__ "Q = V*16.000000" RAT_FUNC "%8.4" "%" COEFFS 0 16 0 0 0 1 /end COMPU_METHOD
/begin COMPU_METHOD ThrottleState4ms_Symbol_CM_ufix16_En10_adm "Q = V*1024.000000" RAT_FUNC "%12.10" "adm" COEFFS 0 1024 0 0 0 1 /end COMPU_METHOD
/begin COMPU_METHOD ThrottleState4ms_Symbol_CM_ufix16_En4__ "Q = V*16.000000" RAT_FUNC "%8.4" "%" COEFFS 0 16 0 0 0 1 /end COMPU_METHOD
/begin COMPU_METHOD ThrottleState4ms_Symbol_CM_uint16_rpm "Q = V" RAT_FUNC "%5.0" "rpm" COEFFS 0 1 0 0 0 1 /end COMPU_METHOD
/begin COMPU_METHOD ThrottleState4ms_Symbol_CM_uint8_adm "Q = V" RAT_FUNC "%3.0" "adm" COEFFS 0 1 0 0 0 1 /end COMPU_METHOD
/begin COMPU_METHOD Thrp4ms_CM_ufix16_En14_adm "Q = V*16384.000000" RAT_FUNC "%15.14" "adm" COEFFS 0 16384 0 0 0 1 /end COMPU_METHOD
/begin COMPU_METHOD Thrp4ms_CM_ufix16_En4_kg_h "Q = V*16.000000" RAT_FUNC "%8.4" "kg/h" COEFFS 0 16 0 0 0 1 /end COMPU_METHOD
/begin COMPU_METHOD Thrp4ms_CM_ufix8_En7_adm "Q = V*128.000000" RAT_FUNC "%8.7" "adm" COEFFS 0 128 0 0 0 1 /end COMPU_METHOD
/begin COMPU_METHOD UEGOHeater4ms_CM_FixEnableT "Enumerated data type: FixEnableT" TAB_VERB "%0.6" "" COMPU_TAB_REF VTAB_FOR_UEGOHeater4ms_CM_FixEnableT /end COMPU_METHOD
/begin COMPU_METHOD UEGOHeater4ms_CM_boolean "Q = V" RAT_FUNC "%1.0" "" COEFFS 0 1 0 0 0 1 /end COMPU_METHOD
/begin COMPU_METHOD UEGOHeater4ms_CM_boolean_adm "Q = V" RAT_FUNC "%1.0" "adm" COEFFS 0 1 0 0 0 1 /end COMPU_METHOD
/begin COMPU_METHOD UEGOHeater4ms_CM_sfix17_En6 "Q = V*64.000000" RAT_FUNC "%14.6" "" COEFFS 0 64 0 0 0 1 /end COMPU_METHOD
/begin COMPU_METHOD UEGOHeater4ms_CM_sfix17_En6_degC "Q = V*64.000000" RAT_FUNC "%14.6" "degC" COEFFS 0 64 0 0 0 1 /end COMPU_METHOD
/begin COMPU_METHOD UEGOHeater4ms_CM_sfix32_En24 "Q = V*16777216.000000" RAT_FUNC "%26.16" "" COEFFS 0 16777216 0 0 0 1 /end COMPU_METHOD
/begin COMPU_METHOD UEGOHeater4ms_CM_sfix32_En24__ "Q = V*16777216.000000" RAT_FUNC "%26.16" "%" COEFFS 0 16777216 0 0 0 1 /end COMPU_METHOD
/begin COMPU_METHOD UEGOHeater4ms_CM_ufix16_Bn40_degC "Q = (V+40.000000)/1.000000" RAT_FUNC "%0.6" "degC" COEFFS 0 1 40 0 0 1 /end COMPU_METHOD
/begin COMPU_METHOD UEGOHeater4ms_CM_ufix16_En10_adm "Q = V*1024.000000" RAT_FUNC "%12.10" "adm" COEFFS 0 1024 0 0 0 1 /end COMPU_METHOD
/begin COMPU_METHOD UEGOHeater4ms_CM_ufix16_En6_B600_degC "Q = (V-600.000000)*64.000000" RAT_FUNC "%0.6" "degC" COEFFS 0 64 -38400 0 0 1 /end COMPU_METHOD
/begin COMPU_METHOD UEGOHeater4ms_CM_ufix16_En6_Ohm "Q = V*64.000000" RAT_FUNC "%10.6" "Ohm" COEFFS 0 64 0 0 0 1 /end COMPU_METHOD
/begin COMPU_METHOD UEGOHeater4ms_CM_ufix16_En6_degC "Q = V*64.000000" RAT_FUNC "%10.6" "degC" COEFFS 0 64 0 0 0 1 /end COMPU_METHOD
/begin COMPU_METHOD UEGOHeater4ms_CM_ufix16_Sp004_sec "Q = V*250.000000" RAT_FUNC "%0.6" "sec" COEFFS 0 250 0 0 0 1 /end COMPU_METHOD
/begin COMPU_METHOD UEGOHeater4ms_CM_ufix16_Sp05_V "Q = V*20.000000" RAT_FUNC "%0.6" "V" COEFFS 0 20 0 0 0 1 /end COMPU_METHOD
/begin COMPU_METHOD UEGOHeater4ms_CM_ufix16_Sp1_sec "Q = V*10.000000" RAT_FUNC "%0.6" "sec" COEFFS 0 10 0 0 0 1 /end COMPU_METHOD
/begin COMPU_METHOD UEGOHeater4ms_CM_ufix32_En24 "Q = V*16777216.000000" RAT_FUNC "%26.16" "" COEFFS 0 16777216 0 0 0 1 /end COMPU_METHOD
/begin COMPU_METHOD UEGOHeater4ms_CM_ufix32_En24__ "Q = V*16777216.000000" RAT_FUNC "%26.16" "%" COEFFS 0 16777216 0 0 0 1 /end COMPU_METHOD
/begin COMPU_METHOD UEGOHeater4ms_CM_ufix8_En4_Vrms "Q = V*16.000000" RAT_FUNC "%6.4" "Vrms" COEFFS 0 16 0 0 0 1 /end COMPU_METHOD
/begin COMPU_METHOD UEGOHeater4ms_CM_ufix8_En8_Vrms_s "Q = V*256.000000" RAT_FUNC "%9.8" "Vrms/s" COEFFS 0 256 0 0 0 1 /end COMPU_METHOD
/begin COMPU_METHOD UEGOHeater4ms_CM_uint8 "Q = V" RAT_FUNC "%3.0" "" COEFFS 0 1 0 0 0 1 /end COMPU_METHOD
/begin COMPU_VTAB VTAB_FOR_ETCLearning4ms_CM_FixEnableT "Enumerated data type: FixEnableT" TAB_VERB 2 171 "Enable" 218 "Disable" /end COMPU_VTAB
/begin COMPU_VTAB VTAB_FOR_EgmdTDC_CM_eTHRP_adm "Enumerated data type: eTHRP" TAB_VERB 3 0 "CLOSED_THROTTLE" 1 "MEDIUM_THROTTLE" 2 "OPEN_THROTTLE" /end COMPU_VTAB
/begin COMPU_VTAB VTAB_FOR_J1939dl_Tx50ms_CM_eEGMD_adm "Enumerated data type: eEGMD" TAB_VERB 5 0 "NOT_DETERM" 1 "CRANK" 2 "IDLE" 3 "NORMAL" 4 "CUT_OFF" /end COMPU_VTAB
/begin COMPU_VTAB VTAB_FOR_J1939dl_Tx50ms_CM_eEGST_adm "Enumerated data type: eEGST" TAB_VERB 7 0 "POWER_ON" 1 "WAIT" 2 "RUN" 3 "POWER_LATCH" 4 "POWER_OFF" 5 "SHUTDOWN" 6 "ACTDIAG_WAIT" /end COMPU_VTAB
/begin COMPU_VTAB VTAB_FOR_J1939dl_Tx50ms_CM_tFault_adm "Enumerated data type: tFault" TAB_VERB 89 0 "NO_FAULT" 1 "SIGNAL_TOO_LOW" 2 "SIGNAL_TOO_BIG" 3 "SC_TO_BATTERY" 4 "SC_TO_GND" 5 "SIGNAL_NOT_PLAUSIBLE" 6 "OC_OR_SC_TO_BATTERY" 7 "OC_OR_SC_TO_GND" 8 "OC" 9 "NO_SIGNAL" 10 "SIGNAL_DELAYED" 11 "TRASMISSION_IMPOSSIBLE" 12 "COMPONENT_DAMAGED" 13 "TEST_CONDITION_NOT_CORRECT" 14 "MECHANICAL_PROBLEM" 15 "GENERIC_FAULT" 16 "DERIVATIVE_TOO_HIGH" 17 "DERIVATIVE_TOO_LOW" 18 "CONTROL_ERROR" 19 "ALIM_KO" 20 "ADC_KO" 21 "CAN_OFF" 22 "AIRQCONTROL_ERROR" 23 "FBCONTROL_ERROR" 24 "RPCONTROL_ERROR" 25 "SAFETY_KO" 26 "SC_HS_LS" 27 "SC_TO_GND_HS" 28 "TPU_ERROR" 29 "OC_OR_SC_TO_GND_LS" 30 "SC_TO_BAT_LS" 31 "OVERTEMPERATURE" 32 "SC_TO_GND_LS" 33 "SC_TO_BAT_HS" 34 "CLOSED" 35 "OPEN" 36 "LOAD_DUMP" 37 "STUCK_OPEN" 38 "STUCK_CLOSED" 39 "UNKNOWN_STATE" 40 "UNDERVOLTAGE" 41 "STUCK_ON" 42 "STUCK_OFF" 43 "ON" 44 "OFF" 45 "THR_INCOHERENCE" 46 "PDL_INCOHERENCE" 47 "POT_2_FAULT" 48 "QAIR_UNDER_ESTIM" 49 "QAIR_OVER_ESTIM" 50 "RSCOPEN_ERROR" 51 "RSCWAIT_ERROR" 52 "RSCCLOSE_ERROR" 53 "OSCCLOSE_ERROR" 54 "OSCOPEN_ERROR" 55 "DTC_ERROR" 56 "NLP_ERROR" 57 "UMA_ERROR" 58 "TEMP_PREWARNING" 59 "TEMP_WARNING" 60 "THR_LRN_ERROR" 61 "COMM_ERROR" 62 "MMP_ERROR" 63 "SMP_ERROR" 64 "EOBD_ERROR" 65 "ENERGY_ERROR" 66 "GAIN_ERROR" 67 "KO2_HPRAIL_ERROR" 68 "KO2_LPRAIL_ERROR" 69 "OFFS_ERROR" 70 "SWT_INCOHERENCE" 71 "MFLV_INCOHERENCE" 72 "SET_PLUS_FAULT" 73 "SET_MINUS_FAULT" 74 "OFF_FAULT" 75 "SET_FAULT" 76 "RESUME_FAULT" 77 "HOLD_FAULT" 78 "STOP_CABIN_TILT_FAULT" 79 "START_CABIN_TILT_FAULT" 80 "STUCK_CLOSED_OR_OPEN_LOAD" 81 "OVERCURR" 82 "CAM_NTEETH_INCOHERENCE" 83 "CAM_POS_INCOHERENCE" 84 "SERIAL_ERROR" 85 "CHIP_FAULT" 86 "SC_PHASES" 87 "NUMBER_OF_FAULT" 88 "ANY_FAULT" /end COMPU_VTAB
/begin COMPU_VTAB VTAB_FOR_KnockTDC_CM_eEGMD_adm "Enumerated data type: eEGMD" TAB_VERB 5 0 "NOT_DETERM" 1 "CRANK" 2 "IDLE" 3 "NORMAL" 4 "CUT_OFF" /end COMPU_VTAB
/begin COMPU_VTAB VTAB_FOR_LambdaHeater100ms_CM_FixEnableT "Enumerated data type: FixEnableT" TAB_VERB 2 171 "Enable" 218 "Disable" /end COMPU_VTAB
/begin COMPU_VTAB VTAB_FOR_LambdaPostTDC_Symbol_CM_FixEnableT "Enumerated data type: FixEnableT" TAB_VERB 2 171 "Enable" 218 "Disable" /end COMPU_VTAB
/begin COMPU_VTAB VTAB_FOR_LambdaPreTDC_CM_FixEnableT "Enumerated data type: FixEnableT" TAB_VERB 2 171 "Enable" 218 "Disable" /end COMPU_VTAB
/begin COMPU_VTAB VTAB_FOR_MisfdTDC_CM_eEGMD_adm "Enumerated data type: eEGMD" TAB_VERB 5 0 "NOT_DETERM" 1 "CRANK" 2 "IDLE" 3 "NORMAL" 4 "CUT_OFF" /end COMPU_VTAB
/begin COMPU_VTAB VTAB_FOR_TE_DrivePedal4ms_Symbol_CM_FixEnableT "Enumerated data type: FixEnableT" TAB_VERB 2 171 "Enable" 218 "Disable" /end COMPU_VTAB
/begin COMPU_VTAB VTAB_FOR_TE_TM_Adv_Ctrl4ms_Symbol_CM_FixEnableT "Enumerated data type: FixEnableT" TAB_VERB 2 171 "Enable" 218 "Disable" /end COMPU_VTAB
/begin COMPU_VTAB VTAB_FOR_TE_TM_Cmu_Ctrl4ms_Symbol_CM_FixEnableT "Enumerated data type: FixEnableT" TAB_VERB 2 171 "Enable" 218 "Disable" /end COMPU_VTAB
/begin COMPU_VTAB VTAB_FOR_TE_TM_CndAbilTHRST4ms_CM_FixEnableT "Enumerated data type: FixEnableT" TAB_VERB 2 171 "Enable" 218 "Disable" /end COMPU_VTAB
/begin COMPU_VTAB VTAB_FOR_TE_TM_CtrlThrotMgm4ms_CM_FixEnableT "Enumerated data type: FixEnableT" TAB_VERB 2 171 "Enable" 218 "Disable" /end COMPU_VTAB
/begin COMPU_VTAB VTAB_FOR_TE_TM_Enable_Idle4ms_Symbol_CM_FixEnableT "Enumerated data type: FixEnableT" TAB_VERB 2 171 "Enable" 218 "Disable" /end COMPU_VTAB
/begin COMPU_VTAB VTAB_FOR_TE_TM_FFW4ms_Symbol_CM_FixEnableT "Enumerated data type: FixEnableT" TAB_VERB 2 171 "Enable" 218 "Disable" /end COMPU_VTAB
/begin COMPU_VTAB VTAB_FOR_TE_TM_LowIdle_Gov_100ms_Symbol_CM_FixEnableT "Enumerated data type: FixEnableT" TAB_VERB 2 171 "Enable" 218 "Disable" /end COMPU_VTAB
/begin COMPU_VTAB VTAB_FOR_TE_TM_Target4ms_CM_FixEnableT "Enumerated data type: FixEnableT" TAB_VERB 2 171 "Enable" 218 "Disable" /end COMPU_VTAB
/begin COMPU_VTAB VTAB_FOR_TE_TM_ThrottleCtrl4ms_CM_FixEnableT "Enumerated data type: FixEnableT" TAB_VERB 2 171 "Enable" 218 "Disable" /end COMPU_VTAB
/begin COMPU_VTAB VTAB_FOR_ThrottleState4ms_Symbol_CM_FixEnableT "Enumerated data type: FixEnableT" TAB_VERB 2 171 "Enable" 218 "Disable" /end COMPU_VTAB
/begin COMPU_VTAB VTAB_FOR_UEGOHeater4ms_CM_FixEnableT "Enumerated data type: FixEnableT" TAB_VERB 2 171 "Enable" 218 "Disable" /end COMPU_VTAB
/begin RECORD_LAYOUT Lookup1D_UWORD FNC_VALUES 1 UWORD COLUMN_DIR DIRECT /end RECORD_LAYOUT
/begin RECORD_LAYOUT Lookup1D_WORD FNC_VALUES 1 SWORD COLUMN_DIR DIRECT /end RECORD_LAYOUT
/begin RECORD_LAYOUT Lookup1D_X_UWORD AXIS_PTS_X 1 UWORD INDEX_INCR DIRECT /end RECORD_LAYOUT
/begin RECORD_LAYOUT Lookup2DSF_UWORD FNC_VALUES 1 UWORD ROW_DIR DIRECT /end RECORD_LAYOUT
/begin RECORD_LAYOUT Lookup2D_UWORD FNC_VALUES 1 UWORD COLUMN_DIR DIRECT /end RECORD_LAYOUT
/begin RECORD_LAYOUT Lookup2D_X_UWORD AXIS_PTS_X 1 UWORD INDEX_INCR DIRECT /end RECORD_LAYOUT
/begin RECORD_LAYOUT Scalar_BOOLEAN FNC_VALUES 1 UBYTE COLUMN_DIR DIRECT /end RECORD_LAYOUT
/begin RECORD_LAYOUT Scalar_BYTE FNC_VALUES 1 SBYTE COLUMN_DIR DIRECT /end RECORD_LAYOUT
/begin RECORD_LAYOUT Scalar_LONG FNC_VALUES 1 SLONG COLUMN_DIR DIRECT /end RECORD_LAYOUT
/begin RECORD_LAYOUT Scalar_SWORD FNC_VALUES 1 SWORD COLUMN_DIR DIRECT /end RECORD_LAYOUT
/begin RECORD_LAYOUT Scalar_UBYTE FNC_VALUES 1 UBYTE COLUMN_DIR DIRECT /end RECORD_LAYOUT
/begin RECORD_LAYOUT Scalar_ULONG FNC_VALUES 1 ULONG COLUMN_DIR DIRECT /end RECORD_LAYOUT
/begin RECORD_LAYOUT Scalar_UWORD FNC_VALUES 1 UWORD COLUMN_DIR DIRECT /end RECORD_LAYOUT
/end MODULE
/end PROJECT
