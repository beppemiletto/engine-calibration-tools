ASAP2_VERSION 1 70
/begin PROJECT XCPonCANFD "Generated for ETAS and Vector "
/begin MODULE XCPonCANFD "Generated for ETAS and Vector "
/begin MOD_COMMON "XCPonCANFD" BYTE_ORDER MSB_FIRST ALIGNMENT_BYTE 1 ALIGNMENT_WORD 2 ALIGNMENT_LONG 4 ALIGNMENT_FLOAT32_IEEE 4 ALIGNMENT_FLOAT64_IEEE 8 ALIGNMENT_INT64 8 /end MOD_COMMON
/begin AXIS_PTS ckRPM_H_BKP "[YBK] Soglia di warning sulla pressione olio" 0xFC84F0 NO_INPUT_QUANTITY Lookup2D_X_UWORD 0 EDC2BC_Tx_50ms_CM_uint16_rpm 5 0 10000 /end AXIS_PTS
/begin AXIS_PTS ckTOIL_V_BKP "[XBK] Soglia di warning sulla pressione olio" 0xFC84E6 NO_INPUT_QUANTITY Lookup2D_X_UWORD 0 EDC2BC_Tx_50ms_CM_ufix16_Bn40_degC 5 -40 130 /end AXIS_PTS
/begin CHARACTERISTIC csERC1_ER_ENABLE "Abilitazione Messaggio J1939 - ERC1_ER" VALUE 0xFC83D0 Scalar_BOOLEAN 0 ERC1_ER_Tx_1s_CM_boolean_adm 0 1 /end CHARACTERISTIC
/begin CHARACTERISTIC csET2_ENABLE "Abilitazione Messaggio J1939 - ET2" VALUE 0xFC83CF Scalar_BOOLEAN 0 ET2_Tx_1s_CM_boolean_adm 0 1 /end CHARACTERISTIC
/begin MEASUREMENT csEnvParDay "Parametro ambientale (giorno) dervato dal msg CAN Rx TimeDate" UBYTE DiagSym100ms_CM_ufix8_En2_day 0 0 0 31.75 ECU_ADDRESS 0x40003355 /end MEASUREMENT
/begin MEASUREMENT csEnvParHours "Informazione (TimeDate) oraria da utilizzare come Parametro Ambientale per la Diagnosi" UBYTE DiagSym100ms_CM_uint8_hour 0 0 0 23 ECU_ADDRESS 0x40003358 /end MEASUREMENT
/begin MEASUREMENT csEnvParMinutes "nformazione (TimeDate) dei minuti primi da utilizzare come Parametro Ambientale per la Diagnosi" UBYTE DiagSym100ms_CM_uint8_min 0 0 0 59 ECU_ADDRESS 0x40003359 /end MEASUREMENT
/begin MEASUREMENT csEnvParMonth "nformazione (TimeDate) del mese da utilizzare come Parametro Ambientale per la Diagnosi" UBYTE DiagSym100ms_CM_uint8_month 0 0 1 12 ECU_ADDRESS 0x40003357 /end MEASUREMENT
/begin MEASUREMENT csEnvParSeconds "nformazione (TimeDate) dei secondi da utilizzare come Parametro Ambientale per la Diagnosi" UBYTE DiagSym100ms_CM_ufix8_En2_sec 0 0 0 59.75 ECU_ADDRESS 0x40003356 /end MEASUREMENT
/begin MEASUREMENT csEnvParYear "Parametro ambientale (anno) derivato dal msg CAN Rx TimeDate (rispetto al 1985)" UBYTE DiagSym100ms_CM_ufix8_B1985_year 0 0 1985 2235 ECU_ADDRESS 0x40003354 /end MEASUREMENT
/begin CHARACTERISTIC csFAN2_ACT_REQ_REC "Valore di recovery sulla gestione Elettroventole" VALUE 0xFC831B Scalar_BOOLEAN 0 BC2EDC2_Rx_50ms_CM_boolean_adm 0 1 /end CHARACTERISTIC
/begin CHARACTERISTIC csFAN_ACT_REQ_PWM_REC "Valore di recovery sul PWM attuato sulle elettroventole" VALUE 0xFC831A Scalar_UBYTE 0 BC2EDC2_Rx_50ms_CM_ufix8_Sp4__ 0 100 /end CHARACTERISTIC
/begin MEASUREMENT csFanActPwm "PWM command related to FAN1 received through CAN" UBYTE FanCool100ms_CM_ufix8_Sp4__ 0 0 0 100 ECU_ADDRESS 0x40003390 /end MEASUREMENT
/begin MEASUREMENT csFanReq "Richiesta gestione Elettroventole" UBYTE J1939dl_Rx50ms_CM_boolean_adm 0 0 0 1 ECU_ADDRESS 0x4000339A /end MEASUREMENT
/begin MEASUREMENT csGearCoupled "Informazione di cambio accoppiato" UBYTE Dcat_Diagnosis100ms_CM_boolean_adm 0 0 0 1 ECU_ADDRESS 0x40004659 /end MEASUREMENT
/begin CHARACTERISTIC csHDSECU1_ENABLE "Abilitazione Messaggio J1939 - MF3ECU1" VALUE 0xFC84E1 Scalar_BOOLEAN 0 HDSECU1_Tx_50ms_CM_boolean_adm 0 1 /end CHARACTERISTIC
/begin CHARACTERISTIC csHDSECU2_ENABLE "Abilitazione Messaggio J1939 - MF3ECU2" VALUE 0xFC84E0 Scalar_BOOLEAN 0 HDSECU2_Tx_50ms_CM_boolean_adm 0 1 /end CHARACTERISTIC
/begin CHARACTERISTIC csHEATER_CTRL_FAIL_REC "Recovery on Heater Control Fail Diagnosis Uego Sensor (01-Fail 00-No Fail)" VALUE 0xFC8319 Scalar_BOOLEAN 0 USS_Rx_50ms_CM_boolean_adm 0 1 /end CHARACTERISTIC
/begin CHARACTERISTIC csHIGH_GOV_REC "Valore di recovery su high governor parameter set" VALUE 0xFC8318 Scalar_UBYTE 0 VCM2ECM_Rx_50ms_CM_uint8_adm 0 7 /end CHARACTERISTIC
/begin CHARACTERISTIC csHIGH_IDLE_REC "Valore di recovery sul low idle set point" VALUE 0xFC8316 Scalar_UWORD 0 VCM2ECM_Rx_50ms_CM_ufix16_En3_rpm 0 8031.875 /end CHARACTERISTIC
/begin CHARACTERISTIC csHOURS_REC "Valore di recovery sulle ore" VALUE 0xFC82AB Scalar_UBYTE 0 TIMEDATE_Rx_1s_CM_uint8_h 0 23 /end CHARACTERISTIC
/begin MEASUREMENT csHeaterCtrlFailUEGO "eater Ctrl Failure on Uego Sensor (1-Fail,0-No Fail)" UBYTE J1939dl_Rx50ms_CM_boolean_adm 0 0 0 1 ECU_ADDRESS 0x40003395 /end MEASUREMENT
/begin MEASUREMENT csHighGov "High Idle Governor parameter set [values: 0..3]" UBYTE J1939dl_Rx50ms_CM_uint8_adm 0 0 0 3 ECU_ADDRESS 0x4000339F /end MEASUREMENT
/begin MEASUREMENT csHighIdle "High Idle Speed SetPoint from CAN" UWORD Idle4ms_CM_uint16_rpm 0 0 0 6000 ECU_ADDRESS 0x400033B8 /end MEASUREMENT
/begin MEASUREMENT csHighRpmCmd "High Engine Speed Lamp Command" UBYTE DLCC1_Tx_1s_CM_uint8_adm 0 0 0 3 ECU_ADDRESS 0x4000341B /end MEASUREMENT
/begin CHARACTERISTIC csINIT_DIRECTION "Set the initialization direction (from the component connector view, 1 -zero position is on the right [CCW Counterclockwise] ; 0 - zero position is on the left [CW Clockwise])." VALUE 0xFC2C1E Scalar_BOOLEAN 0 ECU2TURBO_Tx_4ms_CM_boolean_adm 0 1 /end CHARACTERISTIC
/begin CHARACTERISTIC csINIT_REQUEST "Force the initialization routine ( 1 - Request; 0 - No request)." VALUE 0xFC2C1D Scalar_BOOLEAN 0 ECU2TURBO_Tx_4ms_CM_boolean_adm 0 1 /end CHARACTERISTIC
/begin CHARACTERISTIC csINLETCOND_ENABLE "Abilitazione Messaggio J1939 - INLETCOND" VALUE 0xFC836E Scalar_BOOLEAN 0 INLET_COND_Tx_100ms_CM_boolean_adm 0 1 /end CHARACTERISTIC
/begin CHARACTERISTIC csINT_GOV_REC "Valore di recovery su Intermediate Speed Governor parameter set" VALUE 0xFC8314 Scalar_UBYTE 0 VCM2ECM_Rx_50ms_CM_uint8_adm 0 7 /end CHARACTERISTIC
/begin CHARACTERISTIC csIP_CURRENT_REC "Recovery on current Ip of Uego Sensor (-12mA to 12mA)" VALUE 0xFC8312 Scalar_SWORD 0 USS_Rx_50ms_CM_sfix16_Sp001_Bn15_mA -12 12 /end CHARACTERISTIC
/begin MEASUREMENT csInitWaitInfo "Initializing Wait info communicated by TURBO CONTROLLER (0 -Null;1- Wait)" UBYTE CanPvt_Rx4ms_CM_boolean_adm 0 0 0 1 ECU_ADDRESS 0x400022D4 /end MEASUREMENT
/begin MEASUREMENT csIntGov "Intermediate Speed Governor parameter set [values: 0..7 (4..6 Not used)]" UBYTE J1939dl_Rx50ms_CM_uint8_adm 0 0 0 7 ECU_ADDRESS 0x4000339E /end MEASUREMENT
/begin MEASUREMENT csIpCurrentUEGO "urrent Ip of Uego Sensor (-12mA to 12mA)" SWORD J1939dl_Rx50ms_CM_sfix16_Sp001_Bn15_mA 0 0 -12 12 ECU_ADDRESS 0x400033B2 /end MEASUREMENT
/begin MEASUREMENT csKeySwBatPot "SPN 158 - Key Switch Battery Potential" UWORD VEP1_Tx_1s_CM_ufix16_Sp05_V 0 0 0 3212.75 ECU_ADDRESS 0x4000345A /end MEASUREMENT
/begin MEASUREMENT csKeySwBatPotCAN "Key Switch Battery Potential (MsgTxCAN VEP1 - Byte 7,8)" UWORD VEP1_Tx_1s_CM_uint16_adm 0 0 0 65535 ECU_ADDRESS 0x40003458 /end MEASUREMENT
/begin CHARACTERISTIC csLFC1_ENABLE "Abilitazione Messaggio J1939 - LFC1" VALUE 0xFC83CE Scalar_BOOLEAN 0 LFC1_Tx_1s_CM_boolean_adm 0 1 /end CHARACTERISTIC
/begin CHARACTERISTIC csLFE1_ENABLE "Abilitazione Messaggio J1939 - LFE1" VALUE 0xFC836D Scalar_BOOLEAN 0 LFE1_Tx_100ms_CM_boolean_adm 0 1 /end CHARACTERISTIC
/begin CHARACTERISTIC csLOW_GOV_REC "Valore di recovery sul low Governor parameter set" VALUE 0xFC8310 Scalar_UBYTE 0 VCM2ECM_Rx_50ms_CM_uint8_adm 0 7 /end CHARACTERISTIC
/begin CHARACTERISTIC csLOW_IDLE_REC "Valore di recovery sul low idle set point" VALUE 0xFC830E Scalar_UWORD 0 VCM2ECM_Rx_50ms_CM_ufix16_En3_rpm 0 8031.875 /end CHARACTERISTIC
/begin CHARACTERISTIC csLTD_SHUTD_SPD "Valore di velocità veicolo oltre il quale si ignora la richiesta di shutdown" VALUE 0xFC830D Scalar_UBYTE 0 BC2EDC2_Rx_50ms_CM_uint8_km_h 0 255 /end CHARACTERISTIC
/begin MEASUREMENT csLowBattCmd "Low Battery Voltage Lamp Command" UBYTE DLCC2_Tx_1s_CM_uint8_adm 0 0 0 3 ECU_ADDRESS 0x40003421 /end MEASUREMENT
/begin MEASUREMENT csLowFuelCmd "Low Fuel Level Lamp Command" UBYTE DLCC2_Tx_1s_CM_uint8_adm 0 0 0 3 ECU_ADDRESS 0x40003420 /end MEASUREMENT
/begin MEASUREMENT csLowGov "Low Idle Governor parameter set [values: 0..3]" UBYTE Idle100ms_CM_uint8_adm 0 0 0 3 ECU_ADDRESS 0x400033A0 /end MEASUREMENT
/begin MEASUREMENT csLowIdle "Low Idle Speed SetPoint from CAN" UWORD Idle4ms_CM_uint16_rpm 0 0 0 3000 ECU_ADDRESS 0x400033B6 /end MEASUREMENT
/begin MEASUREMENT csLowOilCmd "Low Level Engine Oil Lamp Command" UBYTE DLCC1_Tx_1s_CM_uint8_adm 0 0 0 3 ECU_ADDRESS 0x4000341A /end MEASUREMENT
/begin CHARACTERISTIC csMECH_PTO_ENG_REC "Valore di recovery su Mechanical PTO Engaged" VALUE 0xFC830C Scalar_UBYTE 0 BC2EDC2_Rx_50ms_CM_uint8_adm 0 1 /end CHARACTERISTIC
/begin CHARACTERISTIC csMIL_AVAIL_REC "Recovery sulla disponibilità MIL (0 available; 1 not available)" VALUE 0xFC830B Scalar_BOOLEAN 0 BC2EDC1_Rx_50ms_CM_boolean_adm 0 1 /end CHARACTERISTIC
/begin CHARACTERISTIC csMINUTES_REC "Valore di recovery sui minuti" VALUE 0xFC82AA Scalar_UBYTE 0 TIMEDATE_Rx_1s_CM_uint8_min 0 59 /end CHARACTERISTIC
/begin CHARACTERISTIC csMONTH_REC "Valore di recovery sui mesi" VALUE 0xFC82A9 Scalar_UBYTE 0 TIMEDATE_Rx_1s_CM_uint8_month 1 12 /end CHARACTERISTIC
/begin CHARACTERISTIC csMVS_ENABLE "Abilitazione Messaggio J1939 - MVS" VALUE 0xFC83CD Scalar_BOOLEAN 0 MVS_Tx_1s_CM_boolean_adm 0 1 /end CHARACTERISTIC
/begin MEASUREMENT csMechPTOEng "PTO meccanica collegata" UBYTE J1939dl_Rx50ms_CM_uint8_adm 0 0 0 3 ECU_ADDRESS 0x400033A9 /end MEASUREMENT
/begin MEASUREMENT csMemAccessAbnorm "Memory Accessl Abnormal Fault communicated by TURBO CONTROLLER (0 - No Fault)" UBYTE CanPvt_Rx4ms_CM_boolean_adm 0 0 0 1 ECU_ADDRESS 0x400022D7 /end MEASUREMENT
/begin MEASUREMENT csMilAvail "Disponibilita MIL lamp (da CAN)" UBYTE J1939dl_Rx50ms_CM_boolean_adm 0 0 0 1 ECU_ADDRESS 0x4000339D /end MEASUREMENT
/begin MEASUREMENT csMilCmd "MIL Command" UBYTE DLCC1_Tx_1s_CM_uint8_adm 0 0 0 3 ECU_ADDRESS 0x40003419 /end MEASUREMENT
/begin MEASUREMENT csMotorShortFault "Motor Short Fault communicated by TURBO CONTROLLER (0-No Fault)" UBYTE CanPvt_Rx4ms_CM_boolean_adm 0 0 0 1 ECU_ADDRESS 0x400022DE /end MEASUREMENT
/begin CHARACTERISTIC csNEUTRAL_REC "Valore di recovery sul Neutral" VALUE 0xFC830A Scalar_UBYTE 0 BC2EDC2_Rx_50ms_CM_uint8_adm 0 1 /end CHARACTERISTIC
/begin MEASUREMENT csNeutral "Stato del Neutral (folle inserita)" UBYTE J1939dl_Rx50ms_CM_boolean_adm 0 0 0 1 ECU_ADDRESS 0x4000339B /end MEASUREMENT
/begin MEASUREMENT csO2ConcUEGO "2 Concentration of Uego Sensor (-30% to 130%)" SWORD Ctit_LambdaCtrlTDC_CM_sfix16_Sp01_Bn40p96__ 0 0 -30 30 ECU_ADDRESS 0x400033B0 /end MEASUREMENT
/begin MEASUREMENT csO2StableUEGO "2 concentration stability on Uego Sensor (1-Stable,0-Not Stable)" UBYTE Ctit_LambdaCtrlTDC_CM_uint8_adm 0 0 0 1 ECU_ADDRESS 0x400033A2 /end MEASUREMENT
/begin MEASUREMENT csOK_Bc2Edc "RX Message available" UBYTE J1939dl_Rx50ms_CM_uint8_adm 0 0 0 2 ECU_ADDRESS 0x400033AA /end MEASUREMENT
/begin MEASUREMENT csOK_Bc2Edc1 "RX Message available" UBYTE J1939dl_Rx50ms_CM_uint8_adm 0 0 0 2 ECU_ADDRESS 0x400033AC /end MEASUREMENT
/begin MEASUREMENT csOK_Ccvs_R "RX Message available" UBYTE J1939dl_Rx100ms_CM_uint8_adm 0 0 0 2 ECU_ADDRESS 0x40003339 /end MEASUREMENT
/begin MEASUREMENT csOK_Epr2Ecm "RX Message EPR2ECM available (0 = Message Not Ok, 1 = Message Ok, 2 = Same Value Not Ok)" UBYTE Epr4ms_CM_uint8_adm 0 0 0 2 ECU_ADDRESS 0x40003334 /end MEASUREMENT
/begin MEASUREMENT csOK_Etc1 "RX Message available" UBYTE J1939dl_Rx4ms_CM_uint8_adm 0 0 0 2 ECU_ADDRESS 0x40003370 /end MEASUREMENT
/begin MEASUREMENT csOK_Etc2 "RX Message available" UBYTE J1939dl_Rx100ms_CM_uint8_adm 0 0 0 2 ECU_ADDRESS 0x40003332 /end MEASUREMENT
/begin MEASUREMENT csOK_Tco1 "RX Message status (0 = Message Not Ok, 1 = Message Ok, 2 = Same Value Not Ok)" UBYTE J1939dl_Rx50ms_CM_uint8_adm 0 0 0 2 ECU_ADDRESS 0x400033A8 /end MEASUREMENT
/begin MEASUREMENT csOK_TimeDate "RX Message available" UBYTE DiagSym100ms_CM_uint8_adm 0 0 0 2 ECU_ADDRESS 0x4000335A /end MEASUREMENT
/begin MEASUREMENT csOK_Tsc1TrRetarder_R "RX Message available" UBYTE Egbrk50ms_CM_uint8_adm 0 0 0 2 ECU_ADDRESS 0x400033A7 /end MEASUREMENT
/begin MEASUREMENT csOK_Tsc1VeControl2_R "RX Message available" UBYTE J1939dl_Rx4ms_CM_uint8_adm 0 0 0 2 ECU_ADDRESS 0x4000336F /end MEASUREMENT
/begin MEASUREMENT csOK_Tsc1VeControl_R "RX Message available" UBYTE J1939dl_Rx4ms_CM_uint8_adm 0 0 0 2 ECU_ADDRESS 0x4000336B /end MEASUREMENT
/begin MEASUREMENT csOK_Tsc1VeLimit_R "RX Message available" UBYTE J1939dl_Rx4ms_CM_uint8_adm 0 0 0 2 ECU_ADDRESS 0x40003367 /end MEASUREMENT
/begin MEASUREMENT csOK_Turbo2Ecu "TURBO2ECU (CAN PVT) RX Message available [0: OK, 1: Not in time, 2: Not in range]" UBYTE CanPvt_Rx4ms_CM_uint8_adm 0 0 0 2 ECU_ADDRESS 0x400022DF /end MEASUREMENT
/begin MEASUREMENT csOK_USS "x message avaible" UBYTE Ctit_LambdaCtrlTDC_CM_uint8_adm 0 0 0 2 ECU_ADDRESS 0x400033A3 /end MEASUREMENT
/begin MEASUREMENT csOK_Vcm2Ecm "RX Message available" UBYTE J1939dl_Rx50ms_CM_uint8_adm 0 0 0 2 ECU_ADDRESS 0x400033A1 /end MEASUREMENT
/begin CHARACTERISTIC csOP_RANGE_MON "Recovery value for field Operating Range communicated by TURBO CONTROLLER" VALUE 0xFC2BF3 Scalar_UBYTE 0 TURBO2ECU_Rx_4ms_CM_ufix8_Sp416_deg 0 106.08 /end CHARACTERISTIC
/begin CHARACTERISTIC csOUT_SHF_SPD_REC "Valore di recovery sulla velocità della distribuzione fra gearbox e differenziale" VALUE 0xFC82CE Scalar_UWORD 0 ETC1_Rx_4ms_CM_ufix16_En3_rpm 0 8031.875 /end CHARACTERISTIC
/begin MEASUREMENT csOilPressState "Stato pressione olio" UBYTE EDC2BC_Tx_50ms_CM_uint8_adm 0 0 0 3 ECU_ADDRESS 0x40003480 /end MEASUREMENT
/begin MEASUREMENT csOpMode "Operation Mode communicated by TURBO CONTROLLER (0 - Supply OFF Impossibile; 1- Supply OFF Possibile)" UBYTE CanPvt_Rx4ms_CM_boolean_adm 0 0 0 1 ECU_ADDRESS 0x400022D3 /end MEASUREMENT
/begin MEASUREMENT csOpRangeAbnorm "Operating Range Abnormal Value Fault communicated by TURBO CONTROLLER (0 - No Fault)" UBYTE CanPvt_Rx4ms_CM_boolean_adm 0 0 0 1 ECU_ADDRESS 0x400022DA /end MEASUREMENT
/begin MEASUREMENT csOpRangeMon "Operating Range communicated by TURBO CONTROLLER" UBYTE CanPvt_Rx4ms_CM_ufix8_Sp416_deg 0 0 0 106.08 ECU_ADDRESS 0x400022CF /end MEASUREMENT
/begin MEASUREMENT csOutShaftSpd "Info velocità a monte del differenziale" UWORD J1939dl_Rx4ms_CM_uint16_rpm 0 0 0 10000 ECU_ADDRESS 0x4000337E /end MEASUREMENT
/begin CHARACTERISTIC csPARK_BRK_REC "Valore di recovery sul freno di stazionamento" VALUE 0xFC8264 Scalar_BOOLEAN 0 CCVS_Rx_100ms_CM_boolean_adm 0 1 /end CHARACTERISTIC
/begin CHARACTERISTIC csPROPB_0A_ENABLE "Abilitazione Messaggio J1939 - PropB_0A" VALUE 0xFC836C Scalar_BOOLEAN 0 PropB_0A_Tx_100ms_CM_boolean_adm 0 1 /end CHARACTERISTIC
/begin MEASUREMENT csPTOState_R "PTO state from CCVS CAN Rx" UBYTE J1939dl_Rx100ms_CM_uint8_adm 0 0 0 31 ECU_ADDRESS 0x40003338 /end MEASUREMENT
/begin CHARACTERISTIC csPTO_STATE_REC "Valore di recovery sullo stato PTO" VALUE 0xFC8263 Scalar_UBYTE 0 CCVS_Rx_100ms_CM_uint8_adm 0 17 /end CHARACTERISTIC
/begin MEASUREMENT csParkBrk "Parking Brake switch from CAN Module (1 -> Actuated, 0 -> Not Actuated)" UBYTE Vfnc4ms_CM_boolean_adm 0 0 0 1 ECU_ADDRESS 0x40004658 /end MEASUREMENT
/begin MEASUREMENT csParkBrk_R "Parking Brake switch from CCVS CAN Rx (1 = Actuated, 0 = Not Actuated)" UBYTE J1939dl_Rx100ms_CM_boolean_adm 0 0 0 1 ECU_ADDRESS 0x40003331 /end MEASUREMENT
/begin MEASUREMENT csPoilNorm "[OUT] Soglia di warning sulla pressione olio" UWORD EDC2BC_Tx_50ms_CM_uint16_mbar 0 0 250 6000 ECU_ADDRESS 0x4000347E /end MEASUREMENT
/begin MEASUREMENT csPosCtrlAbnorm "Position Control Abnormal Fault communicated by TURBO CONTROLLER (0 - No Fault)" UBYTE CanPvt_Rx4ms_CM_boolean_adm 0 0 0 1 ECU_ADDRESS 0x400022D8 /end MEASUREMENT
/begin MEASUREMENT csProtectLampCmd "Th2o Lamp Command" UBYTE DLCC1_Tx_1s_CM_uint8_adm 0 0 0 3 ECU_ADDRESS 0x40003418 /end MEASUREMENT
/begin CHARACTERISTIC csRET_CONF_ENABLE "Abilitazione Messaggio J1939 - RET_CONF" VALUE 0xFC83CC Scalar_BOOLEAN 0 RET_CONF_Tx_1s_CM_boolean_adm 0 1 /end CHARACTERISTIC
/begin CHARACTERISTIC csRPM_MIL_THR "Soglia superiore di giri all avviamento per terminare il test della MIL" VALUE 0xFC84DE Scalar_UWORD 0 EDC2BC_Tx_50ms_CM_uint16_rpm 0 10000 /end CHARACTERISTIC
/begin MEASUREMENT csRedLampCmd "RED Lamp command" UBYTE DLCC1_Tx_1s_CM_uint8_adm 0 0 0 3 ECU_ADDRESS 0x40003417 /end MEASUREMENT
/begin MEASUREMENT csRpmThrCnt "Rpm threshold to enable MIL_ON signal lamp" UBYTE EDC2BC_Tx_50ms_CM_uint8_adm 0 0 0 255 ECU_ADDRESS 0x4000347C /end MEASUREMENT
/begin CHARACTERISTIC csSECONDS_REC "Valore di recovery sui secondi" VALUE 0xFC82A8 Scalar_UBYTE 0 TIMEDATE_Rx_1s_CM_ufix8_En2_s 0 59.75 /end CHARACTERISTIC
/begin CHARACTERISTIC csSEL_GEAR_REC "Valore di recovery sulla marcia selezionata (solo per cambio automatico)" VALUE 0xFC8262 Scalar_UBYTE 0 ETC2_Rx_100ms_CM_ufix8_Bn125_gear -125 125 /end CHARACTERISTIC
/begin CHARACTERISTIC csSEND_TKAT "Enabling transimission of signal zsTKat instead of zsTExh in SPN 173 - Engine Exhaust Temperature." VALUE 0xFC836B Scalar_BOOLEAN 0 INLET_COND_Tx_100ms_CM_boolean_adm 0 1 /end CHARACTERISTIC
/begin CHARACTERISTIC csSEP1_ENABLE "Abilitazione Messaggio J1939 - SEP1" VALUE 0xFC83CB Scalar_BOOLEAN 0 SEP1_Tx_1s_CM_boolean_adm 0 1 /end CHARACTERISTIC
/begin CHARACTERISTIC csSHIFT_PRO_REC "Valore di recovery sullo shift in progress (distribuzione-accoppiata al motore)" VALUE 0xFC82CC Scalar_BOOLEAN 0 ETC1_Rx_4ms_CM_boolean_adm 0 1 /end CHARACTERISTIC
/begin CHARACTERISTIC csSHUTDOWN_ENABLE "Abilitazione Messaggio J1939 - SHUTDOWN" VALUE 0xFC83CA Scalar_BOOLEAN 0 SHUTDOWN_Tx_1s_CM_boolean_adm 0 1 /end CHARACTERISTIC
/begin CHARACTERISTIC csSHUT_DOWN_REC "Valore di recovery sullo switch di spegnimento motore" VALUE 0xFC8309 Scalar_BOOLEAN 0 BC2EDC2_Rx_50ms_CM_boolean_adm 0 1 /end CHARACTERISTIC
/begin CHARACTERISTIC csSPEED_LIMITER_REC "Recovery on speed limitation from BC2EDC1 CAN Rx" VALUE 0xFC8308 Scalar_UBYTE 0 BC2EDC1_Rx_50ms_CM_uint8_km_h 0 250 /end CHARACTERISTIC
/begin CHARACTERISTIC csSPEED_LIM_REC "Valore di recovery sulla richiesta di limitazione giri" VALUE 0xFC82CA Scalar_UWORD 0 TSC1_VE_LIMIT_Rx_4ms_CM_ufix16_En3_rpm 0 8031.875 /end CHARACTERISTIC
/begin CHARACTERISTIC csSPEED_REQ_2_REC "Valore di recovery sulla richiesta regime obiettivo nel secondo TSC1_Ctrl2" VALUE 0xFC82C8 Scalar_UWORD 0 TSC1_VE_CONTROL2_Rx_4ms_CM_ufix16_En3_rpm 0 8031.875 /end CHARACTERISTIC
/begin CHARACTERISTIC csSPEED_REQ_REC "Valore di recovery sulla richiesta regime obiettivo" VALUE 0xFC82C6 Scalar_UWORD 0 TSC1_VE_CONTROL_Rx_4ms_CM_ufix16_En3_rpm 0 8031.875 /end CHARACTERISTIC
/begin CHARACTERISTIC csSRC_ADDR_CAN "Indirizzo sorgente utilizzato dal dispositivo che controlla il motore (es. VCM = 27, MF3 = 0)" VALUE 0xFC8486 Scalar_UBYTE 0 EEC1_Tx_4ms_CM_uint8_adm 0 253 /end CHARACTERISTIC
/begin CHARACTERISTIC csSUP_VOLT_MONITOR "Recovery value for field Supply voltage monitor communicated by TURBO CONTROLLER" VALUE 0xFC2BF2 Scalar_UBYTE 0 TURBO2ECU_Rx_4ms_CM_ufix8_Sp152_V 0 38.76 /end CHARACTERISTIC
/begin MEASUREMENT csSelGear "Valore ricevuto via CAN sulla marcia selezionata (solo per cambio automatico)" UBYTE J1939dl_Rx100ms_CM_ufix8_Bn125_gear 0 0 -125 125 ECU_ADDRESS 0x40003327 /end MEASUREMENT
/begin MEASUREMENT csSelfRecMode "Self Recovery Mode communicated by TURBO CONTROLLER (1-Self Recovery active)" UBYTE CanPvt_Rx4ms_CM_boolean_adm 0 0 0 1 ECU_ADDRESS 0x400022DD /end MEASUREMENT
/begin MEASUREMENT csSensAbnormHiFault "Sensor Abnormal High Value Fault communicated by TURBO CONTROLLER (0 - No Fault)" UBYTE CanPvt_Rx4ms_CM_boolean_adm 0 0 0 1 ECU_ADDRESS 0x400022DB /end MEASUREMENT
/begin MEASUREMENT csSensAbnormLoFault "Sensor Abnormal Low Value Fault communicated by TURBO CONTROLLER (0 - No Fault)" UBYTE CanPvt_Rx4ms_CM_boolean_adm 0 0 0 1 ECU_ADDRESS 0x400022DC /end MEASUREMENT
/begin MEASUREMENT csShif_Pro "Shift in process" UBYTE J1939dl_Rx4ms_CM_boolean_adm 0 0 0 1 ECU_ADDRESS 0x40003362 /end MEASUREMENT
/begin MEASUREMENT csShutDown "Spegnimento motore da VCM con messaggio BC2EDC2" UBYTE Egst4ms_CM_boolean_adm 0 0 0 1 ECU_ADDRESS 0x4000339C /end MEASUREMENT
/begin MEASUREMENT csShutDownCAN "Spegnimento motore da MF3 (MsgTxCAN SHUTDOWN - Byte 5, Bit 2,1)" UBYTE SHUTDOWN_Tx_1s_CM_uint8_adm 0 0 0 1 ECU_ADDRESS 0x40003450 /end MEASUREMENT
/begin MEASUREMENT csSpeedLimVCM_R "Richiesta di limitazione giri da CAN" UWORD J1939dl_Rx4ms_CM_uint16_rpm 0 0 0 10000 ECU_ADDRESS 0x40003378 /end MEASUREMENT
/begin MEASUREMENT csSpeedLimiter "Speed limitation from BC2EDC1 CAN Rx" UBYTE J1939dl_Rx50ms_CM_uint8_km_h 0 0 0 250 ECU_ADDRESS 0x400033AB /end MEASUREMENT
/begin MEASUREMENT csSpeedReqVCM2_R "Richiesta di giri obiettivo da CAN nel msg TSC1_VE_CONTROL2" UWORD J1939dl_Rx4ms_CM_uint16_rpm 0 0 0 10000 ECU_ADDRESS 0x4000337C /end MEASUREMENT
/begin MEASUREMENT csSpeedReqVCM_R "Richiesta di giri obiettivo da CAN" UWORD J1939dl_Rx4ms_CM_uint16_rpm 0 0 0 10000 ECU_ADDRESS 0x4000337A /end MEASUREMENT
/begin MEASUREMENT csSupVoltHigh "Supply Voltage too high Fault communicated by TURBO CONTROLLER (0 - No Fault)" UBYTE CanPvt_Rx4ms_CM_boolean_adm 0 0 0 1 ECU_ADDRESS 0x400022D5 /end MEASUREMENT
/begin MEASUREMENT csSupVoltLow "Supply Voltage too low Fault communicated by TURBO CONTROLLER (0 - No Fault)" UBYTE CanPvt_Rx4ms_CM_boolean_adm 0 0 0 1 ECU_ADDRESS 0x400022D9 /end MEASUREMENT
/begin MEASUREMENT csSupVoltMonitor "Supply voltage monitor communicated by TURBO CONTROLLER" UBYTE CanPvt_Rx4ms_CM_ufix8_Sp152_V 0 0 0 38.76 ECU_ADDRESS 0x400022CE /end MEASUREMENT
/begin MEASUREMENT csSwSelCurGear "cambio selezionato" UBYTE Vfnc4ms_CM_boolean_adm 0 0 0 1 ECU_ADDRESS 0x4000465E /end MEASUREMENT
/begin MEASUREMENT csSwitch_TSC1_2 "Switch ad architettura a due TSC1" UBYTE Trqm_CtrlMgmt4ms_CM_boolean_adm 0 0 0 1 ECU_ADDRESS 0x40004655 /end MEASUREMENT
/begin CHARACTERISTIC csTEMP_FAIL_REC "Recovery on Temperature Control Fail Diagnosis Uego Sensor (01-Fail 00-No Fail)" VALUE 0xFC8307 Scalar_BOOLEAN 0 USS_Rx_50ms_CM_boolean_adm 0 1 /end CHARACTERISTIC
/begin MEASUREMENT csTExhCan "Temperatura gas di scaricoe (MsgTxCAN INLET_COND - Byte 6-7)" UWORD INLET_COND_Tx_100ms_CM_ufix16_En5_Bn273_degC 0 0 -273 1734.96875 ECU_ADDRESS 0x400033FC /end MEASUREMENT
/begin CHARACTERISTIC csTORQUE_LIM_REC "Valore di recovery sulla richiesta di limitazione coppia" VALUE 0xFC82C5 Scalar_UBYTE 0 TSC1_VE_LIMIT_Rx_4ms_CM_ufix8_Bn125__ -125 125 /end CHARACTERISTIC
/begin CHARACTERISTIC csTORQUE_REQ_2_REC "Valore di recovery sulla richiesta coppia obiettivo nel secondo TSC1_Ctrl2" VALUE 0xFC82C4 Scalar_UBYTE 0 TSC1_VE_CONTROL2_Rx_4ms_CM_ufix8_Bn125__ -125 125 /end CHARACTERISTIC
/begin CHARACTERISTIC csTORQUE_REQ_REC "Valore di recovery sulla richiesta coppia obiettivo" VALUE 0xFC82C3 Scalar_UBYTE 0 TSC1_VE_CONTROL_Rx_4ms_CM_ufix8_Bn125__ -125 125 /end CHARACTERISTIC
/begin MEASUREMENT csTOilCAN "Engine Oil Temperature 1 (MsgTxCAN ENG_TEMP - Byte 3-4)" UWORD ENG_TEMP_Tx_1s_CM_uint16_adm 0 0 0 65535 ECU_ADDRESS 0x4000342E /end MEASUREMENT
/begin CHARACTERISTIC csTR_DC_BITS_REC "Recovery value for condition request when signal is not available for message TSC1 TR" VALUE 0xFC8306 Scalar_UBYTE 0 TSC1_TR_RETARDER_Rx_50ms_CM_uint8_adm 0 3 /end CHARACTERISTIC
/begin CHARACTERISTIC csTR_MC_BITS_REC "Recovery value for mode request when signal is not available for message TSC1 TR" VALUE 0xFC8305 Scalar_UBYTE 0 TSC1_TR_RETARDER_Rx_50ms_CM_uint8_adm 0 3 /end CHARACTERISTIC
/begin CHARACTERISTIC csTR_PC_BITS_REC "Recovery value for priority request when signal is not available for message TSC1 TR" VALUE 0xFC8304 Scalar_UBYTE 0 TSC1_TR_RETARDER_Rx_50ms_CM_uint8_adm 0 3 /end CHARACTERISTIC
/begin CHARACTERISTIC csTR_SPEED_REQ_REC "Recovery value for engine speed request when signal is not available for message TSC1 TR" VALUE 0xFC8302 Scalar_UWORD 0 TSC1_TR_RETARDER_Rx_50ms_CM_ufix16_En3_rpm 0 8031.875 /end CHARACTERISTIC
/begin MEASUREMENT csTR_SpeedReq_R "Speed Request for Engine Brake from TSC1 message" UWORD J1939dl_Rx50ms_CM_uint16_rpm 0 0 0 10000 ECU_ADDRESS 0x400033BA /end MEASUREMENT
/begin CHARACTERISTIC csTR_TORQUE_REQ_REC "Recovery value for engine torque request when signal is not available for message TSC1 TR" VALUE 0xFC8301 Scalar_UBYTE 0 TSC1_TR_RETARDER_Rx_50ms_CM_ufix8_Bn125__ -125 125 /end CHARACTERISTIC
/begin MEASUREMENT csTR_TSC_Cond_R "Requested control condition (Transient Drv_diseng, Drv_diseng, Drv_eng - Vehic_Drv, Drv_eng - PTO_Drv) for Engine Brake from TSC1 message" UBYTE J1939dl_Rx50ms_CM_uint8_adm 0 0 0 3 ECU_ADDRESS 0x400033A5 /end MEASUREMENT
/begin MEASUREMENT csTR_TSC_Mode_R "Torque control or limitation Mode (Torque Ctrl = 2 o Speed Ctri = 1) for Engine Brake from TSC1 message" UBYTE Egbrk50ms_CM_uint8_adm 0 0 0 3 ECU_ADDRESS 0x400033A4 /end MEASUREMENT
/begin MEASUREMENT csTR_TSC_Pri_R "Torque control or limitation priority (Max(Pri)=0, Min(Pri)=3)  for Engine Brake from TSC1 message" UBYTE J1939dl_Rx50ms_CM_uint8_adm 0 0 0 3 ECU_ADDRESS 0x400033A6 /end MEASUREMENT
/begin MEASUREMENT csTR_TorqueReq_R "Torque Request for Engine Brake from TSC1 message" SWORD Egbrk50ms_CM_sfix16_En4__ 0 0 -100 0 ECU_ADDRESS 0x400033AE /end MEASUREMENT
/begin MEASUREMENT csTRail1CAN "Engine Fue 1l Temperature 1(MsgTxCAN ENG_TEMP - Byte 2)" UBYTE ENG_TEMP_Tx_1s_CM_uint8_adm 0 0 0 255 ECU_ADDRESS 0x4000342D /end MEASUREMENT
/begin CHARACTERISTIC csT_EXH_NOT_AVAILABLE "Abilitazione Messaggio J1939 - PropB_0A" VALUE 0xFC836A Scalar_BOOLEAN 0 PropB_0A_Tx_100ms_CM_boolean_adm 0 1 /end CHARACTERISTIC
/begin CHARACTERISTIC csT_EXH_PREWRN_CMD "Lamp behavior in case of esTexhOverTemp == 1 (PRE-WARNING). (0-lamp off; 1-lamp on; 2-lamp flash)" VALUE 0xFC8369 Scalar_UBYTE 0 PropB_0A_Tx_100ms_CM_uint8_adm 0 15 /end CHARACTERISTIC
/begin CHARACTERISTIC csT_EXH_WRN_CMD "Lamp behavior in case of esTexhOverTemp == 2 (WARNING). (0-lamp off; 1-lamp on; 2-lamp flash)" VALUE 0xFC8368 Scalar_UBYTE 0 PropB_0A_Tx_100ms_CM_uint8_adm 0 15 /end CHARACTERISTIC
/begin MEASUREMENT csTempFailUEGO "emperature Ctrl Failure on Uego Sensor (1-Fail,0-No Fail)" UBYTE J1939dl_Rx50ms_CM_boolean_adm 0 0 0 1 ECU_ADDRESS 0x40003394 /end MEASUREMENT
/begin MEASUREMENT csTexhHighLmpCmd "Exhaust temperature lamp comand" UBYTE PropB_0A_Tx_100ms_CM_uint8_adm 0 0 0 15 ECU_ADDRESS 0x40003408 /end MEASUREMENT
/begin MEASUREMENT csTh2oCAN "Engine Coolant Temperature (MsgTxCAN ENG_TEMP - Byte 1)" UBYTE ENG_TEMP_Tx_1s_CM_uint8_adm 0 0 0 255 ECU_ADDRESS 0x4000342C /end MEASUREMENT
/begin MEASUREMENT csTh2oHighCmd "High Coolant Temperature Lamp Command" UBYTE DLCC1_Tx_1s_CM_uint8_adm 0 0 0 3 ECU_ADDRESS 0x40003416 /end MEASUREMENT
/begin MEASUREMENT csTorqueLimVCM_R "Richiesta di limitazione Coppia da CAN" UWORD J1939dl_Rx4ms_CM_ufix16_En4__ 0 0 0 100 ECU_ADDRESS 0x40003372 /end MEASUREMENT
/begin MEASUREMENT csTorqueReqVCM2_R "Richiesta di Coppia da CAN nel msg TSC1_VE_CONTROL2" UWORD J1939dl_Rx4ms_CM_ufix16_En4__ 0 0 0 100 ECU_ADDRESS 0x40003376 /end MEASUREMENT
/begin MEASUREMENT csTorqueReqVCM_R "Richiesta di Coppia da CAN" UWORD J1939dl_Rx4ms_CM_ufix16_En4__ 0 0 0 100 ECU_ADDRESS 0x40003374 /end MEASUREMENT
/begin MEASUREMENT csTurboControllerFault "Logical OR of all the selected condition concurring to signale a fault by TURBO CONTROLLER (0 - No Fault). This signal is used to disable CAN WGT command." UBYTE CanPvt_Rx4ms_CM_boolean_adm 0 0 0 1 ECU_ADDRESS 0x400022D1 /end MEASUREMENT
/begin MEASUREMENT csTurboControllerReady "Logical AND of all the selected conditions concurring to signale the controller is ready, by TURBO CONTROLLER (0 - Not Ready; 1- Ready). This signal is used to enable CAN WGT command." UBYTE CanPvt_Rx4ms_CM_boolean_adm 0 0 0 1 ECU_ADDRESS 0x400022D0 /end MEASUREMENT
/begin MEASUREMENT csUEGOFail " failure (Electric/Thermal) on Uego Sensor (1-Fail,0-No Fail)" UBYTE Ctit_LambdaCtrlTDC_CM_boolean_adm 0 0 0 1 ECU_ADDRESS 0x40003392 /end MEASUREMENT
/begin CHARACTERISTIC csUNDER_BRAKE_REC "Valore di recovery su Under Braking Status" VALUE 0xFC8300 Scalar_BOOLEAN 0 VCM2ECM_Rx_50ms_CM_boolean_adm 0 1 /end CHARACTERISTIC
/begin MEASUREMENT csUnderBrake "Under Braking Status [values: 0,1]" UBYTE Idle4ms_CM_boolean_adm 0 0 0 1 ECU_ADDRESS 0x40003391 /end MEASUREMENT
/begin MEASUREMENT csVCM_C_TSC_Cond2_R "Requested speed control condition (Transient Drv_diseng, Drv_diseng, Drv_eng - Vehic_Drv, Drv_eng - PTO_Drv) in TSC1_VE_CONTROL2" UBYTE J1939dl_Rx4ms_CM_uint8_adm 0 0 0 3 ECU_ADDRESS 0x4000336D /end MEASUREMENT
/begin MEASUREMENT csVCM_C_TSC_Cond_R "Requested speed control condition (Transient Drv_diseng, Drv_diseng, Drv_eng - Vehic_Drv, Drv_eng - PTO_Drv)" UBYTE J1939dl_Rx4ms_CM_uint8_adm 0 0 0 3 ECU_ADDRESS 0x40003369 /end MEASUREMENT
/begin MEASUREMENT csVCM_C_TSC_Mode2_R "Modalità di richiesta (Coppia = 2 / Giri = 1) da CAN nel msg TSC1_VE_CONTROL2" UBYTE J1939dl_Rx4ms_CM_uint8_adm 0 0 0 3 ECU_ADDRESS 0x4000336C /end MEASUREMENT
/begin MEASUREMENT csVCM_C_TSC_Mode_R "Modalità di richiesta obiettivo di performance (Coppia Erogata = 2 o giri = 1) da CAN" UBYTE J1939dl_Rx4ms_CM_uint8_adm 0 0 0 3 ECU_ADDRESS 0x40003368 /end MEASUREMENT
/begin MEASUREMENT csVCM_C_TSC_Pri2_R "riorità obiettivi (Coppia / Giri) da CAN (Max(Pri)=0, Min(Pri)=3) nel msg TSC1_CTrl_2" UBYTE J1939dl_Rx4ms_CM_uint8_adm 0 0 0 3 ECU_ADDRESS 0x4000336E /end MEASUREMENT
/begin MEASUREMENT csVCM_C_TSC_Pri_R "Priorità obiettivi (Coppia / Giri) da CAN (Max(Pri)=0, Min(Pri)=3)" UBYTE J1939dl_Rx4ms_CM_uint8_adm 0 0 0 3 ECU_ADDRESS 0x4000336A /end MEASUREMENT
/begin MEASUREMENT csVCM_L_TSC_Cond_R "Requested speed control condition (Transient Drv_diseng, Drv_diseng, Drv_eng - Vehic_Drv, Drv_eng - PTO_Drv)" UBYTE J1939dl_Rx4ms_CM_uint8_adm 0 0 0 3 ECU_ADDRESS 0x40003365 /end MEASUREMENT
/begin MEASUREMENT csVCM_L_TSC_Mode_R "Modalità di richiesta limitazione (Coppia / Giri) da CAN" UBYTE J1939dl_Rx4ms_CM_uint8_adm 0 0 0 3 ECU_ADDRESS 0x40003364 /end MEASUREMENT
/begin MEASUREMENT csVCM_L_TSC_Pri_R "Priorità delle richieste (Coppia / Giri) da CAN (Max(Pri)=0, Min(Pri)=3)" UBYTE J1939dl_Rx4ms_CM_uint8_adm 0 0 0 3 ECU_ADDRESS 0x40003366 /end MEASUREMENT
/begin CHARACTERISTIC csVEH_SPEED_REC "Valore di recovery su Vehicle Speed da TCO1" VALUE 0xFC8260 Scalar_UWORD 0 CCVS_Rx_100ms_CM_ufix16_En8_km_h 0 250.99609375 /end CHARACTERISTIC
/begin CHARACTERISTIC csVEH_TCO1SPD_REC "Valore di recovery su Vehicle Speed da TCO1" VALUE 0xFC82FE Scalar_UWORD 0 TCO1_Rx_50ms_CM_ufix16_En8_km_h 0 250.99609375 /end CHARACTERISTIC
/begin CHARACTERISTIC csVEP1_ENABLE "Abilitazione Messaggio J1939 - VEP1" VALUE 0xFC83C9 Scalar_BOOLEAN 0 VEP1_Tx_1s_CM_boolean_adm 0 1 /end CHARACTERISTIC
/begin CHARACTERISTIC csVE_DC_BITS_2_REC "Valore di recovery sulla modalità di richiesta di performance nel secondo TSC1_Ctrl2" VALUE 0xFC82C2 Scalar_UBYTE 0 TSC1_VE_CONTROL2_Rx_4ms_CM_uint8_adm 0 3 /end CHARACTERISTIC
/begin CHARACTERISTIC csVE_DC_BITS_REC "Valore di recovery sulla modalità di richiesta di performance" VALUE 0xFC82C1 Scalar_UBYTE 0 TSC1_VE_CONTROL_Rx_4ms_CM_uint8_adm 0 3 /end CHARACTERISTIC
/begin CHARACTERISTIC csVE_DL_BITS_REC "Valore di recovery sulla modalità di richiesta di performance (TSC1_VE_LIMIT)" VALUE 0xFC82C0 Scalar_UBYTE 0 TSC1_VE_LIMIT_Rx_4ms_CM_uint8_adm 0 3 /end CHARACTERISTIC
/begin CHARACTERISTIC csVE_MC_BITS_2_REC "Valore di recovery sulla modalità di richiesta di performance nel secondo TSC1_Ctrl2" VALUE 0xFC82BF Scalar_UBYTE 0 TSC1_VE_CONTROL2_Rx_4ms_CM_uint8_adm 0 3 /end CHARACTERISTIC
/begin CHARACTERISTIC csVE_MC_BITS_REC "Valore di recovery sulla modalità di richiesta di performance" VALUE 0xFC82BE Scalar_UBYTE 0 TSC1_VE_CONTROL_Rx_4ms_CM_uint8_adm 0 3 /end CHARACTERISTIC
/begin CHARACTERISTIC csVE_ML_BITS_REC "Valore di recovery sulla modalità di richiesta di performance" VALUE 0xFC82BD Scalar_UBYTE 0 TSC1_VE_LIMIT_Rx_4ms_CM_uint8_adm 0 3 /end CHARACTERISTIC
/begin CHARACTERISTIC csVE_PC_BITS_2_REC "Valore di recovery sulla priorità di richiesta di performance nel secondo TSC1_Ctrl2" VALUE 0xFC82BC Scalar_UBYTE 0 TSC1_VE_CONTROL2_Rx_4ms_CM_uint8_adm 0 3 /end CHARACTERISTIC
/begin CHARACTERISTIC csVE_PC_BITS_REC "Valore di recovery sulla priorità di richiesta di performance" VALUE 0xFC82BB Scalar_UBYTE 0 TSC1_VE_CONTROL_Rx_4ms_CM_uint8_adm 0 3 /end CHARACTERISTIC
/begin CHARACTERISTIC csVE_PL_BITS_REC "Valore di recovery sulla priorità di richiesta di performance" VALUE 0xFC82BA Scalar_UBYTE 0 TSC1_VE_LIMIT_Rx_4ms_CM_uint8_adm 0 3 /end CHARACTERISTIC
/begin CHARACTERISTIC csVKEY_EQUALS_VBATT "Enable transmission of SPN 158 (Key Switch Battery voltage) as the zsVBatt value if zsKey is enabled, 0V if not." VALUE 0xFC83C8 Scalar_BOOLEAN 0 VEP1_Tx_1s_CM_boolean_adm 0 1 /end CHARACTERISTIC
/begin CHARACTERISTIC csVOLTAGE_CHECK_SIGNAL "Setting voltage check for the CAN Turbo Controller ( \'0\' for 12V; \'1\' for 24V)" VALUE 0xFC2C1C Scalar_BOOLEAN 0 ECU2TURBO_Tx_4ms_CM_boolean_adm 0 1 /end CHARACTERISTIC
/begin MEASUREMENT csVehSpeedTCO1CAN "ehicle Speed from MsgRxCAN TC01 (Byte 8,7)" UWORD J1939dl_Rx50ms_CM_ufix16_En8_km_h 0 0 0 250 ECU_ADDRESS 0x400033B4 /end MEASUREMENT
/begin MEASUREMENT csVehicleSpeed "Velocità veicolo acquisita da CAN" UWORD Crkc4ms_CM_uint16_km_h 0 0 0 250 ECU_ADDRESS 0x400046B2 /end MEASUREMENT
/begin MEASUREMENT csVehicleSpeedHR_R "Vehicle Speed from CCVS CAN Rx SAE high resolution" UWORD J1939dl_Rx100ms_CM_ufix16_En8_km_h 0 0 0 250 ECU_ADDRESS 0x40003340 /end MEASUREMENT
/begin MEASUREMENT csVehicleSpeed_R "Vehicle Speed from CCVS CAN Rx SAE low resolution" UWORD J1939dl_Rx100ms_CM_ufix16_En8_km_h 0 0 0 250 ECU_ADDRESS 0x40003342 /end MEASUREMENT
/begin MEASUREMENT csVeryHighRpmCmd "High Engine Speed Lamp Command" UBYTE DLCC1_Tx_1s_CM_uint8_adm 0 0 0 3 ECU_ADDRESS 0x40003415 /end MEASUREMENT
/begin MEASUREMENT csWrnLampCmd "Warning Lamp Command" UBYTE DLCC1_Tx_1s_CM_uint8_adm 0 0 0 3 ECU_ADDRESS 0x40003414 /end MEASUREMENT
/begin CHARACTERISTIC csYEAR_REC "Valore di recovery sugli anni" VALUE 0xFC82A7 Scalar_UBYTE 0 TIMEDATE_Rx_1s_CM_ufix8_B1985_year 1985 2235 /end CHARACTERISTIC
/begin CHARACTERISTIC ctPOIL_UNDER_THR "Soglia di warning sulla pressione olio" MAP 0xFC84AC Lookup2D_UWORD 0 EDC2BC_Tx_50ms_CM_uint16_mbar 250 6000
 /begin AXIS_DESCR COM_AXIS NO_INPUT_QUANTITY EDC2BC_Tx_50ms_CM_uint16_rpm 5 0 10000 AXIS_PTS_REF ckRPM_H_BKP /end AXIS_DESCR
 /begin AXIS_DESCR COM_AXIS NO_INPUT_QUANTITY EDC2BC_Tx_50ms_CM_ufix16_Bn40_degC 5 -40 130 AXIS_PTS_REF ckTOIL_V_BKP /end AXIS_DESCR
/end CHARACTERISTIC
/begin CHARACTERISTIC dfADAT2_ADIA_EN_Enable "[FIX] Fix sulla abilitazione della linea di diagnosi ADAT2" VALUE 0xFC2024 Scalar_UBYTE 0 FaultChkADAT2_4ms_CM_FixEnableT 171 218 /end CHARACTERISTIC
/begin CHARACTERISTIC dfADAT2_ADIA_EN_Value "[FIX] Fix sulla abilitazione della linea di diagnosi ADAT2" VALUE 0xFC2023 Scalar_BOOLEAN 0 FaultChkADAT2_4ms_CM_boolean_adm 0 1 /end CHARACTERISTIC
/begin CHARACTERISTIC dfADAT2_CHK_EN_Enable "[FIX] Fix sul flag di abilitazione del Fault Check della linea ADAT2" VALUE 0xFC2022 Scalar_UBYTE 0 EnableDiagADAT2_4ms_CM_FixEnableT 171 218 /end CHARACTERISTIC
/begin CHARACTERISTIC dfADAT2_CHK_EN_Value "[FIX] Fix sul flag di abilitazione del Fault Check della linea ADAT2" VALUE 0xFC2021 Scalar_BOOLEAN 0 EnableDiagADAT2_4ms_CM_boolean_adm 0 1 /end CHARACTERISTIC
/begin CHARACTERISTIC dfADAT2_CODERR_Enable "[FIX] Fix sul codice di errore della linea di diagnosi ADAT2" VALUE 0xFC2020 Scalar_UBYTE 0 FaultChkADAT2_4ms_CM_FixEnableT 171 218 /end CHARACTERISTIC
/begin CHARACTERISTIC dfADAT2_CODERR_Value "[FIX] Fix sul codice di errore della linea di diagnosi ADAT2" VALUE 0xFC201F Scalar_UBYTE 0 FaultChkADAT2_4ms_CM_tFault_adm 0 88 /end CHARACTERISTIC
/begin CHARACTERISTIC dfADAT_CNT_E2P_Enable "[FIX] Fix sul contatore di CONFIRMED della linea di diagnosi ADAT" VALUE 0xFC201E Scalar_UBYTE 0 FaultChkADAT2_4ms_CM_FixEnableT 171 218 /end CHARACTERISTIC
/begin CHARACTERISTIC dfADAT_CNT_E2P_Value "[FIX] Fix sul contatore di CONFIRMED della linea di diagnosi ADAT" VALUE 0xFC201D Scalar_UBYTE 0 FaultChkADAT2_4ms_CM_uint8_adm 0 255 /end CHARACTERISTIC
/begin CHARACTERISTIC dfADAT_CODERR_Enable "[FIX] Fix sul codice di errore della linea di diagnosi ADAT" VALUE 0xFC2016 Scalar_UBYTE 0 FaultChkADATTDC_CM_FixEnableT 171 218 /end CHARACTERISTIC
/begin CHARACTERISTIC dfADAT_CODERR_Value "[FIX] Fix sul codice di errore della linea di diagnosi ADAT" VALUE 0xFC2015 Scalar_UBYTE 0 FaultChkADATTDC_CM_tFault_adm 0 89 /end CHARACTERISTIC
/begin CHARACTERISTIC dfADAT_FAULT_E2P_Enable "[FIX] Fix sul flag dello stato di CONFIRMED della linea di diagnosi ADAT al trip precedente" VALUE 0xFC201C Scalar_UBYTE 0 EnableDiagADAT2_4ms_CM_FixEnableT 171 218 /end CHARACTERISTIC
/begin CHARACTERISTIC dfADAT_FAULT_E2P_Value "[FIX] Fix sul flag dello stato di CONFIRMED della linea di diagnosi ADAT al trip precedente" VALUE 0xFC201B Scalar_BOOLEAN 0 EnableDiagADAT2_4ms_CM_boolean_adm 0 1 /end CHARACTERISTIC
/begin CHARACTERISTIC dfAIR2H_ERR "[FIX] Fix per forzare la diagnosi di secondo livello per Qair misurata eccessiva" VALUE 0xFCB59C Scalar_UWORD 0 TE_TM_FaultChkAIR2H_50ms_Symbol_CM_boolean_adm 0 1 /end CHARACTERISTIC
/begin CHARACTERISTIC dfAIR2H_ERR_EnFix "[FIX] Fix per forzare la diagnosi di secondo livello per Qair misurata eccessiva" VALUE 0xFCB59A Scalar_UWORD 0 TE_TM_FaultChkAIR2H_50ms_Symbol_CM_FixEnableT 171 218 /end CHARACTERISTIC
/begin CHARACTERISTIC dfAIR2L_ERR "[FIX] Fix per forzare la diagnosi di secondo livello per Qair misurata insufficiente" VALUE 0xFCB5A6 Scalar_UWORD 0 TE_TM_FaultChkAIR2L_50ms_Symbol_CM_boolean_adm 0 1 /end CHARACTERISTIC
/begin CHARACTERISTIC dfAIR2L_ERR_EnFix "[FIX] Fix per forzare la diagnosi di secondo livello per Qair misurata insufficiente" VALUE 0xFCB5A4 Scalar_UWORD 0 TE_TM_FaultChkAIR2L_50ms_Symbol_CM_FixEnableT 171 218 /end CHARACTERISTIC
/begin CHARACTERISTIC dfCOH_LAM_STATE_Enable "[FIX] Fix sulla operatività (per coerenza) della sonda lambda" VALUE 0xFC4032 Scalar_UBYTE 0 DiagLamTDC_CM_FixEnableT 171 218 /end CHARACTERISTIC
/begin CHARACTERISTIC dfCOH_LAM_STATE_Value "[FIX] Fix sulla operatività (per coerenza) della sonda lambda" VALUE 0xFC4031 Scalar_BOOLEAN 0 DiagLamTDC_CM_boolean_adm 0 1 /end CHARACTERISTIC
/begin CHARACTERISTIC dfDELTAPHASE_Enable "[FIX] Fix sulla variazioni in gradi di fase di iniezioni per rifasarla in caso di funzionamento a scintilla persa" VALUE 0xFC800A Scalar_UBYTE 0 RecRifasaInjTDC_CM_FixEnableT 171 218 /end CHARACTERISTIC
/begin CHARACTERISTIC dfDELTAPHASE_Value "[FIX] Fix sulla variazioni in gradi di fase di iniezioni per rifasarla in caso di funzionamento a scintilla persa" VALUE 0xFC8008 Scalar_UWORD 0 RecRifasaInjTDC_CM_ufix16_En4_degree 0 360 /end CHARACTERISTIC
/begin CHARACTERISTIC dfEN_CYL_TR "[FIX] Fix per Torque Reduction sul cilindro corrente: 1 mantiene la programmazione, 0 lo spegne" VALUE 0xFCB676 Scalar_UWORD 0 TE_TM_Torque_CylCut_TDC_Symbol_CM_boolean_adm 0 1 /end CHARACTERISTIC
/begin CHARACTERISTIC dfEN_CYL_TR_EnFix "[FIX] Fix per Torque Reduction sul cilindro corrente: 1 mantiene la programmazione, 0 lo spegne" VALUE 0xFCB674 Scalar_UWORD 0 TE_TM_Torque_CylCut_TDC_Symbol_CM_FixEnableT 171 218 /end CHARACTERISTIC
/begin CHARACTERISTIC dfFAULT_OP2_WAIT_Enable "[FIX] Fix sulle transizioni della macchina di plausibilità tra gli stati \"Operativa\" \"Wait_Lam\"" VALUE 0xFC4030 Scalar_UBYTE 0 DiagLamTDC_CM_FixEnableT 171 218 /end CHARACTERISTIC
/begin CHARACTERISTIC dfFAULT_OP2_WAIT_Value "[FIX] Fix sulle transizioni della macchina di plausibilità tra gli stati \"Operativa\" \"Wait_Lam\"" VALUE 0xFC402E Scalar_UWORD 0 DiagLamTDC_CM_uint16_adm 0 32000 /end CHARACTERISTIC
/begin CHARACTERISTIC dfIDLE_ACC_R_Enable "[FIX] Output Idle accelerator position pedal after recovery" VALUE 0xFCAC48 Scalar_UBYTE 0 TE_RecoverySPP_4ms_CM_FixEnableT 171 218 /end CHARACTERISTIC
/begin CHARACTERISTIC dfIDLE_ACC_R_Value "[FIX] Output Idle accelerator position pedal after recovery" VALUE 0xFCAC47 Scalar_UBYTE 0 TE_RecoverySPP_4ms_CM_uint8_adm 0 3 /end CHARACTERISTIC
/begin CHARACTERISTIC dfKNOCK_SRI_THR_Enable "[FIX] Knock sensor SRI threshold (to diagnose knock sensors not working properly)" VALUE 0xFC9B74 Scalar_UBYTE 0 FaultChkKSPxTDC_CM_FixEnableT 171 218 /end CHARACTERISTIC
/begin CHARACTERISTIC dfKNOCK_SRI_THR_Value "[FIX] Knock sensor SRI threshold (to diagnose knock sensors not working properly)" VALUE 0xFC9B70 Scalar_FLOAT32_IEEE 0 FaultChkKSPxTDC_CM_single_uV 0 10000000000 /end CHARACTERISTIC
/begin CHARACTERISTIC dfLIM_PERF_DERAT "[FIX] Limitazione ETC per Derate Mode per guasto su Iniettore o su Bobina" VALUE 0xFCB5AA Scalar_UWORD 0 TE_TM_RecoveryAIR_50ms_Symbol_CM_ufix16_En4__ 0 100 /end CHARACTERISTIC
/begin CHARACTERISTIC dfLIM_PERF_DERAT_EnFix "[FIX] Limitazione ETC per Derate Mode per guasto su Iniettore o su Bobina" VALUE 0xFCB5A8 Scalar_UWORD 0 TE_TM_RecoveryAIR_50ms_Symbol_CM_FixEnableT 171 218 /end CHARACTERISTIC
/begin CHARACTERISTIC dfLOW_POIL_THR "[FIX] Tabella con valori di POil di warning per funzionamento motore" VALUE 0xFCAAA8 Scalar_UWORD 0 FaultChkPO2L100ms_Symbol_CM_uint16_mbar 250 6000 /end CHARACTERISTIC
/begin CHARACTERISTIC dfLOW_POIL_THR_EnFix "[FIX] Tabella con valori di POil di warning per funzionamento motore" VALUE 0xFCAAA6 Scalar_UWORD 0 FaultChkPO2L100ms_Symbol_CM_FixEnableT 171 218 /end CHARACTERISTIC
/begin CHARACTERISTIC dfREC_TR2_TA "[FIX] Secondo Transitorio veloce di recovery temp. aria in uscita da warm up (raccordo del primo a dsSTA_TFIX)" VALUE 0xFC1E38 Scalar_UWORD 0 RecoverySTA100ms_Symbol_CM_ufix16_En10_adm 0 1 /end CHARACTERISTIC
/begin CHARACTERISTIC dfREC_TR2_TA_EnFix "[FIX] Secondo Transitorio veloce di recovery temp. aria in uscita da warm up (raccordo del primo a dsSTA_TFIX)" VALUE 0xFC1E36 Scalar_UWORD 0 RecoverySTA100ms_Symbol_CM_FixEnableT 171 218 /end CHARACTERISTIC
/begin CHARACTERISTIC dfREC_WUP_TR1_TA "[FIX] Primo Transitorio lento di recovery temp. aria in warm up" VALUE 0xFC1E34 Scalar_UWORD 0 RecoverySTA100ms_Symbol_CM_ufix16_En10_adm 0 1 /end CHARACTERISTIC
/begin CHARACTERISTIC dfREC_WUP_TR1_TA_EnFix "[FIX] Primo Transitorio lento di recovery temp. aria in warm up" VALUE 0xFC1E32 Scalar_UWORD 0 RecoverySTA100ms_Symbol_CM_FixEnableT 171 218 /end CHARACTERISTIC
/begin CHARACTERISTIC dfSM_LAM_STATE_Enable "[FIX] Fix sullo stato corrente della macchina a stati della diagnosi lambda" VALUE 0xFC402D Scalar_UBYTE 0 DiagLamTDC_CM_FixEnableT 171 218 /end CHARACTERISTIC
/begin CHARACTERISTIC dfSM_LAM_STATE_Value "[FIX] Fix sullo stato corrente della macchina a stati della diagnosi lambda" VALUE 0xFC402C Scalar_UBYTE 0 DiagLamTDC_CM_uint8_adm 0 3 /end CHARACTERISTIC
/begin CHARACTERISTIC dfSTAZ_COND "[FIX] Fix per forzare il riconoscimento dello stato stazionario per la diagnosi di secondo livello" VALUE 0xFCB58E Scalar_UWORD 0 TE_TM_CheckStazDiag_50ms_Symbol_CM_boolean_adm 0 1 /end CHARACTERISTIC
/begin CHARACTERISTIC dfSTAZ_COND_EnFix "[FIX] Fix per forzare il riconoscimento dello stato stazionario per la diagnosi di secondo livello" VALUE 0xFCB58C Scalar_UWORD 0 TE_TM_CheckStazDiag_50ms_Symbol_CM_FixEnableT 171 218 /end CHARACTERISTIC
/begin CHARACTERISTIC dfSW_PERC_TR "[FIX] Test Point sulla % di riduzione coppia" VALUE 0xFCB672 Scalar_UWORD 0 TE_TM_Torque_CylCut_TDC_Symbol_CM_uint8__ 1 12 /end CHARACTERISTIC
/begin CHARACTERISTIC dfSW_PERC_TR_EnFix "[FIX] Test Point sulla % di riduzione coppia" VALUE 0xFCB670 Scalar_UWORD 0 TE_TM_Torque_CylCut_TDC_Symbol_CM_FixEnableT 171 218 /end CHARACTERISTIC
/begin CHARACTERISTIC dfTR_OPEN_CL "[FIX] Fix per Torque Reduction sul cilindro corrente: 1 mantiene la programmazione, 0 lo spegne" VALUE 0xFCB66E Scalar_UWORD 0 TE_TM_Torque_CylCut_TDC_Symbol_CM_boolean_adm 0 1 /end CHARACTERISTIC
/begin CHARACTERISTIC dfTR_OPEN_CL_EnFix "[FIX] Fix per Torque Reduction sul cilindro corrente: 1 mantiene la programmazione, 0 lo spegne" VALUE 0xFCB66C Scalar_UWORD 0 TE_TM_Torque_CylCut_TDC_Symbol_CM_FixEnableT 171 218 /end CHARACTERISTIC
/begin CHARACTERISTIC dfVOLT2POTENZ_Enable "[FIX] Voltage fitting of second accelertor potentiomenter" VALUE 0xFCAC46 Scalar_UBYTE 0 TE_FaultChkSPP02_4ms_CM_FixEnableT 171 218 /end CHARACTERISTIC
/begin CHARACTERISTIC dfVOLT2POTENZ_Value "[FIX] Voltage fitting of second accelertor potentiomenter" VALUE 0xFCAC44 Scalar_UWORD 0 TE_FaultChkSPP02_4ms_CM_ufix16_En10_V 0 5 /end CHARACTERISTIC
/begin MEASUREMENT ds2LHDuty "Lambda heater PWM command after the recovery (LHR2)" UWORD Ctit_LambdaHeater100ms_CM_uint16__ 0 0 0 100 ECU_ADDRESS 0x40002512 /end MEASUREMENT
/begin MEASUREMENT ds2LHDutyPostR "EGO heater PWM DC Post Recovery" UWORD RecoveryLHR_2_100ms_CM_uint16__ 0 0 0 100 ECU_ADDRESS 0x400025BA /end MEASUREMENT
/begin CHARACTERISTIC ds2LHR_AUTOD "Lambda Heater Post Catalyst diagnostic line enable" VALUE 0xFC4600 Scalar_BOOLEAN 0 FaultChkLHR_2_100ms_CM_boolean_adm 0 1 /end CHARACTERISTIC
/begin MEASUREMENT ds2LHR_AdiaEn "Error validation state machine enable (LHR2)" UBYTE Ctit_LambdaHeater100ms_CM_boolean_adm 0 0 0 1 ECU_ADDRESS 0x40002510 /end MEASUREMENT
/begin MEASUREMENT ds2LHR_CodErr "Lambda Heater diagnostic line code error (LHR2)" UBYTE Ctit_LambdaHeater100ms_CM_tFault_adm 0 0 0 88 ECU_ADDRESS 0x4000250A /end MEASUREMENT
/begin MEASUREMENT ds2TLambdaOK "Lambda temperature OK flag after recovery" UBYTE Ctit_LambdaCtrlTDC_CM_boolean_adm 0 0 0 1 ECU_ADDRESS 0x4000250C /end MEASUREMENT
/begin MEASUREMENT ds2TLambdaOKPostR "Flag riscaldatore sonda lambda settato a 1 dopo la fase di riscaldamento post recovery" UBYTE RecoveryLHR_2_100ms_CM_boolean_adm 0 0 0 1 ECU_ADDRESS 0x400025B8 /end MEASUREMENT
/begin CHARACTERISTIC dsADAT2_AUTOD "Calibrazione di abilitazione della linea di diagnosi ADAT2" VALUE 0xFC201A Scalar_BOOLEAN 0 EnableDiagADAT2_4ms_CM_boolean_adm 0 1 /end CHARACTERISTIC
/begin MEASUREMENT dsADAT2_AdiaEn "abilitazione automa della linea ADAT2" UBYTE Auto_DiagLineADAT2_4ms_CM_boolean_adm 0 0 0 1 ECU_ADDRESS 0x400021C4 /end MEASUREMENT
/begin MEASUREMENT dsADAT2_CodErr "Codice di errore della linea di diagnosi ADAT2" UBYTE Auto_DiagLineADAT2_4ms_CM_tFault_adm 0 0 0 88 ECU_ADDRESS 0x400021C3 /end MEASUREMENT
/begin CHARACTERISTIC dsADAT_AUTOD "Calibrazione di abilitazione della linea di diagnosi autoadattativa" VALUE 0xFC2014 Scalar_BOOLEAN 0 FaultChkADATTDC_CM_boolean_adm 0 1 /end CHARACTERISTIC
/begin MEASUREMENT dsADAT_AutoD "Abilitazione alla linea di diagnosi ADAT" UBYTE AutoTDC_CM_boolean_adm 0 0 0 1 ECU_ADDRESS 0x400020A1 /end MEASUREMENT
/begin MEASUREMENT dsADAT_CodErr "Codice di errore della linea di diagnosi ADAT" UBYTE AutoTDC_CM_tFault_adm 0 0 0 89 ECU_ADDRESS 0x400020A0 /end MEASUREMENT
/begin CHARACTERISTIC dsADAT_HIGH "Soglia massima per il riconoscimento di incoerenza autoadattativa" VALUE 0xFC2012 Scalar_UWORD 0 FaultChkADATTDC_CM_ufix16_En12_adm 0.125 7.5 /end CHARACTERISTIC
/begin CHARACTERISTIC dsADAT_LOW "Soglia minima per il riconoscimento di incoerenza autoadattativa" VALUE 0xFC2010 Scalar_UWORD 0 FaultChkADATTDC_CM_ufix16_En12_adm 0.125 7.5 /end CHARACTERISTIC
/begin MEASUREMENT dsADCylAFDis "Flag di disabilitazione del controllo titolo in closed loop per diagnosi attiva cilindri" UBYTE Fuels_CtrlMgmtTDC_CM_boolean_adm 0 0 0 1 ECU_ADDRESS 0x400032E6 /end MEASUREMENT
/begin CHARACTERISTIC dsAIR2H_AUTOD "Flag per abilitare la diagnosi di secondo livello per Qair misurata eccessiva" VALUE 0xFCB594 Scalar_BOOLEAN 0 TE_TM_FaultChkAIR2H_50ms_Symbol_CM_boolean_adm 0 1 /end CHARACTERISTIC
/begin MEASUREMENT dsAIR2H_AutoD "Flag di abilitazione della diagnosi di secondo livello AIR2H (Qair misurata superiore a desiderata)" UBYTE Thrp_Mgmt50ms_CM_boolean_adm 0 0 0 1 ECU_ADDRESS 0x400041AC /end MEASUREMENT
/begin MEASUREMENT dsAIR2H_CodErr "Codice di errore della linea di diagnosi di secondo livello AIR2H (Qair misurata superiore a desiderata)" UBYTE Thrp_Mgmt50ms_CM_tFault_adm 0 0 0 81 ECU_ADDRESS 0x400041AA /end MEASUREMENT
/begin CHARACTERISTIC dsAIR2L_AUTOD "Flag per abilitare la diagnosi di secondo livello per Qair misurata insufficiente" VALUE 0xFCB59E Scalar_BOOLEAN 0 TE_TM_FaultChkAIR2L_50ms_Symbol_CM_boolean_adm 0 1 /end CHARACTERISTIC
/begin MEASUREMENT dsAIR2L_AutoD "Flag di abilitazione della diagnosi di secondo livello AIR2L (Qair misurata inferiore a desiderata)" UBYTE Thrp_Mgmt50ms_CM_boolean_adm 0 0 0 1 ECU_ADDRESS 0x400041AB /end MEASUREMENT
/begin MEASUREMENT dsAIR2L_CodErr "Codice di errore della linea di diagnosi di secondo livello AIR2L (Qair misurata inferiore a desiderata);" UBYTE Thrp_Mgmt50ms_CM_tFault_adm 0 0 0 81 ECU_ADDRESS 0x400041A9 /end MEASUREMENT
/begin MEASUREMENT dsActDiagCylxEn "Flag che mette a zero il tempo di iniezione sul cilindro x" UBYTE InjtTDC_CM_boolean_adm 0 0 0 1 ECU_ADDRESS 0x40001072 /end MEASUREMENT
/begin MEASUREMENT dsAdat2FltChkEn "abilitazione del fault check della linea ADAT2: da init e da strategia" UBYTE Auto_DiagLineADAT2_4ms_CM_boolean_adm 0 0 0 1 ECU_ADDRESS 0x400021C5 /end MEASUREMENT
/begin MEASUREMENT dsAdatCntE2P "contatore di CONFIRMED della linea ADAT da memorizzare in EEPROM" UBYTE Auto_DiagLineADAT2_4ms_CM_uint8_adm 0 0 0 255 ECU_ADDRESS 0x400021C7 /end MEASUREMENT
/begin MEASUREMENT dsAdatFaultEEPROM "flag di confermato della linea ADAT da memorizzare al PowerLatch nella variabile bsAdatFaultOldTrip" UBYTE Auto_DiagLineADAT2_4ms_CM_boolean_adm 0 0 0 1 ECU_ADDRESS 0x400021C6 /end MEASUREMENT
/begin MEASUREMENT dsAttVerDisun "Evento che attiva la verifica della disuniformita ciclica" UBYTE RecRifasaInjTDC_CM_boolean_adm 0 0 0 1 ECU_ADDRESS 0x400032E2 /end MEASUREMENT
/begin CHARACTERISTIC dsBAT_AUTOD "Flag Abilitazione Diagnosi tensione batteria" VALUE 0xFC202E Scalar_BOOLEAN 0 FaultChkBAT4ms_CM_boolean_adm 0 1 /end CHARACTERISTIC
/begin MEASUREMENT dsBAT_AutoD "Flag Abilitazione Diagnosi tensione batteria" UBYTE Batt4ms_CM_boolean_adm 0 0 0 1 ECU_ADDRESS 0x400021CF /end MEASUREMENT
/begin MEASUREMENT dsBAT_CodErr "Codice di errore della linea tensione batteria" UBYTE Batt4ms_CM_tFault_adm 0 0 0 88 ECU_ADDRESS 0x400021CE /end MEASUREMENT
/begin CHARACTERISTIC dsBAT_FLTCNT "Pre-recovery filtering counter" VALUE 0xFC202C Scalar_UWORD 0 FaultChkBAT4ms_CM_ufix16_En8_s 0 50 /end CHARACTERISTIC
/begin CHARACTERISTIC dsBAT_VBATV_LL "Soglia Inferiore VBATV" VALUE 0xFC202A Scalar_UWORD 0 FaultChkBAT4ms_CM_ufix16_S50_mV 6000 40000 /end CHARACTERISTIC
/begin CHARACTERISTIC dsBAT_VBATV_UL "Soglia Superiore VBATV" VALUE 0xFC2028 Scalar_UWORD 0 FaultChkBAT4ms_CM_ufix16_S50_mV 6000 40000 /end CHARACTERISTIC
/begin CHARACTERISTIC dsBRKCH_AUTOD "Abilitazione del check di coerenza su brake1 e brake2" VALUE 0xFC4CA5 Scalar_BOOLEAN 0 FaultChkBRKCH_4ms_Symbol_CM_boolean_adm 0 1 /end CHARACTERISTIC
/begin MEASUREMENT dsBRKCH_AutoD "Flag Abilitazione Diagnosi BRKCH" UBYTE Digin4ms_CM_boolean_adm 0 0 0 1 ECU_ADDRESS 0x4000298C /end MEASUREMENT
/begin MEASUREMENT dsBRKCH_CodErr "Codice di errore della linea BRKCH" UBYTE Digin4ms_CM_tFault_adm 0 0 0 89 ECU_ADDRESS 0x4000298A /end MEASUREMENT
/begin CHARACTERISTIC dsCAM_HIST_DELTA "Cam hysteresis degree value (that need to be subtracted to dsCAM_THR_DIAG) under which NO_FAULT is detected." VALUE 0xFCAFEE Scalar_UWORD 0 FaultChkSFR4ms_CM_ufix16_Sp1_degree 0 30 /end CHARACTERISTIC
/begin CHARACTERISTIC dsCAM_THR_DIAG "Cam degree threshold above wich a CAM_POS_INCOHERENCE error arises." VALUE 0xFCAFEC Scalar_UWORD 0 FaultChkSFR4ms_CM_ufix16_Sp1_degree 0 30 /end CHARACTERISTIC
/begin CHARACTERISTIC dsCHANG_PHS_STOP "Numero rifasature massimo consentito prima di fermarsi e considerare comunque ultima fasatura come adeguata" VALUE 0xFC8007 Scalar_UBYTE 0 RecRifasaInjTDC_CM_uint8_adm 0 40 /end CHARACTERISTIC
/begin CHARACTERISTIC dsCHECK_IND_STOP "Numero di cicli di validazione prima di dare OK a fasatura" VALUE 0xFC8006 Scalar_UBYTE 0 RecRifasaInjTDC_CM_uint8_adm 0 50 /end CHARACTERISTIC
/begin CHARACTERISTIC dsCLO1_AUTOD "Enable CAN Channel 1 Diagnosis (XCP)" VALUE 0xFC2BF1 Scalar_BOOLEAN 0 FaultChkCLO1_100ms_CM_boolean_adm 0 1 /end CHARACTERISTIC
/begin MEASUREMENT dsCLO1_AutoD "Enable CAN Channel 1 Diagnosis (XCP)" UBYTE Canal_Diagnosis100ms_CM_boolean_adm 0 0 0 1 ECU_ADDRESS 0x400022C9 /end MEASUREMENT
/begin MEASUREMENT dsCLO1_CodErr "Can1 (XCP) diagnosi line Error Code " UBYTE Canal_Diagnosis100ms_CM_tFault_adm 0 0 0 88 ECU_ADDRESS 0x400022C5 /end MEASUREMENT
/begin CHARACTERISTIC dsCLO2_AUTOD "Enable CAN Channel 2 Diagnosis (J1939)" VALUE 0xFC2BF0 Scalar_BOOLEAN 0 FaultChkCLO2_100ms_CM_boolean_adm 0 1 /end CHARACTERISTIC
/begin MEASUREMENT dsCLO2_AutoD "Enable CAN Channel 2 Diagnosis (J1939)" UBYTE Canal_Diagnosis100ms_CM_boolean_adm 0 0 0 1 ECU_ADDRESS 0x400022C8 /end MEASUREMENT
/begin MEASUREMENT dsCLO2_CodErr "Can2 (J1939) diagnosi line Error Code " UBYTE Canal_Diagnosis100ms_CM_tFault_adm 0 0 0 88 ECU_ADDRESS 0x400022C4 /end MEASUREMENT
/begin CHARACTERISTIC dsCLO3_AUTOD "Enable CAN Channel 3 Diagnosis (UDS)" VALUE 0xFC2BEF Scalar_BOOLEAN 0 FaultChkCLO3_100ms_CM_boolean_adm 0 1 /end CHARACTERISTIC
/begin MEASUREMENT dsCLO3_AutoD "Enable CAN Channel 3 Diagnosis (UDS)" UBYTE Canal_Diagnosis100ms_CM_boolean_adm 0 0 0 1 ECU_ADDRESS 0x400022C7 /end MEASUREMENT
/begin MEASUREMENT dsCLO3_CodErr "Can3 (UDS) diagnosi line Error Code " UBYTE Canal_Diagnosis100ms_CM_tFault_adm 0 0 0 88 ECU_ADDRESS 0x400022C3 /end MEASUREMENT
/begin CHARACTERISTIC dsCLO4_AUTOD "Enable CAN Channel 4 Diagnosis (CAN PRIVATE)" VALUE 0xFC2BEE Scalar_BOOLEAN 0 FaultChkCLO4_100ms_CM_boolean_adm 0 1 /end CHARACTERISTIC
/begin MEASUREMENT dsCLO4_AutoD "Enable CAN Channel 4 Diagnosis (CAN Private)" UBYTE Canal_Diagnosis100ms_CM_boolean_adm 0 0 0 1 ECU_ADDRESS 0x400022C6 /end MEASUREMENT
/begin MEASUREMENT dsCLO4_CodErr "Can4 (CAN Private) diagnosi line Error Code " UBYTE Canal_Diagnosis100ms_CM_tFault_adm 0 0 0 88 ECU_ADDRESS 0x400022C2 /end MEASUREMENT
/begin CHARACTERISTIC dsCNT_IN_STZ_Q "Contatore per il tempo di ingresso in stazionario" VALUE 0xFCB590 Scalar_ULONG 0 TE_TM_CheckStazDiag_50ms_Symbol_CM_ufix32_Sp05_s 0 214748364 /end CHARACTERISTIC
/begin CHARACTERISTIC dsCOH_MFLV_FAULT_EN "Flag Abilitazione Diagnosi coerenza segnali nella diagnosi MFLV" VALUE 0xFCC87B Scalar_BOOLEAN 0 TE_FaultChkMFLV4ms_Symbol_CM_boolean_adm 0 1 /end CHARACTERISTIC
/begin CHARACTERISTIC dsCOIL1_AUTOD "Enable of the diagnostic line of cylinder 1 ignition coil" VALUE 0xFC71FF Scalar_BOOLEAN 0 FaultChkCOILxTDC_CM_boolean_adm 0 1 /end CHARACTERISTIC
/begin CHARACTERISTIC dsCOIL2_AUTOD "Enable of the diagnostic line of cylinder 2 ignition coil" VALUE 0xFC71FE Scalar_BOOLEAN 0 FaultChkCOILxTDC_CM_boolean_adm 0 1 /end CHARACTERISTIC
/begin CHARACTERISTIC dsCOIL3_AUTOD "Enable of the diagnostic line of cylinder 3 ignition coil" VALUE 0xFC71FD Scalar_BOOLEAN 0 FaultChkCOILxTDC_CM_boolean_adm 0 1 /end CHARACTERISTIC
/begin CHARACTERISTIC dsCOIL4_AUTOD "Enable of the diagnostic line of cylinder 4 ignition coil" VALUE 0xFC71FC Scalar_BOOLEAN 0 FaultChkCOILxTDC_CM_boolean_adm 0 1 /end CHARACTERISTIC
/begin CHARACTERISTIC dsCOIL5_AUTOD "Enable of the diagnostic line of cylinder 5 ignition coil" VALUE 0xFC71FB Scalar_BOOLEAN 0 FaultChkCOILxTDC_CM_boolean_adm 0 1 /end CHARACTERISTIC
/begin CHARACTERISTIC dsCOIL6_AUTOD "Enable of the diagnostic line of cylinder 6 ignition coil" VALUE 0xFC71FA Scalar_BOOLEAN 0 FaultChkCOILxTDC_CM_boolean_adm 0 1 /end CHARACTERISTIC
/begin CHARACTERISTIC dsCOIL7_AUTOD "Enable of the diagnostic line of cylinder 7 ignition coil" VALUE 0xFC71F9 Scalar_BOOLEAN 0 FaultChkCOILxTDC_CM_boolean_adm 0 1 /end CHARACTERISTIC
/begin CHARACTERISTIC dsCOIL8_AUTOD "Enable of the diagnostic line of cylinder 8 ignition coil" VALUE 0xFC71F8 Scalar_BOOLEAN 0 FaultChkCOILxTDC_CM_boolean_adm 0 1 /end CHARACTERISTIC
/begin CHARACTERISTIC dsCOILX_TDWELL "Dwell time recovery value" VALUE 0xFC71F6 Scalar_UWORD 0 RecoveryCOILxTDC_CM_ufix16_E1_us 0 3000 /end CHARACTERISTIC
/begin MEASUREMENT dsCOILxDwTime "Dwell time generated by active diagnosis" UWORD IgntTDC_CM_ufix16_E1_us 0 0 0 6000 ECU_ADDRESS 0x400030B4 /end MEASUREMENT
/begin MEASUREMENT dsCOILxDwTimePD "Tst_dsCOILxDwTimePD: Dwell time after the recovery - diagnostic internal variable" UWORD RecoveryCOILxTDC_CM_ufix16_E1_us 0 0 0 6000 ECU_ADDRESS 0x40003198 /end MEASUREMENT
/begin MEASUREMENT dsCOILxDwTimePDRec "Dwell time after the recovery - diagnostic internal variable (to be applied only if recovery 50 is active)" UWORD RecoveryCOILxTDC_CM_ufix16_E1_us 0 0 0 6000 ECU_ADDRESS 0x40003196 /end MEASUREMENT
/begin MEASUREMENT dsCOILxDwTimeRec "Dwell time generated by active diagnosis" UWORD IgntTDC_CM_ufix16_E1_us 0 0 0 6000 ECU_ADDRESS 0x400030B2 /end MEASUREMENT
/begin MEASUREMENT dsCOILxRec_AdiaEn "Error validation state machine enable" UBYTE IgntTDC_CM_boolean_adm 0 0 0 1 ECU_ADDRESS 0x400030AF /end MEASUREMENT
/begin MEASUREMENT dsCOILxRec_CodErr "Coilx diagnostic line error code" UBYTE IgntTDC_CM_tFault_adm 0 0 0 89 ECU_ADDRESS 0x400030AD /end MEASUREMENT
/begin MEASUREMENT dsCOILx_AdiaEn "Error validation state machine enable" UBYTE IgntTDC_CM_boolean_adm 0 0 0 1 ECU_ADDRESS 0x400030B0 /end MEASUREMENT
/begin MEASUREMENT dsCOILx_CodErr "Coilx diagnostic line error code" UBYTE IgntTDC_CM_tFault_adm 0 0 0 89 ECU_ADDRESS 0x400030AE /end MEASUREMENT
/begin MEASUREMENT dsCOILx_ErrSt "Stato automa di diagnosi coilx" UBYTE InjtTDC_CM_tErrState_adm 0 0 0 128 ECU_ADDRESS 0x400031A7 /end MEASUREMENT
/begin CHARACTERISTIC dsCTSP_AUTOD "Flag Abilitazione Diagnosi CTSP (Cabin Tilt Stop Button)" VALUE 0xFCC6AC Scalar_BOOLEAN 0 FaultChkCTSP4ms_CM_boolean_adm 0 1 /end CHARACTERISTIC
/begin MEASUREMENT dsCTSP_AutoD "Abilitazione automa di diagnosi CTSP (Cabin Tilt Stop Button)" UBYTE Vfnc4ms_CM_boolean_adm 0 0 0 1 ECU_ADDRESS 0x4000466E /end MEASUREMENT
/begin MEASUREMENT dsCTSP_CodErr "Codice di errore della linea CTSP (Cabin Tilt Stop Button)" UBYTE Vfnc4ms_CM_tFault_adm 0 0 0 88 ECU_ADDRESS 0x40004649 /end MEASUREMENT
/begin CHARACTERISTIC dsCTSP_ERROR_TIME "Flag Abilitazione Diagnosi coerenza segnali nella diagnosi CTSP (Cabin Tilt Stop Button)" VALUE 0xFCC6AA Scalar_UWORD 0 FaultChkCTSP4ms_CM_ufix16_Sp004_sec 0 240 /end CHARACTERISTIC
/begin CHARACTERISTIC dsCTST_AUTOD "Flag Abilitazione Diagnosi CTST (Cabin Tilt Start Button)" VALUE 0xFCC6A8 Scalar_BOOLEAN 0 FaultChkCTST4ms_CM_boolean_adm 0 1 /end CHARACTERISTIC
/begin MEASUREMENT dsCTST_AutoD "Abilitazione automa di diagnosi CTST (Cabin Tilt Start Button)" UBYTE Vfnc4ms_CM_boolean_adm 0 0 0 1 ECU_ADDRESS 0x4000466D /end MEASUREMENT
/begin MEASUREMENT dsCTST_CodErr "Codice di errore della linea CTST (Cabin Tilt Start Button)" UBYTE Vfnc4ms_CM_tFault_adm 0 0 0 88 ECU_ADDRESS 0x40004648 /end MEASUREMENT
/begin CHARACTERISTIC dsCTST_ERROR_TIME "Flag Abilitazione Diagnosi coerenza segnali nella diagnosi CTST (Cabin Tilt Start Button)" VALUE 0xFCC6A6 Scalar_UWORD 0 FaultChkCTST4ms_CM_ufix16_Sp004_sec 0 240 /end CHARACTERISTIC
/begin MEASUREMENT dsChange_Phase "Numero volte in cui la strategia ha cambiato fase di iniezione" UBYTE RecRifasaInjTDC_CM_uint8_adm 0 0 0 40 ECU_ADDRESS 0x400032E1 /end MEASUREMENT
/begin MEASUREMENT dsCheckStazQ "Stato della FlowChart di test delle condizioni di stazionario" UBYTE TE_TM_CheckStazDiag_50ms_Symbol_CM_uint8_adm 0 0 1 3 ECU_ADDRESS 0x400041C2 /end MEASUREMENT
/begin MEASUREMENT dsCheck_Index "Numero di cicli di validazione con esito OK" UBYTE RecRifasaInjTDC_CM_uint8_adm 0 0 0 50 ECU_ADDRESS 0x400032E0 /end MEASUREMENT
/begin MEASUREMENT dsCnd2ndLvlDiag "Flag che riassume le condizioni per abilitare il riconoscimento dello stazionario per la diagnosi di secondo livello" UBYTE TE_TM_CheckStazDiag_50ms_Symbol_CM_boolean_adm 0 0 0 1 ECU_ADDRESS 0x400041C1 /end MEASUREMENT
/begin MEASUREMENT dsCntPMSDaAbil "Number of PMS occurred since the RecRifasaInj enabling" ULONG RecRifasaInjTDC_CM_uint32_adm 0 0 0 65000 ECU_ADDRESS 0x400032DC /end MEASUREMENT
/begin MEASUREMENT dsCohLamState "Flag che segnala l`operatività della sonda lambda" UBYTE Ctit_LambdaCtrlTDC_CM_boolean_adm 0 0 0 1 ECU_ADDRESS 0x400023D2 /end MEASUREMENT
/begin MEASUREMENT dsContAzz "Evento contatore qsCntPMSDaAbil azzerato" UBYTE RecRifasaInjTDC_CM_boolean_adm 0 0 0 1 ECU_ADDRESS 0x400032D8 /end MEASUREMENT
/begin CHARACTERISTIC dsDCAT_AUTOD "Flag abilitazione generale diagnosi catalizzatore" VALUE 0xFC4805 Scalar_BOOLEAN 0 Cata100ms_Symbol_CM_boolean_adm 0 1 /end CHARACTERISTIC
/begin MEASUREMENT dsDCAT_CodErr "lag di risultato diagnosi (diagnosi catalizzatore)" UBYTE Dcat_Diagnosis100ms_CM_tFault_adm 0 0 0 89 ECU_ADDRESS 0x40002661 /end MEASUREMENT
/begin CHARACTERISTIC dsDCMV_AUTOD "Abilitazione diagnosi monte-valle" VALUE 0xFC49AE Scalar_BOOLEAN 0 DCmvInterface100ms_Symbol_CM_boolean_adm 0 1 /end CHARACTERISTIC
/begin MEASUREMENT dsDCMV_CodErr "Flag di risultato diagnosi (diagnosi monte-valle)" UBYTE Dcat_Diagnosis100ms_CM_tFault_adm 0 0 0 89 ECU_ADDRESS 0x40002660 /end MEASUREMENT
/begin CHARACTERISTIC dsDELTA_UMA "Delta per la minima tensione ammessa per UMA" VALUE 0xFC5784 Scalar_UWORD 0 FaultCheckLRN024ms_Symbol_CM_ufix16_En10_V 0 5 /end CHARACTERISTIC
/begin CHARACTERISTIC dsDEL_INF_AIR2H "Delta aria minima Diagnosi di 2ndo Livello per AIR2H" VALUE 0xFCB598 Scalar_UWORD 0 TE_TM_FaultChkAIR2H_50ms_Symbol_CM_ufix16_En4_kg_h 0 1000 /end CHARACTERISTIC
/begin CHARACTERISTIC dsDEL_INF_AIR2L "Delta aria minima Diagnosi di 2ndo Livello per AIR2L" VALUE 0xFCB5A2 Scalar_UWORD 0 TE_TM_FaultChkAIR2L_50ms_Symbol_CM_ufix16_En4_kg_h 0 1000 /end CHARACTERISTIC
/begin MEASUREMENT dsDFLF_CodErr "Flag di risultato diagnosi (diagnosi fuel system - ripartizione)" UBYTE Fuels_CtrlMgmtTDC_CM_tFault_adm 0 0 0 81 ECU_ADDRESS 0x40002EA5 /end MEASUREMENT
/begin MEASUREMENT dsDFLL_CodErr "Flag di risultato diagnosi (diagnosi fuel system - lean)" UBYTE Fuels_CtrlMgmtTDC_CM_tFault_adm 0 0 0 81 ECU_ADDRESS 0x40002EA4 /end MEASUREMENT
/begin MEASUREMENT dsDFLR_CodErr "Flag di risultato diagnosi (diagnosi fuel system - rich)" UBYTE Fuels_CtrlMgmtTDC_CM_tFault_adm 0 0 0 81 ECU_ADDRESS 0x40002EA3 /end MEASUREMENT
/begin CHARACTERISTIC dsDFLSY_AUTOD "Abilitazione generale della diagnosi Fuel System" VALUE 0xFC59A9 Scalar_BOOLEAN 0 Abilitazione_DFSLY_100ms_Symbol_CM_boolean_adm 0 1 /end CHARACTERISTIC
/begin CHARACTERISTIC dsDIS_COUNT_ADD "Delta di incremento al contatore di disuniformita ciclica in caso di superamento soglia" VALUE 0xFC8004 Scalar_UWORD 0 RecRifasaInjTDC_CM_uint16_adm 0 100 /end CHARACTERISTIC
/begin CHARACTERISTIC dsDIS_COUNT_LESS "Delta di decremento al contatore di disuniformita ciclica in caso di superamento soglia" VALUE 0xFC8002 Scalar_UWORD 0 RecRifasaInjTDC_CM_uint16_adm 0 100 /end CHARACTERISTIC
/begin CHARACTERISTIC dsDIS_CYL_MISF_ADV "(1) Disabilita la strategia di cut-off pilotata dalla strategia \"MisfireTimeHis_TDC\"" VALUE 0xFC71F4 Scalar_BOOLEAN 0 RecoveryCOILxTDC_CM_boolean_adm 0 1 /end CHARACTERISTIC
/begin CHARACTERISTIC dsDIS_CYL_MISF_INJ "(1) Abilita la strategia di cut-off pilotata dalla strategia \"MisfireTimeHis_TDC\"" VALUE 0xFC8001 Scalar_BOOLEAN 0 RecoveryINJxTDC_CM_boolean_adm 0 1 /end CHARACTERISTIC
/begin CHARACTERISTIC dsDIS_CYL_TR_ADV "(1) Disabilita la strategia di cut-off pilotata dalla strategia di torque reduction" VALUE 0xFC71F3 Scalar_BOOLEAN 0 RecoveryCOILxTDC_CM_boolean_adm 0 1 /end CHARACTERISTIC
/begin CHARACTERISTIC dsDIS_CYL_TR_INJ "(1) Abilita la strategia di cut-off pilotata dalla strategia di torque reduction" VALUE 0xFC8000 Scalar_BOOLEAN 0 RecoveryINJxTDC_CM_boolean_adm 0 1 /end CHARACTERISTIC
/begin CHARACTERISTIC dsDLAM_AUTOD "Abilitazione generale della diagnosi sonda lambda monte" VALUE 0xFC47E8 Scalar_BOOLEAN 0 AbilitazioneDLAM100ms_Symbol_CM_boolean_adm 0 1 /end CHARACTERISTIC
/begin MEASUREMENT dsDLAM_CodErr "Flag di risultato diagnosi (diagnosi sonda lambda monte)" UBYTE Dcat_Diagnosis100ms_CM_tFault_adm 0 0 0 89 ECU_ADDRESS 0x4000265F /end MEASUREMENT
/begin MEASUREMENT dsDeltaPhase "Variazioni in gradi di fase di iniezioni per rifasarla in caso di funzionamento a scintilla persa" UWORD InjtTDC_CM_ufix16_En4_degree 0 0 0 360 ECU_ADDRESS 0x400031B6 /end MEASUREMENT
/begin MEASUREMENT dsDiagEVRTimerSF "Timer per diagnosi EVR in uscita FSM" UWORD DiagEVRPON4ms_Symbol_CM_ufix16_E2_ms 0 0 0 12000 ECU_ADDRESS 0x40002DF8 /end MEASUREMENT
/begin MEASUREMENT dsDiagPRVTimerSF "Timer diagnosi PRV in uscita FSM" UWORD DiagPRVPON4ms_Symbol_CM_ufix16_E2_ms 0 0 0 12000 ECU_ADDRESS 0x40003FF4 /end MEASUREMENT
/begin MEASUREMENT dsDiagSTRTimer "Starter Relay Diagnosis timer in uscita FSM" UWORD TF_TE_DiagSTR_PON4ms_CM_ufix16_E2_ms 0 0 0 12000 ECU_ADDRESS 0x4000239E /end MEASUREMENT
/begin MEASUREMENT dsDiffDurataTDC "Differenza fra Massima e Minima durata del TDC relativa ad un ciclo motore (720 gradi)" ULONG RecRifasaInjTDC_CM_uint32_us 0 0 0 130000 ECU_ADDRESS 0x400032D4 /end MEASUREMENT
/begin MEASUREMENT dsDisCount "Indice di disuniformita ciclica" UWORD RecRifasaInjTDC_CM_uint16_adm 0 0 0 10000 ECU_ADDRESS 0x400032D0 /end MEASUREMENT
/begin MEASUREMENT dsDisCountBefAzz "Indice di disuniformita ciclica prima di effettuare azzeramento per fine ciclo di verifica" UWORD RecRifasaInjTDC_CM_uint16_adm 0 0 0 10000 ECU_ADDRESS 0x400032CE /end MEASUREMENT
/begin MEASUREMENT dsECUTempV "Sensor voltage for Ecu temperature elaborated by recovery block" UWORD Ecut1s_CM_ufix16_En10_V 0 0 0 5 ECU_ADDRESS 0x40002A36 /end MEASUREMENT
/begin CHARACTERISTIC dsEGBRK_DUTYREC "Engine Brake actuator command duty cycle recovery value" VALUE 0xFC4D24 Scalar_UWORD 0 EngineBrakeMgm50ms_CM_ufix16_En4__ 0 100 /end CHARACTERISTIC
/begin CHARACTERISTIC dsEGRC_AUTOD "EGR control stability diagnosis enable flag" VALUE 0xFC557B Scalar_BOOLEAN 0 FaultChkEGRC4ms_CM_boolean_adm 0 1 /end CHARACTERISTIC
/begin MEASUREMENT dsEGRC_AutoD "EGR control, enable diagnosis signal." UBYTE EgrMgm4ms_CM_boolean_adm 0 0 0 1 ECU_ADDRESS 0x40002AEC /end MEASUREMENT
/begin MEASUREMENT dsEGRC_CodErr "EGR control, error code." UBYTE EgrMgm4ms_CM_tFault_adm 0 0 0 89 ECU_ADDRESS 0x40002AE8 /end MEASUREMENT
/begin CHARACTERISTIC dsEGRP_AUTOD "EGR position sensor diagnosis enable flag" VALUE 0xFC557A Scalar_BOOLEAN 0 FaultChkEGRP4ms_CM_boolean_adm 0 1 /end CHARACTERISTIC
/begin MEASUREMENT dsEGRP_AutoD "EGR position sensor, enable diagnosis signal." UBYTE EgrMgm4ms_CM_boolean_adm 0 0 0 1 ECU_ADDRESS 0x40002AEB /end MEASUREMENT
/begin MEASUREMENT dsEGRP_CodErr "EGR position sensor, error code." UBYTE EgrMgm4ms_CM_tFault_adm 0 0 0 89 ECU_ADDRESS 0x40002AE7 /end MEASUREMENT
/begin CHARACTERISTIC dsEGRP_VFIX "EGR position recovery value" VALUE 0xFC5578 Scalar_UWORD 0 RecoveryEGRP4ms_CM_ufix16_En10_V 0 5 /end CHARACTERISTIC
/begin CHARACTERISTIC dsEGRP_VS "Diag line selector to set the Supply Voltage channel used for EGR position sensor (diag EGRP)." VALUE 0xFC5576 Scalar_UBYTE 0 FaultChkEGRP4ms_CM_uint8_adm 1 3 /end CHARACTERISTIC
/begin CHARACTERISTIC dsEGRP_V_ORH "Voltage higher threshold for EGR position sensor. " VALUE 0xFC5574 Scalar_UWORD 0 FaultChkEGRP4ms_CM_ufix16_En10_V 0 5 /end CHARACTERISTIC
/begin CHARACTERISTIC dsEGRP_V_ORL "Voltage lower threshold for EGR position sensor. " VALUE 0xFC5572 Scalar_UWORD 0 FaultChkEGRP4ms_CM_ufix16_En10_V 0 5 /end CHARACTERISTIC
/begin CHARACTERISTIC dsEGRV_AUTOD "EGR valve electrical diagnosis enable flag" VALUE 0xFC5571 Scalar_BOOLEAN 0 FaultChkEGRV4ms_CM_boolean_adm 0 1 /end CHARACTERISTIC
/begin MEASUREMENT dsEGRV_AutoD "EGR valve, enable diagnosis signal." UBYTE EgrMgm4ms_CM_boolean_adm 0 0 0 1 ECU_ADDRESS 0x40002AEA /end MEASUREMENT
/begin MEASUREMENT dsEGRV_CodErr "EGR valve, error code." UBYTE EgrMgm4ms_CM_tFault_adm 0 0 0 89 ECU_ADDRESS 0x40002AE6 /end MEASUREMENT
/begin CHARACTERISTIC dsENGBRK_AUTOD "Engine brake diagnostic line enable" VALUE 0xFC4D23 Scalar_BOOLEAN 0 FaultChkENGBRK50ms_CM_boolean_adm 0 1 /end CHARACTERISTIC
/begin MEASUREMENT dsENGBRK_AdiaEn "Diagnosis Engine Brake enabled by line calibration flag" UBYTE Egbrk50ms_CM_boolean_adm 0 0 0 1 ECU_ADDRESS 0x40002AA7 /end MEASUREMENT
/begin MEASUREMENT dsENGBRK_CodErr "Engine Brake diagnostic line error code" UBYTE Egbrk50ms_CM_tFault_adm 0 0 0 89 ECU_ADDRESS 0x40002AA6 /end MEASUREMENT
/begin MEASUREMENT dsEPRMgs_CodErr "Code error DU-EPR MGS device" UBYTE EprMgm4ms_CM_tFault_adm 0 0 0 88 ECU_ADDRESS 0x40002C48 /end MEASUREMENT
/begin MEASUREMENT dsEPRTEcuCond_CodErr "Code error DU-EPR temperature" UBYTE EprMgm4ms_CM_tFault_adm 0 0 0 88 ECU_ADDRESS 0x40002C47 /end MEASUREMENT
/begin MEASUREMENT dsEPRTEcu_CodErr "Code error DU-EPR temperature sensor" UBYTE EprMgm4ms_CM_tFault_adm 0 0 0 88 ECU_ADDRESS 0x40002C46 /end MEASUREMENT
/begin MEASUREMENT dsEPRVPW_CodErr "Code error DU-EPR supply voltage" UBYTE EprMgm4ms_CM_tFault_adm 0 0 0 88 ECU_ADDRESS 0x40002C45 /end MEASUREMENT
/begin CHARACTERISTIC dsETASP_SRI_EVAL "ETASP threshold under which the KSP diagnosis is disabled" VALUE 0xFC9B2C Scalar_UWORD 0 FaultChkKSPxTDC_CM_ufix16_En10_adm 0 3 /end CHARACTERISTIC
/begin MEASUREMENT dsEVRADiagStat "CNG electrovalves relay active diagnosis state (UNKNOWN = 39, STOPPED = 0 DURING =1 END = 2 IMPOSSIBLE = 3)" UBYTE Evrc4ms_CM_tActDiagStat_adm 0 0 0 39 ECU_ADDRESS 0x40001070 /end MEASUREMENT
/begin CHARACTERISTIC dsEVRCGND_AUTOD "CNG electrovalves command shortcut to ground- diagnostic line enable flag" VALUE 0xFC5790 Scalar_BOOLEAN 0 FaultChkELTEVR4ms_CM_boolean_adm 0 1 /end CHARACTERISTIC
/begin MEASUREMENT dsEVRCGND_AdiaEn "Error validation state machine enable" UBYTE Evrc4ms_CM_boolean_adm 0 0 0 1 ECU_ADDRESS 0x40002DE9 /end MEASUREMENT
/begin MEASUREMENT dsEVRCGND_AutoD "CNG electrovalves command shortcut to ground- diagnostic line enable flag" UBYTE Evrc4ms_CM_boolean_adm 0 0 0 1 ECU_ADDRESS 0x40002DEA /end MEASUREMENT
/begin MEASUREMENT dsEVRCGND_CodErr "Error code of diagnostic line detecting CNG electrovalves relay command shortcut to ground" UBYTE Evrc4ms_CM_tFault_adm 0 0 0 88 ECU_ADDRESS 0x40002DE1 /end MEASUREMENT
/begin CHARACTERISTIC dsEVRCOL_AUTOD "Open load on CNG electrovalves command - diagnostic line enable flag" VALUE 0xFC578F Scalar_BOOLEAN 0 FaultChkELTEVR4ms_CM_boolean_adm 0 1 /end CHARACTERISTIC
/begin MEASUREMENT dsEVRCOL_AdiaEn "Error validation state machine enable" UBYTE Evrc4ms_CM_boolean_adm 0 0 0 1 ECU_ADDRESS 0x40002DED /end MEASUREMENT
/begin MEASUREMENT dsEVRCOL_AutoD "Open load on CNG electrovalves command - diagnostic line enable flag" UBYTE Evrc4ms_CM_boolean_adm 0 0 0 1 ECU_ADDRESS 0x40002DEE /end MEASUREMENT
/begin MEASUREMENT dsEVRCOL_CodErr "Error code of diagnostic line detecting open load on CNG electrovalves relay command" UBYTE Evrc4ms_CM_tFault_adm 0 0 0 88 ECU_ADDRESS 0x40002DE3 /end MEASUREMENT
/begin CHARACTERISTIC dsEVRCVB_AUTOD "CNG electrovalves command shortcut to battery - diagnostic line enable flag" VALUE 0xFC578E Scalar_BOOLEAN 0 FaultChkELTEVR4ms_CM_boolean_adm 0 1 /end CHARACTERISTIC
/begin MEASUREMENT dsEVRCVB_AdiaEn "Error validation state machine enable" UBYTE Evrc4ms_CM_boolean_adm 0 0 0 1 ECU_ADDRESS 0x40002DEB /end MEASUREMENT
/begin MEASUREMENT dsEVRCVB_AutoD "CNG electrovalves command shortcut to battery - diagnostic line enable flag" UBYTE Evrc4ms_CM_boolean_adm 0 0 0 1 ECU_ADDRESS 0x40002DEC /end MEASUREMENT
/begin MEASUREMENT dsEVRCVB_CodErr "Error code of diagnostic line detecting CNG electrovalves relay command shortcut to battery" UBYTE Evrc4ms_CM_tFault_adm 0 0 0 88 ECU_ADDRESS 0x40002DE2 /end MEASUREMENT
/begin CHARACTERISTIC dsEVRPON_AUTOD "CNG electrovalves diagnosis at power on enable flag" VALUE 0xFC5792 Scalar_BOOLEAN 0 DiagEVRPON4ms_Symbol_CM_boolean_adm 0 1 /end CHARACTERISTIC
/begin CHARACTERISTIC dsEVR_TIMEOFF "Steps for diagnosis at power on with CNG electrovalves not driven by ECU" VALUE 0xFC5794 Scalar_UWORD 0 DiagEVRPON4ms_Symbol_CM_ufix16_E2_ms 0 10000 /end CHARACTERISTIC
/begin CHARACTERISTIC dsEVR_TIMEON "Steps for diagnosis at power on with CNG electrovalves driven by ECU" VALUE 0xFC5796 Scalar_UWORD 0 DiagEVRPON4ms_Symbol_CM_ufix16_E2_ms 0 10000 /end CHARACTERISTIC
/begin MEASUREMENT dsEVRel "CNG electrovalves relay command after the recovery" UBYTE Evrc4ms_CM_boolean_adm 0 0 0 1 ECU_ADDRESS 0x40002DE6 /end MEASUREMENT
/begin MEASUREMENT dsEgrPosRec "EGR position sensor voltage (used by recovery)" UWORD EgrMgm4ms_CM_ufix16_En10_V 0 0 0 5 ECU_ADDRESS 0x40002B02 /end MEASUREMENT
/begin MEASUREMENT dsEgrPosV "EGR position sensor voltage (after recovery)" UWORD EgrMgm4ms_CM_ufix16_En10_V 0 0 0 5 ECU_ADDRESS 0x40002B04 /end MEASUREMENT
/begin MEASUREMENT dsEgrPosVPostD "EGR position sensor post diagnosis value" UWORD RecoveryEGRP4ms_CM_ufix16_En10_V 0 0 0 5 ECU_ADDRESS 0x40002B5E /end MEASUREMENT
/begin MEASUREMENT dsEgrPosVPreR "EGR position sensor voltage (used by recovery)" UWORD EgrMgm4ms_CM_ufix16_En10_V 0 0 0 5 ECU_ADDRESS 0x40002B06 /end MEASUREMENT
/begin MEASUREMENT dsEnClosedLoopPR "Abilitazione closed loop Post Recovery" UBYTE BoostControl50ms_Symbol_CM_boolean_adm 0 0 0 1 ECU_ADDRESS 0x4000222D /end MEASUREMENT
/begin MEASUREMENT dsEnCyl_TRTmp "Stato abilitazione Torque Reduction sul cilindro corrente" UBYTE TE_TM_Torque_CylCut_TDC_Symbol_CM_boolean_adm 0 0 0 1 ECU_ADDRESS 0x400041FC /end MEASUREMENT
/begin MEASUREMENT dsEn_Cyl_TR "Flag di Torque Reduction sul cilindro corrente: 1 mantiene la programmazione, 0 lo spegne" UBYTE IgntTDC_CM_boolean_adm 0 0 0 1 ECU_ADDRESS 0x400041E2 /end MEASUREMENT
/begin MEASUREMENT dsEnableCondTHRST "bilitazione generale delle linee THRST e THRDL" UBYTE Ethrc4ms_CM_boolean_adm 0 0 0 1 ECU_ADDRESS 0x40002C5D /end MEASUREMENT
/begin MEASUREMENT dsEngBrkDutyPostRec "Engine Brake actuator command duty cycle after recovery" UWORD EngineBrakeMgm50ms_CM_ufix16_En4__ 0 0 0 100 ECU_ADDRESS 0x40002AB0 /end MEASUREMENT
/begin MEASUREMENT dsFAN1DutyPostR "FAN1 Duty-Cycle post recovery " UWORD RecoveryFAN1_100ms_CM_ufix16_En3__ 0 0 0 100 ECU_ADDRESS 0x40002E70 /end MEASUREMENT
/begin CHARACTERISTIC dsFAN1_AUTOD "FAN1 diagnostic line enable" VALUE 0xFC59A6 Scalar_BOOLEAN 0 FaultChkFAN1_100ms_CM_boolean_adm 0 1 /end CHARACTERISTIC
/begin MEASUREMENT dsFAN1_AdiaEn "Error validation state machine enable for diagnostic line FAN1" UBYTE FanCool100ms_CM_boolean_adm 0 0 0 1 ECU_ADDRESS 0x40002E0D /end MEASUREMENT
/begin MEASUREMENT dsFAN1_CodErr "Error code of diagnostic line detecting open load, short to battery or overtemperature on fan1 cool relay command" UBYTE FanCool100ms_CM_tFault_adm 0 0 0 88 ECU_ADDRESS 0x40002E0B /end MEASUREMENT
/begin CHARACTERISTIC dsFAN1_DUTYREC "FAN1 Recovery Duty-Cycle Value" VALUE 0xFC59A4 Scalar_UWORD 0 RecoveryFAN1_100ms_CM_ufix16_En3__ 0 100 /end CHARACTERISTIC
/begin CHARACTERISTIC dsFAN1_UP_THR "Upper DutyCycle Threshold for FAN1 command" VALUE 0xFC59A2 Scalar_UWORD 0 RecoveryFAN1_100ms_CM_ufix16_En3__ 0 100 /end CHARACTERISTIC
/begin MEASUREMENT dsFAN2CmdPostR "FAN2 command post recovery " UBYTE RecoveryFAN2_100ms_CM_boolean_adm 0 0 0 1 ECU_ADDRESS 0x40002E72 /end MEASUREMENT
/begin CHARACTERISTIC dsFAN2_AUTOD "FAN2 diagnostic line enable" VALUE 0xFC59A1 Scalar_BOOLEAN 0 FaultChkFAN2_100ms_CM_boolean_adm 0 1 /end CHARACTERISTIC
/begin MEASUREMENT dsFAN2_AdiaEn "Error validation state machine enable for diagnostic line FAN2" UBYTE FanCool100ms_CM_boolean_adm 0 0 0 1 ECU_ADDRESS 0x40002E0C /end MEASUREMENT
/begin MEASUREMENT dsFAN2_CodErr "Error code of diagnostic line detecting open load, short to battery or overtemperature on fan2 cool relay command" UBYTE FanCool100ms_CM_tFault_adm 0 0 0 88 ECU_ADDRESS 0x40002E0A /end MEASUREMENT
/begin CHARACTERISTIC dsFAR01_AUTOD "Flag Abilitazione Diagnosi sul potenziometro principale della farfalla motorizzata" VALUE 0xFCB47B Scalar_BOOLEAN 0 TE_TM_FaultChkFAR014ms_CM_boolean_adm 0 1 /end CHARACTERISTIC
/begin MEASUREMENT dsFAR01_AutoD "Flag abilitazione diagnosi potenziometro principale farfalla motorizzata" UBYTE Thrp4ms_CM_boolean_adm 0 0 0 1 ECU_ADDRESS 0x400040F5 /end MEASUREMENT
/begin MEASUREMENT dsFAR01_CodErr "Codice di errore linea potenziometro principale farfalla motorizzata" UBYTE Thrp4ms_CM_tFault_adm 0 0 0 89 ECU_ADDRESS 0x400040F0 /end MEASUREMENT
/begin CHARACTERISTIC dsFAR01_VS "Selettore linea di diagnosi associata al canale di alimentazione (Voltage Supply) potenziometro (POT_1) farfalla." VALUE 0xFCB47A Scalar_UBYTE 0 TE_TM_FaultChkFAR014ms_CM_uint8_adm 1 3 /end CHARACTERISTIC
/begin CHARACTERISTIC dsFAR02_AUTOD "Flag Abilitazione Diagnosi sul potenziometro secondario della farfalla motorizzata" VALUE 0xFCB479 Scalar_BOOLEAN 0 TE_TM_FaultChkFAR024ms_CM_boolean_adm 0 1 /end CHARACTERISTIC
/begin MEASUREMENT dsFAR02_AutoD "Flag abilitazione diagnosi potenziometro secondario farfalla motorizzata" UBYTE Thrp4ms_CM_boolean_adm 0 0 0 1 ECU_ADDRESS 0x400040F4 /end MEASUREMENT
/begin MEASUREMENT dsFAR02_CodErr "Codice di errore linea potenziometro secondario farfalla motorizzata" UBYTE Thrp4ms_CM_tFault_adm 0 0 0 89 ECU_ADDRESS 0x400040EF /end MEASUREMENT
/begin CHARACTERISTIC dsFAR02_VS "Selettore linea di diagnosi associata al canale di alimentazione (Voltage Supply) potenziometro (POT_2) farfalla." VALUE 0xFCB478 Scalar_UBYTE 0 TE_TM_FaultChkFAR024ms_CM_uint8_adm 1 3 /end CHARACTERISTIC
/begin CHARACTERISTIC dsFAR12_AUTOD "Abilitazione del check di doppio fault sui potenziometri farfalla motorizzata" VALUE 0xFCB47C Scalar_BOOLEAN 0 TE_TM_FaultChkFAR124ms_Symbol_CM_boolean_adm 0 1 /end CHARACTERISTIC
/begin MEASUREMENT dsFAR12_AutoD "Flag abilitazione diagnosi doppio fault elettrico potenziometro farfalla FAR12" UBYTE Thrp4ms_CM_boolean_adm 0 0 0 1 ECU_ADDRESS 0x400040F3 /end MEASUREMENT
/begin MEASUREMENT dsFAR12_CodErr "Codice di errore linea sul doppio fault elettrico potenziometro farfalla FAR12" UBYTE Thrp4ms_CM_tFault_adm 0 0 0 89 ECU_ADDRESS 0x400040EE /end MEASUREMENT
/begin CHARACTERISTIC dsFAR2_THRV_ORH "Soglia Superiore PTTHRV sul potenziometro secondario" VALUE 0xFCB476 Scalar_UWORD 0 TE_TM_FaultChkFAR024ms_CM_ufix16_En10_V 0 5 /end CHARACTERISTIC
/begin CHARACTERISTIC dsFAR2_THRV_ORL "Soglia Inferiore PTTHRV sul potenziometro secondario" VALUE 0xFCB474 Scalar_UWORD 0 TE_TM_FaultChkFAR024ms_CM_ufix16_En10_V 0 5 /end CHARACTERISTIC
/begin CHARACTERISTIC dsFARCH_AUTOD "Abilitazione del check di coerenza sulle due tracce posizione farfalla motorizzata" VALUE 0xFCB47E Scalar_BOOLEAN 0 TE_TM_FaultChkFARCH4ms_Symbol_CM_boolean_adm 0 1 /end CHARACTERISTIC
/begin MEASUREMENT dsFARCH_AutoD "Flag abilitazione diagnosi coerenza potenziometri farfalla motorizzata" UBYTE Thrp4ms_CM_boolean_adm 0 0 0 1 ECU_ADDRESS 0x400040F2 /end MEASUREMENT
/begin MEASUREMENT dsFARCH_CodErr "Codice di errore linea coerenza potenziometri farfalla motorizzata" UBYTE Thrp4ms_CM_tFault_adm 0 0 0 89 ECU_ADDRESS 0x400040ED /end MEASUREMENT
/begin MEASUREMENT dsFARConfig "Valore di configurazione del sensore posizione farfalla motorizzata" UBYTE Thrp4ms_CM_uint8_adm 0 0 1 2 ECU_ADDRESS 0x400040F6 /end MEASUREMENT
/begin CHARACTERISTIC dsFAR_CONFIG "Costante di configurazione del sensore posizione farfalla motorizzata" VALUE 0xFCB472 Scalar_UBYTE 0 TE_TM_FaultChkFAR024ms_CM_uint8_adm 1 2 /end CHARACTERISTIC
/begin CHARACTERISTIC dsFAR_REC_VAL "Valore di recovery sul potenziometro principale della farfalla motorizzata" VALUE 0xFCB49C Scalar_UWORD 0 TE_TM_RecoveryFAR4ms_Symbol_CM_ufix16_En10_V 0 5 /end CHARACTERISTIC
/begin CHARACTERISTIC dsFAR_THRV_ORH "Soglia Superiore PTTHRV sul potenziometro principale" VALUE 0xFCB470 Scalar_UWORD 0 TE_TM_FaultChkFAR014ms_CM_ufix16_En10_V 0 5 /end CHARACTERISTIC
/begin CHARACTERISTIC dsFAR_THRV_ORL "Soglia Inferiore PTTHRV sul potenziometro principale" VALUE 0xFCB46E Scalar_UWORD 0 TE_TM_FaultChkFAR014ms_CM_ufix16_En10_V 0 5 /end CHARACTERISTIC
/begin MEASUREMENT dsFaultOp2Wait "Numero di transizioni della sonda lambda da operativa a wait" UWORD Ctit_LambdaCtrlTDC_CM_uint16_adm 0 0 0 32000 ECU_ADDRESS 0x400023E8 /end MEASUREMENT
/begin MEASUREMENT dsFlagTrOrFix "Flag che indica il tipo di recovery attuata sulla temp. aria (1 transitorio, 0 fix)" UBYTE RecoverySTA100ms_Symbol_CM_boolean_adm 0 0 0 1 ECU_ADDRESS 0x4000204D /end MEASUREMENT
/begin MEASUREMENT dsFlagWupOn "Flag che indica lÿesaurimento o meno del warm up" UBYTE RecoverySTA100ms_Symbol_CM_boolean_adm 0 0 0 1 ECU_ADDRESS 0x4000204C /end MEASUREMENT
/begin MEASUREMENT dsGasEnable "lag di abilitazione della linea del gas" UBYTE Evrc4ms_CM_boolean_adm 0 0 0 1 ECU_ADDRESS 0x40002DE5 /end MEASUREMENT
/begin CHARACTERISTIC dsHW_GAIN_VS1 "Voltage Supplier 1 Hardware Gain (partitore stadio Power Supply Voltage) - SensSply1_SS" VALUE 0xFCB00C Scalar_UWORD 0 FaultChkVS14ms_CM_ufix16_En10_adm 0 2 /end CHARACTERISTIC
/begin CHARACTERISTIC dsHW_GAIN_VS2 "Voltage Supplier 2 Hardware Gain (partitore stadio Power Supply Voltage) - SensSply2_SS" VALUE 0xFCB00A Scalar_UWORD 0 FaultChkVS24ms_CM_ufix16_En10_adm 0 2 /end CHARACTERISTIC
/begin CHARACTERISTIC dsHW_GAIN_VS3 "Voltage Supplier 3 Hardware Gain (partitore stadio Power Supply Voltage) - SensSply3_SS" VALUE 0xFCB008 Scalar_UWORD 0 FaultChkVS34ms_CM_ufix16_En10_adm 0 2 /end CHARACTERISTIC
/begin CHARACTERISTIC dsHYST_MAP_STZ_Q "Delta di cui varia la MAP rimanendo nello stazionario" VALUE 0xFCB58A Scalar_UWORD 0 TE_TM_CheckStazDiag_50ms_Symbol_CM_uint16_mbar 0 1000 /end CHARACTERISTIC
/begin CHARACTERISTIC dsHYST_RPM_STZ_Q "Delta di cui variano gli RPM rimanendo nello stazionario" VALUE 0xFCB588 Scalar_UWORD 0 TE_TM_CheckStazDiag_50ms_Symbol_CM_uint16_rpm 0 10000 /end CHARACTERISTIC
/begin MEASUREMENT dsHeatingRampFail "Diagnosys: UEGO Ramp Heating Failed" UBYTE Ctit_UEGOHeater4ms_CM_boolean 0 0 0 1 ECU_ADDRESS 0x400025D5 /end MEASUREMENT
/begin MEASUREMENT dsI19 "Recovery action dsI19: throttle angle reduction" UBYTE Pwrl4ms_CM_boolean_adm 0 0 0 1 ECU_ADDRESS 0x4000400F /end MEASUREMENT
/begin MEASUREMENT dsI20 "Immediate Recovery dsI20 activation" UBYTE RecoveryINJxTDC_CM_boolean_adm 0 0 0 1 ECU_ADDRESS 0x400032A0 /end MEASUREMENT
/begin MEASUREMENT dsI24 "Instantaneous diagnosis flag" UBYTE Boost_CtrlMgmt50ms_CM_boolean_adm 0 0 0 1 ECU_ADDRESS 0x4000400D /end MEASUREMENT
/begin MEASUREMENT dsI29 "Instantaneous diagnosis flag" UBYTE Boost_CtrlMgmt50ms_CM_boolean_adm 0 0 0 1 ECU_ADDRESS 0x4000400E /end MEASUREMENT
/begin CHARACTERISTIC dsIDLE_DOWN "Soglia Inferiore PTACCV per coerenza con switch Idle" VALUE 0xFCAC32 Scalar_UWORD 0 TE_FaultChkSPPC1_4ms_CM_ufix16_En10_V 0 5 /end CHARACTERISTIC
/begin CHARACTERISTIC dsIDLE_UP "Soglia Inferiore PTACCV per coerenza con switch Idle" VALUE 0xFCAC30 Scalar_UWORD 0 TE_FaultChkSPPC1_4ms_CM_ufix16_En10_V 0 5 /end CHARACTERISTIC
/begin CHARACTERISTIC dsINJ1_AUTOD "Flag Abilitazione Diagnosi Iniettore cilindro 1" VALUE 0xFC7FFF Scalar_BOOLEAN 0 FaultChkINJxTDC_CM_boolean_adm 0 1 /end CHARACTERISTIC
/begin CHARACTERISTIC dsINJ2_AUTOD "Flag Abilitazione Diagnosi Iniettore cilindro 2" VALUE 0xFC7FFE Scalar_BOOLEAN 0 FaultChkINJxTDC_CM_boolean_adm 0 1 /end CHARACTERISTIC
/begin CHARACTERISTIC dsINJ3_AUTOD "Flag Abilitazione Diagnosi Iniettore cilindro 3" VALUE 0xFC7FFD Scalar_BOOLEAN 0 FaultChkINJxTDC_CM_boolean_adm 0 1 /end CHARACTERISTIC
/begin CHARACTERISTIC dsINJ4_AUTOD "Flag Abilitazione Diagnosi Iniettore cilindro 4" VALUE 0xFC7FFC Scalar_BOOLEAN 0 FaultChkINJxTDC_CM_boolean_adm 0 1 /end CHARACTERISTIC
/begin CHARACTERISTIC dsINJ5_AUTOD "Flag Abilitazione Diagnosi Iniettore cilindro 5" VALUE 0xFC7FFB Scalar_BOOLEAN 0 FaultChkINJxTDC_CM_boolean_adm 0 1 /end CHARACTERISTIC
/begin CHARACTERISTIC dsINJ6_AUTOD "Flag Abilitazione Diagnosi Iniettore cilindro 6" VALUE 0xFC7FFA Scalar_BOOLEAN 0 FaultChkINJxTDC_CM_boolean_adm 0 1 /end CHARACTERISTIC
/begin CHARACTERISTIC dsINJ7_AUTOD "Flag Abilitazione Diagnosi Iniettore cilindro 7" VALUE 0xFC7FF9 Scalar_BOOLEAN 0 FaultChkINJxTDC_CM_boolean_adm 0 1 /end CHARACTERISTIC
/begin CHARACTERISTIC dsINJ8_AUTOD "Flag Abilitazione Diagnosi Iniettore cilindro 8" VALUE 0xFC7FF8 Scalar_BOOLEAN 0 FaultChkINJxTDC_CM_boolean_adm 0 1 /end CHARACTERISTIC
/begin CHARACTERISTIC dsINJX_TINJREC "Recovery Injection time on the faulty cylinder" VALUE 0xFC7FF6 Scalar_UWORD 0 RecoveryINJxTDC_CM_ufix16_E4_us 0 3008 /end CHARACTERISTIC
/begin MEASUREMENT dsINJxTInj "Tempo di iniezione valle di diagnosi e recovery (blocco RecoveryINJxTDC)" UWORD InjtTDC_CM_ufix16_E4_us 0 0 0 65520 ECU_ADDRESS 0x400031B2 /end MEASUREMENT
/begin MEASUREMENT dsINJxTInjPostR "Test Point sulla variabile dsINJxTInjPostR" UWORD RecoveryINJxTDC_CM_ufix16_E4_us 0 0 0 65520 ECU_ADDRESS 0x4000329E /end MEASUREMENT
/begin MEASUREMENT dsINJx_AdiaEn "Flag di attivazione automa di diagnosi" UBYTE InjtTDC_CM_boolean_adm 0 0 0 1 ECU_ADDRESS 0x400031A9 /end MEASUREMENT
/begin MEASUREMENT dsINJx_CodErr "Codice errore iniettore corrente" UBYTE InjtTDC_CM_tFault_adm 0 0 0 89 ECU_ADDRESS 0x400031A5 /end MEASUREMENT
/begin MEASUREMENT dsINJx_ErrSt "Stato automa di diagnosi iniettore x" UBYTE InjtTDC_CM_tErrState_adm 0 0 0 128 ECU_ADDRESS 0x400031A6 /end MEASUREMENT
/begin MEASUREMENT dsIgntFaultChkEn "Flag di abilitazione spark fault check" UBYTE IgntTDC_CM_boolean_adm 0 0 0 1 ECU_ADDRESS 0x400030AC /end MEASUREMENT
/begin MEASUREMENT dsInjtFaultChkEn "Flag di abilitazione Fault Check iniettori" UBYTE InjtTDC_CM_boolean_us 0 0 0 1 ECU_ADDRESS 0x400031A4 /end MEASUREMENT
/begin CHARACTERISTIC dsKSP1_AUTOD "Knock sensor 1 present diagnosis line enable" VALUE 0xFC9B2B Scalar_BOOLEAN 0 FaultChkKSPxTDC_CM_boolean_adm 0 1 /end CHARACTERISTIC
/begin CHARACTERISTIC dsKSP2_AUTOD "Knock sensor 2 present diagnosis line enable" VALUE 0xFC9B2A Scalar_BOOLEAN 0 FaultChkKSPxTDC_CM_boolean_adm 0 1 /end CHARACTERISTIC
/begin MEASUREMENT dsKSPx_AdiaEn "Error validation state machine enable for Knock sensor present X diagnosis line" UBYTE KnockTDC_CM_boolean_adm 0 0 0 1 ECU_ADDRESS 0x400034AE /end MEASUREMENT
/begin MEASUREMENT dsKSPx_CodErr "Knock sensor present X diagnostic line error code" UBYTE KnockTDC_CM_tFault_adm 0 0 0 89 ECU_ADDRESS 0x400034A9 /end MEASUREMENT
/begin CHARACTERISTIC dsK_TR2_TA "Costante transitorio di recovery temp. aria in uscita da warm up" VALUE 0xFC1E30 Scalar_UWORD 0 RecoverySTA100ms_Symbol_CM_ufix16_En10_adm 0 1 /end CHARACTERISTIC
/begin CHARACTERISTIC dsK_WUP_TR1_TA "Costante transitorio di recovery temp. aria in warm up" VALUE 0xFC1E2E Scalar_UWORD 0 RecoverySTA100ms_Symbol_CM_ufix16_En10_adm 0 1 /end CHARACTERISTIC
/begin MEASUREMENT dsKnockSriThr "[OUT]  Knock sensor SRI threshold (to diagnose knock sensors not working properly)" FLOAT32_IEEE FaultChkKSPxTDC_CM_single_uV 0 0 0 10000000000 ECU_ADDRESS 0x400034BC /end MEASUREMENT
/begin MEASUREMENT dsLHDuty "Lambda heater PWM command after the recovery" UWORD Ctit_LambdaHeater100ms_CM_uint16__ 0 0 0 100 ECU_ADDRESS 0x40002514 /end MEASUREMENT
/begin MEASUREMENT dsLHDutyPostR "EGO heater PWM DC Post Recovery" UWORD RecoveryLHR100ms_CM_uint16__ 0 0 0 100 ECU_ADDRESS 0x400025B6 /end MEASUREMENT
/begin CHARACTERISTIC dsLHR_AUTOD "Lambda Heater Pre Catalyst diagnostic line enable" VALUE 0xFC45FF Scalar_BOOLEAN 0 FaultChkLHR100ms_CM_boolean_adm 0 1 /end CHARACTERISTIC
/begin MEASUREMENT dsLHR_AdiaEn "Error validation state machine enable (LHR)" UBYTE Ctit_LambdaHeater100ms_CM_boolean_adm 0 0 0 1 ECU_ADDRESS 0x40002511 /end MEASUREMENT
/begin MEASUREMENT dsLHR_CodErr "Lambda Heater diagnostic line code error" UBYTE Ctit_LambdaHeater100ms_CM_tFault_adm 0 0 0 88 ECU_ADDRESS 0x4000250B /end MEASUREMENT
/begin CHARACTERISTIC dsLRN01_AUTOD "Flag Abilitazione Diagnosi LRN01 su corpo farfallato" VALUE 0xFC5781 Scalar_BOOLEAN 0 FaultCheckLRN014ms_Symbol_CM_boolean_adm 0 1 /end CHARACTERISTIC
/begin MEASUREMENT dsLRN01_AdiaEn "Abilitazione automa di diagnosi della linea LRN01" UBYTE Ethrl4ms_CM_boolean_adm 0 0 0 1 ECU_ADDRESS 0x40002D20 /end MEASUREMENT
/begin MEASUREMENT dsLRN01_AutoD "alibrazione di abilitazione della linea di diagnosi LRN01" UBYTE Ethrl4ms_CM_boolean_adm 0 0 0 1 ECU_ADDRESS 0x40002D1F /end MEASUREMENT
/begin MEASUREMENT dsLRN01_CodErr "Codice di errore della linea di diagnosi LRN01" UBYTE Ethrl4ms_CM_tFault_adm 0 0 0 89 ECU_ADDRESS 0x40002D1A /end MEASUREMENT
/begin CHARACTERISTIC dsLRN02_AUTOD "Flag Abilitazione Diagnosi LRN02 su corpo farfallato" VALUE 0xFC5782 Scalar_BOOLEAN 0 FaultCheckLRN024ms_Symbol_CM_boolean_adm 0 1 /end CHARACTERISTIC
/begin MEASUREMENT dsLRN02_AdiaEn "Abilitazione automa di diagnosi della linea LRN02" UBYTE Ethrl4ms_CM_boolean_adm 0 0 0 1 ECU_ADDRESS 0x40002D1E /end MEASUREMENT
/begin MEASUREMENT dsLRN02_AutoD "alibrazione di abilitazione della linea di diagnosi LRN02" UBYTE Ethrl4ms_CM_boolean_adm 0 0 0 1 ECU_ADDRESS 0x40002D1D /end MEASUREMENT
/begin MEASUREMENT dsLRN02_CodErr "Codice di errore della linea di diagnosi LRN02" UBYTE Ethrl4ms_CM_tFault_adm 0 0 0 89 ECU_ADDRESS 0x40002D19 /end MEASUREMENT
/begin CHARACTERISTIC dsLRN03_AUTOD "Flag Abilitazione Diagnosi LRN03 su corpo farfallato" VALUE 0xFC5788 Scalar_BOOLEAN 0 FaultCheckLRN034ms_Symbol_CM_boolean_adm 0 1 /end CHARACTERISTIC
/begin MEASUREMENT dsLRN03_AdiaEn "Abilitazione automa di diagnosi della linea LRN03" UBYTE Ethrl4ms_CM_boolean_adm 0 0 0 1 ECU_ADDRESS 0x40002D1C /end MEASUREMENT
/begin MEASUREMENT dsLRN03_AutoD "alibrazione di abilitazione della linea di diagnosi LRN03" UBYTE Ethrl4ms_CM_boolean_adm 0 0 0 1 ECU_ADDRESS 0x40002D1B /end MEASUREMENT
/begin MEASUREMENT dsLRN03_CodErr "Codice di errore della linea di diagnosi LRN03" UBYTE Ethrl4ms_CM_tFault_adm 0 0 0 89 ECU_ADDRESS 0x40002D18 /end MEASUREMENT
/begin MEASUREMENT dsLambdaPreDisableCL "Flag di apertura controllo titolo in loop chiuso per presenza di diagnosi sulla modalità di calcolo del valore di lambda scelto" UBYTE LambdaPreTDC_CM_boolean_adm 0 0 0 1 ECU_ADDRESS 0x40002506 /end MEASUREMENT
/begin MEASUREMENT dsLimPerfDerOrig "Valore della curva di coppia degradata f(RPM), senza Offset per Diag. da Iniettori o Bobine e senza intervento di degrado per diagnosi di secondo livello" UWORD Thrp_Mgmt50ms_CM_ufix16_En4__ 0 0 0 100 ECU_ADDRESS 0x400041AE /end MEASUREMENT
/begin MEASUREMENT dsLimPerfDerWOff "Riduzione % di performance per recovery dsR20 e dsR23 (iniettori e bobine)" UWORD Thrp_Mgmt50ms_CM_ufix16_En4__ 0 0 0 100 ECU_ADDRESS 0x400041B0 /end MEASUREMENT
/begin MEASUREMENT dsLimPerfDerat "[OUT] Limitazione ETC per Derate Mode per guasto su Iniettore o su Bobina" UWORD TE_TM_RecoveryAIR_50ms_Symbol_CM_ufix16_En4__ 0 0 0 100 ECU_ADDRESS 0x400041D0 /end MEASUREMENT
/begin MEASUREMENT dsLoadDiagEn "Diagnosis enabled by Main-Relay flag" UBYTE Boost_CtrlMgmt50ms_CM_boolean_adm 0 0 0 1 ECU_ADDRESS 0x40004011 /end MEASUREMENT
/begin MEASUREMENT dsLoadEn "Loads actuation enable" UBYTE Boost_CtrlMgmt50ms_CM_boolean_adm 0 0 0 1 ECU_ADDRESS 0x40004010 /end MEASUREMENT
/begin MEASUREMENT dsLowPoilThr "[OUT] Tabella con valori di POil di warning per funzionamento motore" UWORD FaultChkPO2L100ms_Symbol_CM_uint16_mbar 0 0 250 6000 ECU_ADDRESS 0x40003F10 /end MEASUREMENT
/begin CHARACTERISTIC dsMAX_ADAT_CNT "Saturatore sul contatore di CONFIRMED della linea ADAT" VALUE 0xFC2019 Scalar_UBYTE 0 FaultChkADAT2_4ms_CM_uint8_adm 0 255 /end CHARACTERISTIC
/begin CHARACTERISTIC dsMAX_ADAT_CONF "Soglia sul numero di CONFIRMED della linea ADAT per accensione della spia gialla" VALUE 0xFC2018 Scalar_UBYTE 0 FaultChkADAT2_4ms_CM_uint8_adm 0 255 /end CHARACTERISTIC
/begin CHARACTERISTIC dsMD1_AUTOD "Cylinder 1 Misfire detection diagnostic line enable" VALUE 0xFCAA5D Scalar_BOOLEAN 0 FaultChkMDxTDC_CM_boolean_adm 0 1 /end CHARACTERISTIC
/begin MEASUREMENT dsMD1_AdiaEn "Error validation state machine enable (MD1)" UBYTE MisfdTDC_CM_boolean_adm 0 0 0 1 ECU_ADDRESS 0x400037F8 /end MEASUREMENT
/begin MEASUREMENT dsMD1_CodErr "Cylinder 1 Misfire detection diagnostic line code error (MD1)" UBYTE MisfdTDC_CM_tFault_adm 0 0 0 89 ECU_ADDRESS 0x400037E8 /end MEASUREMENT
/begin CHARACTERISTIC dsMD2_AUTOD "Cylinder 2 Misfire detection diagnostic line enable" VALUE 0xFCAA5C Scalar_BOOLEAN 0 FaultChkMDxTDC_CM_boolean_adm 0 1 /end CHARACTERISTIC
/begin MEASUREMENT dsMD2_AdiaEn "Error validation state machine enable (MD2)" UBYTE MisfdTDC_CM_boolean_adm 0 0 0 1 ECU_ADDRESS 0x400037F7 /end MEASUREMENT
/begin MEASUREMENT dsMD2_CodErr "Cylinder 2 Misfire detection diagnostic line code error (MD2)" UBYTE MisfdTDC_CM_tFault_adm 0 0 0 89 ECU_ADDRESS 0x400037E7 /end MEASUREMENT
/begin CHARACTERISTIC dsMD3_AUTOD "Cylinder 3 Misfire detection diagnostic line enable" VALUE 0xFCAA5B Scalar_BOOLEAN 0 FaultChkMDxTDC_CM_boolean_adm 0 1 /end CHARACTERISTIC
/begin MEASUREMENT dsMD3_AdiaEn "Error validation state machine enable (MD3)" UBYTE MisfdTDC_CM_boolean_adm 0 0 0 1 ECU_ADDRESS 0x400037F6 /end MEASUREMENT
/begin MEASUREMENT dsMD3_CodErr "Cylinder 3 Misfire detection diagnostic line code error (MD3)" UBYTE MisfdTDC_CM_tFault_adm 0 0 0 89 ECU_ADDRESS 0x400037E6 /end MEASUREMENT
/begin CHARACTERISTIC dsMD4_AUTOD "Cylinder 4 Misfire detection diagnostic line enable" VALUE 0xFCAA5A Scalar_BOOLEAN 0 FaultChkMDxTDC_CM_boolean_adm 0 1 /end CHARACTERISTIC
/begin MEASUREMENT dsMD4_AdiaEn "Error validation state machine enable (MD4)" UBYTE MisfdTDC_CM_boolean_adm 0 0 0 1 ECU_ADDRESS 0x400037F5 /end MEASUREMENT
/begin MEASUREMENT dsMD4_CodErr "Cylinder 4 Misfire detection diagnostic line code error (MD4)" UBYTE MisfdTDC_CM_tFault_adm 0 0 0 89 ECU_ADDRESS 0x400037E5 /end MEASUREMENT
/begin CHARACTERISTIC dsMD5_AUTOD "Cylinder 5 Misfire detection diagnostic line enable" VALUE 0xFCAA59 Scalar_BOOLEAN 0 FaultChkMDxTDC_CM_boolean_adm 0 1 /end CHARACTERISTIC
/begin MEASUREMENT dsMD5_AdiaEn "Error validation state machine enable (MD5)" UBYTE MisfdTDC_CM_boolean_adm 0 0 0 1 ECU_ADDRESS 0x400037F4 /end MEASUREMENT
/begin MEASUREMENT dsMD5_CodErr "Cylinder 5 Misfire detection diagnostic line code error (MD5)" UBYTE MisfdTDC_CM_tFault_adm 0 0 0 89 ECU_ADDRESS 0x400037E4 /end MEASUREMENT
/begin CHARACTERISTIC dsMD6_AUTOD "Cylinder 6 Misfire detection diagnostic line enable" VALUE 0xFCAA58 Scalar_BOOLEAN 0 FaultChkMDxTDC_CM_boolean_adm 0 1 /end CHARACTERISTIC
/begin MEASUREMENT dsMD6_AdiaEn "Error validation state machine enable (MD6)" UBYTE MisfdTDC_CM_boolean_adm 0 0 0 1 ECU_ADDRESS 0x400037F3 /end MEASUREMENT
/begin MEASUREMENT dsMD6_CodErr "Cylinder 6 Misfire detection diagnostic line code error (MD6)" UBYTE MisfdTDC_CM_tFault_adm 0 0 0 89 ECU_ADDRESS 0x400037E3 /end MEASUREMENT
/begin CHARACTERISTIC dsMD7_AUTOD "Cylinder 7 Misfire detection diagnostic line enable" VALUE 0xFCAA57 Scalar_BOOLEAN 0 FaultChkMDxTDC_CM_boolean_adm 0 1 /end CHARACTERISTIC
/begin MEASUREMENT dsMD7_AdiaEn "Error validation state machine enable (MD7)" UBYTE MisfdTDC_CM_boolean_adm 0 0 0 1 ECU_ADDRESS 0x400037F2 /end MEASUREMENT
/begin MEASUREMENT dsMD7_CodErr "Cylinder 7 Misfire detection diagnostic line code error (MD7)" UBYTE MisfdTDC_CM_tFault_adm 0 0 0 89 ECU_ADDRESS 0x400037E2 /end MEASUREMENT
/begin CHARACTERISTIC dsMD8_AUTOD "Cylinder 8 Misfire detection diagnostic line enable" VALUE 0xFCAA56 Scalar_BOOLEAN 0 FaultChkMDxTDC_CM_boolean_adm 0 1 /end CHARACTERISTIC
/begin MEASUREMENT dsMD8_AdiaEn "Error validation state machine enable (MD8)" UBYTE MisfdTDC_CM_boolean_adm 0 0 0 1 ECU_ADDRESS 0x400037F1 /end MEASUREMENT
/begin MEASUREMENT dsMD8_CodErr "Cylinder 8 Misfire detection diagnostic line code error (MD8)" UBYTE MisfdTDC_CM_tFault_adm 0 0 0 89 ECU_ADDRESS 0x400037E1 /end MEASUREMENT
/begin CHARACTERISTIC dsMDR_AUTOD "Random Misfire detection diagnostic line enable" VALUE 0xFCAA55 Scalar_BOOLEAN 0 FaultChkMDxTDC_CM_boolean_adm 0 1 /end CHARACTERISTIC
/begin MEASUREMENT dsMDR_AdiaEn "Error validation state machine enable (MDR)" UBYTE MisfdTDC_CM_boolean_adm 0 0 0 1 ECU_ADDRESS 0x400037F0 /end MEASUREMENT
/begin MEASUREMENT dsMDR_CodErr "Random Misfire detection diagnostic line code error (MDR)" UBYTE MisfdTDC_CM_tFault_adm 0 0 0 89 ECU_ADDRESS 0x400037E0 /end MEASUREMENT
/begin CHARACTERISTIC dsMFLV_AUTOD "Flag Abilitazione Diagnosi MFLV" VALUE 0xFCC87A Scalar_BOOLEAN 0 TE_FaultChkMFLV4ms_Symbol_CM_boolean_adm 0 1 /end CHARACTERISTIC
/begin MEASUREMENT dsMFLV_AutoD "bilitazione automa di diagnosi MFLV" UBYTE Vfnc4ms_CM_boolean_adm 0 0 0 1 ECU_ADDRESS 0x40004650 /end MEASUREMENT
/begin MEASUREMENT dsMFLV_CodErr "odice di errore della linea MFLV" UBYTE Vfnc4ms_CM_tFault_adm 0 0 0 88 ECU_ADDRESS 0x40004647 /end MEASUREMENT
/begin CHARACTERISTIC dsMFLV_ERROR_TIME "Flag Abilitazione Diagnosi coerenza segnali nella diagnosi MFLV" VALUE 0xFCC87C Scalar_UWORD 0 TE_FaultChkMFLV4ms_Symbol_CM_ufix16_Sp004_sec 0 240 /end CHARACTERISTIC
/begin MEASUREMENT dsMILCmd "Comando MIL (after Recovery)" UBYTE Lamp100ms_CM_boolean_adm 0 0 0 1 ECU_ADDRESS 0x40003757 /end MEASUREMENT
/begin CHARACTERISTIC dsMIL_AUTOD "MIL diagnosis line enable flag" VALUE 0xFC9C94 Scalar_BOOLEAN 0 FaultChkELTLMP100ms_CM_boolean_adm 0 1 /end CHARACTERISTIC
/begin MEASUREMENT dsMIL_AutoD "MIL command diagnosis line enable flag" UBYTE Lamp100ms_CM_boolean_adm 0 0 0 1 ECU_ADDRESS 0x40003761 /end MEASUREMENT
/begin MEASUREMENT dsMIL_CodErr "Error code of diagnostic line detecting fault on MIL command" UBYTE Lamp100ms_CM_tFault_adm 0 0 0 88 ECU_ADDRESS 0x40003756 /end MEASUREMENT
/begin CHARACTERISTIC dsMIN_BETWEEN_PED "Use minimimum value between pot1 and pot2 if coherency fault detected" VALUE 0xFCAC2F Scalar_BOOLEAN 0 TE_RecoverySPP_4ms_CM_boolean_adm 0 1 /end CHARACTERISTIC
/begin MEASUREMENT dsMapRec "Valore di recovery GSEC della pressione aria" UWORD Mpre4ms_CM_uint16_mbar 0 0 150 2500 ECU_ADDRESS 0x40003ED6 /end MEASUREMENT
/begin MEASUREMENT dsMapV "Pressione aria in volt elaborata dal blocco di recovery" UWORD Mpre4ms_CM_ufix16_En10_V 0 0 0 5 ECU_ADDRESS 0x40003ED2 /end MEASUREMENT
/begin MEASUREMENT dsMapVPreR "Pressione aria in volt elaborata dal blocco di recovery" UWORD Mpre4ms_CM_ufix16_En10_V 0 0 0 5 ECU_ADDRESS 0x40003ED4 /end MEASUREMENT
/begin CHARACTERISTIC dsNIDLE_GREATER "Flag for NIdle relative position vs Idle (1=Greater, 0=Lower)" VALUE 0xFCAC2E Scalar_BOOLEAN 0 TE_FaultChkSPPC2_4ms_CM_boolean_adm 0 1 /end CHARACTERISTIC
/begin CHARACTERISTIC dsNLP_DELTA "Delta sulla massima tensione ammessa per NLP" VALUE 0xFC578A Scalar_UWORD 0 FaultCheckLRN034ms_Symbol_CM_ufix16_En10_V 0 5 /end CHARACTERISTIC
/begin CHARACTERISTIC dsNOP_INI_LAMSAT "Counter init value for authority limits fault" VALUE 0xFC402A Scalar_UWORD 0 DiagLamTDC_CM_uint16_TDC 0 32000 /end CHARACTERISTIC
/begin CHARACTERISTIC dsNUM_VAL_CYCL "Numero di cicli elementari (un ciclo elementare pare a Ncyl Pms) che compongono un singolo ciclo di validazione" VALUE 0xFC7FF4 Scalar_UWORD 0 RecRifasaInjTDC_CM_uint16_adm 0 50 /end CHARACTERISTIC
/begin CHARACTERISTIC dsOFFSET_RPM "Target RPM offset for coil or injector fault" VALUE 0xFC7FF2 Scalar_UWORD 0 RecoveryINJxTDC_CM_uint16_rpm 0 3000 /end CHARACTERISTIC
/begin CHARACTERISTIC dsOFF_RIF_PRESS "Offset of Boost pressure reference to degrade performance" VALUE 0xFC2BBA Scalar_UWORD 0 RecoveryWGT50ms_Symbol_CM_uint16_mbar 0 4000 /end CHARACTERISTIC
/begin MEASUREMENT dsOffRifPress "Offset of Boost pressure reference to degrade performance" UWORD Boost_CtrlMgmt50ms_CM_uint16_mbar 0 0 0 4000 ECU_ADDRESS 0x400021FC /end MEASUREMENT
/begin MEASUREMENT dsOffsetRPM "Target RPM offset for coil or injector fault" UWORD Idle4ms_CM_uint16_rpm 0 0 0 3000 ECU_ADDRESS 0x400031C4 /end MEASUREMENT
/begin MEASUREMENT dsPAtmPostD "Atmospheric pressure sensor post diagnosis value" UWORD RecoverySPT100ms_Symbol_CM_ufix16_En10_V 0 0 0 5 ECU_ADDRESS 0x40002086 /end MEASUREMENT
/begin MEASUREMENT dsPAtmRec "Valore di recovery GSEC della pressione atmosferica" UWORD Apre100ms_CM_uint16_mbar 0 0 150 1150 ECU_ADDRESS 0x4000206E /end MEASUREMENT
/begin MEASUREMENT dsPAtmV "Pressione atmosferica in volt elaborata dal blocco di recovery" UWORD Apre100ms_CM_ufix16_En10_V 0 0 0 5 ECU_ADDRESS 0x4000206A /end MEASUREMENT
/begin MEASUREMENT dsPAtmVPreR "Pressione atmosferica in volt elaborata dal blocco di recovery" UWORD Apre100ms_CM_ufix16_En10_V 0 0 0 5 ECU_ADDRESS 0x4000206C /end MEASUREMENT
/begin MEASUREMENT dsPBoostV "Pressione di sovralimentazione in volt elaborata dal blocco di recovery" UWORD Bpre4ms_CM_ufix16_En10_V 0 0 0 5 ECU_ADDRESS 0x400022A0 /end MEASUREMENT
/begin MEASUREMENT dsPBoostVPreR "Pressione di sovralimentazione in volt elaborata dal blocco di recovery" UWORD Bpre4ms_CM_ufix16_En10_V 0 0 0 5 ECU_ADDRESS 0x400022A2 /end MEASUREMENT
/begin CHARACTERISTIC dsPDL_GAP "Admissible voltage gap between accelerator potentiometers values." VALUE 0xFCAC2C Scalar_UWORD 0 TE_FaultChkSPPCH_4ms_CM_ufix16_En10_V 0 5 /end CHARACTERISTIC
/begin CHARACTERISTIC dsPER_TOR_AIR2H "Percentuale della Coppia massima da eccedere per Diagnosi di 2ndo Livello per AIR2H" VALUE 0xFCB596 Scalar_UWORD 0 TE_TM_FaultChkAIR2H_50ms_Symbol_CM_ufix16_En4__ 0 100 /end CHARACTERISTIC
/begin CHARACTERISTIC dsPER_TOR_AIR2L "Percentuale della Coppia massima da deficere per Diagnosi di 2ndo Livello per AIR2L" VALUE 0xFCB5A0 Scalar_UWORD 0 TE_TM_FaultChkAIR2L_50ms_Symbol_CM_ufix16_En4__ 0 100 /end CHARACTERISTIC
/begin CHARACTERISTIC dsPO2L_AUTOD "Flag Abilitazione Diagnosi pressione olio" VALUE 0xFCAAA0 Scalar_BOOLEAN 0 FaultChkPO2L100ms_Symbol_CM_boolean_adm 0 1 /end CHARACTERISTIC
/begin MEASUREMENT dsPO2L_AutoD "Abilitazione alla linea di diagnosi PO2L" UBYTE Oilp100ms_CM_boolean_adm 0 0 0 1 ECU_ADDRESS 0x40003EF9 /end MEASUREMENT
/begin CHARACTERISTIC dsPO2L_CNT_THR "Tempo dopo il quale può essere abilitata la diagnosi pressione olio bassa" VALUE 0xFCAB4C Scalar_ULONG 0 FaultChkPO2L100ms_Symbol_CM_ufix32_Sp1_s 0 429496729.5 /end CHARACTERISTIC
/begin MEASUREMENT dsPO2L_CodErr "Codice di errore della linea di diagnosi PO2L" UBYTE Oilp100ms_CM_tFault_adm 0 0 0 88 ECU_ADDRESS 0x40003EF7 /end MEASUREMENT
/begin CHARACTERISTIC dsPO2L_RPM_THR "Soglia in giri superata la quale può essere abilitata la diagnosi pressione olio bassa" VALUE 0xFCAAA4 Scalar_UWORD 0 FaultChkPO2L100ms_Symbol_CM_uint16_rpm 0 10000 /end CHARACTERISTIC
/begin MEASUREMENT dsPONEVRContStat "CNG electrovalves relay contact state at power-on. The state is deduced only from the diag made on the ECU cmd" UBYTE Egst4ms_CM_tFault_adm 0 0 0 88 ECU_ADDRESS 0x40002DE0 /end MEASUREMENT
/begin MEASUREMENT dsPONEVRContStatSF "CNG electrovalves relay contact state at power-on in uscita FSM" UBYTE DiagEVRPON4ms_Symbol_CM_uint8_adm 0 0 0 255 ECU_ADDRESS 0x40002DF5 /end MEASUREMENT
/begin MEASUREMENT dsPONEVRDiagStat "State of CNG electrovalves relay power-on diagnosis" UBYTE Egst4ms_CM_tDiagStat_adm 0 0 0 39 ECU_ADDRESS 0x40002DE4 /end MEASUREMENT
/begin MEASUREMENT dsPONEVRDiagStatSF "State of CNG electrovalves relay power-on diagnosis in uscita FSM" UBYTE DiagEVRPON4ms_Symbol_CM_uint8_adm 0 0 0 255 ECU_ADDRESS 0x40002DF6 /end MEASUREMENT
/begin MEASUREMENT dsPONEVRel "CNG electrovalves relay command after power-on diagnosis" UBYTE Evrc4ms_CM_boolean_adm 0 0 0 1 ECU_ADDRESS 0x40002DE8 /end MEASUREMENT
/begin MEASUREMENT dsPONEVRelSF "CNG electrovalves relay command after power-on diagnosis in uscita FSM" UBYTE DiagEVRPON4ms_Symbol_CM_boolean_adm 0 0 0 1 ECU_ADDRESS 0x40002DF4 /end MEASUREMENT
/begin MEASUREMENT dsPONLoadDiagEn "Loads diagnosis enable after the power on diagnosis block (1= enabled)" UBYTE Pwrl4ms_CM_boolean_adm 0 0 0 1 ECU_ADDRESS 0x4000401B /end MEASUREMENT
/begin MEASUREMENT dsPONLoadEn "Loads command enable after the power on diagnosis block (1 = enabled)" UBYTE Pwrl4ms_CM_boolean_adm 0 0 0 1 ECU_ADDRESS 0x4000401A /end MEASUREMENT
/begin MEASUREMENT dsPONPRVCmd "CNG pressure reducing valve command after power-on diagnosis" UBYTE Prvc4ms_CM_boolean_adm 0 0 0 1 ECU_ADDRESS 0x40003FE4 /end MEASUREMENT
/begin MEASUREMENT dsPONPRVCmdSF "CNG pressure reducing valve command after power-on diagnosis in uscita FSM" UBYTE DiagPRVPON4ms_Symbol_CM_boolean_adm 0 0 0 1 ECU_ADDRESS 0x40003FF1 /end MEASUREMENT
/begin MEASUREMENT dsPONPRVDiagStat "State of CNG pressure reducing valve power-on diagnosis" UBYTE Egst4ms_CM_tDiagStat_adm 0 0 0 39 ECU_ADDRESS 0x40003FE0 /end MEASUREMENT
/begin MEASUREMENT dsPONPRVDiagStatSF "State of CNG pressure reducing valve power-on diagnosis in uscita FSM" UBYTE DiagPRVPON4ms_Symbol_CM_uint8_adm 0 0 0 255 ECU_ADDRESS 0x40003FF2 /end MEASUREMENT
/begin MEASUREMENT dsPONPRVStat "CNG pressure reducing valve state at power-on. The state is deduced only from the diag made on the ECU cmd" UBYTE Egst4ms_CM_tFault_adm 0 0 0 88 ECU_ADDRESS 0x40003FDC /end MEASUREMENT
/begin COMPU_METHOD AbilitazioneDLAM100ms_Symbol_CM_boolean_adm "Q = V" RAT_FUNC "%1.0" "adm" COEFFS 0 1 0 0 0 1 /end COMPU_METHOD
/begin COMPU_METHOD Abilitazione_DFSLY_100ms_Symbol_CM_boolean_adm "Q = V" RAT_FUNC "%1.0" "adm" COEFFS 0 1 0 0 0 1 /end COMPU_METHOD
/begin COMPU_METHOD Apre100ms_CM_ufix16_En10_V "Q = V*1024.000000" RAT_FUNC "%12.10" "V" COEFFS 0 1024 0 0 0 1 /end COMPU_METHOD
/begin COMPU_METHOD Apre100ms_CM_uint16_mbar "Q = V" RAT_FUNC "%5.0" "mbar" COEFFS 0 1 0 0 0 1 /end COMPU_METHOD
/begin COMPU_METHOD AutoTDC_CM_boolean_adm "Q = V" RAT_FUNC "%1.0" "adm" COEFFS 0 1 0 0 0 1 /end COMPU_METHOD
/begin COMPU_METHOD AutoTDC_CM_tFault_adm "Enumerated data type: tFault" TAB_VERB "%0.6" "adm" COMPU_TAB_REF VTAB_FOR_AutoTDC_CM_tFault_adm /end COMPU_METHOD
/begin COMPU_METHOD Auto_DiagLineADAT2_4ms_CM_boolean_adm "Q = V" RAT_FUNC "%1.0" "adm" COEFFS 0 1 0 0 0 1 /end COMPU_METHOD
/begin COMPU_METHOD Auto_DiagLineADAT2_4ms_CM_tFault_adm "Enumerated data type: tFault" TAB_VERB "%0.6" "adm" COMPU_TAB_REF VTAB_FOR_Auto_DiagLineADAT2_4ms_CM_tFault_adm /end COMPU_METHOD
/begin COMPU_METHOD Auto_DiagLineADAT2_4ms_CM_uint8_adm "Q = V" RAT_FUNC "%3.0" "adm" COEFFS 0 1 0 0 0 1 /end COMPU_METHOD
/begin COMPU_METHOD BC2EDC1_Rx_50ms_CM_boolean_adm "Q = V" RAT_FUNC "%1.0" "adm" COEFFS 0 1 0 0 0 1 /end COMPU_METHOD
/begin COMPU_METHOD BC2EDC1_Rx_50ms_CM_uint8_km_h "Q = V" RAT_FUNC "%3.0" "km/h" COEFFS 0 1 0 0 0 1 /end COMPU_METHOD
/begin COMPU_METHOD BC2EDC2_Rx_50ms_CM_boolean_adm "Q = V" RAT_FUNC "%1.0" "adm" COEFFS 0 1 0 0 0 1 /end COMPU_METHOD
/begin COMPU_METHOD BC2EDC2_Rx_50ms_CM_ufix8_Sp4__ "Q = V*2.500000" RAT_FUNC "%0.6" "%" COEFFS 0 2.5 0 0 0 1 /end COMPU_METHOD
/begin COMPU_METHOD BC2EDC2_Rx_50ms_CM_uint8_adm "Q = V" RAT_FUNC "%3.0" "adm" COEFFS 0 1 0 0 0 1 /end COMPU_METHOD
/begin COMPU_METHOD BC2EDC2_Rx_50ms_CM_uint8_km_h "Q = V" RAT_FUNC "%3.0" "km/h" COEFFS 0 1 0 0 0 1 /end COMPU_METHOD
/begin COMPU_METHOD Batt4ms_CM_boolean_adm "Q = V" RAT_FUNC "%1.0" "adm" COEFFS 0 1 0 0 0 1 /end COMPU_METHOD
/begin COMPU_METHOD Batt4ms_CM_tFault_adm "Enumerated data type: tFault" TAB_VERB "%0.6" "adm" COMPU_TAB_REF VTAB_FOR_Batt4ms_CM_tFault_adm /end COMPU_METHOD
/begin COMPU_METHOD BoostControl50ms_Symbol_CM_boolean_adm "Q = V" RAT_FUNC "%1.0" "adm" COEFFS 0 1 0 0 0 1 /end COMPU_METHOD
/begin COMPU_METHOD Boost_CtrlMgmt50ms_CM_boolean_adm "Q = V" RAT_FUNC "%1.0" "adm" COEFFS 0 1 0 0 0 1 /end COMPU_METHOD
/begin COMPU_METHOD Boost_CtrlMgmt50ms_CM_uint16_mbar "Q = V" RAT_FUNC "%5.0" "mbar" COEFFS 0 1 0 0 0 1 /end COMPU_METHOD
/begin COMPU_METHOD Bpre4ms_CM_ufix16_En10_V "Q = V*1024.000000" RAT_FUNC "%12.10" "V" COEFFS 0 1024 0 0 0 1 /end COMPU_METHOD
/begin COMPU_METHOD CCVS_Rx_100ms_CM_boolean_adm "Q = V" RAT_FUNC "%1.0" "adm" COEFFS 0 1 0 0 0 1 /end COMPU_METHOD
/begin COMPU_METHOD CCVS_Rx_100ms_CM_ufix16_En8_km_h "Q = V*256.000000" RAT_FUNC "%11.8" "km/h" COEFFS 0 256 0 0 0 1 /end COMPU_METHOD
/begin COMPU_METHOD CCVS_Rx_100ms_CM_uint8_adm "Q = V" RAT_FUNC "%3.0" "adm" COEFFS 0 1 0 0 0 1 /end COMPU_METHOD
/begin COMPU_METHOD CanPvt_Rx4ms_CM_boolean_adm "Q = V" RAT_FUNC "%1.0" "adm" COEFFS 0 1 0 0 0 1 /end COMPU_METHOD
/begin COMPU_METHOD CanPvt_Rx4ms_CM_ufix8_Sp152_V "Q = V*6.578947" RAT_FUNC "%0.6" "V" COEFFS 0 6.578947 0 0 0 1 /end COMPU_METHOD
/begin COMPU_METHOD CanPvt_Rx4ms_CM_ufix8_Sp416_deg "Q = V*2.403846" RAT_FUNC "%0.6" "deg" COEFFS 0 2.403846 0 0 0 1 /end COMPU_METHOD
/begin COMPU_METHOD CanPvt_Rx4ms_CM_uint8_adm "Q = V" RAT_FUNC "%3.0" "adm" COEFFS 0 1 0 0 0 1 /end COMPU_METHOD
/begin COMPU_METHOD Canal_Diagnosis100ms_CM_boolean_adm "Q = V" RAT_FUNC "%1.0" "adm" COEFFS 0 1 0 0 0 1 /end COMPU_METHOD
/begin COMPU_METHOD Canal_Diagnosis100ms_CM_tFault_adm "Enumerated data type: tFault" TAB_VERB "%0.6" "adm" COMPU_TAB_REF VTAB_FOR_Canal_Diagnosis100ms_CM_tFault_adm /end COMPU_METHOD
/begin COMPU_METHOD Cata100ms_Symbol_CM_boolean_adm "Q = V" RAT_FUNC "%1.0" "adm" COEFFS 0 1 0 0 0 1 /end COMPU_METHOD
/begin COMPU_METHOD Crkc4ms_CM_uint16_km_h "Q = V" RAT_FUNC "%5.0" "km/h" COEFFS 0 1 0 0 0 1 /end COMPU_METHOD
/begin COMPU_METHOD Ctit_LambdaCtrlTDC_CM_boolean_adm "Q = V" RAT_FUNC "%1.0" "adm" COEFFS 0 1 0 0 0 1 /end COMPU_METHOD
/begin COMPU_METHOD Ctit_LambdaCtrlTDC_CM_sfix16_Sp01_Bn40p96__ "Q = (V+40.960000)*100.000000" RAT_FUNC "%0.6" "%" COEFFS 0 100 4096 0 0 1 /end COMPU_METHOD
/begin COMPU_METHOD Ctit_LambdaCtrlTDC_CM_uint16_adm "Q = V" RAT_FUNC "%5.0" "adm" COEFFS 0 1 0 0 0 1 /end COMPU_METHOD
/begin COMPU_METHOD Ctit_LambdaCtrlTDC_CM_uint8_adm "Q = V" RAT_FUNC "%3.0" "adm" COEFFS 0 1 0 0 0 1 /end COMPU_METHOD
/begin COMPU_METHOD Ctit_LambdaHeater100ms_CM_boolean_adm "Q = V" RAT_FUNC "%1.0" "adm" COEFFS 0 1 0 0 0 1 /end COMPU_METHOD
/begin COMPU_METHOD Ctit_LambdaHeater100ms_CM_tFault_adm "Enumerated data type: tFault" TAB_VERB "%0.6" "adm" COMPU_TAB_REF VTAB_FOR_Ctit_LambdaHeater100ms_CM_tFault_adm /end COMPU_METHOD
/begin COMPU_METHOD Ctit_LambdaHeater100ms_CM_uint16__ "Q = V" RAT_FUNC "%5.0" "%" COEFFS 0 1 0 0 0 1 /end COMPU_METHOD
/begin COMPU_METHOD Ctit_UEGOHeater4ms_CM_boolean "Q = V" RAT_FUNC "%1.0" "" COEFFS 0 1 0 0 0 1 /end COMPU_METHOD
/begin COMPU_METHOD DCmvInterface100ms_Symbol_CM_boolean_adm "Q = V" RAT_FUNC "%1.0" "adm" COEFFS 0 1 0 0 0 1 /end COMPU_METHOD
/begin COMPU_METHOD DLCC1_Tx_1s_CM_uint8_adm "Q = V" RAT_FUNC "%3.0" "adm" COEFFS 0 1 0 0 0 1 /end COMPU_METHOD
/begin COMPU_METHOD DLCC2_Tx_1s_CM_uint8_adm "Q = V" RAT_FUNC "%3.0" "adm" COEFFS 0 1 0 0 0 1 /end COMPU_METHOD
/begin COMPU_METHOD Dcat_Diagnosis100ms_CM_boolean_adm "Q = V" RAT_FUNC "%1.0" "adm" COEFFS 0 1 0 0 0 1 /end COMPU_METHOD
/begin COMPU_METHOD Dcat_Diagnosis100ms_CM_tFault_adm "Enumerated data type: tFault" TAB_VERB "%0.6" "adm" COMPU_TAB_REF VTAB_FOR_Dcat_Diagnosis100ms_CM_tFault_adm /end COMPU_METHOD
/begin COMPU_METHOD DiagEVRPON4ms_Symbol_CM_boolean_adm "Q = V" RAT_FUNC "%1.0" "adm" COEFFS 0 1 0 0 0 1 /end COMPU_METHOD
/begin COMPU_METHOD DiagEVRPON4ms_Symbol_CM_ufix16_E2_ms "Q = V/4.000000" RAT_FUNC "%5.0" "ms" COEFFS 0 1 0 0 0 4 /end COMPU_METHOD
/begin COMPU_METHOD DiagEVRPON4ms_Symbol_CM_uint8_adm "Q = V" RAT_FUNC "%3.0" "adm" COEFFS 0 1 0 0 0 1 /end COMPU_METHOD
/begin COMPU_METHOD DiagLamTDC_CM_FixEnableT "Enumerated data type: FixEnableT" TAB_VERB "%0.6" "" COMPU_TAB_REF VTAB_FOR_DiagLamTDC_CM_FixEnableT /end COMPU_METHOD
/begin COMPU_METHOD DiagLamTDC_CM_boolean_adm "Q = V" RAT_FUNC "%1.0" "adm" COEFFS 0 1 0 0 0 1 /end COMPU_METHOD
/begin COMPU_METHOD DiagLamTDC_CM_uint16_TDC "Q = V" RAT_FUNC "%5.0" "TDC" COEFFS 0 1 0 0 0 1 /end COMPU_METHOD
/begin COMPU_METHOD DiagLamTDC_CM_uint16_adm "Q = V" RAT_FUNC "%5.0" "adm" COEFFS 0 1 0 0 0 1 /end COMPU_METHOD
/begin COMPU_METHOD DiagLamTDC_CM_uint8_adm "Q = V" RAT_FUNC "%3.0" "adm" COEFFS 0 1 0 0 0 1 /end COMPU_METHOD
/begin COMPU_METHOD DiagPRVPON4ms_Symbol_CM_boolean_adm "Q = V" RAT_FUNC "%1.0" "adm" COEFFS 0 1 0 0 0 1 /end COMPU_METHOD
/begin COMPU_METHOD DiagPRVPON4ms_Symbol_CM_ufix16_E2_ms "Q = V/4.000000" RAT_FUNC "%5.0" "ms" COEFFS 0 1 0 0 0 4 /end COMPU_METHOD
/begin COMPU_METHOD DiagPRVPON4ms_Symbol_CM_uint8_adm "Q = V" RAT_FUNC "%3.0" "adm" COEFFS 0 1 0 0 0 1 /end COMPU_METHOD
/begin COMPU_METHOD DiagSym100ms_CM_ufix8_B1985_year "Q = (V-1985.000000)/1.000000" RAT_FUNC "%0.6" "year" COEFFS 0 1 -1985 0 0 1 /end COMPU_METHOD
/begin COMPU_METHOD DiagSym100ms_CM_ufix8_En2_day "Q = V*4.000000" RAT_FUNC "%4.2" "day" COEFFS 0 4 0 0 0 1 /end COMPU_METHOD
/begin COMPU_METHOD DiagSym100ms_CM_ufix8_En2_sec "Q = V*4.000000" RAT_FUNC "%4.2" "sec" COEFFS 0 4 0 0 0 1 /end COMPU_METHOD
/begin COMPU_METHOD DiagSym100ms_CM_uint8_adm "Q = V" RAT_FUNC "%3.0" "adm" COEFFS 0 1 0 0 0 1 /end COMPU_METHOD
/begin COMPU_METHOD DiagSym100ms_CM_uint8_hour "Q = V" RAT_FUNC "%3.0" "hour" COEFFS 0 1 0 0 0 1 /end COMPU_METHOD
/begin COMPU_METHOD DiagSym100ms_CM_uint8_min "Q = V" RAT_FUNC "%3.0" "min" COEFFS 0 1 0 0 0 1 /end COMPU_METHOD
/begin COMPU_METHOD DiagSym100ms_CM_uint8_month "Q = V" RAT_FUNC "%3.0" "month" COEFFS 0 1 0 0 0 1 /end COMPU_METHOD
/begin COMPU_METHOD Digin4ms_CM_boolean_adm "Q = V" RAT_FUNC "%1.0" "adm" COEFFS 0 1 0 0 0 1 /end COMPU_METHOD
/begin COMPU_METHOD Digin4ms_CM_tFault_adm "Enumerated data type: tFault" TAB_VERB "%0.6" "adm" COMPU_TAB_REF VTAB_FOR_Digin4ms_CM_tFault_adm /end COMPU_METHOD
/begin COMPU_METHOD ECU2TURBO_Tx_4ms_CM_boolean_adm "Q = V" RAT_FUNC "%1.0" "adm" COEFFS 0 1 0 0 0 1 /end COMPU_METHOD
/begin COMPU_METHOD EDC2BC_Tx_50ms_CM_ufix16_Bn40_degC "Q = (V+40.000000)/1.000000" RAT_FUNC "%0.6" "degC" COEFFS 0 1 40 0 0 1 /end COMPU_METHOD
/begin COMPU_METHOD EDC2BC_Tx_50ms_CM_uint16_mbar "Q = V" RAT_FUNC "%5.0" "mbar" COEFFS 0 1 0 0 0 1 /end COMPU_METHOD
/begin COMPU_METHOD EDC2BC_Tx_50ms_CM_uint16_rpm "Q = V" RAT_FUNC "%5.0" "rpm" COEFFS 0 1 0 0 0 1 /end COMPU_METHOD
/begin COMPU_METHOD EDC2BC_Tx_50ms_CM_uint8_adm "Q = V" RAT_FUNC "%3.0" "adm" COEFFS 0 1 0 0 0 1 /end COMPU_METHOD
/begin COMPU_METHOD EEC1_Tx_4ms_CM_uint8_adm "Q = V" RAT_FUNC "%3.0" "adm" COEFFS 0 1 0 0 0 1 /end COMPU_METHOD
/begin COMPU_METHOD ENG_TEMP_Tx_1s_CM_uint16_adm "Q = V" RAT_FUNC "%5.0" "adm" COEFFS 0 1 0 0 0 1 /end COMPU_METHOD
/begin COMPU_METHOD ENG_TEMP_Tx_1s_CM_uint8_adm "Q = V" RAT_FUNC "%3.0" "adm" COEFFS 0 1 0 0 0 1 /end COMPU_METHOD
/begin COMPU_METHOD ERC1_ER_Tx_1s_CM_boolean_adm "Q = V" RAT_FUNC "%1.0" "adm" COEFFS 0 1 0 0 0 1 /end COMPU_METHOD
/begin COMPU_METHOD ET2_Tx_1s_CM_boolean_adm "Q = V" RAT_FUNC "%1.0" "adm" COEFFS 0 1 0 0 0 1 /end COMPU_METHOD
/begin COMPU_METHOD ETC1_Rx_4ms_CM_boolean_adm "Q = V" RAT_FUNC "%1.0" "adm" COEFFS 0 1 0 0 0 1 /end COMPU_METHOD
/begin COMPU_METHOD ETC1_Rx_4ms_CM_ufix16_En3_rpm "Q = V*8.000000" RAT_FUNC "%7.3" "rpm" COEFFS 0 8 0 0 0 1 /end COMPU_METHOD
/begin COMPU_METHOD ETC2_Rx_100ms_CM_ufix8_Bn125_gear "Q = (V+125.000000)/1.000000" RAT_FUNC "%0.6" "gear" COEFFS 0 1 125 0 0 1 /end COMPU_METHOD
/begin COMPU_METHOD Ecut1s_CM_ufix16_En10_V "Q = V*1024.000000" RAT_FUNC "%12.10" "V" COEFFS 0 1024 0 0 0 1 /end COMPU_METHOD
/begin COMPU_METHOD Egbrk50ms_CM_boolean_adm "Q = V" RAT_FUNC "%1.0" "adm" COEFFS 0 1 0 0 0 1 /end COMPU_METHOD
/begin COMPU_METHOD Egbrk50ms_CM_sfix16_En4__ "Q = V*16.000000" RAT_FUNC "%8.4" "%" COEFFS 0 16 0 0 0 1 /end COMPU_METHOD
/begin COMPU_METHOD Egbrk50ms_CM_tFault_adm "Enumerated data type: tFault" TAB_VERB "%0.6" "adm" COMPU_TAB_REF VTAB_FOR_Egbrk50ms_CM_tFault_adm /end COMPU_METHOD
/begin COMPU_METHOD Egbrk50ms_CM_uint8_adm "Q = V" RAT_FUNC "%3.0" "adm" COEFFS 0 1 0 0 0 1 /end COMPU_METHOD
/begin COMPU_METHOD EgrMgm4ms_CM_boolean_adm "Q = V" RAT_FUNC "%1.0" "adm" COEFFS 0 1 0 0 0 1 /end COMPU_METHOD
/begin COMPU_METHOD EgrMgm4ms_CM_tFault_adm "Enumerated data type: tFault" TAB_VERB "%0.6" "adm" COMPU_TAB_REF VTAB_FOR_EgrMgm4ms_CM_tFault_adm /end COMPU_METHOD
/begin COMPU_METHOD EgrMgm4ms_CM_ufix16_En10_V "Q = V*1024.000000" RAT_FUNC "%12.10" "V" COEFFS 0 1024 0 0 0 1 /end COMPU_METHOD
/begin COMPU_METHOD Egst4ms_CM_boolean_adm "Q = V" RAT_FUNC "%1.0" "adm" COEFFS 0 1 0 0 0 1 /end COMPU_METHOD
/begin COMPU_METHOD Egst4ms_CM_tDiagStat_adm "Enumerated data type: tDiagStat" TAB_VERB "%0.6" "adm" COMPU_TAB_REF VTAB_FOR_Egst4ms_CM_tDiagStat_adm /end COMPU_METHOD
/begin COMPU_METHOD Egst4ms_CM_tFault_adm "Enumerated data type: tFault" TAB_VERB "%0.6" "adm" COMPU_TAB_REF VTAB_FOR_Egst4ms_CM_tFault_adm /end COMPU_METHOD
/begin COMPU_METHOD EnableDiagADAT2_4ms_CM_FixEnableT "Enumerated data type: FixEnableT" TAB_VERB "%0.6" "" COMPU_TAB_REF VTAB_FOR_EnableDiagADAT2_4ms_CM_FixEnableT /end COMPU_METHOD
/begin COMPU_METHOD EnableDiagADAT2_4ms_CM_boolean_adm "Q = V" RAT_FUNC "%1.0" "adm" COEFFS 0 1 0 0 0 1 /end COMPU_METHOD
/begin COMPU_METHOD EngineBrakeMgm50ms_CM_ufix16_En4__ "Q = V*16.000000" RAT_FUNC "%8.4" "%" COEFFS 0 16 0 0 0 1 /end COMPU_METHOD
/begin COMPU_METHOD Epr4ms_CM_uint8_adm "Q = V" RAT_FUNC "%3.0" "adm" COEFFS 0 1 0 0 0 1 /end COMPU_METHOD
/begin COMPU_METHOD EprMgm4ms_CM_tFault_adm "Enumerated data type: tFault" TAB_VERB "%0.6" "adm" COMPU_TAB_REF VTAB_FOR_EprMgm4ms_CM_tFault_adm /end COMPU_METHOD
/begin COMPU_METHOD Ethrc4ms_CM_boolean_adm "Q = V" RAT_FUNC "%1.0" "adm" COEFFS 0 1 0 0 0 1 /end COMPU_METHOD
/begin COMPU_METHOD Ethrc4ms_CM_sfix16_En8__ "Q = V*256.000000" RAT_FUNC "%11.8" "%" COEFFS 0 256 0 0 0 1 /end COMPU_METHOD
/begin COMPU_METHOD Ethrc4ms_CM_tKeyState_adm "Enumerated data type: tKeyState" TAB_VERB "%0.6" "adm" COMPU_TAB_REF VTAB_FOR_Ethrc4ms_CM_tKeyState_adm /end COMPU_METHOD
/begin COMPU_METHOD Ethrc4ms_CM_ufix16_Bn40_degC "Q = (V+40.000000)/1.000000" RAT_FUNC "%0.6" "degC" COEFFS 0 1 40 0 0 1 /end COMPU_METHOD
/begin COMPU_METHOD Ethrc4ms_CM_ufix16_En8__ "Q = V*256.000000" RAT_FUNC "%11.8" "%" COEFFS 0 256 0 0 0 1 /end COMPU_METHOD
/begin COMPU_METHOD Ethrc4ms_CM_ufix16_S50_mV "Q = V/50.000000" RAT_FUNC "%0.6" "mV" COEFFS 0 1 0 0 0 50 /end COMPU_METHOD
/begin COMPU_METHOD Ethrl4ms_CM_boolean_adm "Q = V" RAT_FUNC "%1.0" "adm" COEFFS 0 1 0 0 0 1 /end COMPU_METHOD
/begin COMPU_METHOD Ethrl4ms_CM_eEGST_adm "Enumerated data type: eEGST" TAB_VERB "%0.6" "adm" COMPU_TAB_REF VTAB_FOR_Ethrl4ms_CM_eEGST_adm /end COMPU_METHOD
/begin COMPU_METHOD Ethrl4ms_CM_sfix16_En12_Nm "Q = V*4096.000000" RAT_FUNC "%14.12" "Nm" COEFFS 0 4096 0 0 0 1 /end COMPU_METHOD
/begin COMPU_METHOD Ethrl4ms_CM_tFault_adm "Enumerated data type: tFault" TAB_VERB "%0.6" "adm" COMPU_TAB_REF VTAB_FOR_Ethrl4ms_CM_tFault_adm /end COMPU_METHOD
/begin COMPU_METHOD Ethrl4ms_CM_tKeyState_adm "Enumerated data type: tKeyState" TAB_VERB "%0.6" "adm" COMPU_TAB_REF VTAB_FOR_Ethrl4ms_CM_tKeyState_adm /end COMPU_METHOD
/begin COMPU_METHOD Ethrl4ms_CM_ufix16_Bn40_degC "Q = (V+40.000000)/1.000000" RAT_FUNC "%0.6" "degC" COEFFS 0 1 40 0 0 1 /end COMPU_METHOD
/begin COMPU_METHOD Ethrl4ms_CM_ufix16_En8__ "Q = V*256.000000" RAT_FUNC "%11.8" "%" COEFFS 0 256 0 0 0 1 /end COMPU_METHOD
/begin COMPU_METHOD Ethrl4ms_CM_ufix16_S50_mV "Q = V/50.000000" RAT_FUNC "%0.6" "mV" COEFFS 0 1 0 0 0 50 /end COMPU_METHOD
/begin COMPU_METHOD Ethrl4ms_CM_uint16_km_h "Q = V" RAT_FUNC "%5.0" "km/h" COEFFS 0 1 0 0 0 1 /end COMPU_METHOD
/begin COMPU_METHOD Evrc4ms_CM_boolean_adm "Q = V" RAT_FUNC "%1.0" "adm" COEFFS 0 1 0 0 0 1 /end COMPU_METHOD
/begin COMPU_METHOD Evrc4ms_CM_eEGST_adm "Enumerated data type: eEGST" TAB_VERB "%0.6" "adm" COMPU_TAB_REF VTAB_FOR_Evrc4ms_CM_eEGST_adm /end COMPU_METHOD
/begin COMPU_METHOD Evrc4ms_CM_tActDiagStat_adm "Enumerated data type: tActDiagStat" TAB_VERB "%0.6" "adm" COMPU_TAB_REF VTAB_FOR_Evrc4ms_CM_tActDiagStat_adm /end COMPU_METHOD
/begin COMPU_METHOD Evrc4ms_CM_tDiagStat_adm "Enumerated data type: tDiagStat" TAB_VERB "%0.6" "adm" COMPU_TAB_REF VTAB_FOR_Evrc4ms_CM_tDiagStat_adm /end COMPU_METHOD
/begin COMPU_METHOD Evrc4ms_CM_tFault_adm "Enumerated data type: tFault" TAB_VERB "%0.6" "adm" COMPU_TAB_REF VTAB_FOR_Evrc4ms_CM_tFault_adm /end COMPU_METHOD
/begin COMPU_METHOD Evrc4ms_CM_tKeyState_adm "Enumerated data type: tKeyState" TAB_VERB "%0.6" "adm" COMPU_TAB_REF VTAB_FOR_Evrc4ms_CM_tKeyState_adm /end COMPU_METHOD
/begin COMPU_METHOD FanCool100ms_CM_boolean_adm "Q = V" RAT_FUNC "%1.0" "adm" COEFFS 0 1 0 0 0 1 /end COMPU_METHOD
/begin COMPU_METHOD FanCool100ms_CM_eEGMD_adm "Enumerated data type: eEGMD" TAB_VERB "%0.6" "adm" COMPU_TAB_REF VTAB_FOR_FanCool100ms_CM_eEGMD_adm /end COMPU_METHOD
/begin COMPU_METHOD FanCool100ms_CM_eEGST_adm "Enumerated data type: eEGST" TAB_VERB "%0.6" "adm" COMPU_TAB_REF VTAB_FOR_FanCool100ms_CM_eEGST_adm /end COMPU_METHOD
/begin COMPU_METHOD FanCool100ms_CM_tFault_adm "Enumerated data type: tFault" TAB_VERB "%0.6" "adm" COMPU_TAB_REF VTAB_FOR_FanCool100ms_CM_tFault_adm /end COMPU_METHOD
/begin COMPU_METHOD FanCool100ms_CM_ufix16_Bn40_degC "Q = (V+40.000000)/1.000000" RAT_FUNC "%0.6" "degC" COEFFS 0 1 40 0 0 1 /end COMPU_METHOD
/begin COMPU_METHOD FanCool100ms_CM_ufix16_S50_mV "Q = V/50.000000" RAT_FUNC "%0.6" "mV" COEFFS 0 1 0 0 0 50 /end COMPU_METHOD
/begin COMPU_METHOD FanCool100ms_CM_ufix8_Sp4__ "Q = V*2.500000" RAT_FUNC "%0.6" "%" COEFFS 0 2.5 0 0 0 1 /end COMPU_METHOD
/begin COMPU_METHOD FaultCheckLRN014ms_Symbol_CM_boolean_adm "Q = V" RAT_FUNC "%1.0" "adm" COEFFS 0 1 0 0 0 1 /end COMPU_METHOD
/begin COMPU_METHOD FaultCheckLRN024ms_Symbol_CM_boolean_adm "Q = V" RAT_FUNC "%1.0" "adm" COEFFS 0 1 0 0 0 1 /end COMPU_METHOD
/begin COMPU_METHOD FaultCheckLRN024ms_Symbol_CM_ufix16_En10_V "Q = V*1024.000000" RAT_FUNC "%12.10" "V" COEFFS 0 1024 0 0 0 1 /end COMPU_METHOD
/begin COMPU_METHOD FaultCheckLRN034ms_Symbol_CM_boolean_adm "Q = V" RAT_FUNC "%1.0" "adm" COEFFS 0 1 0 0 0 1 /end COMPU_METHOD
/begin COMPU_METHOD FaultCheckLRN034ms_Symbol_CM_ufix16_En10_V "Q = V*1024.000000" RAT_FUNC "%12.10" "V" COEFFS 0 1024 0 0 0 1 /end COMPU_METHOD
/begin COMPU_METHOD FaultChkADAT2_4ms_CM_FixEnableT "Enumerated data type: FixEnableT" TAB_VERB "%0.6" "" COMPU_TAB_REF VTAB_FOR_FaultChkADAT2_4ms_CM_FixEnableT /end COMPU_METHOD
/begin COMPU_METHOD FaultChkADAT2_4ms_CM_boolean_adm "Q = V" RAT_FUNC "%1.0" "adm" COEFFS 0 1 0 0 0 1 /end COMPU_METHOD
/begin COMPU_METHOD FaultChkADAT2_4ms_CM_tFault_adm "Enumerated data type: tFault" TAB_VERB "%0.6" "adm" COMPU_TAB_REF VTAB_FOR_FaultChkADAT2_4ms_CM_tFault_adm /end COMPU_METHOD
/begin COMPU_METHOD FaultChkADAT2_4ms_CM_uint8_adm "Q = V" RAT_FUNC "%3.0" "adm" COEFFS 0 1 0 0 0 1 /end COMPU_METHOD
/begin COMPU_METHOD FaultChkADATTDC_CM_FixEnableT "Enumerated data type: FixEnableT" TAB_VERB "%0.6" "" COMPU_TAB_REF VTAB_FOR_FaultChkADATTDC_CM_FixEnableT /end COMPU_METHOD
/begin COMPU_METHOD FaultChkADATTDC_CM_boolean_adm "Q = V" RAT_FUNC "%1.0" "adm" COEFFS 0 1 0 0 0 1 /end COMPU_METHOD
/begin COMPU_METHOD FaultChkADATTDC_CM_tFault_adm "Enumerated data type: tFault" TAB_VERB "%0.6" "adm" COMPU_TAB_REF VTAB_FOR_FaultChkADATTDC_CM_tFault_adm /end COMPU_METHOD
/begin COMPU_METHOD FaultChkADATTDC_CM_ufix16_En12_adm "Q = V*4096.000000" RAT_FUNC "%14.12" "adm" COEFFS 0 4096 0 0 0 1 /end COMPU_METHOD
/begin COMPU_METHOD FaultChkBAT4ms_CM_boolean_adm "Q = V" RAT_FUNC "%1.0" "adm" COEFFS 0 1 0 0 0 1 /end COMPU_METHOD
/begin COMPU_METHOD FaultChkBAT4ms_CM_ufix16_En8_s "Q = V*256.000000" RAT_FUNC "%11.8" "s" COEFFS 0 256 0 0 0 1 /end COMPU_METHOD
/begin COMPU_METHOD FaultChkBAT4ms_CM_ufix16_S50_mV "Q = V/50.000000" RAT_FUNC "%0.6" "mV" COEFFS 0 1 0 0 0 50 /end COMPU_METHOD
/begin COMPU_METHOD FaultChkBRKCH_4ms_Symbol_CM_boolean_adm "Q = V" RAT_FUNC "%1.0" "adm" COEFFS 0 1 0 0 0 1 /end COMPU_METHOD
/begin COMPU_METHOD FaultChkCLO1_100ms_CM_boolean_adm "Q = V" RAT_FUNC "%1.0" "adm" COEFFS 0 1 0 0 0 1 /end COMPU_METHOD
/begin COMPU_METHOD FaultChkCLO2_100ms_CM_boolean_adm "Q = V" RAT_FUNC "%1.0" "adm" COEFFS 0 1 0 0 0 1 /end COMPU_METHOD
/begin COMPU_METHOD FaultChkCLO3_100ms_CM_boolean_adm "Q = V" RAT_FUNC "%1.0" "adm" COEFFS 0 1 0 0 0 1 /end COMPU_METHOD
/begin COMPU_METHOD FaultChkCLO4_100ms_CM_boolean_adm "Q = V" RAT_FUNC "%1.0" "adm" COEFFS 0 1 0 0 0 1 /end COMPU_METHOD
/begin COMPU_METHOD FaultChkCOILxTDC_CM_boolean_adm "Q = V" RAT_FUNC "%1.0" "adm" COEFFS 0 1 0 0 0 1 /end COMPU_METHOD
/begin COMPU_METHOD FaultChkCTSP4ms_CM_boolean_adm "Q = V" RAT_FUNC "%1.0" "adm" COEFFS 0 1 0 0 0 1 /end COMPU_METHOD
/begin COMPU_METHOD FaultChkCTSP4ms_CM_ufix16_Sp004_sec "Q = V*250.000000" RAT_FUNC "%0.6" "sec" COEFFS 0 250 0 0 0 1 /end COMPU_METHOD
/begin COMPU_METHOD FaultChkCTST4ms_CM_boolean_adm "Q = V" RAT_FUNC "%1.0" "adm" COEFFS 0 1 0 0 0 1 /end COMPU_METHOD
/begin COMPU_METHOD FaultChkCTST4ms_CM_ufix16_Sp004_sec "Q = V*250.000000" RAT_FUNC "%0.6" "sec" COEFFS 0 250 0 0 0 1 /end COMPU_METHOD
/begin COMPU_METHOD FaultChkEGRC4ms_CM_boolean_adm "Q = V" RAT_FUNC "%1.0" "adm" COEFFS 0 1 0 0 0 1 /end COMPU_METHOD
/begin COMPU_METHOD FaultChkEGRP4ms_CM_boolean_adm "Q = V" RAT_FUNC "%1.0" "adm" COEFFS 0 1 0 0 0 1 /end COMPU_METHOD
/begin COMPU_METHOD FaultChkEGRP4ms_CM_ufix16_En10_V "Q = V*1024.000000" RAT_FUNC "%12.10" "V" COEFFS 0 1024 0 0 0 1 /end COMPU_METHOD
/begin COMPU_METHOD FaultChkEGRP4ms_CM_uint8_adm "Q = V" RAT_FUNC "%3.0" "adm" COEFFS 0 1 0 0 0 1 /end COMPU_METHOD
/begin COMPU_METHOD FaultChkEGRV4ms_CM_boolean_adm "Q = V" RAT_FUNC "%1.0" "adm" COEFFS 0 1 0 0 0 1 /end COMPU_METHOD
/begin COMPU_METHOD FaultChkELTEVR4ms_CM_boolean_adm "Q = V" RAT_FUNC "%1.0" "adm" COEFFS 0 1 0 0 0 1 /end COMPU_METHOD
/begin COMPU_METHOD FaultChkELTLMP100ms_CM_boolean_adm "Q = V" RAT_FUNC "%1.0" "adm" COEFFS 0 1 0 0 0 1 /end COMPU_METHOD
/begin COMPU_METHOD FaultChkENGBRK50ms_CM_boolean_adm "Q = V" RAT_FUNC "%1.0" "adm" COEFFS 0 1 0 0 0 1 /end COMPU_METHOD
/begin COMPU_METHOD FaultChkFAN1_100ms_CM_boolean_adm "Q = V" RAT_FUNC "%1.0" "adm" COEFFS 0 1 0 0 0 1 /end COMPU_METHOD
/begin COMPU_METHOD FaultChkFAN2_100ms_CM_boolean_adm "Q = V" RAT_FUNC "%1.0" "adm" COEFFS 0 1 0 0 0 1 /end COMPU_METHOD
/begin COMPU_METHOD FaultChkINJxTDC_CM_boolean_adm "Q = V" RAT_FUNC "%1.0" "adm" COEFFS 0 1 0 0 0 1 /end COMPU_METHOD
/begin COMPU_METHOD FaultChkKSPxTDC_CM_FixEnableT "Enumerated data type: FixEnableT" TAB_VERB "%0.6" "" COMPU_TAB_REF VTAB_FOR_FaultChkKSPxTDC_CM_FixEnableT /end COMPU_METHOD
/begin COMPU_METHOD FaultChkKSPxTDC_CM_boolean_adm "Q = V" RAT_FUNC "%1.0" "adm" COEFFS 0 1 0 0 0 1 /end COMPU_METHOD
/begin COMPU_METHOD FaultChkKSPxTDC_CM_single_uV "Q = V" RAT_FUNC "%8.6" "uV" COEFFS 0 1 0 0 0 1 /end COMPU_METHOD
/begin COMPU_METHOD FaultChkKSPxTDC_CM_ufix16_En10_adm "Q = V*1024.000000" RAT_FUNC "%12.10" "adm" COEFFS 0 1024 0 0 0 1 /end COMPU_METHOD
/begin COMPU_METHOD FaultChkLHR100ms_CM_boolean_adm "Q = V" RAT_FUNC "%1.0" "adm" COEFFS 0 1 0 0 0 1 /end COMPU_METHOD
/begin COMPU_METHOD FaultChkLHR_2_100ms_CM_boolean_adm "Q = V" RAT_FUNC "%1.0" "adm" COEFFS 0 1 0 0 0 1 /end COMPU_METHOD
/begin COMPU_METHOD FaultChkMDxTDC_CM_boolean_adm "Q = V" RAT_FUNC "%1.0" "adm" COEFFS 0 1 0 0 0 1 /end COMPU_METHOD
/begin COMPU_METHOD FaultChkPO2L100ms_Symbol_CM_FixEnableT "Enumerated data type: FixEnableT" TAB_VERB "%0.6" "" COMPU_TAB_REF VTAB_FOR_FaultChkPO2L100ms_Symbol_CM_FixEnableT /end COMPU_METHOD
/begin COMPU_METHOD FaultChkPO2L100ms_Symbol_CM_boolean_adm "Q = V" RAT_FUNC "%1.0" "adm" COEFFS 0 1 0 0 0 1 /end COMPU_METHOD
/begin COMPU_METHOD FaultChkPO2L100ms_Symbol_CM_ufix32_Sp1_s "Q = V*10.000000" RAT_FUNC "%0.6" "s" COEFFS 0 10 0 0 0 1 /end COMPU_METHOD
/begin COMPU_METHOD FaultChkPO2L100ms_Symbol_CM_uint16_mbar "Q = V" RAT_FUNC "%5.0" "mbar" COEFFS 0 1 0 0 0 1 /end COMPU_METHOD
/begin COMPU_METHOD FaultChkPO2L100ms_Symbol_CM_uint16_rpm "Q = V" RAT_FUNC "%5.0" "rpm" COEFFS 0 1 0 0 0 1 /end COMPU_METHOD
/begin COMPU_METHOD FaultChkSFR4ms_CM_ufix16_Sp1_degree "Q = V*10.000000" RAT_FUNC "%0.6" "degree" COEFFS 0 10 0 0 0 1 /end COMPU_METHOD
/begin COMPU_METHOD FaultChkVS14ms_CM_ufix16_En10_adm "Q = V*1024.000000" RAT_FUNC "%12.10" "adm" COEFFS 0 1024 0 0 0 1 /end COMPU_METHOD
/begin COMPU_METHOD FaultChkVS24ms_CM_ufix16_En10_adm "Q = V*1024.000000" RAT_FUNC "%12.10" "adm" COEFFS 0 1024 0 0 0 1 /end COMPU_METHOD
/begin COMPU_METHOD FaultChkVS34ms_CM_ufix16_En10_adm "Q = V*1024.000000" RAT_FUNC "%12.10" "adm" COEFFS 0 1024 0 0 0 1 /end COMPU_METHOD
/begin COMPU_METHOD Fuels_CtrlMgmt100ms_CM_ufix16_Bn40_degC "Q = (V+40.000000)/1.000000" RAT_FUNC "%0.6" "degC" COEFFS 0 1 40 0 0 1 /end COMPU_METHOD
/begin COMPU_METHOD Fuels_CtrlMgmt100ms_CM_ufix16_En15_adm "Q = V*32768.000000" RAT_FUNC "%16.15" "adm" COEFFS 0 32768 0 0 0 1 /end COMPU_METHOD
/begin COMPU_METHOD Fuels_CtrlMgmt100ms_CM_uint16_mbar "Q = V" RAT_FUNC "%5.0" "mbar" COEFFS 0 1 0 0 0 1 /end COMPU_METHOD
/begin COMPU_METHOD Fuels_CtrlMgmtTDC_CM_boolean_adm "Q = V" RAT_FUNC "%1.0" "adm" COEFFS 0 1 0 0 0 1 /end COMPU_METHOD
/begin COMPU_METHOD Fuels_CtrlMgmtTDC_CM_eEGMD_adm "Enumerated data type: eEGMD" TAB_VERB "%0.6" "adm" COMPU_TAB_REF VTAB_FOR_Fuels_CtrlMgmtTDC_CM_eEGMD_adm /end COMPU_METHOD
/begin COMPU_METHOD Fuels_CtrlMgmtTDC_CM_tFault_adm "Enumerated data type: tFault" TAB_VERB "%0.6" "adm" COMPU_TAB_REF VTAB_FOR_Fuels_CtrlMgmtTDC_CM_tFault_adm /end COMPU_METHOD
/begin COMPU_METHOD Fuels_CtrlMgmtTDC_CM_ufix16_Bn40_degC "Q = (V+40.000000)/1.000000" RAT_FUNC "%0.6" "degC" COEFFS 0 1 40 0 0 1 /end COMPU_METHOD
/begin COMPU_METHOD Fuels_CtrlMgmtTDC_CM_ufix16_En15_adm "Q = V*32768.000000" RAT_FUNC "%16.15" "adm" COEFFS 0 32768 0 0 0 1 /end COMPU_METHOD
/begin COMPU_METHOD Fuels_CtrlMgmtTDC_CM_ufix16_S50_mV "Q = V/50.000000" RAT_FUNC "%0.6" "mV" COEFFS 0 1 0 0 0 50 /end COMPU_METHOD
/begin COMPU_METHOD Fuels_CtrlMgmtTDC_CM_ufix8_Bn40_degC "Q = (V+40.000000)/1.000000" RAT_FUNC "%0.6" "degC" COEFFS 0 1 40 0 0 1 /end COMPU_METHOD
/begin COMPU_METHOD Fuels_CtrlMgmtTDC_CM_uint16_mV "Q = V" RAT_FUNC "%5.0" "mV" COEFFS 0 1 0 0 0 1 /end COMPU_METHOD
/begin COMPU_METHOD HDSECU1_Tx_50ms_CM_boolean_adm "Q = V" RAT_FUNC "%1.0" "adm" COEFFS 0 1 0 0 0 1 /end COMPU_METHOD
/begin COMPU_METHOD HDSECU2_Tx_50ms_CM_boolean_adm "Q = V" RAT_FUNC "%1.0" "adm" COEFFS 0 1 0 0 0 1 /end COMPU_METHOD
/begin COMPU_METHOD INLET_COND_Tx_100ms_CM_boolean_adm "Q = V" RAT_FUNC "%1.0" "adm" COEFFS 0 1 0 0 0 1 /end COMPU_METHOD
/begin COMPU_METHOD INLET_COND_Tx_100ms_CM_ufix16_En5_Bn273_degC "Q = (V+273.000000)*32.000000" RAT_FUNC "%0.6" "degC" COEFFS 0 32 8736 0 0 1 /end COMPU_METHOD
/begin COMPU_METHOD Idle100ms_CM_uint8_adm "Q = V" RAT_FUNC "%3.0" "adm" COEFFS 0 1 0 0 0 1 /end COMPU_METHOD
/begin COMPU_METHOD Idle4ms_CM_boolean_adm "Q = V" RAT_FUNC "%1.0" "adm" COEFFS 0 1 0 0 0 1 /end COMPU_METHOD
/begin COMPU_METHOD Idle4ms_CM_uint16_rpm "Q = V" RAT_FUNC "%5.0" "rpm" COEFFS 0 1 0 0 0 1 /end COMPU_METHOD
/begin COMPU_METHOD IgntTDC_CM_boolean_adm "Q = V" RAT_FUNC "%1.0" "adm" COEFFS 0 1 0 0 0 1 /end COMPU_METHOD
/begin COMPU_METHOD IgntTDC_CM_tFault_adm "Enumerated data type: tFault" TAB_VERB "%0.6" "adm" COMPU_TAB_REF VTAB_FOR_IgntTDC_CM_tFault_adm /end COMPU_METHOD
/begin COMPU_METHOD IgntTDC_CM_ufix16_E1_us "Q = V/2.000000" RAT_FUNC "%5.0" "us" COEFFS 0 1 0 0 0 2 /end COMPU_METHOD
/begin COMPU_METHOD InjtTDC_CM_boolean_adm "Q = V" RAT_FUNC "%1.0" "adm" COEFFS 0 1 0 0 0 1 /end COMPU_METHOD
/begin COMPU_METHOD InjtTDC_CM_boolean_us "Q = V" RAT_FUNC "%1.0" "us" COEFFS 0 1 0 0 0 1 /end COMPU_METHOD
/begin COMPU_METHOD InjtTDC_CM_tErrState_adm "Enumerated data type: tErrState" TAB_VERB "%0.6" "adm" COMPU_TAB_REF VTAB_FOR_InjtTDC_CM_tErrState_adm /end COMPU_METHOD
/begin COMPU_METHOD InjtTDC_CM_tFault_adm "Enumerated data type: tFault" TAB_VERB "%0.6" "adm" COMPU_TAB_REF VTAB_FOR_InjtTDC_CM_tFault_adm /end COMPU_METHOD
/begin COMPU_METHOD InjtTDC_CM_ufix16_E4_us "Q = V/16.000000" RAT_FUNC "%5.0" "us" COEFFS 0 1 0 0 0 16 /end COMPU_METHOD
/begin COMPU_METHOD InjtTDC_CM_ufix16_En4_degree "Q = V*16.000000" RAT_FUNC "%8.4" "degree" COEFFS 0 16 0 0 0 1 /end COMPU_METHOD
/begin COMPU_METHOD J1939dl_Rx100ms_CM_boolean_adm "Q = V" RAT_FUNC "%1.0" "adm" COEFFS 0 1 0 0 0 1 /end COMPU_METHOD
/begin COMPU_METHOD J1939dl_Rx100ms_CM_ufix16_En8_km_h "Q = V*256.000000" RAT_FUNC "%11.8" "km/h" COEFFS 0 256 0 0 0 1 /end COMPU_METHOD
/begin COMPU_METHOD J1939dl_Rx100ms_CM_ufix8_Bn125_gear "Q = (V+125.000000)/1.000000" RAT_FUNC "%0.6" "gear" COEFFS 0 1 125 0 0 1 /end COMPU_METHOD
/begin COMPU_METHOD J1939dl_Rx100ms_CM_uint8_adm "Q = V" RAT_FUNC "%3.0" "adm" COEFFS 0 1 0 0 0 1 /end COMPU_METHOD
/begin COMPU_METHOD J1939dl_Rx4ms_CM_boolean_adm "Q = V" RAT_FUNC "%1.0" "adm" COEFFS 0 1 0 0 0 1 /end COMPU_METHOD
/begin COMPU_METHOD J1939dl_Rx4ms_CM_ufix16_En4__ "Q = V*16.000000" RAT_FUNC "%8.4" "%" COEFFS 0 16 0 0 0 1 /end COMPU_METHOD
/begin COMPU_METHOD J1939dl_Rx4ms_CM_uint16_rpm "Q = V" RAT_FUNC "%5.0" "rpm" COEFFS 0 1 0 0 0 1 /end COMPU_METHOD
/begin COMPU_METHOD J1939dl_Rx4ms_CM_uint8_adm "Q = V" RAT_FUNC "%3.0" "adm" COEFFS 0 1 0 0 0 1 /end COMPU_METHOD
/begin COMPU_METHOD J1939dl_Rx50ms_CM_boolean_adm "Q = V" RAT_FUNC "%1.0" "adm" COEFFS 0 1 0 0 0 1 /end COMPU_METHOD
/begin COMPU_METHOD J1939dl_Rx50ms_CM_sfix16_Sp001_Bn15_mA "Q = (V+15.000000)*1000.000000" RAT_FUNC "%0.6" "mA" COEFFS 0 1000 15000 0 0 1 /end COMPU_METHOD
/begin COMPU_METHOD J1939dl_Rx50ms_CM_ufix16_En8_km_h "Q = V*256.000000" RAT_FUNC "%11.8" "km/h" COEFFS 0 256 0 0 0 1 /end COMPU_METHOD
/begin COMPU_METHOD J1939dl_Rx50ms_CM_uint16_rpm "Q = V" RAT_FUNC "%5.0" "rpm" COEFFS 0 1 0 0 0 1 /end COMPU_METHOD
/begin COMPU_METHOD J1939dl_Rx50ms_CM_uint8_adm "Q = V" RAT_FUNC "%3.0" "adm" COEFFS 0 1 0 0 0 1 /end COMPU_METHOD
/begin COMPU_METHOD J1939dl_Rx50ms_CM_uint8_km_h "Q = V" RAT_FUNC "%3.0" "km/h" COEFFS 0 1 0 0 0 1 /end COMPU_METHOD
/begin COMPU_METHOD KnockTDC_CM_boolean_adm "Q = V" RAT_FUNC "%1.0" "adm" COEFFS 0 1 0 0 0 1 /end COMPU_METHOD
/begin COMPU_METHOD KnockTDC_CM_tFault_adm "Enumerated data type: tFault" TAB_VERB "%0.6" "adm" COMPU_TAB_REF VTAB_FOR_KnockTDC_CM_tFault_adm /end COMPU_METHOD
/begin COMPU_METHOD LFC1_Tx_1s_CM_boolean_adm "Q = V" RAT_FUNC "%1.0" "adm" COEFFS 0 1 0 0 0 1 /end COMPU_METHOD
/begin COMPU_METHOD LFE1_Tx_100ms_CM_boolean_adm "Q = V" RAT_FUNC "%1.0" "adm" COEFFS 0 1 0 0 0 1 /end COMPU_METHOD
/begin COMPU_METHOD LambdaPreTDC_CM_boolean_adm "Q = V" RAT_FUNC "%1.0" "adm" COEFFS 0 1 0 0 0 1 /end COMPU_METHOD
/begin COMPU_METHOD Lamp100ms_CM_boolean_adm "Q = V" RAT_FUNC "%1.0" "adm" COEFFS 0 1 0 0 0 1 /end COMPU_METHOD
/begin COMPU_METHOD Lamp100ms_CM_tFault_adm "Enumerated data type: tFault" TAB_VERB "%0.6" "adm" COMPU_TAB_REF VTAB_FOR_Lamp100ms_CM_tFault_adm /end COMPU_METHOD
/begin COMPU_METHOD MVS_Tx_1s_CM_boolean_adm "Q = V" RAT_FUNC "%1.0" "adm" COEFFS 0 1 0 0 0 1 /end COMPU_METHOD
/begin COMPU_METHOD MisfdTDC_CM_boolean_adm "Q = V" RAT_FUNC "%1.0" "adm" COEFFS 0 1 0 0 0 1 /end COMPU_METHOD
/begin COMPU_METHOD MisfdTDC_CM_tFault_adm "Enumerated data type: tFault" TAB_VERB "%0.6" "adm" COMPU_TAB_REF VTAB_FOR_MisfdTDC_CM_tFault_adm /end COMPU_METHOD
/begin COMPU_METHOD Mpre4ms_CM_ufix16_En10_V "Q = V*1024.000000" RAT_FUNC "%12.10" "V" COEFFS 0 1024 0 0 0 1 /end COMPU_METHOD
/begin COMPU_METHOD Mpre4ms_CM_uint16_mbar "Q = V" RAT_FUNC "%5.0" "mbar" COEFFS 0 1 0 0 0 1 /end COMPU_METHOD
/begin COMPU_METHOD Oilp100ms_CM_boolean_adm "Q = V" RAT_FUNC "%1.0" "adm" COEFFS 0 1 0 0 0 1 /end COMPU_METHOD
/begin COMPU_METHOD Oilp100ms_CM_tFault_adm "Enumerated data type: tFault" TAB_VERB "%0.6" "adm" COMPU_TAB_REF VTAB_FOR_Oilp100ms_CM_tFault_adm /end COMPU_METHOD
/begin COMPU_METHOD PropB_0A_Tx_100ms_CM_boolean_adm "Q = V" RAT_FUNC "%1.0" "adm" COEFFS 0 1 0 0 0 1 /end COMPU_METHOD
/begin COMPU_METHOD PropB_0A_Tx_100ms_CM_uint8_adm "Q = V" RAT_FUNC "%3.0" "adm" COEFFS 0 1 0 0 0 1 /end COMPU_METHOD
/begin COMPU_METHOD Prvc4ms_CM_boolean_adm "Q = V" RAT_FUNC "%1.0" "adm" COEFFS 0 1 0 0 0 1 /end COMPU_METHOD
/begin COMPU_METHOD Pwrl4ms_CM_boolean_adm "Q = V" RAT_FUNC "%1.0" "adm" COEFFS 0 1 0 0 0 1 /end COMPU_METHOD
/begin COMPU_METHOD RET_CONF_Tx_1s_CM_boolean_adm "Q = V" RAT_FUNC "%1.0" "adm" COEFFS 0 1 0 0 0 1 /end COMPU_METHOD
/begin COMPU_METHOD RecRifasaInjTDC_CM_FixEnableT "Enumerated data type: FixEnableT" TAB_VERB "%0.6" "" COMPU_TAB_REF VTAB_FOR_RecRifasaInjTDC_CM_FixEnableT /end COMPU_METHOD
/begin COMPU_METHOD RecRifasaInjTDC_CM_boolean_adm "Q = V" RAT_FUNC "%1.0" "adm" COEFFS 0 1 0 0 0 1 /end COMPU_METHOD
/begin COMPU_METHOD RecRifasaInjTDC_CM_ufix16_En4_degree "Q = V*16.000000" RAT_FUNC "%8.4" "degree" COEFFS 0 16 0 0 0 1 /end COMPU_METHOD
/begin COMPU_METHOD RecRifasaInjTDC_CM_uint16_adm "Q = V" RAT_FUNC "%5.0" "adm" COEFFS 0 1 0 0 0 1 /end COMPU_METHOD
/begin COMPU_METHOD RecRifasaInjTDC_CM_uint32_adm "Q = V" RAT_FUNC "%10.0" "adm" COEFFS 0 1 0 0 0 1 /end COMPU_METHOD
/begin COMPU_METHOD RecRifasaInjTDC_CM_uint32_us "Q = V" RAT_FUNC "%10.0" "us" COEFFS 0 1 0 0 0 1 /end COMPU_METHOD
/begin COMPU_METHOD RecRifasaInjTDC_CM_uint8_adm "Q = V" RAT_FUNC "%3.0" "adm" COEFFS 0 1 0 0 0 1 /end COMPU_METHOD
/begin COMPU_METHOD RecoveryCOILxTDC_CM_boolean_adm "Q = V" RAT_FUNC "%1.0" "adm" COEFFS 0 1 0 0 0 1 /end COMPU_METHOD
/begin COMPU_METHOD RecoveryCOILxTDC_CM_ufix16_E1_us "Q = V/2.000000" RAT_FUNC "%5.0" "us" COEFFS 0 1 0 0 0 2 /end COMPU_METHOD
/begin COMPU_METHOD RecoveryEGRP4ms_CM_ufix16_En10_V "Q = V*1024.000000" RAT_FUNC "%12.10" "V" COEFFS 0 1024 0 0 0 1 /end COMPU_METHOD
/begin COMPU_METHOD RecoveryFAN1_100ms_CM_ufix16_En3__ "Q = V*8.000000" RAT_FUNC "%7.3" "%" COEFFS 0 8 0 0 0 1 /end COMPU_METHOD
/begin COMPU_METHOD RecoveryFAN2_100ms_CM_boolean_adm "Q = V" RAT_FUNC "%1.0" "adm" COEFFS 0 1 0 0 0 1 /end COMPU_METHOD
/begin COMPU_METHOD RecoveryINJxTDC_CM_boolean_adm "Q = V" RAT_FUNC "%1.0" "adm" COEFFS 0 1 0 0 0 1 /end COMPU_METHOD
/begin COMPU_METHOD RecoveryINJxTDC_CM_ufix16_E4_us "Q = V/16.000000" RAT_FUNC "%5.0" "us" COEFFS 0 1 0 0 0 16 /end COMPU_METHOD
/begin COMPU_METHOD RecoveryINJxTDC_CM_uint16_rpm "Q = V" RAT_FUNC "%5.0" "rpm" COEFFS 0 1 0 0 0 1 /end COMPU_METHOD
/begin COMPU_METHOD RecoveryLHR100ms_CM_uint16__ "Q = V" RAT_FUNC "%5.0" "%" COEFFS 0 1 0 0 0 1 /end COMPU_METHOD
/begin COMPU_METHOD RecoveryLHR_2_100ms_CM_boolean_adm "Q = V" RAT_FUNC "%1.0" "adm" COEFFS 0 1 0 0 0 1 /end COMPU_METHOD
/begin COMPU_METHOD RecoveryLHR_2_100ms_CM_uint16__ "Q = V" RAT_FUNC "%5.0" "%" COEFFS 0 1 0 0 0 1 /end COMPU_METHOD
/begin COMPU_METHOD RecoverySPT100ms_Symbol_CM_ufix16_En10_V "Q = V*1024.000000" RAT_FUNC "%12.10" "V" COEFFS 0 1024 0 0 0 1 /end COMPU_METHOD
/begin COMPU_METHOD RecoverySTA100ms_Symbol_CM_FixEnableT "Enumerated data type: FixEnableT" TAB_VERB "%0.6" "" COMPU_TAB_REF VTAB_FOR_RecoverySTA100ms_Symbol_CM_FixEnableT /end COMPU_METHOD
/begin COMPU_METHOD RecoverySTA100ms_Symbol_CM_boolean_adm "Q = V" RAT_FUNC "%1.0" "adm" COEFFS 0 1 0 0 0 1 /end COMPU_METHOD
/begin COMPU_METHOD RecoverySTA100ms_Symbol_CM_ufix16_En10_adm "Q = V*1024.000000" RAT_FUNC "%12.10" "adm" COEFFS 0 1024 0 0 0 1 /end COMPU_METHOD
/begin COMPU_METHOD RecoveryWGT50ms_Symbol_CM_uint16_mbar "Q = V" RAT_FUNC "%5.0" "mbar" COEFFS 0 1 0 0 0 1 /end COMPU_METHOD
/begin COMPU_METHOD SEP1_Tx_1s_CM_boolean_adm "Q = V" RAT_FUNC "%1.0" "adm" COEFFS 0 1 0 0 0 1 /end COMPU_METHOD
/begin COMPU_METHOD SHUTDOWN_Tx_1s_CM_boolean_adm "Q = V" RAT_FUNC "%1.0" "adm" COEFFS 0 1 0 0 0 1 /end COMPU_METHOD
/begin COMPU_METHOD SHUTDOWN_Tx_1s_CM_uint8_adm "Q = V" RAT_FUNC "%3.0" "adm" COEFFS 0 1 0 0 0 1 /end COMPU_METHOD
/begin COMPU_METHOD TCO1_Rx_50ms_CM_ufix16_En8_km_h "Q = V*256.000000" RAT_FUNC "%11.8" "km/h" COEFFS 0 256 0 0 0 1 /end COMPU_METHOD
/begin COMPU_METHOD TE_FaultChkMFLV4ms_Symbol_CM_boolean_adm "Q = V" RAT_FUNC "%1.0" "adm" COEFFS 0 1 0 0 0 1 /end COMPU_METHOD
/begin COMPU_METHOD TE_FaultChkMFLV4ms_Symbol_CM_ufix16_Sp004_sec "Q = V*250.000000" RAT_FUNC "%0.6" "sec" COEFFS 0 250 0 0 0 1 /end COMPU_METHOD
/begin COMPU_METHOD TE_FaultChkSPP02_4ms_CM_FixEnableT "Enumerated data type: FixEnableT" TAB_VERB "%0.6" "" COMPU_TAB_REF VTAB_FOR_TE_FaultChkSPP02_4ms_CM_FixEnableT /end COMPU_METHOD
/begin COMPU_METHOD TE_FaultChkSPP02_4ms_CM_ufix16_En10_V "Q = V*1024.000000" RAT_FUNC "%12.10" "V" COEFFS 0 1024 0 0 0 1 /end COMPU_METHOD
/begin COMPU_METHOD TE_FaultChkSPPC1_4ms_CM_ufix16_En10_V "Q = V*1024.000000" RAT_FUNC "%12.10" "V" COEFFS 0 1024 0 0 0 1 /end COMPU_METHOD
/begin COMPU_METHOD TE_FaultChkSPPC2_4ms_CM_boolean_adm "Q = V" RAT_FUNC "%1.0" "adm" COEFFS 0 1 0 0 0 1 /end COMPU_METHOD
/begin COMPU_METHOD TE_FaultChkSPPCH_4ms_CM_ufix16_En10_V "Q = V*1024.000000" RAT_FUNC "%12.10" "V" COEFFS 0 1024 0 0 0 1 /end COMPU_METHOD
/begin COMPU_METHOD TE_RecoverySPP_4ms_CM_FixEnableT "Enumerated data type: FixEnableT" TAB_VERB "%0.6" "" COMPU_TAB_REF VTAB_FOR_TE_RecoverySPP_4ms_CM_FixEnableT /end COMPU_METHOD
/begin COMPU_METHOD TE_RecoverySPP_4ms_CM_boolean_adm "Q = V" RAT_FUNC "%1.0" "adm" COEFFS 0 1 0 0 0 1 /end COMPU_METHOD
/begin COMPU_METHOD TE_RecoverySPP_4ms_CM_uint8_adm "Q = V" RAT_FUNC "%3.0" "adm" COEFFS 0 1 0 0 0 1 /end COMPU_METHOD
/begin COMPU_METHOD TE_TM_CheckStazDiag_50ms_Symbol_CM_FixEnableT "Enumerated data type: FixEnableT" TAB_VERB "%0.6" "" COMPU_TAB_REF VTAB_FOR_TE_TM_CheckStazDiag_50ms_Symbol_CM_FixEnableT /end COMPU_METHOD
/begin COMPU_METHOD TE_TM_CheckStazDiag_50ms_Symbol_CM_boolean_adm "Q = V" RAT_FUNC "%1.0" "adm" COEFFS 0 1 0 0 0 1 /end COMPU_METHOD
/begin COMPU_METHOD TE_TM_CheckStazDiag_50ms_Symbol_CM_ufix32_Sp05_s "Q = V*20.000000" RAT_FUNC "%0.6" "s" COEFFS 0 20 0 0 0 1 /end COMPU_METHOD
/begin COMPU_METHOD TE_TM_CheckStazDiag_50ms_Symbol_CM_uint16_mbar "Q = V" RAT_FUNC "%5.0" "mbar" COEFFS 0 1 0 0 0 1 /end COMPU_METHOD
/begin COMPU_METHOD TE_TM_CheckStazDiag_50ms_Symbol_CM_uint16_rpm "Q = V" RAT_FUNC "%5.0" "rpm" COEFFS 0 1 0 0 0 1 /end COMPU_METHOD
/begin COMPU_METHOD TE_TM_CheckStazDiag_50ms_Symbol_CM_uint8_adm "Q = V" RAT_FUNC "%3.0" "adm" COEFFS 0 1 0 0 0 1 /end COMPU_METHOD
/begin COMPU_METHOD TE_TM_FaultChkAIR2H_50ms_Symbol_CM_FixEnableT "Enumerated data type: FixEnableT" TAB_VERB "%0.6" "" COMPU_TAB_REF VTAB_FOR_TE_TM_FaultChkAIR2H_50ms_Symbol_CM_FixEnableT /end COMPU_METHOD
/begin COMPU_METHOD TE_TM_FaultChkAIR2H_50ms_Symbol_CM_boolean_adm "Q = V" RAT_FUNC "%1.0" "adm" COEFFS 0 1 0 0 0 1 /end COMPU_METHOD
/begin COMPU_METHOD TE_TM_FaultChkAIR2H_50ms_Symbol_CM_ufix16_En4__ "Q = V*16.000000" RAT_FUNC "%8.4" "%" COEFFS 0 16 0 0 0 1 /end COMPU_METHOD
/begin COMPU_METHOD TE_TM_FaultChkAIR2H_50ms_Symbol_CM_ufix16_En4_kg_h "Q = V*16.000000" RAT_FUNC "%8.4" "kg/h" COEFFS 0 16 0 0 0 1 /end COMPU_METHOD
/begin COMPU_METHOD TE_TM_FaultChkAIR2L_50ms_Symbol_CM_FixEnableT "Enumerated data type: FixEnableT" TAB_VERB "%0.6" "" COMPU_TAB_REF VTAB_FOR_TE_TM_FaultChkAIR2L_50ms_Symbol_CM_FixEnableT /end COMPU_METHOD
/begin COMPU_METHOD TE_TM_FaultChkAIR2L_50ms_Symbol_CM_boolean_adm "Q = V" RAT_FUNC "%1.0" "adm" COEFFS 0 1 0 0 0 1 /end COMPU_METHOD
/begin COMPU_METHOD TE_TM_FaultChkAIR2L_50ms_Symbol_CM_ufix16_En4__ "Q = V*16.000000" RAT_FUNC "%8.4" "%" COEFFS 0 16 0 0 0 1 /end COMPU_METHOD
/begin COMPU_METHOD TE_TM_FaultChkAIR2L_50ms_Symbol_CM_ufix16_En4_kg_h "Q = V*16.000000" RAT_FUNC "%8.4" "kg/h" COEFFS 0 16 0 0 0 1 /end COMPU_METHOD
/begin COMPU_METHOD TE_TM_FaultChkFAR014ms_CM_boolean_adm "Q = V" RAT_FUNC "%1.0" "adm" COEFFS 0 1 0 0 0 1 /end COMPU_METHOD
/begin COMPU_METHOD TE_TM_FaultChkFAR014ms_CM_ufix16_En10_V "Q = V*1024.000000" RAT_FUNC "%12.10" "V" COEFFS 0 1024 0 0 0 1 /end COMPU_METHOD
/begin COMPU_METHOD TE_TM_FaultChkFAR014ms_CM_uint8_adm "Q = V" RAT_FUNC "%3.0" "adm" COEFFS 0 1 0 0 0 1 /end COMPU_METHOD
/begin COMPU_METHOD TE_TM_FaultChkFAR024ms_CM_boolean_adm "Q = V" RAT_FUNC "%1.0" "adm" COEFFS 0 1 0 0 0 1 /end COMPU_METHOD
/begin COMPU_METHOD TE_TM_FaultChkFAR024ms_CM_ufix16_En10_V "Q = V*1024.000000" RAT_FUNC "%12.10" "V" COEFFS 0 1024 0 0 0 1 /end COMPU_METHOD
/begin COMPU_METHOD TE_TM_FaultChkFAR024ms_CM_uint8_adm "Q = V" RAT_FUNC "%3.0" "adm" COEFFS 0 1 0 0 0 1 /end COMPU_METHOD
/begin COMPU_METHOD TE_TM_FaultChkFAR124ms_Symbol_CM_boolean_adm "Q = V" RAT_FUNC "%1.0" "adm" COEFFS 0 1 0 0 0 1 /end COMPU_METHOD
/begin COMPU_METHOD TE_TM_FaultChkFARCH4ms_Symbol_CM_boolean_adm "Q = V" RAT_FUNC "%1.0" "adm" COEFFS 0 1 0 0 0 1 /end COMPU_METHOD
/begin COMPU_METHOD TE_TM_RecoveryAIR_50ms_Symbol_CM_FixEnableT "Enumerated data type: FixEnableT" TAB_VERB "%0.6" "" COMPU_TAB_REF VTAB_FOR_TE_TM_RecoveryAIR_50ms_Symbol_CM_FixEnableT /end COMPU_METHOD
/begin COMPU_METHOD TE_TM_RecoveryAIR_50ms_Symbol_CM_ufix16_En4__ "Q = V*16.000000" RAT_FUNC "%8.4" "%" COEFFS 0 16 0 0 0 1 /end COMPU_METHOD
/begin COMPU_METHOD TE_TM_RecoveryFAR4ms_Symbol_CM_ufix16_En10_V "Q = V*1024.000000" RAT_FUNC "%12.10" "V" COEFFS 0 1024 0 0 0 1 /end COMPU_METHOD
/begin COMPU_METHOD TE_TM_Torque_CylCut_TDC_Symbol_CM_FixEnableT "Enumerated data type: FixEnableT" TAB_VERB "%0.6" "" COMPU_TAB_REF VTAB_FOR_TE_TM_Torque_CylCut_TDC_Symbol_CM_FixEnableT /end COMPU_METHOD
/begin COMPU_METHOD TE_TM_Torque_CylCut_TDC_Symbol_CM_boolean_adm "Q = V" RAT_FUNC "%1.0" "adm" COEFFS 0 1 0 0 0 1 /end COMPU_METHOD
/begin COMPU_METHOD TE_TM_Torque_CylCut_TDC_Symbol_CM_uint8__ "Q = V" RAT_FUNC "%3.0" "%" COEFFS 0 1 0 0 0 1 /end COMPU_METHOD
/begin COMPU_METHOD TF_TE_DiagSTR_PON4ms_CM_ufix16_E2_ms "Q = V/4.000000" RAT_FUNC "%5.0" "ms" COEFFS 0 1 0 0 0 4 /end COMPU_METHOD
/begin COMPU_METHOD TIMEDATE_Rx_1s_CM_ufix8_B1985_year "Q = (V-1985.000000)/1.000000" RAT_FUNC "%0.6" "year" COEFFS 0 1 -1985 0 0 1 /end COMPU_METHOD
/begin COMPU_METHOD TIMEDATE_Rx_1s_CM_ufix8_En2_s "Q = V*4.000000" RAT_FUNC "%4.2" "s" COEFFS 0 4 0 0 0 1 /end COMPU_METHOD
/begin COMPU_METHOD TIMEDATE_Rx_1s_CM_uint8_h "Q = V" RAT_FUNC "%3.0" "h" COEFFS 0 1 0 0 0 1 /end COMPU_METHOD
/begin COMPU_METHOD TIMEDATE_Rx_1s_CM_uint8_min "Q = V" RAT_FUNC "%3.0" "min" COEFFS 0 1 0 0 0 1 /end COMPU_METHOD
/begin COMPU_METHOD TIMEDATE_Rx_1s_CM_uint8_month "Q = V" RAT_FUNC "%3.0" "month" COEFFS 0 1 0 0 0 1 /end COMPU_METHOD
/begin COMPU_METHOD TSC1_TR_RETARDER_Rx_50ms_CM_ufix16_En3_rpm "Q = V*8.000000" RAT_FUNC "%7.3" "rpm" COEFFS 0 8 0 0 0 1 /end COMPU_METHOD
/begin COMPU_METHOD TSC1_TR_RETARDER_Rx_50ms_CM_ufix8_Bn125__ "Q = (V+125.000000)/1.000000" RAT_FUNC "%0.6" "%" COEFFS 0 1 125 0 0 1 /end COMPU_METHOD
/begin COMPU_METHOD TSC1_TR_RETARDER_Rx_50ms_CM_uint8_adm "Q = V" RAT_FUNC "%3.0" "adm" COEFFS 0 1 0 0 0 1 /end COMPU_METHOD
/begin COMPU_METHOD TSC1_VE_CONTROL2_Rx_4ms_CM_ufix16_En3_rpm "Q = V*8.000000" RAT_FUNC "%7.3" "rpm" COEFFS 0 8 0 0 0 1 /end COMPU_METHOD
/begin COMPU_METHOD TSC1_VE_CONTROL2_Rx_4ms_CM_ufix8_Bn125__ "Q = (V+125.000000)/1.000000" RAT_FUNC "%0.6" "%" COEFFS 0 1 125 0 0 1 /end COMPU_METHOD
/begin COMPU_METHOD TSC1_VE_CONTROL2_Rx_4ms_CM_uint8_adm "Q = V" RAT_FUNC "%3.0" "adm" COEFFS 0 1 0 0 0 1 /end COMPU_METHOD
/begin COMPU_METHOD TSC1_VE_CONTROL_Rx_4ms_CM_ufix16_En3_rpm "Q = V*8.000000" RAT_FUNC "%7.3" "rpm" COEFFS 0 8 0 0 0 1 /end COMPU_METHOD
/begin COMPU_METHOD TSC1_VE_CONTROL_Rx_4ms_CM_ufix8_Bn125__ "Q = (V+125.000000)/1.000000" RAT_FUNC "%0.6" "%" COEFFS 0 1 125 0 0 1 /end COMPU_METHOD
/begin COMPU_METHOD TSC1_VE_CONTROL_Rx_4ms_CM_uint8_adm "Q = V" RAT_FUNC "%3.0" "adm" COEFFS 0 1 0 0 0 1 /end COMPU_METHOD
/begin COMPU_METHOD TSC1_VE_LIMIT_Rx_4ms_CM_ufix16_En3_rpm "Q = V*8.000000" RAT_FUNC "%7.3" "rpm" COEFFS 0 8 0 0 0 1 /end COMPU_METHOD
/begin COMPU_METHOD TSC1_VE_LIMIT_Rx_4ms_CM_ufix8_Bn125__ "Q = (V+125.000000)/1.000000" RAT_FUNC "%0.6" "%" COEFFS 0 1 125 0 0 1 /end COMPU_METHOD
/begin COMPU_METHOD TSC1_VE_LIMIT_Rx_4ms_CM_uint8_adm "Q = V" RAT_FUNC "%3.0" "adm" COEFFS 0 1 0 0 0 1 /end COMPU_METHOD
/begin COMPU_METHOD TURBO2ECU_Rx_4ms_CM_ufix8_Sp152_V "Q = V*6.578947" RAT_FUNC "%0.6" "V" COEFFS 0 6.578947 0 0 0 1 /end COMPU_METHOD
/begin COMPU_METHOD TURBO2ECU_Rx_4ms_CM_ufix8_Sp416_deg "Q = V*2.403846" RAT_FUNC "%0.6" "deg" COEFFS 0 2.403846 0 0 0 1 /end COMPU_METHOD
/begin COMPU_METHOD Thrp4ms_CM_boolean_adm "Q = V" RAT_FUNC "%1.0" "adm" COEFFS 0 1 0 0 0 1 /end COMPU_METHOD
/begin COMPU_METHOD Thrp4ms_CM_tFault_adm "Enumerated data type: tFault" TAB_VERB "%0.6" "adm" COMPU_TAB_REF VTAB_FOR_Thrp4ms_CM_tFault_adm /end COMPU_METHOD
/begin COMPU_METHOD Thrp4ms_CM_uint8_adm "Q = V" RAT_FUNC "%3.0" "adm" COEFFS 0 1 0 0 0 1 /end COMPU_METHOD
/begin COMPU_METHOD Thrp_Mgmt50ms_CM_boolean_adm "Q = V" RAT_FUNC "%1.0" "adm" COEFFS 0 1 0 0 0 1 /end COMPU_METHOD
/begin COMPU_METHOD Thrp_Mgmt50ms_CM_tFault_adm "Enumerated data type: tFault" TAB_VERB "%0.6" "adm" COMPU_TAB_REF VTAB_FOR_Thrp_Mgmt50ms_CM_tFault_adm /end COMPU_METHOD
/begin COMPU_METHOD Thrp_Mgmt50ms_CM_ufix16_En4__ "Q = V*16.000000" RAT_FUNC "%8.4" "%" COEFFS 0 16 0 0 0 1 /end COMPU_METHOD
/begin COMPU_METHOD Trqm_CtrlMgmt4ms_CM_boolean_adm "Q = V" RAT_FUNC "%1.0" "adm" COEFFS 0 1 0 0 0 1 /end COMPU_METHOD
/begin COMPU_METHOD USS_Rx_50ms_CM_boolean_adm "Q = V" RAT_FUNC "%1.0" "adm" COEFFS 0 1 0 0 0 1 /end COMPU_METHOD
/begin COMPU_METHOD USS_Rx_50ms_CM_sfix16_Sp001_Bn15_mA "Q = (V+15.000000)*1000.000000" RAT_FUNC "%0.6" "mA" COEFFS 0 1000 15000 0 0 1 /end COMPU_METHOD
/begin COMPU_METHOD VCM2ECM_Rx_50ms_CM_boolean_adm "Q = V" RAT_FUNC "%1.0" "adm" COEFFS 0 1 0 0 0 1 /end COMPU_METHOD
/begin COMPU_METHOD VCM2ECM_Rx_50ms_CM_ufix16_En3_rpm "Q = V*8.000000" RAT_FUNC "%7.3" "rpm" COEFFS 0 8 0 0 0 1 /end COMPU_METHOD
/begin COMPU_METHOD VCM2ECM_Rx_50ms_CM_uint8_adm "Q = V" RAT_FUNC "%3.0" "adm" COEFFS 0 1 0 0 0 1 /end COMPU_METHOD
/begin COMPU_METHOD VEP1_Tx_1s_CM_boolean_adm "Q = V" RAT_FUNC "%1.0" "adm" COEFFS 0 1 0 0 0 1 /end COMPU_METHOD
/begin COMPU_METHOD VEP1_Tx_1s_CM_ufix16_Sp05_V "Q = V*20.000000" RAT_FUNC "%0.6" "V" COEFFS 0 20 0 0 0 1 /end COMPU_METHOD
/begin COMPU_METHOD VEP1_Tx_1s_CM_uint16_adm "Q = V" RAT_FUNC "%5.0" "adm" COEFFS 0 1 0 0 0 1 /end COMPU_METHOD
/begin COMPU_METHOD Vfnc4ms_CM_boolean_adm "Q = V" RAT_FUNC "%1.0" "adm" COEFFS 0 1 0 0 0 1 /end COMPU_METHOD
/begin COMPU_METHOD Vfnc4ms_CM_tFault_adm "Enumerated data type: tFault" TAB_VERB "%0.6" "adm" COMPU_TAB_REF VTAB_FOR_Vfnc4ms_CM_tFault_adm /end COMPU_METHOD
/begin COMPU_VTAB VTAB_FOR_AutoTDC_CM_tFault_adm "Enumerated data type: tFault" TAB_VERB 90 0 "NO_FAULT" 1 "SIGNAL_TOO_LOW" 2 "SIGNAL_TOO_BIG" 3 "SC_TO_BATTERY" 4 "SC_TO_GND" 5 "SIGNAL_NOT_PLAUSIBLE" 6 "OC_OR_SC_TO_BATTERY" 7 "OC_OR_SC_TO_GND" 8 "OC" 9 "NO_SIGNAL" 10 "SIGNAL_DELAYED" 11 "TRASMISSION_IMPOSSIBLE" 12 "COMPONENT_DAMAGED" 13 "TEST_CONDITION_NOT_CORRECT" 14 "MECHANICAL_PROBLEM" 15 "GENERIC_FAULT" 16 "DERIVATIVE_TOO_HIGH" 17 "DERIVATIVE_TOO_LOW" 18 "CONTROL_ERROR" 19 "ALIM_KO" 20 "ADC_KO" 21 "CAN_OFF" 22 "AIRQCONTROL_ERROR" 23 "FBCONTROL_ERROR" 24 "RPCONTROL_ERROR" 25 "SAFETY_KO" 26 "SC_HS_LS" 27 "SC_TO_GND_HS" 28 "TPU_ERROR" 29 "OC_OR_SC_TO_GND_LS" 30 "SC_TO_BAT_LS" 31 "OVERTEMPERATURE" 32 "SC_TO_GND_LS" 33 "SC_TO_BAT_HS" 34 "CLOSED" 35 "OPEN" 36 "LOAD_DUMP" 37 "STUCK_OPEN" 38 "STUCK_CLOSED" 39 "UNKNOWN_STATE" 40 "UNDERVOLTAGE" 41 "STUCK_ON" 42 "STUCK_OFF" 43 "ON" 44 "OFF" 45 "THR_INCOHERENCE" 46 "PDL_INCOHERENCE" 47 "POT_2_FAULT" 48 "QAIR_UNDER_ESTIM" 49 "QAIR_OVER_ESTIM" 50 "RSCOPEN_ERROR" 51 "RSCWAIT_ERROR" 52 "RSCCLOSE_ERROR" 53 "OSCCLOSE_ERROR" 54 "OSCOPEN_ERROR" 55 "DTC_ERROR" 56 "NLP_ERROR" 57 "UMA_ERROR" 58 "TEMP_PREWARNING" 59 "TEMP_WARNING" 60 "THR_LRN_ERROR" 61 "COMM_ERROR" 62 "MMP_ERROR" 63 "SMP_ERROR" 64 "EOBD_ERROR" 65 "ENERGY_ERROR" 66 "GAIN_ERROR" 67 "KO2_HPRAIL_ERROR" 68 "KO2_LPRAIL_ERROR" 69 "OFFS_ERROR" 70 "SWT_INCOHERENCE" 71 "MFLV_INCOHERENCE" 72 "SET_PLUS_FAULT" 73 "SET_MINUS_FAULT" 74 "OFF_FAULT" 75 "SET_FAULT" 76 "RESUME_FAULT" 77 "HOLD_FAULT" 78 "STOP_CABIN_TILT_FAULT" 79 "START_CABIN_TILT_FAULT" 80 "STUCK_CLOSED_OR_OPEN_LOAD" 81 "OVERCURR" 82 "CAM_NTEETH_INCOHERENCE" 83 "CAM_POS_INCOHERENCE" 84 "SERIAL_ERROR" 85 "CHIP_FAULT" 86 "SC_PHASES" 87 "STACK_ERROR" 88 "NUMBER_OF_FAULT" 89 "ANY_FAULT" /end COMPU_VTAB
/begin COMPU_VTAB VTAB_FOR_Auto_DiagLineADAT2_4ms_CM_tFault_adm "Enumerated data type: tFault" TAB_VERB 89 0 "NO_FAULT" 1 "SIGNAL_TOO_LOW" 2 "SIGNAL_TOO_BIG" 3 "SC_TO_BATTERY" 4 "SC_TO_GND" 5 "SIGNAL_NOT_PLAUSIBLE" 6 "OC_OR_SC_TO_BATTERY" 7 "OC_OR_SC_TO_GND" 8 "OC" 9 "NO_SIGNAL" 10 "SIGNAL_DELAYED" 11 "TRASMISSION_IMPOSSIBLE" 12 "COMPONENT_DAMAGED" 13 "TEST_CONDITION_NOT_CORRECT" 14 "MECHANICAL_PROBLEM" 15 "GENERIC_FAULT" 16 "DERIVATIVE_TOO_HIGH" 17 "DERIVATIVE_TOO_LOW" 18 "CONTROL_ERROR" 19 "ALIM_KO" 20 "ADC_KO" 21 "CAN_OFF" 22 "AIRQCONTROL_ERROR" 23 "FBCONTROL_ERROR" 24 "RPCONTROL_ERROR" 25 "SAFETY_KO" 26 "SC_HS_LS" 27 "SC_TO_GND_HS" 28 "TPU_ERROR" 29 "OC_OR_SC_TO_GND_LS" 30 "SC_TO_BAT_LS" 31 "OVERTEMPERATURE" 32 "SC_TO_GND_LS" 33 "SC_TO_BAT_HS" 34 "CLOSED" 35 "OPEN" 36 "LOAD_DUMP" 37 "STUCK_OPEN" 38 "STUCK_CLOSED" 39 "UNKNOWN_STATE" 40 "UNDERVOLTAGE" 41 "STUCK_ON" 42 "STUCK_OFF" 43 "ON" 44 "OFF" 45 "THR_INCOHERENCE" 46 "PDL_INCOHERENCE" 47 "POT_2_FAULT" 48 "QAIR_UNDER_ESTIM" 49 "QAIR_OVER_ESTIM" 50 "RSCOPEN_ERROR" 51 "RSCWAIT_ERROR" 52 "RSCCLOSE_ERROR" 53 "OSCCLOSE_ERROR" 54 "OSCOPEN_ERROR" 55 "DTC_ERROR" 56 "NLP_ERROR" 57 "UMA_ERROR" 58 "TEMP_PREWARNING" 59 "TEMP_WARNING" 60 "THR_LRN_ERROR" 61 "COMM_ERROR" 62 "MMP_ERROR" 63 "SMP_ERROR" 64 "EOBD_ERROR" 65 "ENERGY_ERROR" 66 "GAIN_ERROR" 67 "KO2_HPRAIL_ERROR" 68 "KO2_LPRAIL_ERROR" 69 "OFFS_ERROR" 70 "SWT_INCOHERENCE" 71 "MFLV_INCOHERENCE" 72 "SET_PLUS_FAULT" 73 "SET_MINUS_FAULT" 74 "OFF_FAULT" 75 "SET_FAULT" 76 "RESUME_FAULT" 77 "HOLD_FAULT" 78 "STOP_CABIN_TILT_FAULT" 79 "START_CABIN_TILT_FAULT" 80 "STUCK_CLOSED_OR_OPEN_LOAD" 81 "OVERCURR" 82 "CAM_NTEETH_INCOHERENCE" 83 "CAM_POS_INCOHERENCE" 84 "SERIAL_ERROR" 85 "CHIP_FAULT" 86 "SC_PHASES" 87 "NUMBER_OF_FAULT" 88 "ANY_FAULT" /end COMPU_VTAB
/begin COMPU_VTAB VTAB_FOR_Batt4ms_CM_tFault_adm "Enumerated data type: tFault" TAB_VERB 89 0 "NO_FAULT" 1 "SIGNAL_TOO_LOW" 2 "SIGNAL_TOO_BIG" 3 "SC_TO_BATTERY" 4 "SC_TO_GND" 5 "SIGNAL_NOT_PLAUSIBLE" 6 "OC_OR_SC_TO_BATTERY" 7 "OC_OR_SC_TO_GND" 8 "OC" 9 "NO_SIGNAL" 10 "SIGNAL_DELAYED" 11 "TRASMISSION_IMPOSSIBLE" 12 "COMPONENT_DAMAGED" 13 "TEST_CONDITION_NOT_CORRECT" 14 "MECHANICAL_PROBLEM" 15 "GENERIC_FAULT" 16 "DERIVATIVE_TOO_HIGH" 17 "DERIVATIVE_TOO_LOW" 18 "CONTROL_ERROR" 19 "ALIM_KO" 20 "ADC_KO" 21 "CAN_OFF" 22 "AIRQCONTROL_ERROR" 23 "FBCONTROL_ERROR" 24 "RPCONTROL_ERROR" 25 "SAFETY_KO" 26 "SC_HS_LS" 27 "SC_TO_GND_HS" 28 "TPU_ERROR" 29 "OC_OR_SC_TO_GND_LS" 30 "SC_TO_BAT_LS" 31 "OVERTEMPERATURE" 32 "SC_TO_GND_LS" 33 "SC_TO_BAT_HS" 34 "CLOSED" 35 "OPEN" 36 "LOAD_DUMP" 37 "STUCK_OPEN" 38 "STUCK_CLOSED" 39 "UNKNOWN_STATE" 40 "UNDERVOLTAGE" 41 "STUCK_ON" 42 "STUCK_OFF" 43 "ON" 44 "OFF" 45 "THR_INCOHERENCE" 46 "PDL_INCOHERENCE" 47 "POT_2_FAULT" 48 "QAIR_UNDER_ESTIM" 49 "QAIR_OVER_ESTIM" 50 "RSCOPEN_ERROR" 51 "RSCWAIT_ERROR" 52 "RSCCLOSE_ERROR" 53 "OSCCLOSE_ERROR" 54 "OSCOPEN_ERROR" 55 "DTC_ERROR" 56 "NLP_ERROR" 57 "UMA_ERROR" 58 "TEMP_PREWARNING" 59 "TEMP_WARNING" 60 "THR_LRN_ERROR" 61 "COMM_ERROR" 62 "MMP_ERROR" 63 "SMP_ERROR" 64 "EOBD_ERROR" 65 "ENERGY_ERROR" 66 "GAIN_ERROR" 67 "KO2_HPRAIL_ERROR" 68 "KO2_LPRAIL_ERROR" 69 "OFFS_ERROR" 70 "SWT_INCOHERENCE" 71 "MFLV_INCOHERENCE" 72 "SET_PLUS_FAULT" 73 "SET_MINUS_FAULT" 74 "OFF_FAULT" 75 "SET_FAULT" 76 "RESUME_FAULT" 77 "HOLD_FAULT" 78 "STOP_CABIN_TILT_FAULT" 79 "START_CABIN_TILT_FAULT" 80 "STUCK_CLOSED_OR_OPEN_LOAD" 81 "OVERCURR" 82 "CAM_NTEETH_INCOHERENCE" 83 "CAM_POS_INCOHERENCE" 84 "SERIAL_ERROR" 85 "CHIP_FAULT" 86 "SC_PHASES" 87 "NUMBER_OF_FAULT" 88 "ANY_FAULT" /end COMPU_VTAB
/begin COMPU_VTAB VTAB_FOR_Canal_Diagnosis100ms_CM_tFault_adm "Enumerated data type: tFault" TAB_VERB 89 0 "NO_FAULT" 1 "SIGNAL_TOO_LOW" 2 "SIGNAL_TOO_BIG" 3 "SC_TO_BATTERY" 4 "SC_TO_GND" 5 "SIGNAL_NOT_PLAUSIBLE" 6 "OC_OR_SC_TO_BATTERY" 7 "OC_OR_SC_TO_GND" 8 "OC" 9 "NO_SIGNAL" 10 "SIGNAL_DELAYED" 11 "TRASMISSION_IMPOSSIBLE" 12 "COMPONENT_DAMAGED" 13 "TEST_CONDITION_NOT_CORRECT" 14 "MECHANICAL_PROBLEM" 15 "GENERIC_FAULT" 16 "DERIVATIVE_TOO_HIGH" 17 "DERIVATIVE_TOO_LOW" 18 "CONTROL_ERROR" 19 "ALIM_KO" 20 "ADC_KO" 21 "CAN_OFF" 22 "AIRQCONTROL_ERROR" 23 "FBCONTROL_ERROR" 24 "RPCONTROL_ERROR" 25 "SAFETY_KO" 26 "SC_HS_LS" 27 "SC_TO_GND_HS" 28 "TPU_ERROR" 29 "OC_OR_SC_TO_GND_LS" 30 "SC_TO_BAT_LS" 31 "OVERTEMPERATURE" 32 "SC_TO_GND_LS" 33 "SC_TO_BAT_HS" 34 "CLOSED" 35 "OPEN" 36 "LOAD_DUMP" 37 "STUCK_OPEN" 38 "STUCK_CLOSED" 39 "UNKNOWN_STATE" 40 "UNDERVOLTAGE" 41 "STUCK_ON" 42 "STUCK_OFF" 43 "ON" 44 "OFF" 45 "THR_INCOHERENCE" 46 "PDL_INCOHERENCE" 47 "POT_2_FAULT" 48 "QAIR_UNDER_ESTIM" 49 "QAIR_OVER_ESTIM" 50 "RSCOPEN_ERROR" 51 "RSCWAIT_ERROR" 52 "RSCCLOSE_ERROR" 53 "OSCCLOSE_ERROR" 54 "OSCOPEN_ERROR" 55 "DTC_ERROR" 56 "NLP_ERROR" 57 "UMA_ERROR" 58 "TEMP_PREWARNING" 59 "TEMP_WARNING" 60 "THR_LRN_ERROR" 61 "COMM_ERROR" 62 "MMP_ERROR" 63 "SMP_ERROR" 64 "EOBD_ERROR" 65 "ENERGY_ERROR" 66 "GAIN_ERROR" 67 "KO2_HPRAIL_ERROR" 68 "KO2_LPRAIL_ERROR" 69 "OFFS_ERROR" 70 "SWT_INCOHERENCE" 71 "MFLV_INCOHERENCE" 72 "SET_PLUS_FAULT" 73 "SET_MINUS_FAULT" 74 "OFF_FAULT" 75 "SET_FAULT" 76 "RESUME_FAULT" 77 "HOLD_FAULT" 78 "STOP_CABIN_TILT_FAULT" 79 "START_CABIN_TILT_FAULT" 80 "STUCK_CLOSED_OR_OPEN_LOAD" 81 "OVERCURR" 82 "CAM_NTEETH_INCOHERENCE" 83 "CAM_POS_INCOHERENCE" 84 "SERIAL_ERROR" 85 "CHIP_FAULT" 86 "SC_PHASES" 87 "NUMBER_OF_FAULT" 88 "ANY_FAULT" /end COMPU_VTAB
/begin COMPU_VTAB VTAB_FOR_Ctit_LambdaHeater100ms_CM_tFault_adm "Enumerated data type: tFault" TAB_VERB 89 0 "NO_FAULT" 1 "SIGNAL_TOO_LOW" 2 "SIGNAL_TOO_BIG" 3 "SC_TO_BATTERY" 4 "SC_TO_GND" 5 "SIGNAL_NOT_PLAUSIBLE" 6 "OC_OR_SC_TO_BATTERY" 7 "OC_OR_SC_TO_GND" 8 "OC" 9 "NO_SIGNAL" 10 "SIGNAL_DELAYED" 11 "TRASMISSION_IMPOSSIBLE" 12 "COMPONENT_DAMAGED" 13 "TEST_CONDITION_NOT_CORRECT" 14 "MECHANICAL_PROBLEM" 15 "GENERIC_FAULT" 16 "DERIVATIVE_TOO_HIGH" 17 "DERIVATIVE_TOO_LOW" 18 "CONTROL_ERROR" 19 "ALIM_KO" 20 "ADC_KO" 21 "CAN_OFF" 22 "AIRQCONTROL_ERROR" 23 "FBCONTROL_ERROR" 24 "RPCONTROL_ERROR" 25 "SAFETY_KO" 26 "SC_HS_LS" 27 "SC_TO_GND_HS" 28 "TPU_ERROR" 29 "OC_OR_SC_TO_GND_LS" 30 "SC_TO_BAT_LS" 31 "OVERTEMPERATURE" 32 "SC_TO_GND_LS" 33 "SC_TO_BAT_HS" 34 "CLOSED" 35 "OPEN" 36 "LOAD_DUMP" 37 "STUCK_OPEN" 38 "STUCK_CLOSED" 39 "UNKNOWN_STATE" 40 "UNDERVOLTAGE" 41 "STUCK_ON" 42 "STUCK_OFF" 43 "ON" 44 "OFF" 45 "THR_INCOHERENCE" 46 "PDL_INCOHERENCE" 47 "POT_2_FAULT" 48 "QAIR_UNDER_ESTIM" 49 "QAIR_OVER_ESTIM" 50 "RSCOPEN_ERROR" 51 "RSCWAIT_ERROR" 52 "RSCCLOSE_ERROR" 53 "OSCCLOSE_ERROR" 54 "OSCOPEN_ERROR" 55 "DTC_ERROR" 56 "NLP_ERROR" 57 "UMA_ERROR" 58 "TEMP_PREWARNING" 59 "TEMP_WARNING" 60 "THR_LRN_ERROR" 61 "COMM_ERROR" 62 "MMP_ERROR" 63 "SMP_ERROR" 64 "EOBD_ERROR" 65 "ENERGY_ERROR" 66 "GAIN_ERROR" 67 "KO2_HPRAIL_ERROR" 68 "KO2_LPRAIL_ERROR" 69 "OFFS_ERROR" 70 "SWT_INCOHERENCE" 71 "MFLV_INCOHERENCE" 72 "SET_PLUS_FAULT" 73 "SET_MINUS_FAULT" 74 "OFF_FAULT" 75 "SET_FAULT" 76 "RESUME_FAULT" 77 "HOLD_FAULT" 78 "STOP_CABIN_TILT_FAULT" 79 "START_CABIN_TILT_FAULT" 80 "STUCK_CLOSED_OR_OPEN_LOAD" 81 "OVERCURR" 82 "CAM_NTEETH_INCOHERENCE" 83 "CAM_POS_INCOHERENCE" 84 "SERIAL_ERROR" 85 "CHIP_FAULT" 86 "SC_PHASES" 87 "NUMBER_OF_FAULT" 88 "ANY_FAULT" /end COMPU_VTAB
/begin COMPU_VTAB VTAB_FOR_Dcat_Diagnosis100ms_CM_tFault_adm "Enumerated data type: tFault" TAB_VERB 90 0 "NO_FAULT" 1 "SIGNAL_TOO_LOW" 2 "SIGNAL_TOO_BIG" 3 "SC_TO_BATTERY" 4 "SC_TO_GND" 5 "SIGNAL_NOT_PLAUSIBLE" 6 "OC_OR_SC_TO_BATTERY" 7 "OC_OR_SC_TO_GND" 8 "OC" 9 "NO_SIGNAL" 10 "SIGNAL_DELAYED" 11 "TRASMISSION_IMPOSSIBLE" 12 "COMPONENT_DAMAGED" 13 "TEST_CONDITION_NOT_CORRECT" 14 "MECHANICAL_PROBLEM" 15 "GENERIC_FAULT" 16 "DERIVATIVE_TOO_HIGH" 17 "DERIVATIVE_TOO_LOW" 18 "CONTROL_ERROR" 19 "ALIM_KO" 20 "ADC_KO" 21 "CAN_OFF" 22 "AIRQCONTROL_ERROR" 23 "FBCONTROL_ERROR" 24 "RPCONTROL_ERROR" 25 "SAFETY_KO" 26 "SC_HS_LS" 27 "SC_TO_GND_HS" 28 "TPU_ERROR" 29 "OC_OR_SC_TO_GND_LS" 30 "SC_TO_BAT_LS" 31 "OVERTEMPERATURE" 32 "SC_TO_GND_LS" 33 "SC_TO_BAT_HS" 34 "CLOSED" 35 "OPEN" 36 "LOAD_DUMP" 37 "STUCK_OPEN" 38 "STUCK_CLOSED" 39 "UNKNOWN_STATE" 40 "UNDERVOLTAGE" 41 "STUCK_ON" 42 "STUCK_OFF" 43 "ON" 44 "OFF" 45 "THR_INCOHERENCE" 46 "PDL_INCOHERENCE" 47 "POT_2_FAULT" 48 "QAIR_UNDER_ESTIM" 49 "QAIR_OVER_ESTIM" 50 "RSCOPEN_ERROR" 51 "RSCWAIT_ERROR" 52 "RSCCLOSE_ERROR" 53 "OSCCLOSE_ERROR" 54 "OSCOPEN_ERROR" 55 "DTC_ERROR" 56 "NLP_ERROR" 57 "UMA_ERROR" 58 "TEMP_PREWARNING" 59 "TEMP_WARNING" 60 "THR_LRN_ERROR" 61 "COMM_ERROR" 62 "MMP_ERROR" 63 "SMP_ERROR" 64 "EOBD_ERROR" 65 "ENERGY_ERROR" 66 "GAIN_ERROR" 67 "KO2_HPRAIL_ERROR" 68 "KO2_LPRAIL_ERROR" 69 "OFFS_ERROR" 70 "SWT_INCOHERENCE" 71 "MFLV_INCOHERENCE" 72 "SET_PLUS_FAULT" 73 "SET_MINUS_FAULT" 74 "OFF_FAULT" 75 "SET_FAULT" 76 "RESUME_FAULT" 77 "HOLD_FAULT" 78 "STOP_CABIN_TILT_FAULT" 79 "START_CABIN_TILT_FAULT" 80 "STUCK_CLOSED_OR_OPEN_LOAD" 81 "OVERCURR" 82 "CAM_NTEETH_INCOHERENCE" 83 "CAM_POS_INCOHERENCE" 84 "SERIAL_ERROR" 85 "CHIP_FAULT" 86 "SC_PHASES" 87 "STACK_ERROR" 88 "NUMBER_OF_FAULT" 89 "ANY_FAULT" /end COMPU_VTAB
/begin COMPU_VTAB VTAB_FOR_DiagLamTDC_CM_FixEnableT "Enumerated data type: FixEnableT" TAB_VERB 2 171 "Enable" 218 "Disable" /end COMPU_VTAB
/begin COMPU_VTAB VTAB_FOR_Digin4ms_CM_tFault_adm "Enumerated data type: tFault" TAB_VERB 90 0 "NO_FAULT" 1 "SIGNAL_TOO_LOW" 2 "SIGNAL_TOO_BIG" 3 "SC_TO_BATTERY" 4 "SC_TO_GND" 5 "SIGNAL_NOT_PLAUSIBLE" 6 "OC_OR_SC_TO_BATTERY" 7 "OC_OR_SC_TO_GND" 8 "OC" 9 "NO_SIGNAL" 10 "SIGNAL_DELAYED" 11 "TRASMISSION_IMPOSSIBLE" 12 "COMPONENT_DAMAGED" 13 "TEST_CONDITION_NOT_CORRECT" 14 "MECHANICAL_PROBLEM" 15 "GENERIC_FAULT" 16 "DERIVATIVE_TOO_HIGH" 17 "DERIVATIVE_TOO_LOW" 18 "CONTROL_ERROR" 19 "ALIM_KO" 20 "ADC_KO" 21 "CAN_OFF" 22 "AIRQCONTROL_ERROR" 23 "FBCONTROL_ERROR" 24 "RPCONTROL_ERROR" 25 "SAFETY_KO" 26 "SC_HS_LS" 27 "SC_TO_GND_HS" 28 "TPU_ERROR" 29 "OC_OR_SC_TO_GND_LS" 30 "SC_TO_BAT_LS" 31 "OVERTEMPERATURE" 32 "SC_TO_GND_LS" 33 "SC_TO_BAT_HS" 34 "CLOSED" 35 "OPEN" 36 "LOAD_DUMP" 37 "STUCK_OPEN" 38 "STUCK_CLOSED" 39 "UNKNOWN_STATE" 40 "UNDERVOLTAGE" 41 "STUCK_ON" 42 "STUCK_OFF" 43 "ON" 44 "OFF" 45 "THR_INCOHERENCE" 46 "PDL_INCOHERENCE" 47 "POT_2_FAULT" 48 "QAIR_UNDER_ESTIM" 49 "QAIR_OVER_ESTIM" 50 "RSCOPEN_ERROR" 51 "RSCWAIT_ERROR" 52 "RSCCLOSE_ERROR" 53 "OSCCLOSE_ERROR" 54 "OSCOPEN_ERROR" 55 "DTC_ERROR" 56 "NLP_ERROR" 57 "UMA_ERROR" 58 "TEMP_PREWARNING" 59 "TEMP_WARNING" 60 "THR_LRN_ERROR" 61 "COMM_ERROR" 62 "MMP_ERROR" 63 "SMP_ERROR" 64 "EOBD_ERROR" 65 "ENERGY_ERROR" 66 "GAIN_ERROR" 67 "KO2_HPRAIL_ERROR" 68 "KO2_LPRAIL_ERROR" 69 "OFFS_ERROR" 70 "SWT_INCOHERENCE" 71 "MFLV_INCOHERENCE" 72 "SET_PLUS_FAULT" 73 "SET_MINUS_FAULT" 74 "OFF_FAULT" 75 "SET_FAULT" 76 "RESUME_FAULT" 77 "HOLD_FAULT" 78 "STOP_CABIN_TILT_FAULT" 79 "START_CABIN_TILT_FAULT" 80 "STUCK_CLOSED_OR_OPEN_LOAD" 81 "OVERCURR" 82 "CAM_NTEETH_INCOHERENCE" 83 "CAM_POS_INCOHERENCE" 84 "SERIAL_ERROR" 85 "CHIP_FAULT" 86 "SC_PHASES" 87 "STACK_ERROR" 88 "NUMBER_OF_FAULT" 89 "ANY_FAULT" /end COMPU_VTAB
/begin COMPU_VTAB VTAB_FOR_Egbrk50ms_CM_tFault_adm "Enumerated data type: tFault" TAB_VERB 90 0 "NO_FAULT" 1 "SIGNAL_TOO_LOW" 2 "SIGNAL_TOO_BIG" 3 "SC_TO_BATTERY" 4 "SC_TO_GND" 5 "SIGNAL_NOT_PLAUSIBLE" 6 "OC_OR_SC_TO_BATTERY" 7 "OC_OR_SC_TO_GND" 8 "OC" 9 "NO_SIGNAL" 10 "SIGNAL_DELAYED" 11 "TRASMISSION_IMPOSSIBLE" 12 "COMPONENT_DAMAGED" 13 "TEST_CONDITION_NOT_CORRECT" 14 "MECHANICAL_PROBLEM" 15 "GENERIC_FAULT" 16 "DERIVATIVE_TOO_HIGH" 17 "DERIVATIVE_TOO_LOW" 18 "CONTROL_ERROR" 19 "ALIM_KO" 20 "ADC_KO" 21 "CAN_OFF" 22 "AIRQCONTROL_ERROR" 23 "FBCONTROL_ERROR" 24 "RPCONTROL_ERROR" 25 "SAFETY_KO" 26 "SC_HS_LS" 27 "SC_TO_GND_HS" 28 "TPU_ERROR" 29 "OC_OR_SC_TO_GND_LS" 30 "SC_TO_BAT_LS" 31 "OVERTEMPERATURE" 32 "SC_TO_GND_LS" 33 "SC_TO_BAT_HS" 34 "CLOSED" 35 "OPEN" 36 "LOAD_DUMP" 37 "STUCK_OPEN" 38 "STUCK_CLOSED" 39 "UNKNOWN_STATE" 40 "UNDERVOLTAGE" 41 "STUCK_ON" 42 "STUCK_OFF" 43 "ON" 44 "OFF" 45 "THR_INCOHERENCE" 46 "PDL_INCOHERENCE" 47 "POT_2_FAULT" 48 "QAIR_UNDER_ESTIM" 49 "QAIR_OVER_ESTIM" 50 "RSCOPEN_ERROR" 51 "RSCWAIT_ERROR" 52 "RSCCLOSE_ERROR" 53 "OSCCLOSE_ERROR" 54 "OSCOPEN_ERROR" 55 "DTC_ERROR" 56 "NLP_ERROR" 57 "UMA_ERROR" 58 "TEMP_PREWARNING" 59 "TEMP_WARNING" 60 "THR_LRN_ERROR" 61 "COMM_ERROR" 62 "MMP_ERROR" 63 "SMP_ERROR" 64 "EOBD_ERROR" 65 "ENERGY_ERROR" 66 "GAIN_ERROR" 67 "KO2_HPRAIL_ERROR" 68 "KO2_LPRAIL_ERROR" 69 "OFFS_ERROR" 70 "SWT_INCOHERENCE" 71 "MFLV_INCOHERENCE" 72 "SET_PLUS_FAULT" 73 "SET_MINUS_FAULT" 74 "OFF_FAULT" 75 "SET_FAULT" 76 "RESUME_FAULT" 77 "HOLD_FAULT" 78 "STOP_CABIN_TILT_FAULT" 79 "START_CABIN_TILT_FAULT" 80 "STUCK_CLOSED_OR_OPEN_LOAD" 81 "OVERCURR" 82 "CAM_NTEETH_INCOHERENCE" 83 "CAM_POS_INCOHERENCE" 84 "SERIAL_ERROR" 85 "CHIP_FAULT" 86 "SC_PHASES" 87 "STACK_ERROR" 88 "NUMBER_OF_FAULT" 89 "ANY_FAULT" /end COMPU_VTAB
/begin COMPU_VTAB VTAB_FOR_EgrMgm4ms_CM_tFault_adm "Enumerated data type: tFault" TAB_VERB 90 0 "NO_FAULT" 1 "SIGNAL_TOO_LOW" 2 "SIGNAL_TOO_BIG" 3 "SC_TO_BATTERY" 4 "SC_TO_GND" 5 "SIGNAL_NOT_PLAUSIBLE" 6 "OC_OR_SC_TO_BATTERY" 7 "OC_OR_SC_TO_GND" 8 "OC" 9 "NO_SIGNAL" 10 "SIGNAL_DELAYED" 11 "TRASMISSION_IMPOSSIBLE" 12 "COMPONENT_DAMAGED" 13 "TEST_CONDITION_NOT_CORRECT" 14 "MECHANICAL_PROBLEM" 15 "GENERIC_FAULT" 16 "DERIVATIVE_TOO_HIGH" 17 "DERIVATIVE_TOO_LOW" 18 "CONTROL_ERROR" 19 "ALIM_KO" 20 "ADC_KO" 21 "CAN_OFF" 22 "AIRQCONTROL_ERROR" 23 "FBCONTROL_ERROR" 24 "RPCONTROL_ERROR" 25 "SAFETY_KO" 26 "SC_HS_LS" 27 "SC_TO_GND_HS" 28 "TPU_ERROR" 29 "OC_OR_SC_TO_GND_LS" 30 "SC_TO_BAT_LS" 31 "OVERTEMPERATURE" 32 "SC_TO_GND_LS" 33 "SC_TO_BAT_HS" 34 "CLOSED" 35 "OPEN" 36 "LOAD_DUMP" 37 "STUCK_OPEN" 38 "STUCK_CLOSED" 39 "UNKNOWN_STATE" 40 "UNDERVOLTAGE" 41 "STUCK_ON" 42 "STUCK_OFF" 43 "ON" 44 "OFF" 45 "THR_INCOHERENCE" 46 "PDL_INCOHERENCE" 47 "POT_2_FAULT" 48 "QAIR_UNDER_ESTIM" 49 "QAIR_OVER_ESTIM" 50 "RSCOPEN_ERROR" 51 "RSCWAIT_ERROR" 52 "RSCCLOSE_ERROR" 53 "OSCCLOSE_ERROR" 54 "OSCOPEN_ERROR" 55 "DTC_ERROR" 56 "NLP_ERROR" 57 "UMA_ERROR" 58 "TEMP_PREWARNING" 59 "TEMP_WARNING" 60 "THR_LRN_ERROR" 61 "COMM_ERROR" 62 "MMP_ERROR" 63 "SMP_ERROR" 64 "EOBD_ERROR" 65 "ENERGY_ERROR" 66 "GAIN_ERROR" 67 "KO2_HPRAIL_ERROR" 68 "KO2_LPRAIL_ERROR" 69 "OFFS_ERROR" 70 "SWT_INCOHERENCE" 71 "MFLV_INCOHERENCE" 72 "SET_PLUS_FAULT" 73 "SET_MINUS_FAULT" 74 "OFF_FAULT" 75 "SET_FAULT" 76 "RESUME_FAULT" 77 "HOLD_FAULT" 78 "STOP_CABIN_TILT_FAULT" 79 "START_CABIN_TILT_FAULT" 80 "STUCK_CLOSED_OR_OPEN_LOAD" 81 "OVERCURR" 82 "CAM_NTEETH_INCOHERENCE" 83 "CAM_POS_INCOHERENCE" 84 "SERIAL_ERROR" 85 "CHIP_FAULT" 86 "SC_PHASES" 87 "STACK_ERROR" 88 "NUMBER_OF_FAULT" 89 "ANY_FAULT" /end COMPU_VTAB
/begin COMPU_VTAB VTAB_FOR_Egst4ms_CM_tDiagStat_adm "Enumerated data type: tDiagStat" TAB_VERB 4 0 "ENTRY" 1 "DURING" 2 "END" 39 "UNKNOWN_DIAGSTAT" /end COMPU_VTAB
/begin COMPU_VTAB VTAB_FOR_Egst4ms_CM_tFault_adm "Enumerated data type: tFault" TAB_VERB 89 0 "NO_FAULT" 1 "SIGNAL_TOO_LOW" 2 "SIGNAL_TOO_BIG" 3 "SC_TO_BATTERY" 4 "SC_TO_GND" 5 "SIGNAL_NOT_PLAUSIBLE" 6 "OC_OR_SC_TO_BATTERY" 7 "OC_OR_SC_TO_GND" 8 "OC" 9 "NO_SIGNAL" 10 "SIGNAL_DELAYED" 11 "TRASMISSION_IMPOSSIBLE" 12 "COMPONENT_DAMAGED" 13 "TEST_CONDITION_NOT_CORRECT" 14 "MECHANICAL_PROBLEM" 15 "GENERIC_FAULT" 16 "DERIVATIVE_TOO_HIGH" 17 "DERIVATIVE_TOO_LOW" 18 "CONTROL_ERROR" 19 "ALIM_KO" 20 "ADC_KO" 21 "CAN_OFF" 22 "AIRQCONTROL_ERROR" 23 "FBCONTROL_ERROR" 24 "RPCONTROL_ERROR" 25 "SAFETY_KO" 26 "SC_HS_LS" 27 "SC_TO_GND_HS" 28 "TPU_ERROR" 29 "OC_OR_SC_TO_GND_LS" 30 "SC_TO_BAT_LS" 31 "OVERTEMPERATURE" 32 "SC_TO_GND_LS" 33 "SC_TO_BAT_HS" 34 "CLOSED" 35 "OPEN" 36 "LOAD_DUMP" 37 "STUCK_OPEN" 38 "STUCK_CLOSED" 39 "UNKNOWN_STATE" 40 "UNDERVOLTAGE" 41 "STUCK_ON" 42 "STUCK_OFF" 43 "ON" 44 "OFF" 45 "THR_INCOHERENCE" 46 "PDL_INCOHERENCE" 47 "POT_2_FAULT" 48 "QAIR_UNDER_ESTIM" 49 "QAIR_OVER_ESTIM" 50 "RSCOPEN_ERROR" 51 "RSCWAIT_ERROR" 52 "RSCCLOSE_ERROR" 53 "OSCCLOSE_ERROR" 54 "OSCOPEN_ERROR" 55 "DTC_ERROR" 56 "NLP_ERROR" 57 "UMA_ERROR" 58 "TEMP_PREWARNING" 59 "TEMP_WARNING" 60 "THR_LRN_ERROR" 61 "COMM_ERROR" 62 "MMP_ERROR" 63 "SMP_ERROR" 64 "EOBD_ERROR" 65 "ENERGY_ERROR" 66 "GAIN_ERROR" 67 "KO2_HPRAIL_ERROR" 68 "KO2_LPRAIL_ERROR" 69 "OFFS_ERROR" 70 "SWT_INCOHERENCE" 71 "MFLV_INCOHERENCE" 72 "SET_PLUS_FAULT" 73 "SET_MINUS_FAULT" 74 "OFF_FAULT" 75 "SET_FAULT" 76 "RESUME_FAULT" 77 "HOLD_FAULT" 78 "STOP_CABIN_TILT_FAULT" 79 "START_CABIN_TILT_FAULT" 80 "STUCK_CLOSED_OR_OPEN_LOAD" 81 "OVERCURR" 82 "CAM_NTEETH_INCOHERENCE" 83 "CAM_POS_INCOHERENCE" 84 "SERIAL_ERROR" 85 "CHIP_FAULT" 86 "SC_PHASES" 87 "NUMBER_OF_FAULT" 88 "ANY_FAULT" /end COMPU_VTAB
/begin COMPU_VTAB VTAB_FOR_EnableDiagADAT2_4ms_CM_FixEnableT "Enumerated data type: FixEnableT" TAB_VERB 2 171 "Enable" 218 "Disable" /end COMPU_VTAB
/begin COMPU_VTAB VTAB_FOR_EprMgm4ms_CM_tFault_adm "Enumerated data type: tFault" TAB_VERB 89 0 "NO_FAULT" 1 "SIGNAL_TOO_LOW" 2 "SIGNAL_TOO_BIG" 3 "SC_TO_BATTERY" 4 "SC_TO_GND" 5 "SIGNAL_NOT_PLAUSIBLE" 6 "OC_OR_SC_TO_BATTERY" 7 "OC_OR_SC_TO_GND" 8 "OC" 9 "NO_SIGNAL" 10 "SIGNAL_DELAYED" 11 "TRASMISSION_IMPOSSIBLE" 12 "COMPONENT_DAMAGED" 13 "TEST_CONDITION_NOT_CORRECT" 14 "MECHANICAL_PROBLEM" 15 "GENERIC_FAULT" 16 "DERIVATIVE_TOO_HIGH" 17 "DERIVATIVE_TOO_LOW" 18 "CONTROL_ERROR" 19 "ALIM_KO" 20 "ADC_KO" 21 "CAN_OFF" 22 "AIRQCONTROL_ERROR" 23 "FBCONTROL_ERROR" 24 "RPCONTROL_ERROR" 25 "SAFETY_KO" 26 "SC_HS_LS" 27 "SC_TO_GND_HS" 28 "TPU_ERROR" 29 "OC_OR_SC_TO_GND_LS" 30 "SC_TO_BAT_LS" 31 "OVERTEMPERATURE" 32 "SC_TO_GND_LS" 33 "SC_TO_BAT_HS" 34 "CLOSED" 35 "OPEN" 36 "LOAD_DUMP" 37 "STUCK_OPEN" 38 "STUCK_CLOSED" 39 "UNKNOWN_STATE" 40 "UNDERVOLTAGE" 41 "STUCK_ON" 42 "STUCK_OFF" 43 "ON" 44 "OFF" 45 "THR_INCOHERENCE" 46 "PDL_INCOHERENCE" 47 "POT_2_FAULT" 48 "QAIR_UNDER_ESTIM" 49 "QAIR_OVER_ESTIM" 50 "RSCOPEN_ERROR" 51 "RSCWAIT_ERROR" 52 "RSCCLOSE_ERROR" 53 "OSCCLOSE_ERROR" 54 "OSCOPEN_ERROR" 55 "DTC_ERROR" 56 "NLP_ERROR" 57 "UMA_ERROR" 58 "TEMP_PREWARNING" 59 "TEMP_WARNING" 60 "THR_LRN_ERROR" 61 "COMM_ERROR" 62 "MMP_ERROR" 63 "SMP_ERROR" 64 "EOBD_ERROR" 65 "ENERGY_ERROR" 66 "GAIN_ERROR" 67 "KO2_HPRAIL_ERROR" 68 "KO2_LPRAIL_ERROR" 69 "OFFS_ERROR" 70 "SWT_INCOHERENCE" 71 "MFLV_INCOHERENCE" 72 "SET_PLUS_FAULT" 73 "SET_MINUS_FAULT" 74 "OFF_FAULT" 75 "SET_FAULT" 76 "RESUME_FAULT" 77 "HOLD_FAULT" 78 "STOP_CABIN_TILT_FAULT" 79 "START_CABIN_TILT_FAULT" 80 "STUCK_CLOSED_OR_OPEN_LOAD" 81 "OVERCURR" 82 "CAM_NTEETH_INCOHERENCE" 83 "CAM_POS_INCOHERENCE" 84 "SERIAL_ERROR" 85 "CHIP_FAULT" 86 "SC_PHASES" 87 "NUMBER_OF_FAULT" 88 "ANY_FAULT" /end COMPU_VTAB
/begin COMPU_VTAB VTAB_FOR_Ethrc4ms_CM_tKeyState_adm "Enumerated data type: tKeyState" TAB_VERB 2 0 "KEY_OFF" 1 "KEY_ON" /end COMPU_VTAB
/begin COMPU_VTAB VTAB_FOR_Ethrl4ms_CM_eEGST_adm "Enumerated data type: eEGST" TAB_VERB 8 0 "POWER_ON" 1 "WAIT" 2 "RUN" 3 "POWER_LATCH" 4 "POWER_OFF" 5 "SHUTDOWN" 6 "ACTDIAG_WAIT" 7 "SAFETY_CHECK" /end COMPU_VTAB
/begin COMPU_VTAB VTAB_FOR_Ethrl4ms_CM_tFault_adm "Enumerated data type: tFault" TAB_VERB 90 0 "NO_FAULT" 1 "SIGNAL_TOO_LOW" 2 "SIGNAL_TOO_BIG" 3 "SC_TO_BATTERY" 4 "SC_TO_GND" 5 "SIGNAL_NOT_PLAUSIBLE" 6 "OC_OR_SC_TO_BATTERY" 7 "OC_OR_SC_TO_GND" 8 "OC" 9 "NO_SIGNAL" 10 "SIGNAL_DELAYED" 11 "TRASMISSION_IMPOSSIBLE" 12 "COMPONENT_DAMAGED" 13 "TEST_CONDITION_NOT_CORRECT" 14 "MECHANICAL_PROBLEM" 15 "GENERIC_FAULT" 16 "DERIVATIVE_TOO_HIGH" 17 "DERIVATIVE_TOO_LOW" 18 "CONTROL_ERROR" 19 "ALIM_KO" 20 "ADC_KO" 21 "CAN_OFF" 22 "AIRQCONTROL_ERROR" 23 "FBCONTROL_ERROR" 24 "RPCONTROL_ERROR" 25 "SAFETY_KO" 26 "SC_HS_LS" 27 "SC_TO_GND_HS" 28 "TPU_ERROR" 29 "OC_OR_SC_TO_GND_LS" 30 "SC_TO_BAT_LS" 31 "OVERTEMPERATURE" 32 "SC_TO_GND_LS" 33 "SC_TO_BAT_HS" 34 "CLOSED" 35 "OPEN" 36 "LOAD_DUMP" 37 "STUCK_OPEN" 38 "STUCK_CLOSED" 39 "UNKNOWN_STATE" 40 "UNDERVOLTAGE" 41 "STUCK_ON" 42 "STUCK_OFF" 43 "ON" 44 "OFF" 45 "THR_INCOHERENCE" 46 "PDL_INCOHERENCE" 47 "POT_2_FAULT" 48 "QAIR_UNDER_ESTIM" 49 "QAIR_OVER_ESTIM" 50 "RSCOPEN_ERROR" 51 "RSCWAIT_ERROR" 52 "RSCCLOSE_ERROR" 53 "OSCCLOSE_ERROR" 54 "OSCOPEN_ERROR" 55 "DTC_ERROR" 56 "NLP_ERROR" 57 "UMA_ERROR" 58 "TEMP_PREWARNING" 59 "TEMP_WARNING" 60 "THR_LRN_ERROR" 61 "COMM_ERROR" 62 "MMP_ERROR" 63 "SMP_ERROR" 64 "EOBD_ERROR" 65 "ENERGY_ERROR" 66 "GAIN_ERROR" 67 "KO2_HPRAIL_ERROR" 68 "KO2_LPRAIL_ERROR" 69 "OFFS_ERROR" 70 "SWT_INCOHERENCE" 71 "MFLV_INCOHERENCE" 72 "SET_PLUS_FAULT" 73 "SET_MINUS_FAULT" 74 "OFF_FAULT" 75 "SET_FAULT" 76 "RESUME_FAULT" 77 "HOLD_FAULT" 78 "STOP_CABIN_TILT_FAULT" 79 "START_CABIN_TILT_FAULT" 80 "STUCK_CLOSED_OR_OPEN_LOAD" 81 "OVERCURR" 82 "CAM_NTEETH_INCOHERENCE" 83 "CAM_POS_INCOHERENCE" 84 "SERIAL_ERROR" 85 "CHIP_FAULT" 86 "SC_PHASES" 87 "STACK_ERROR" 88 "NUMBER_OF_FAULT" 89 "ANY_FAULT" /end COMPU_VTAB
/begin COMPU_VTAB VTAB_FOR_Ethrl4ms_CM_tKeyState_adm "Enumerated data type: tKeyState" TAB_VERB 2 0 "KEY_OFF" 1 "KEY_ON" /end COMPU_VTAB
/begin COMPU_VTAB VTAB_FOR_Evrc4ms_CM_eEGST_adm "Enumerated data type: eEGST" TAB_VERB 7 0 "POWER_ON" 1 "WAIT" 2 "RUN" 3 "POWER_LATCH" 4 "POWER_OFF" 5 "SHUTDOWN" 6 "ACTDIAG_WAIT" /end COMPU_VTAB
/begin COMPU_VTAB VTAB_FOR_Evrc4ms_CM_tActDiagStat_adm "Enumerated data type: tActDiagStat" TAB_VERB 5 0 "STOPPED_AD" 1 "DURING_AD" 2 "END_AD" 3 "IMPOSSIBLE_AD" 39 "UNKNOWN_AD" /end COMPU_VTAB
/begin COMPU_VTAB VTAB_FOR_Evrc4ms_CM_tDiagStat_adm "Enumerated data type: tDiagStat" TAB_VERB 4 0 "ENTRY" 1 "DURING" 2 "END" 39 "UNKNOWN_DIAGSTAT" /end COMPU_VTAB
/begin COMPU_VTAB VTAB_FOR_Evrc4ms_CM_tFault_adm "Enumerated data type: tFault" TAB_VERB 89 0 "NO_FAULT" 1 "SIGNAL_TOO_LOW" 2 "SIGNAL_TOO_BIG" 3 "SC_TO_BATTERY" 4 "SC_TO_GND" 5 "SIGNAL_NOT_PLAUSIBLE" 6 "OC_OR_SC_TO_BATTERY" 7 "OC_OR_SC_TO_GND" 8 "OC" 9 "NO_SIGNAL" 10 "SIGNAL_DELAYED" 11 "TRASMISSION_IMPOSSIBLE" 12 "COMPONENT_DAMAGED" 13 "TEST_CONDITION_NOT_CORRECT" 14 "MECHANICAL_PROBLEM" 15 "GENERIC_FAULT" 16 "DERIVATIVE_TOO_HIGH" 17 "DERIVATIVE_TOO_LOW" 18 "CONTROL_ERROR" 19 "ALIM_KO" 20 "ADC_KO" 21 "CAN_OFF" 22 "AIRQCONTROL_ERROR" 23 "FBCONTROL_ERROR" 24 "RPCONTROL_ERROR" 25 "SAFETY_KO" 26 "SC_HS_LS" 27 "SC_TO_GND_HS" 28 "TPU_ERROR" 29 "OC_OR_SC_TO_GND_LS" 30 "SC_TO_BAT_LS" 31 "OVERTEMPERATURE" 32 "SC_TO_GND_LS" 33 "SC_TO_BAT_HS" 34 "CLOSED" 35 "OPEN" 36 "LOAD_DUMP" 37 "STUCK_OPEN" 38 "STUCK_CLOSED" 39 "UNKNOWN_STATE" 40 "UNDERVOLTAGE" 41 "STUCK_ON" 42 "STUCK_OFF" 43 "ON" 44 "OFF" 45 "THR_INCOHERENCE" 46 "PDL_INCOHERENCE" 47 "POT_2_FAULT" 48 "QAIR_UNDER_ESTIM" 49 "QAIR_OVER_ESTIM" 50 "RSCOPEN_ERROR" 51 "RSCWAIT_ERROR" 52 "RSCCLOSE_ERROR" 53 "OSCCLOSE_ERROR" 54 "OSCOPEN_ERROR" 55 "DTC_ERROR" 56 "NLP_ERROR" 57 "UMA_ERROR" 58 "TEMP_PREWARNING" 59 "TEMP_WARNING" 60 "THR_LRN_ERROR" 61 "COMM_ERROR" 62 "MMP_ERROR" 63 "SMP_ERROR" 64 "EOBD_ERROR" 65 "ENERGY_ERROR" 66 "GAIN_ERROR" 67 "KO2_HPRAIL_ERROR" 68 "KO2_LPRAIL_ERROR" 69 "OFFS_ERROR" 70 "SWT_INCOHERENCE" 71 "MFLV_INCOHERENCE" 72 "SET_PLUS_FAULT" 73 "SET_MINUS_FAULT" 74 "OFF_FAULT" 75 "SET_FAULT" 76 "RESUME_FAULT" 77 "HOLD_FAULT" 78 "STOP_CABIN_TILT_FAULT" 79 "START_CABIN_TILT_FAULT" 80 "STUCK_CLOSED_OR_OPEN_LOAD" 81 "OVERCURR" 82 "CAM_NTEETH_INCOHERENCE" 83 "CAM_POS_INCOHERENCE" 84 "SERIAL_ERROR" 85 "CHIP_FAULT" 86 "SC_PHASES" 87 "NUMBER_OF_FAULT" 88 "ANY_FAULT" /end COMPU_VTAB
/begin COMPU_VTAB VTAB_FOR_Evrc4ms_CM_tKeyState_adm "Enumerated data type: tKeyState" TAB_VERB 2 0 "KEY_OFF" 1 "KEY_ON" /end COMPU_VTAB
/begin COMPU_VTAB VTAB_FOR_FanCool100ms_CM_eEGMD_adm "Enumerated data type: eEGMD" TAB_VERB 5 0 "NOT_DETERM" 1 "CRANK" 2 "IDLE" 3 "NORMAL" 4 "CUT_OFF" /end COMPU_VTAB
/begin COMPU_VTAB VTAB_FOR_FanCool100ms_CM_eEGST_adm "Enumerated data type: eEGST" TAB_VERB 8 0 "POWER_ON" 1 "WAIT" 2 "RUN" 3 "POWER_LATCH" 4 "POWER_OFF" 5 "SHUTDOWN" 6 "ACTDIAG_WAIT" 7 "SAFETY_CHECK" /end COMPU_VTAB
/begin COMPU_VTAB VTAB_FOR_FanCool100ms_CM_tFault_adm "Enumerated data type: tFault" TAB_VERB 89 0 "NO_FAULT" 1 "SIGNAL_TOO_LOW" 2 "SIGNAL_TOO_BIG" 3 "SC_TO_BATTERY" 4 "SC_TO_GND" 5 "SIGNAL_NOT_PLAUSIBLE" 6 "OC_OR_SC_TO_BATTERY" 7 "OC_OR_SC_TO_GND" 8 "OC" 9 "NO_SIGNAL" 10 "SIGNAL_DELAYED" 11 "TRASMISSION_IMPOSSIBLE" 12 "COMPONENT_DAMAGED" 13 "TEST_CONDITION_NOT_CORRECT" 14 "MECHANICAL_PROBLEM" 15 "GENERIC_FAULT" 16 "DERIVATIVE_TOO_HIGH" 17 "DERIVATIVE_TOO_LOW" 18 "CONTROL_ERROR" 19 "ALIM_KO" 20 "ADC_KO" 21 "CAN_OFF" 22 "AIRQCONTROL_ERROR" 23 "FBCONTROL_ERROR" 24 "RPCONTROL_ERROR" 25 "SAFETY_KO" 26 "SC_HS_LS" 27 "SC_TO_GND_HS" 28 "TPU_ERROR" 29 "OC_OR_SC_TO_GND_LS" 30 "SC_TO_BAT_LS" 31 "OVERTEMPERATURE" 32 "SC_TO_GND_LS" 33 "SC_TO_BAT_HS" 34 "CLOSED" 35 "OPEN" 36 "LOAD_DUMP" 37 "STUCK_OPEN" 38 "STUCK_CLOSED" 39 "UNKNOWN_STATE" 40 "UNDERVOLTAGE" 41 "STUCK_ON" 42 "STUCK_OFF" 43 "ON" 44 "OFF" 45 "THR_INCOHERENCE" 46 "PDL_INCOHERENCE" 47 "POT_2_FAULT" 48 "QAIR_UNDER_ESTIM" 49 "QAIR_OVER_ESTIM" 50 "RSCOPEN_ERROR" 51 "RSCWAIT_ERROR" 52 "RSCCLOSE_ERROR" 53 "OSCCLOSE_ERROR" 54 "OSCOPEN_ERROR" 55 "DTC_ERROR" 56 "NLP_ERROR" 57 "UMA_ERROR" 58 "TEMP_PREWARNING" 59 "TEMP_WARNING" 60 "THR_LRN_ERROR" 61 "COMM_ERROR" 62 "MMP_ERROR" 63 "SMP_ERROR" 64 "EOBD_ERROR" 65 "ENERGY_ERROR" 66 "GAIN_ERROR" 67 "KO2_HPRAIL_ERROR" 68 "KO2_LPRAIL_ERROR" 69 "OFFS_ERROR" 70 "SWT_INCOHERENCE" 71 "MFLV_INCOHERENCE" 72 "SET_PLUS_FAULT" 73 "SET_MINUS_FAULT" 74 "OFF_FAULT" 75 "SET_FAULT" 76 "RESUME_FAULT" 77 "HOLD_FAULT" 78 "STOP_CABIN_TILT_FAULT" 79 "START_CABIN_TILT_FAULT" 80 "STUCK_CLOSED_OR_OPEN_LOAD" 81 "OVERCURR" 82 "CAM_NTEETH_INCOHERENCE" 83 "CAM_POS_INCOHERENCE" 84 "SERIAL_ERROR" 85 "CHIP_FAULT" 86 "SC_PHASES" 87 "NUMBER_OF_FAULT" 88 "ANY_FAULT" /end COMPU_VTAB
/begin COMPU_VTAB VTAB_FOR_FaultChkADAT2_4ms_CM_FixEnableT "Enumerated data type: FixEnableT" TAB_VERB 2 171 "Enable" 218 "Disable" /end COMPU_VTAB
/begin COMPU_VTAB VTAB_FOR_FaultChkADAT2_4ms_CM_tFault_adm "Enumerated data type: tFault" TAB_VERB 89 0 "NO_FAULT" 1 "SIGNAL_TOO_LOW" 2 "SIGNAL_TOO_BIG" 3 "SC_TO_BATTERY" 4 "SC_TO_GND" 5 "SIGNAL_NOT_PLAUSIBLE" 6 "OC_OR_SC_TO_BATTERY" 7 "OC_OR_SC_TO_GND" 8 "OC" 9 "NO_SIGNAL" 10 "SIGNAL_DELAYED" 11 "TRASMISSION_IMPOSSIBLE" 12 "COMPONENT_DAMAGED" 13 "TEST_CONDITION_NOT_CORRECT" 14 "MECHANICAL_PROBLEM" 15 "GENERIC_FAULT" 16 "DERIVATIVE_TOO_HIGH" 17 "DERIVATIVE_TOO_LOW" 18 "CONTROL_ERROR" 19 "ALIM_KO" 20 "ADC_KO" 21 "CAN_OFF" 22 "AIRQCONTROL_ERROR" 23 "FBCONTROL_ERROR" 24 "RPCONTROL_ERROR" 25 "SAFETY_KO" 26 "SC_HS_LS" 27 "SC_TO_GND_HS" 28 "TPU_ERROR" 29 "OC_OR_SC_TO_GND_LS" 30 "SC_TO_BAT_LS" 31 "OVERTEMPERATURE" 32 "SC_TO_GND_LS" 33 "SC_TO_BAT_HS" 34 "CLOSED" 35 "OPEN" 36 "LOAD_DUMP" 37 "STUCK_OPEN" 38 "STUCK_CLOSED" 39 "UNKNOWN_STATE" 40 "UNDERVOLTAGE" 41 "STUCK_ON" 42 "STUCK_OFF" 43 "ON" 44 "OFF" 45 "THR_INCOHERENCE" 46 "PDL_INCOHERENCE" 47 "POT_2_FAULT" 48 "QAIR_UNDER_ESTIM" 49 "QAIR_OVER_ESTIM" 50 "RSCOPEN_ERROR" 51 "RSCWAIT_ERROR" 52 "RSCCLOSE_ERROR" 53 "OSCCLOSE_ERROR" 54 "OSCOPEN_ERROR" 55 "DTC_ERROR" 56 "NLP_ERROR" 57 "UMA_ERROR" 58 "TEMP_PREWARNING" 59 "TEMP_WARNING" 60 "THR_LRN_ERROR" 61 "COMM_ERROR" 62 "MMP_ERROR" 63 "SMP_ERROR" 64 "EOBD_ERROR" 65 "ENERGY_ERROR" 66 "GAIN_ERROR" 67 "KO2_HPRAIL_ERROR" 68 "KO2_LPRAIL_ERROR" 69 "OFFS_ERROR" 70 "SWT_INCOHERENCE" 71 "MFLV_INCOHERENCE" 72 "SET_PLUS_FAULT" 73 "SET_MINUS_FAULT" 74 "OFF_FAULT" 75 "SET_FAULT" 76 "RESUME_FAULT" 77 "HOLD_FAULT" 78 "STOP_CABIN_TILT_FAULT" 79 "START_CABIN_TILT_FAULT" 80 "STUCK_CLOSED_OR_OPEN_LOAD" 81 "OVERCURR" 82 "CAM_NTEETH_INCOHERENCE" 83 "CAM_POS_INCOHERENCE" 84 "SERIAL_ERROR" 85 "CHIP_FAULT" 86 "SC_PHASES" 87 "NUMBER_OF_FAULT" 88 "ANY_FAULT" /end COMPU_VTAB
/begin COMPU_VTAB VTAB_FOR_FaultChkADATTDC_CM_FixEnableT "Enumerated data type: FixEnableT" TAB_VERB 2 171 "Enable" 218 "Disable" /end COMPU_VTAB
/begin COMPU_VTAB VTAB_FOR_FaultChkADATTDC_CM_tFault_adm "Enumerated data type: tFault" TAB_VERB 90 0 "NO_FAULT" 1 "SIGNAL_TOO_LOW" 2 "SIGNAL_TOO_BIG" 3 "SC_TO_BATTERY" 4 "SC_TO_GND" 5 "SIGNAL_NOT_PLAUSIBLE" 6 "OC_OR_SC_TO_BATTERY" 7 "OC_OR_SC_TO_GND" 8 "OC" 9 "NO_SIGNAL" 10 "SIGNAL_DELAYED" 11 "TRASMISSION_IMPOSSIBLE" 12 "COMPONENT_DAMAGED" 13 "TEST_CONDITION_NOT_CORRECT" 14 "MECHANICAL_PROBLEM" 15 "GENERIC_FAULT" 16 "DERIVATIVE_TOO_HIGH" 17 "DERIVATIVE_TOO_LOW" 18 "CONTROL_ERROR" 19 "ALIM_KO" 20 "ADC_KO" 21 "CAN_OFF" 22 "AIRQCONTROL_ERROR" 23 "FBCONTROL_ERROR" 24 "RPCONTROL_ERROR" 25 "SAFETY_KO" 26 "SC_HS_LS" 27 "SC_TO_GND_HS" 28 "TPU_ERROR" 29 "OC_OR_SC_TO_GND_LS" 30 "SC_TO_BAT_LS" 31 "OVERTEMPERATURE" 32 "SC_TO_GND_LS" 33 "SC_TO_BAT_HS" 34 "CLOSED" 35 "OPEN" 36 "LOAD_DUMP" 37 "STUCK_OPEN" 38 "STUCK_CLOSED" 39 "UNKNOWN_STATE" 40 "UNDERVOLTAGE" 41 "STUCK_ON" 42 "STUCK_OFF" 43 "ON" 44 "OFF" 45 "THR_INCOHERENCE" 46 "PDL_INCOHERENCE" 47 "POT_2_FAULT" 48 "QAIR_UNDER_ESTIM" 49 "QAIR_OVER_ESTIM" 50 "RSCOPEN_ERROR" 51 "RSCWAIT_ERROR" 52 "RSCCLOSE_ERROR" 53 "OSCCLOSE_ERROR" 54 "OSCOPEN_ERROR" 55 "DTC_ERROR" 56 "NLP_ERROR" 57 "UMA_ERROR" 58 "TEMP_PREWARNING" 59 "TEMP_WARNING" 60 "THR_LRN_ERROR" 61 "COMM_ERROR" 62 "MMP_ERROR" 63 "SMP_ERROR" 64 "EOBD_ERROR" 65 "ENERGY_ERROR" 66 "GAIN_ERROR" 67 "KO2_HPRAIL_ERROR" 68 "KO2_LPRAIL_ERROR" 69 "OFFS_ERROR" 70 "SWT_INCOHERENCE" 71 "MFLV_INCOHERENCE" 72 "SET_PLUS_FAULT" 73 "SET_MINUS_FAULT" 74 "OFF_FAULT" 75 "SET_FAULT" 76 "RESUME_FAULT" 77 "HOLD_FAULT" 78 "STOP_CABIN_TILT_FAULT" 79 "START_CABIN_TILT_FAULT" 80 "STUCK_CLOSED_OR_OPEN_LOAD" 81 "OVERCURR" 82 "CAM_NTEETH_INCOHERENCE" 83 "CAM_POS_INCOHERENCE" 84 "SERIAL_ERROR" 85 "CHIP_FAULT" 86 "SC_PHASES" 87 "STACK_ERROR" 88 "NUMBER_OF_FAULT" 89 "ANY_FAULT" /end COMPU_VTAB
/begin COMPU_VTAB VTAB_FOR_FaultChkKSPxTDC_CM_FixEnableT "Enumerated data type: FixEnableT" TAB_VERB 2 171 "Enable" 218 "Disable" /end COMPU_VTAB
/begin COMPU_VTAB VTAB_FOR_FaultChkPO2L100ms_Symbol_CM_FixEnableT "Enumerated data type: FixEnableT" TAB_VERB 2 171 "Enable" 218 "Disable" /end COMPU_VTAB
/begin COMPU_VTAB VTAB_FOR_Fuels_CtrlMgmtTDC_CM_eEGMD_adm "Enumerated data type: eEGMD" TAB_VERB 5 0 "NOT_DETERM" 1 "CRANK" 2 "IDLE" 3 "NORMAL" 4 "CUT_OFF" /end COMPU_VTAB
/begin COMPU_VTAB VTAB_FOR_Fuels_CtrlMgmtTDC_CM_tFault_adm "Enumerated data type: tFault" TAB_VERB 82 0 "NO_FAULT" 1 "SIGNAL_TOO_LOW" 2 "SIGNAL_TOO_BIG" 3 "SC_TO_BATTERY" 4 "SC_TO_GND" 5 "SIGNAL_NOT_PLAUSIBLE" 6 "OC_OR_SC_TO_BATTERY" 7 "OC_OR_SC_TO_GND" 8 "OC" 9 "NO_SIGNAL" 10 "SIGNAL_DELAYED" 11 "TRASMISSION_IMPOSSIBLE" 12 "COMPONENT_DAMAGED" 13 "CONDITION_NOT_CORRECT" 14 "MECHANICAL_PROBLEM" 15 "GENERIC_FAULT" 16 "DERIVATIVE_TOO_HIGH" 17 "DERIVATIVE_TOO_LOW" 18 "CONTROL_ERROR" 19 "ALIM_KO" 20 "ADC_KO" 21 "CAN_OFF" 22 "AIRQCONTROL_ERROR" 23 "FBCONTROL_ERROR" 24 "RPCONTROL_ERROR" 25 "SAFETY_KO" 26 "SC_HS_LS" 27 "SC_TO_GND_HS" 28 "TPU_ERROR" 29 "OC_OR_SC_TO_GND_LS" 30 "SC_TO_BAT_LS" 31 "OVER_TEMPERATURE" 32 "SC_TO_GND_LS" 33 "SC_TO_BAT_HS" 34 "CLOSED" 35 "OPEN" 36 "LOAD_DUMP" 37 "STUCK_OPEN" 38 "STUCK_CLOSED" 39 "UNKNOWN_STATE" 40 "UNDERVOLTAGE" 41 "STUCK_ON" 42 "STUCK_OFF" 43 "ON" 44 "OFF" 45 "THR_INCOHERENCE" 46 "PDL_INCOHERENCE" 47 "POT_2_FAULT" 48 "QAIR_UNDER_ESTIM" 49 "QAIR_OVER_ESTIM" 50 "RSCOPEN_ERROR" 51 "RSCWAIT_ERROR" 52 "RSCCLOSE_ERROR" 53 "OSCCLOSE_ERROR" 54 "OSCOPEN_ERROR" 55 "DTC_ERROR" 56 "NLP_ERROR" 57 "UMA_ERROR" 58 "TEMP_PREWARNING" 59 "TEMP_WARNING" 60 "THR_LRN_ERROR" 61 "COMM_ERROR" 62 "MMP_ERROR" 63 "SMP_ERROR" 64 "EOBD_ERROR" 65 "ENERGY_ERROR" 66 "GAIN_ERROR" 67 "KO2_HPRAIL_ERROR" 68 "KO2_LPRAIL_ERROR" 69 "OFFS_ERROR" 70 "SWT_INCOHERENCE" 71 "MFLV_INCOHERENCE" 72 "SET_PLUS_FAULT" 73 "SET_MINUS_FAULT" 74 "OFF_FAULT" 75 "SET_FAULT" 76 "RESUME_FAULT" 77 "HOLD_FAULT" 78 "STOP_CABIN_TILT_FAULT" 79 "START_CABIN_TILT_FAULT" 80 "NUMBER_OF_FAULT" 81 "ANY_FAULT" /end COMPU_VTAB
/begin COMPU_VTAB VTAB_FOR_IgntTDC_CM_tFault_adm "Enumerated data type: tFault" TAB_VERB 90 0 "NO_FAULT" 1 "SIGNAL_TOO_LOW" 2 "SIGNAL_TOO_BIG" 3 "SC_TO_BATTERY" 4 "SC_TO_GND" 5 "SIGNAL_NOT_PLAUSIBLE" 6 "OC_OR_SC_TO_BATTERY" 7 "OC_OR_SC_TO_GND" 8 "OC" 9 "NO_SIGNAL" 10 "SIGNAL_DELAYED" 11 "TRASMISSION_IMPOSSIBLE" 12 "COMPONENT_DAMAGED" 13 "TEST_CONDITION_NOT_CORRECT" 14 "MECHANICAL_PROBLEM" 15 "GENERIC_FAULT" 16 "DERIVATIVE_TOO_HIGH" 17 "DERIVATIVE_TOO_LOW" 18 "CONTROL_ERROR" 19 "ALIM_KO" 20 "ADC_KO" 21 "CAN_OFF" 22 "AIRQCONTROL_ERROR" 23 "FBCONTROL_ERROR" 24 "RPCONTROL_ERROR" 25 "SAFETY_KO" 26 "SC_HS_LS" 27 "SC_TO_GND_HS" 28 "TPU_ERROR" 29 "OC_OR_SC_TO_GND_LS" 30 "SC_TO_BAT_LS" 31 "OVERTEMPERATURE" 32 "SC_TO_GND_LS" 33 "SC_TO_BAT_HS" 34 "CLOSED" 35 "OPEN" 36 "LOAD_DUMP" 37 "STUCK_OPEN" 38 "STUCK_CLOSED" 39 "UNKNOWN_STATE" 40 "UNDERVOLTAGE" 41 "STUCK_ON" 42 "STUCK_OFF" 43 "ON" 44 "OFF" 45 "THR_INCOHERENCE" 46 "PDL_INCOHERENCE" 47 "POT_2_FAULT" 48 "QAIR_UNDER_ESTIM" 49 "QAIR_OVER_ESTIM" 50 "RSCOPEN_ERROR" 51 "RSCWAIT_ERROR" 52 "RSCCLOSE_ERROR" 53 "OSCCLOSE_ERROR" 54 "OSCOPEN_ERROR" 55 "DTC_ERROR" 56 "NLP_ERROR" 57 "UMA_ERROR" 58 "TEMP_PREWARNING" 59 "TEMP_WARNING" 60 "THR_LRN_ERROR" 61 "COMM_ERROR" 62 "MMP_ERROR" 63 "SMP_ERROR" 64 "EOBD_ERROR" 65 "ENERGY_ERROR" 66 "GAIN_ERROR" 67 "KO2_HPRAIL_ERROR" 68 "KO2_LPRAIL_ERROR" 69 "OFFS_ERROR" 70 "SWT_INCOHERENCE" 71 "MFLV_INCOHERENCE" 72 "SET_PLUS_FAULT" 73 "SET_MINUS_FAULT" 74 "OFF_FAULT" 75 "SET_FAULT" 76 "RESUME_FAULT" 77 "HOLD_FAULT" 78 "STOP_CABIN_TILT_FAULT" 79 "START_CABIN_TILT_FAULT" 80 "STUCK_CLOSED_OR_OPEN_LOAD" 81 "OVERCURR" 82 "CAM_NTEETH_INCOHERENCE" 83 "CAM_POS_INCOHERENCE" 84 "SERIAL_ERROR" 85 "CHIP_FAULT" 86 "SC_PHASES" 87 "STACK_ERROR" 88 "NUMBER_OF_FAULT" 89 "ANY_FAULT" /end COMPU_VTAB
/begin COMPU_VTAB VTAB_FOR_InjtTDC_CM_tErrState_adm "Enumerated data type: tErrState" TAB_VERB 9 0 "NO_ERROR" 1 "FILTERING" 2 "VALIDATING" 4 "CONFIRMED" 8 "CONFIRMED_OLD" 16 "DEBOUNCING" 32 "DEVALIDATED" 64 "REFILTERING" 128 "REVALIDATING" /end COMPU_VTAB
/begin COMPU_VTAB VTAB_FOR_InjtTDC_CM_tFault_adm "Enumerated data type: tFault" TAB_VERB 90 0 "NO_FAULT" 1 "SIGNAL_TOO_LOW" 2 "SIGNAL_TOO_BIG" 3 "SC_TO_BATTERY" 4 "SC_TO_GND" 5 "SIGNAL_NOT_PLAUSIBLE" 6 "OC_OR_SC_TO_BATTERY" 7 "OC_OR_SC_TO_GND" 8 "OC" 9 "NO_SIGNAL" 10 "SIGNAL_DELAYED" 11 "TRASMISSION_IMPOSSIBLE" 12 "COMPONENT_DAMAGED" 13 "TEST_CONDITION_NOT_CORRECT" 14 "MECHANICAL_PROBLEM" 15 "GENERIC_FAULT" 16 "DERIVATIVE_TOO_HIGH" 17 "DERIVATIVE_TOO_LOW" 18 "CONTROL_ERROR" 19 "ALIM_KO" 20 "ADC_KO" 21 "CAN_OFF" 22 "AIRQCONTROL_ERROR" 23 "FBCONTROL_ERROR" 24 "RPCONTROL_ERROR" 25 "SAFETY_KO" 26 "SC_HS_LS" 27 "SC_TO_GND_HS" 28 "TPU_ERROR" 29 "OC_OR_SC_TO_GND_LS" 30 "SC_TO_BAT_LS" 31 "OVERTEMPERATURE" 32 "SC_TO_GND_LS" 33 "SC_TO_BAT_HS" 34 "CLOSED" 35 "OPEN" 36 "LOAD_DUMP" 37 "STUCK_OPEN" 38 "STUCK_CLOSED" 39 "UNKNOWN_STATE" 40 "UNDERVOLTAGE" 41 "STUCK_ON" 42 "STUCK_OFF" 43 "ON" 44 "OFF" 45 "THR_INCOHERENCE" 46 "PDL_INCOHERENCE" 47 "POT_2_FAULT" 48 "QAIR_UNDER_ESTIM" 49 "QAIR_OVER_ESTIM" 50 "RSCOPEN_ERROR" 51 "RSCWAIT_ERROR" 52 "RSCCLOSE_ERROR" 53 "OSCCLOSE_ERROR" 54 "OSCOPEN_ERROR" 55 "DTC_ERROR" 56 "NLP_ERROR" 57 "UMA_ERROR" 58 "TEMP_PREWARNING" 59 "TEMP_WARNING" 60 "THR_LRN_ERROR" 61 "COMM_ERROR" 62 "MMP_ERROR" 63 "SMP_ERROR" 64 "EOBD_ERROR" 65 "ENERGY_ERROR" 66 "GAIN_ERROR" 67 "KO2_HPRAIL_ERROR" 68 "KO2_LPRAIL_ERROR" 69 "OFFS_ERROR" 70 "SWT_INCOHERENCE" 71 "MFLV_INCOHERENCE" 72 "SET_PLUS_FAULT" 73 "SET_MINUS_FAULT" 74 "OFF_FAULT" 75 "SET_FAULT" 76 "RESUME_FAULT" 77 "HOLD_FAULT" 78 "STOP_CABIN_TILT_FAULT" 79 "START_CABIN_TILT_FAULT" 80 "STUCK_CLOSED_OR_OPEN_LOAD" 81 "OVERCURR" 82 "CAM_NTEETH_INCOHERENCE" 83 "CAM_POS_INCOHERENCE" 84 "SERIAL_ERROR" 85 "CHIP_FAULT" 86 "SC_PHASES" 87 "STACK_ERROR" 88 "NUMBER_OF_FAULT" 89 "ANY_FAULT" /end COMPU_VTAB
/begin COMPU_VTAB VTAB_FOR_KnockTDC_CM_tFault_adm "Enumerated data type: tFault" TAB_VERB 90 0 "NO_FAULT" 1 "SIGNAL_TOO_LOW" 2 "SIGNAL_TOO_BIG" 3 "SC_TO_BATTERY" 4 "SC_TO_GND" 5 "SIGNAL_NOT_PLAUSIBLE" 6 "OC_OR_SC_TO_BATTERY" 7 "OC_OR_SC_TO_GND" 8 "OC" 9 "NO_SIGNAL" 10 "SIGNAL_DELAYED" 11 "TRASMISSION_IMPOSSIBLE" 12 "COMPONENT_DAMAGED" 13 "TEST_CONDITION_NOT_CORRECT" 14 "MECHANICAL_PROBLEM" 15 "GENERIC_FAULT" 16 "DERIVATIVE_TOO_HIGH" 17 "DERIVATIVE_TOO_LOW" 18 "CONTROL_ERROR" 19 "ALIM_KO" 20 "ADC_KO" 21 "CAN_OFF" 22 "AIRQCONTROL_ERROR" 23 "FBCONTROL_ERROR" 24 "RPCONTROL_ERROR" 25 "SAFETY_KO" 26 "SC_HS_LS" 27 "SC_TO_GND_HS" 28 "TPU_ERROR" 29 "OC_OR_SC_TO_GND_LS" 30 "SC_TO_BAT_LS" 31 "OVERTEMPERATURE" 32 "SC_TO_GND_LS" 33 "SC_TO_BAT_HS" 34 "CLOSED" 35 "OPEN" 36 "LOAD_DUMP" 37 "STUCK_OPEN" 38 "STUCK_CLOSED" 39 "UNKNOWN_STATE" 40 "UNDERVOLTAGE" 41 "STUCK_ON" 42 "STUCK_OFF" 43 "ON" 44 "OFF" 45 "THR_INCOHERENCE" 46 "PDL_INCOHERENCE" 47 "POT_2_FAULT" 48 "QAIR_UNDER_ESTIM" 49 "QAIR_OVER_ESTIM" 50 "RSCOPEN_ERROR" 51 "RSCWAIT_ERROR" 52 "RSCCLOSE_ERROR" 53 "OSCCLOSE_ERROR" 54 "OSCOPEN_ERROR" 55 "DTC_ERROR" 56 "NLP_ERROR" 57 "UMA_ERROR" 58 "TEMP_PREWARNING" 59 "TEMP_WARNING" 60 "THR_LRN_ERROR" 61 "COMM_ERROR" 62 "MMP_ERROR" 63 "SMP_ERROR" 64 "EOBD_ERROR" 65 "ENERGY_ERROR" 66 "GAIN_ERROR" 67 "KO2_HPRAIL_ERROR" 68 "KO2_LPRAIL_ERROR" 69 "OFFS_ERROR" 70 "SWT_INCOHERENCE" 71 "MFLV_INCOHERENCE" 72 "SET_PLUS_FAULT" 73 "SET_MINUS_FAULT" 74 "OFF_FAULT" 75 "SET_FAULT" 76 "RESUME_FAULT" 77 "HOLD_FAULT" 78 "STOP_CABIN_TILT_FAULT" 79 "START_CABIN_TILT_FAULT" 80 "STUCK_CLOSED_OR_OPEN_LOAD" 81 "OVERCURR" 82 "CAM_NTEETH_INCOHERENCE" 83 "CAM_POS_INCOHERENCE" 84 "SERIAL_ERROR" 85 "CHIP_FAULT" 86 "SC_PHASES" 87 "STACK_ERROR" 88 "NUMBER_OF_FAULT" 89 "ANY_FAULT" /end COMPU_VTAB
/begin COMPU_VTAB VTAB_FOR_Lamp100ms_CM_tFault_adm "Enumerated data type: tFault" TAB_VERB 89 0 "NO_FAULT" 1 "SIGNAL_TOO_LOW" 2 "SIGNAL_TOO_BIG" 3 "SC_TO_BATTERY" 4 "SC_TO_GND" 5 "SIGNAL_NOT_PLAUSIBLE" 6 "OC_OR_SC_TO_BATTERY" 7 "OC_OR_SC_TO_GND" 8 "OC" 9 "NO_SIGNAL" 10 "SIGNAL_DELAYED" 11 "TRASMISSION_IMPOSSIBLE" 12 "COMPONENT_DAMAGED" 13 "TEST_CONDITION_NOT_CORRECT" 14 "MECHANICAL_PROBLEM" 15 "GENERIC_FAULT" 16 "DERIVATIVE_TOO_HIGH" 17 "DERIVATIVE_TOO_LOW" 18 "CONTROL_ERROR" 19 "ALIM_KO" 20 "ADC_KO" 21 "CAN_OFF" 22 "AIRQCONTROL_ERROR" 23 "FBCONTROL_ERROR" 24 "RPCONTROL_ERROR" 25 "SAFETY_KO" 26 "SC_HS_LS" 27 "SC_TO_GND_HS" 28 "TPU_ERROR" 29 "OC_OR_SC_TO_GND_LS" 30 "SC_TO_BAT_LS" 31 "OVERTEMPERATURE" 32 "SC_TO_GND_LS" 33 "SC_TO_BAT_HS" 34 "CLOSED" 35 "OPEN" 36 "LOAD_DUMP" 37 "STUCK_OPEN" 38 "STUCK_CLOSED" 39 "UNKNOWN_STATE" 40 "UNDERVOLTAGE" 41 "STUCK_ON" 42 "STUCK_OFF" 43 "ON" 44 "OFF" 45 "THR_INCOHERENCE" 46 "PDL_INCOHERENCE" 47 "POT_2_FAULT" 48 "QAIR_UNDER_ESTIM" 49 "QAIR_OVER_ESTIM" 50 "RSCOPEN_ERROR" 51 "RSCWAIT_ERROR" 52 "RSCCLOSE_ERROR" 53 "OSCCLOSE_ERROR" 54 "OSCOPEN_ERROR" 55 "DTC_ERROR" 56 "NLP_ERROR" 57 "UMA_ERROR" 58 "TEMP_PREWARNING" 59 "TEMP_WARNING" 60 "THR_LRN_ERROR" 61 "COMM_ERROR" 62 "MMP_ERROR" 63 "SMP_ERROR" 64 "EOBD_ERROR" 65 "ENERGY_ERROR" 66 "GAIN_ERROR" 67 "KO2_HPRAIL_ERROR" 68 "KO2_LPRAIL_ERROR" 69 "OFFS_ERROR" 70 "SWT_INCOHERENCE" 71 "MFLV_INCOHERENCE" 72 "SET_PLUS_FAULT" 73 "SET_MINUS_FAULT" 74 "OFF_FAULT" 75 "SET_FAULT" 76 "RESUME_FAULT" 77 "HOLD_FAULT" 78 "STOP_CABIN_TILT_FAULT" 79 "START_CABIN_TILT_FAULT" 80 "STUCK_CLOSED_OR_OPEN_LOAD" 81 "OVERCURR" 82 "CAM_NTEETH_INCOHERENCE" 83 "CAM_POS_INCOHERENCE" 84 "SERIAL_ERROR" 85 "CHIP_FAULT" 86 "SC_PHASES" 87 "NUMBER_OF_FAULT" 88 "ANY_FAULT" /end COMPU_VTAB
/begin COMPU_VTAB VTAB_FOR_MisfdTDC_CM_tFault_adm "Enumerated data type: tFault" TAB_VERB 90 0 "NO_FAULT" 1 "SIGNAL_TOO_LOW" 2 "SIGNAL_TOO_BIG" 3 "SC_TO_BATTERY" 4 "SC_TO_GND" 5 "SIGNAL_NOT_PLAUSIBLE" 6 "OC_OR_SC_TO_BATTERY" 7 "OC_OR_SC_TO_GND" 8 "OC" 9 "NO_SIGNAL" 10 "SIGNAL_DELAYED" 11 "TRASMISSION_IMPOSSIBLE" 12 "COMPONENT_DAMAGED" 13 "TEST_CONDITION_NOT_CORRECT" 14 "MECHANICAL_PROBLEM" 15 "GENERIC_FAULT" 16 "DERIVATIVE_TOO_HIGH" 17 "DERIVATIVE_TOO_LOW" 18 "CONTROL_ERROR" 19 "ALIM_KO" 20 "ADC_KO" 21 "CAN_OFF" 22 "AIRQCONTROL_ERROR" 23 "FBCONTROL_ERROR" 24 "RPCONTROL_ERROR" 25 "SAFETY_KO" 26 "SC_HS_LS" 27 "SC_TO_GND_HS" 28 "TPU_ERROR" 29 "OC_OR_SC_TO_GND_LS" 30 "SC_TO_BAT_LS" 31 "OVERTEMPERATURE" 32 "SC_TO_GND_LS" 33 "SC_TO_BAT_HS" 34 "CLOSED" 35 "OPEN" 36 "LOAD_DUMP" 37 "STUCK_OPEN" 38 "STUCK_CLOSED" 39 "UNKNOWN_STATE" 40 "UNDERVOLTAGE" 41 "STUCK_ON" 42 "STUCK_OFF" 43 "ON" 44 "OFF" 45 "THR_INCOHERENCE" 46 "PDL_INCOHERENCE" 47 "POT_2_FAULT" 48 "QAIR_UNDER_ESTIM" 49 "QAIR_OVER_ESTIM" 50 "RSCOPEN_ERROR" 51 "RSCWAIT_ERROR" 52 "RSCCLOSE_ERROR" 53 "OSCCLOSE_ERROR" 54 "OSCOPEN_ERROR" 55 "DTC_ERROR" 56 "NLP_ERROR" 57 "UMA_ERROR" 58 "TEMP_PREWARNING" 59 "TEMP_WARNING" 60 "THR_LRN_ERROR" 61 "COMM_ERROR" 62 "MMP_ERROR" 63 "SMP_ERROR" 64 "EOBD_ERROR" 65 "ENERGY_ERROR" 66 "GAIN_ERROR" 67 "KO2_HPRAIL_ERROR" 68 "KO2_LPRAIL_ERROR" 69 "OFFS_ERROR" 70 "SWT_INCOHERENCE" 71 "MFLV_INCOHERENCE" 72 "SET_PLUS_FAULT" 73 "SET_MINUS_FAULT" 74 "OFF_FAULT" 75 "SET_FAULT" 76 "RESUME_FAULT" 77 "HOLD_FAULT" 78 "STOP_CABIN_TILT_FAULT" 79 "START_CABIN_TILT_FAULT" 80 "STUCK_CLOSED_OR_OPEN_LOAD" 81 "OVERCURR" 82 "CAM_NTEETH_INCOHERENCE" 83 "CAM_POS_INCOHERENCE" 84 "SERIAL_ERROR" 85 "CHIP_FAULT" 86 "SC_PHASES" 87 "STACK_ERROR" 88 "NUMBER_OF_FAULT" 89 "ANY_FAULT" /end COMPU_VTAB
/begin COMPU_VTAB VTAB_FOR_Oilp100ms_CM_tFault_adm "Enumerated data type: tFault" TAB_VERB 89 0 "NO_FAULT" 1 "SIGNAL_TOO_LOW" 2 "SIGNAL_TOO_BIG" 3 "SC_TO_BATTERY" 4 "SC_TO_GND" 5 "SIGNAL_NOT_PLAUSIBLE" 6 "OC_OR_SC_TO_BATTERY" 7 "OC_OR_SC_TO_GND" 8 "OC" 9 "NO_SIGNAL" 10 "SIGNAL_DELAYED" 11 "TRASMISSION_IMPOSSIBLE" 12 "COMPONENT_DAMAGED" 13 "TEST_CONDITION_NOT_CORRECT" 14 "MECHANICAL_PROBLEM" 15 "GENERIC_FAULT" 16 "DERIVATIVE_TOO_HIGH" 17 "DERIVATIVE_TOO_LOW" 18 "CONTROL_ERROR" 19 "ALIM_KO" 20 "ADC_KO" 21 "CAN_OFF" 22 "AIRQCONTROL_ERROR" 23 "FBCONTROL_ERROR" 24 "RPCONTROL_ERROR" 25 "SAFETY_KO" 26 "SC_HS_LS" 27 "SC_TO_GND_HS" 28 "TPU_ERROR" 29 "OC_OR_SC_TO_GND_LS" 30 "SC_TO_BAT_LS" 31 "OVERTEMPERATURE" 32 "SC_TO_GND_LS" 33 "SC_TO_BAT_HS" 34 "CLOSED" 35 "OPEN" 36 "LOAD_DUMP" 37 "STUCK_OPEN" 38 "STUCK_CLOSED" 39 "UNKNOWN_STATE" 40 "UNDERVOLTAGE" 41 "STUCK_ON" 42 "STUCK_OFF" 43 "ON" 44 "OFF" 45 "THR_INCOHERENCE" 46 "PDL_INCOHERENCE" 47 "POT_2_FAULT" 48 "QAIR_UNDER_ESTIM" 49 "QAIR_OVER_ESTIM" 50 "RSCOPEN_ERROR" 51 "RSCWAIT_ERROR" 52 "RSCCLOSE_ERROR" 53 "OSCCLOSE_ERROR" 54 "OSCOPEN_ERROR" 55 "DTC_ERROR" 56 "NLP_ERROR" 57 "UMA_ERROR" 58 "TEMP_PREWARNING" 59 "TEMP_WARNING" 60 "THR_LRN_ERROR" 61 "COMM_ERROR" 62 "MMP_ERROR" 63 "SMP_ERROR" 64 "EOBD_ERROR" 65 "ENERGY_ERROR" 66 "GAIN_ERROR" 67 "KO2_HPRAIL_ERROR" 68 "KO2_LPRAIL_ERROR" 69 "OFFS_ERROR" 70 "SWT_INCOHERENCE" 71 "MFLV_INCOHERENCE" 72 "SET_PLUS_FAULT" 73 "SET_MINUS_FAULT" 74 "OFF_FAULT" 75 "SET_FAULT" 76 "RESUME_FAULT" 77 "HOLD_FAULT" 78 "STOP_CABIN_TILT_FAULT" 79 "START_CABIN_TILT_FAULT" 80 "STUCK_CLOSED_OR_OPEN_LOAD" 81 "OVERCURR" 82 "CAM_NTEETH_INCOHERENCE" 83 "CAM_POS_INCOHERENCE" 84 "SERIAL_ERROR" 85 "CHIP_FAULT" 86 "SC_PHASES" 87 "NUMBER_OF_FAULT" 88 "ANY_FAULT" /end COMPU_VTAB
/begin COMPU_VTAB VTAB_FOR_RecRifasaInjTDC_CM_FixEnableT "Enumerated data type: FixEnableT" TAB_VERB 2 171 "Enable" 218 "Disable" /end COMPU_VTAB
/begin COMPU_VTAB VTAB_FOR_RecoverySTA100ms_Symbol_CM_FixEnableT "Enumerated data type: FixEnableT" TAB_VERB 2 171 "Enable" 218 "Disable" /end COMPU_VTAB
/begin COMPU_VTAB VTAB_FOR_TE_FaultChkSPP02_4ms_CM_FixEnableT "Enumerated data type: FixEnableT" TAB_VERB 2 171 "Enable" 218 "Disable" /end COMPU_VTAB
/begin COMPU_VTAB VTAB_FOR_TE_RecoverySPP_4ms_CM_FixEnableT "Enumerated data type: FixEnableT" TAB_VERB 2 171 "Enable" 218 "Disable" /end COMPU_VTAB
/begin COMPU_VTAB VTAB_FOR_TE_TM_CheckStazDiag_50ms_Symbol_CM_FixEnableT "Enumerated data type: FixEnableT" TAB_VERB 2 171 "Enable" 218 "Disable" /end COMPU_VTAB
/begin COMPU_VTAB VTAB_FOR_TE_TM_FaultChkAIR2H_50ms_Symbol_CM_FixEnableT "Enumerated data type: FixEnableT" TAB_VERB 2 171 "Enable" 218 "Disable" /end COMPU_VTAB
/begin COMPU_VTAB VTAB_FOR_TE_TM_FaultChkAIR2L_50ms_Symbol_CM_FixEnableT "Enumerated data type: FixEnableT" TAB_VERB 2 171 "Enable" 218 "Disable" /end COMPU_VTAB
/begin COMPU_VTAB VTAB_FOR_TE_TM_RecoveryAIR_50ms_Symbol_CM_FixEnableT "Enumerated data type: FixEnableT" TAB_VERB 2 171 "Enable" 218 "Disable" /end COMPU_VTAB
/begin COMPU_VTAB VTAB_FOR_TE_TM_Torque_CylCut_TDC_Symbol_CM_FixEnableT "Enumerated data type: FixEnableT" TAB_VERB 2 171 "Enable" 218 "Disable" /end COMPU_VTAB
/begin COMPU_VTAB VTAB_FOR_Thrp4ms_CM_tFault_adm "Enumerated data type: tFault" TAB_VERB 90 0 "NO_FAULT" 1 "SIGNAL_TOO_LOW" 2 "SIGNAL_TOO_BIG" 3 "SC_TO_BATTERY" 4 "SC_TO_GND" 5 "SIGNAL_NOT_PLAUSIBLE" 6 "OC_OR_SC_TO_BATTERY" 7 "OC_OR_SC_TO_GND" 8 "OC" 9 "NO_SIGNAL" 10 "SIGNAL_DELAYED" 11 "TRASMISSION_IMPOSSIBLE" 12 "COMPONENT_DAMAGED" 13 "TEST_CONDITION_NOT_CORRECT" 14 "MECHANICAL_PROBLEM" 15 "GENERIC_FAULT" 16 "DERIVATIVE_TOO_HIGH" 17 "DERIVATIVE_TOO_LOW" 18 "CONTROL_ERROR" 19 "ALIM_KO" 20 "ADC_KO" 21 "CAN_OFF" 22 "AIRQCONTROL_ERROR" 23 "FBCONTROL_ERROR" 24 "RPCONTROL_ERROR" 25 "SAFETY_KO" 26 "SC_HS_LS" 27 "SC_TO_GND_HS" 28 "TPU_ERROR" 29 "OC_OR_SC_TO_GND_LS" 30 "SC_TO_BAT_LS" 31 "OVERTEMPERATURE" 32 "SC_TO_GND_LS" 33 "SC_TO_BAT_HS" 34 "CLOSED" 35 "OPEN" 36 "LOAD_DUMP" 37 "STUCK_OPEN" 38 "STUCK_CLOSED" 39 "UNKNOWN_STATE" 40 "UNDERVOLTAGE" 41 "STUCK_ON" 42 "STUCK_OFF" 43 "ON" 44 "OFF" 45 "THR_INCOHERENCE" 46 "PDL_INCOHERENCE" 47 "POT_2_FAULT" 48 "QAIR_UNDER_ESTIM" 49 "QAIR_OVER_ESTIM" 50 "RSCOPEN_ERROR" 51 "RSCWAIT_ERROR" 52 "RSCCLOSE_ERROR" 53 "OSCCLOSE_ERROR" 54 "OSCOPEN_ERROR" 55 "DTC_ERROR" 56 "NLP_ERROR" 57 "UMA_ERROR" 58 "TEMP_PREWARNING" 59 "TEMP_WARNING" 60 "THR_LRN_ERROR" 61 "COMM_ERROR" 62 "MMP_ERROR" 63 "SMP_ERROR" 64 "EOBD_ERROR" 65 "ENERGY_ERROR" 66 "GAIN_ERROR" 67 "KO2_HPRAIL_ERROR" 68 "KO2_LPRAIL_ERROR" 69 "OFFS_ERROR" 70 "SWT_INCOHERENCE" 71 "MFLV_INCOHERENCE" 72 "SET_PLUS_FAULT" 73 "SET_MINUS_FAULT" 74 "OFF_FAULT" 75 "SET_FAULT" 76 "RESUME_FAULT" 77 "HOLD_FAULT" 78 "STOP_CABIN_TILT_FAULT" 79 "START_CABIN_TILT_FAULT" 80 "STUCK_CLOSED_OR_OPEN_LOAD" 81 "OVERCURR" 82 "CAM_NTEETH_INCOHERENCE" 83 "CAM_POS_INCOHERENCE" 84 "SERIAL_ERROR" 85 "CHIP_FAULT" 86 "SC_PHASES" 87 "STACK_ERROR" 88 "NUMBER_OF_FAULT" 89 "ANY_FAULT" /end COMPU_VTAB
/begin COMPU_VTAB VTAB_FOR_Thrp_Mgmt50ms_CM_tFault_adm "Enumerated data type: tFault" TAB_VERB 82 0 "NO_FAULT" 1 "SIGNAL_TOO_LOW" 2 "SIGNAL_TOO_BIG" 3 "SC_TO_BATTERY" 4 "SC_TO_GND" 5 "SIGNAL_NOT_PLAUSIBLE" 6 "OC_OR_SC_TO_BATTERY" 7 "OC_OR_SC_TO_GND" 8 "OC" 9 "NO_SIGNAL" 10 "SIGNAL_DELAYED" 11 "TRASMISSION_IMPOSSIBLE" 12 "COMPONENT_DAMAGED" 13 "CONDITION_NOT_CORRECT" 14 "MECHANICAL_PROBLEM" 15 "GENERIC_FAULT" 16 "DERIVATIVE_TOO_HIGH" 17 "DERIVATIVE_TOO_LOW" 18 "CONTROL_ERROR" 19 "ALIM_KO" 20 "ADC_KO" 21 "CAN_OFF" 22 "AIRQCONTROL_ERROR" 23 "FBCONTROL_ERROR" 24 "RPCONTROL_ERROR" 25 "SAFETY_KO" 26 "SC_HS_LS" 27 "SC_TO_GND_HS" 28 "TPU_ERROR" 29 "OC_OR_SC_TO_GND_LS" 30 "SC_TO_BAT_LS" 31 "OVER_TEMPERATURE" 32 "SC_TO_GND_LS" 33 "SC_TO_BAT_HS" 34 "CLOSED" 35 "OPEN" 36 "LOAD_DUMP" 37 "STUCK_OPEN" 38 "STUCK_CLOSED" 39 "UNKNOWN_STATE" 40 "UNDERVOLTAGE" 41 "STUCK_ON" 42 "STUCK_OFF" 43 "ON" 44 "OFF" 45 "THR_INCOHERENCE" 46 "PDL_INCOHERENCE" 47 "POT_2_FAULT" 48 "QAIR_UNDER_ESTIM" 49 "QAIR_OVER_ESTIM" 50 "RSCOPEN_ERROR" 51 "RSCWAIT_ERROR" 52 "RSCCLOSE_ERROR" 53 "OSCCLOSE_ERROR" 54 "OSCOPEN_ERROR" 55 "DTC_ERROR" 56 "NLP_ERROR" 57 "UMA_ERROR" 58 "TEMP_PREWARNING" 59 "TEMP_WARNING" 60 "THR_LRN_ERROR" 61 "COMM_ERROR" 62 "MMP_ERROR" 63 "SMP_ERROR" 64 "EOBD_ERROR" 65 "ENERGY_ERROR" 66 "GAIN_ERROR" 67 "KO2_HPRAIL_ERROR" 68 "KO2_LPRAIL_ERROR" 69 "OFFS_ERROR" 70 "SWT_INCOHERENCE" 71 "MFLV_INCOHERENCE" 72 "SET_PLUS_FAULT" 73 "SET_MINUS_FAULT" 74 "OFF_FAULT" 75 "SET_FAULT" 76 "RESUME_FAULT" 77 "HOLD_FAULT" 78 "STOP_CABIN_TILT_FAULT" 79 "START_CABIN_TILT_FAULT" 80 "NUMBER_OF_FAULT" 81 "ANY_FAULT" /end COMPU_VTAB
/begin COMPU_VTAB VTAB_FOR_Vfnc4ms_CM_tFault_adm "Enumerated data type: tFault" TAB_VERB 89 0 "NO_FAULT" 1 "SIGNAL_TOO_LOW" 2 "SIGNAL_TOO_BIG" 3 "SC_TO_BATTERY" 4 "SC_TO_GND" 5 "SIGNAL_NOT_PLAUSIBLE" 6 "OC_OR_SC_TO_BATTERY" 7 "OC_OR_SC_TO_GND" 8 "OC" 9 "NO_SIGNAL" 10 "SIGNAL_DELAYED" 11 "TRASMISSION_IMPOSSIBLE" 12 "COMPONENT_DAMAGED" 13 "TEST_CONDITION_NOT_CORRECT" 14 "MECHANICAL_PROBLEM" 15 "GENERIC_FAULT" 16 "DERIVATIVE_TOO_HIGH" 17 "DERIVATIVE_TOO_LOW" 18 "CONTROL_ERROR" 19 "ALIM_KO" 20 "ADC_KO" 21 "CAN_OFF" 22 "AIRQCONTROL_ERROR" 23 "FBCONTROL_ERROR" 24 "RPCONTROL_ERROR" 25 "SAFETY_KO" 26 "SC_HS_LS" 27 "SC_TO_GND_HS" 28 "TPU_ERROR" 29 "OC_OR_SC_TO_GND_LS" 30 "SC_TO_BAT_LS" 31 "OVERTEMPERATURE" 32 "SC_TO_GND_LS" 33 "SC_TO_BAT_HS" 34 "CLOSED" 35 "OPEN" 36 "LOAD_DUMP" 37 "STUCK_OPEN" 38 "STUCK_CLOSED" 39 "UNKNOWN_STATE" 40 "UNDERVOLTAGE" 41 "STUCK_ON" 42 "STUCK_OFF" 43 "ON" 44 "OFF" 45 "THR_INCOHERENCE" 46 "PDL_INCOHERENCE" 47 "POT_2_FAULT" 48 "QAIR_UNDER_ESTIM" 49 "QAIR_OVER_ESTIM" 50 "RSCOPEN_ERROR" 51 "RSCWAIT_ERROR" 52 "RSCCLOSE_ERROR" 53 "OSCCLOSE_ERROR" 54 "OSCOPEN_ERROR" 55 "DTC_ERROR" 56 "NLP_ERROR" 57 "UMA_ERROR" 58 "TEMP_PREWARNING" 59 "TEMP_WARNING" 60 "THR_LRN_ERROR" 61 "COMM_ERROR" 62 "MMP_ERROR" 63 "SMP_ERROR" 64 "EOBD_ERROR" 65 "ENERGY_ERROR" 66 "GAIN_ERROR" 67 "KO2_HPRAIL_ERROR" 68 "KO2_LPRAIL_ERROR" 69 "OFFS_ERROR" 70 "SWT_INCOHERENCE" 71 "MFLV_INCOHERENCE" 72 "SET_PLUS_FAULT" 73 "SET_MINUS_FAULT" 74 "OFF_FAULT" 75 "SET_FAULT" 76 "RESUME_FAULT" 77 "HOLD_FAULT" 78 "STOP_CABIN_TILT_FAULT" 79 "START_CABIN_TILT_FAULT" 80 "STUCK_CLOSED_OR_OPEN_LOAD" 81 "OVERCURR" 82 "CAM_NTEETH_INCOHERENCE" 83 "CAM_POS_INCOHERENCE" 84 "SERIAL_ERROR" 85 "CHIP_FAULT" 86 "SC_PHASES" 87 "NUMBER_OF_FAULT" 88 "ANY_FAULT" /end COMPU_VTAB
/begin RECORD_LAYOUT Lookup2D_UWORD FNC_VALUES 1 UWORD COLUMN_DIR DIRECT /end RECORD_LAYOUT
/begin RECORD_LAYOUT Lookup2D_X_UWORD AXIS_PTS_X 1 UWORD INDEX_INCR DIRECT /end RECORD_LAYOUT
/begin RECORD_LAYOUT Scalar_BOOLEAN FNC_VALUES 1 UBYTE COLUMN_DIR DIRECT /end RECORD_LAYOUT
/begin RECORD_LAYOUT Scalar_FLOAT32_IEEE FNC_VALUES 1 FLOAT32_IEEE COLUMN_DIR DIRECT /end RECORD_LAYOUT
/begin RECORD_LAYOUT Scalar_SWORD FNC_VALUES 1 SWORD COLUMN_DIR DIRECT /end RECORD_LAYOUT
/begin RECORD_LAYOUT Scalar_UBYTE FNC_VALUES 1 UBYTE COLUMN_DIR DIRECT /end RECORD_LAYOUT
/begin RECORD_LAYOUT Scalar_ULONG FNC_VALUES 1 ULONG COLUMN_DIR DIRECT /end RECORD_LAYOUT
/begin RECORD_LAYOUT Scalar_UWORD FNC_VALUES 1 UWORD COLUMN_DIR DIRECT /end RECORD_LAYOUT
/end MODULE
/end PROJECT
