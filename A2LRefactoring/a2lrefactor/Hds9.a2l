ASAP2_VERSION 1 70
/begin PROJECT XCPonCANFD "Generated for ETAS and Vector "
/begin MODULE XCPonCANFD "Generated for ETAS and Vector "
/begin MOD_COMMON "XCPonCANFD" BYTE_ORDER MSB_FIRST ALIGNMENT_BYTE 1 ALIGNMENT_WORD 2 ALIGNMENT_LONG 4 ALIGNMENT_FLOAT32_IEEE 4 ALIGNMENT_FLOAT64_IEEE 8 ALIGNMENT_INT64 8 /end MOD_COMMON
/begin AXIS_PTS ikELECTRIC_LOAD "[XBK] Richiesta di coppia per carichi elettrici" 0xFC5F9C NO_INPUT_QUANTITY Lookup1D_X_UWORD 0 TE_TM_FFW4ms_Symbol_CM_ufix16_S50_mV 8 12000 36000 /end AXIS_PTS
/begin AXIS_PTS ikFEEDFW_CM_OFFN "[XBK] Feed Forward sulla percentuale di coppia di friction attesa al regime obiettivo" 0xFC5F84 NO_INPUT_QUANTITY Lookup2D_X_UWORD 0 TE_TM_FFW4ms_Symbol_CM_uint16_rpm 12 0 10000 /end AXIS_PTS
/begin AXIS_PTS ikFEEDFW_CM_OFFT "[YBK] Feed Forward sulla percentuale di coppia di friction attesa al regime obiettivo" 0xFC5F74 NO_INPUT_QUANTITY Lookup2D_X_UWORD 0 TE_TM_FFW4ms_Symbol_CM_ufix16_Bn40_degC 8 -40 130 /end AXIS_PTS
/begin AXIS_PTS ikKDSPD_CM_ERR "[YBK] Contributo KD sulla percentuale di Coppia" 0xFC5D4E NO_INPUT_QUANTITY Lookup2D_X_UWORD 0 TE_TM_Cmu_Ctrl4ms_Symbol_CM_ufix16_Bn1800_rpm 7 -1800 1800 /end AXIS_PTS
/begin AXIS_PTS ikKDSPD_CM_GOV "[XBK] Contributo KD sulla percentuale di Coppia" 0xFC5D46 NO_INPUT_QUANTITY Lookup2D_X_UWORD 0 TE_TM_Cmu_Ctrl4ms_Symbol_CM_uint16_rpm 4 0 10000 /end AXIS_PTS
/begin AXIS_PTS ikKD_LOW_GOV "[XBK] Vettore per setting della durezza del controllo del Low Idle" 0xFC5ADA NO_INPUT_QUANTITY Lookup1D_X_UWORD 0 TE_TM_LowIdle_Gov_100ms_Symbol_CM_uint16_adm 4 1 4 /end AXIS_PTS
/begin AXIS_PTS ikKI1ANTIWUPH_DN "[YBK] AntiWindUp superiore del KI" 0xFC5D3C NO_INPUT_QUANTITY Lookup2D_X_UWORD 0 TE_TM_Cmu_Ctrl4ms_Symbol_CM_ufix16_Bn32000_rpm_s 5 -32000 32000 /end AXIS_PTS
/begin AXIS_PTS ikKI1ANTIWUPH_EN "[XBK] AntiWindUp superiore del KI" 0xFC5D32 NO_INPUT_QUANTITY Lookup2D_X_UWORD 0 TE_TM_Cmu_Ctrl4ms_Symbol_CM_ufix16_Bn1800_rpm 5 -1800 1800 /end AXIS_PTS
/begin AXIS_PTS ikKI1ANTIWUPL_DN "[YBK] AntiWindUp inferiore del KI" 0xFC5D28 NO_INPUT_QUANTITY Lookup2D_X_UWORD 0 TE_TM_Cmu_Ctrl4ms_Symbol_CM_ufix16_Bn32000_rpm_s 5 -32000 32000 /end AXIS_PTS
/begin AXIS_PTS ikKI1ANTIWUPL_EN "[XBK] AntiWindUp inferiore del KI" 0xFC5D1E NO_INPUT_QUANTITY Lookup2D_X_UWORD 0 TE_TM_Cmu_Ctrl4ms_Symbol_CM_ufix16_Bn1800_rpm 5 -1800 1800 /end AXIS_PTS
/begin AXIS_PTS ikKISPD_CM_ERR "[YBK] Contributo KI sulla percentuale di Coppia" 0xFC5D10 NO_INPUT_QUANTITY Lookup2D_X_UWORD 0 TE_TM_Cmu_Ctrl4ms_Symbol_CM_ufix16_Bn1800_rpm 7 -1800 1800 /end AXIS_PTS
/begin AXIS_PTS ikKISPD_CM_NOB "[XBK] Contributo KI sulla percentuale di Coppia" 0xFC5D08 NO_INPUT_QUANTITY Lookup2D_X_UWORD 0 TE_TM_Cmu_Ctrl4ms_Symbol_CM_uint16_rpm 4 0 10000 /end AXIS_PTS
/begin AXIS_PTS ikKI_LOW_GOV "[XBK] Vettore per setting della durezza del controllo del Low Idle" 0xFC5AD2 NO_INPUT_QUANTITY Lookup1D_X_UWORD 0 TE_TM_LowIdle_Gov_100ms_Symbol_CM_uint16_adm 4 1 4 /end AXIS_PTS
/begin AXIS_PTS ikKPSPD_CM_ERR "[YBK] Contributo KP sulla percentuale di Coppia" 0xFC5CFA NO_INPUT_QUANTITY Lookup2D_X_UWORD 0 TE_TM_Cmu_Ctrl4ms_Symbol_CM_ufix16_Bn1800_rpm 7 -1800 1800 /end AXIS_PTS
/begin AXIS_PTS ikKPSPD_CM_GOV "[XBK] Contributo KP sulla percentuale di Coppia" 0xFC5CF2 NO_INPUT_QUANTITY Lookup2D_X_UWORD 0 TE_TM_Cmu_Ctrl4ms_Symbol_CM_uint16_rpm 4 0 10000 /end AXIS_PTS
/begin AXIS_PTS ikKP_LOW_GOV "[XBK] Vettore per setting della durezza del controllo del Low Idle" 0xFC5ACA NO_INPUT_QUANTITY Lookup1D_X_UWORD 0 TE_TM_LowIdle_Gov_100ms_Symbol_CM_uint16_adm 4 1 4 /end AXIS_PTS
/begin AXIS_PTS ikOFF_C_AUTNGEAR "[XBK] Tabella Offset di richiesta Coppia con Cambio Automatico Accoppiato" 0xFC5F68 NO_INPUT_QUANTITY Lookup2D_X_UWORD 0 TE_TM_FFW4ms_Symbol_CM_ufix16_Bn125_adm 6 -125 125 /end AXIS_PTS
/begin AXIS_PTS ikOFF_C_AUTVELVE "[YBK] Tabella Offset di richiesta Coppia con Cambio Automatico Accoppiato" 0xFC5F5C NO_INPUT_QUANTITY Lookup2D_X_UWORD 0 TE_TM_FFW4ms_Symbol_CM_uint16_km_h 6 0 250 /end AXIS_PTS
/begin AXIS_PTS ikOFF_REQ_GEAR "[XBK] Tabella Offset di richiesta Coppia con Cambio Manuale Accoppiato" 0xFC5F4C NO_INPUT_QUANTITY Lookup1D_X_UWORD 0 TE_TM_FFW4ms_Symbol_CM_uint16_rpm 8 0 10000 /end AXIS_PTS
/begin AXIS_PTS ikOFF_RE_G_CAUTH "[YBK] Tabella Offset di richiesta Coppia con Cambio Automatico Accoppiato" 0xFC5F3C NO_INPUT_QUANTITY Lookup2D_X_UWORD 0 TE_TM_FFW4ms_Symbol_CM_ufix16_Bn40_degC 8 -40 140 /end AXIS_PTS
/begin AXIS_PTS ikOFF_RE_G_CAUTN "[XBK] Tabella Offset di richiesta Coppia con Cambio Automatico Accoppiato" 0xFC5F2C NO_INPUT_QUANTITY Lookup2D_X_UWORD 0 TE_TM_FFW4ms_Symbol_CM_uint16_rpm 8 0 10000 /end AXIS_PTS
/begin AXIS_PTS ikRESET_KD_DERR "[YBK] Tabella zone di reset del KD" 0xFC5CEC NO_INPUT_QUANTITY Lookup2D_X_UWORD 0 TE_TM_Cmu_Ctrl4ms_Symbol_CM_ufix16_Bn1_adm 3 -1 1 /end AXIS_PTS
/begin AXIS_PTS ikRESET_KD_ERR "[XBK] Tabella zone di reset del KD" 0xFC5CE6 NO_INPUT_QUANTITY Lookup2D_X_UWORD 0 TE_TM_Cmu_Ctrl4ms_Symbol_CM_ufix16_Bn1_adm 3 -1 1 /end AXIS_PTS
/begin AXIS_PTS ikRPM_DELTA_VBAT "[XBK]   Idle speed control nominal RPM  " 0xFC5B48 NO_INPUT_QUANTITY Lookup1D_X_UWORD 0 TE_TM_Target4ms_CM_ufix16_S50_mV 8 12000 36000 /end AXIS_PTS
/begin AXIS_PTS ikRPM_IDLE_NOM "[XBK] Idle speed control nominal RPM target" 0xFC5B28 NO_INPUT_QUANTITY Lookup1D_X_UWORD 0 TE_TM_Target4ms_CM_ufix16_Bn40_degC 16 -40 140 /end AXIS_PTS
/begin AXIS_PTS ikSYS_GAIN_C_TOIL "[XBK]  " 0xFC5CDA NO_INPUT_QUANTITY Lookup1D_X_UWORD 0 TE_TM_Cmu_Ctrl4ms_Symbol_CM_ufix16_Bn40_degC 6 -40 130 /end AXIS_PTS
/begin AXIS_PTS ikSYS_GAIN_GEARC "[XBK] Guadagno controllo in Coppia in funzione della marcia" 0xFC5CCA NO_INPUT_QUANTITY Lookup1D_X_UWORD 0 TE_TM_Cmu_Ctrl4ms_Symbol_CM_ufix16_Bn125_adm 8 -125 125 /end AXIS_PTS
/begin MEASUREMENT isElectricLoad "[OUT] Richiesta di coppia per carichi elettrici" UWORD TE_TM_FFW4ms_Symbol_CM_ufix16_En4__ 0 0 0 100 ECU_ADDRESS 0x40003010 /end MEASUREMENT
/begin MEASUREMENT isEnCloop "Flag che abilita la parte di Feed-Back del Ctrl Idle" UBYTE Idle4ms_CM_boolean_adm 0 0 0 1 ECU_ADDRESS 0x40002F6B /end MEASUREMENT
/begin MEASUREMENT isEnableIdleCtrl "Flag di stato per abilitare il vControllo in Idle" UBYTE Airq4ms_CM_boolean_adm 0 0 0 1 ECU_ADDRESS 0x40002F6A /end MEASUREMENT
/begin MEASUREMENT isEnablePID_CM "tato del PID per il controllo della Coppia" UBYTE Idle4ms_CM_boolean_adm 0 0 0 1 ECU_ADDRESS 0x40002F6C /end MEASUREMENT
/begin MEASUREMENT isErrCntLim "Contatore per lo smoothing tra Rpm e Target statico" UWORD TE_TM_Target4ms_CM_ufix16_En10_adm 0 0 0 1 ECU_ADDRESS 0x40003056 /end MEASUREMENT
/begin MEASUREMENT isFeedForwardCmOff "[OUT] Feed Forward sulla percentuale di coppia di friction attesa al regime obiettivo" UWORD TE_TM_FFW4ms_Symbol_CM_ufix16_En4__ 0 0 0 100 ECU_ADDRESS 0x4000300E /end MEASUREMENT
/begin MEASUREMENT isFeedFwCmOff "Friction in Feed-Forward (su rpm Obiettivo Low Idle / PTO / High Idle)" UWORD Idle4ms_CM_ufix16_En4__ 0 0 0 100 ECU_ADDRESS 0x40002F70 /end MEASUREMENT
/begin MEASUREMENT isGearCoupled "Cambio accoppiato a valle del timeout" UBYTE TE_TM_Target4ms_CM_boolean_adm 0 0 0 1 ECU_ADDRESS 0x40003054 /end MEASUREMENT
/begin MEASUREMENT isGearOffReqTst "Richiesta finale Offset sulla Coppia Erogata per Cambio accoppiato" UWORD TE_TM_FFW4ms_Symbol_CM_ufix16_En4__ 0 0 0 100 ECU_ADDRESS 0x4000300C /end MEASUREMENT
/begin CHARACTERISTIC isKD_IDLE_DAV "Contributo KD sulla percentuale di Anticipo" VALUE 0xFC5B6E Scalar_UWORD 0 TE_TM_Adv_Ctrl4ms_Symbol_CM_ufix16_En15__s_rpm 0 1.953125 /end CHARACTERISTIC
/begin CHARACTERISTIC isKFHW_RPMOBTSTAT "Costante del filtro PassaBasso su obiettivo di giri statico" VALUE 0xFC5B22 Scalar_UWORD 0 TE_TM_Target4ms_CM_ufix16_En10_adm 0 1 /end CHARACTERISTIC
/begin CHARACTERISTIC isKF_RE_GEAR_COUP_DW "Costante di tempo filtro Offset richiesta Coppia Erogata per Gear Coupled (Rilascio)" VALUE 0xFC5DB2 Scalar_UWORD 0 TE_TM_FFW4ms_Symbol_CM_ufix16_En10_adm 0 1 /end CHARACTERISTIC
/begin CHARACTERISTIC isKF_RE_GEAR_COUP_UP "Costante di tempo filtro Offset richiesta Coppia Erogata per Gear Coupled (Attacco)" VALUE 0xFC5DB0 Scalar_UWORD 0 TE_TM_FFW4ms_Symbol_CM_ufix16_En10_adm 0 1 /end CHARACTERISTIC
/begin CHARACTERISTIC isKP_IDLE_DAV "Contributo KP sulla percentuale di Anticipo" VALUE 0xFC5B6C Scalar_UWORD 0 TE_TM_Adv_Ctrl4ms_Symbol_CM_ufix16_En15___rpm 0 1.953125 /end CHARACTERISTIC
/begin CHARACTERISTIC isKP_UN_BR_GAIN "Guadagno sul contributo KP in condizione di UNDER BRAKING in Idle" VALUE 0xFC5B84 Scalar_UWORD 0 TE_TM_Cmu_Ctrl4ms_Symbol_CM_ufix16_En10_adm 0.099609375 10 /end CHARACTERISTIC
/begin MEASUREMENT isKdDeltaAdv "Delta su anticipo per contributo derivativo Ctrl PD" SWORD TE_TM_Adv_Ctrl4ms_Symbol_CM_sfix16_En4_degE 0 0 -20 20 ECU_ADDRESS 0x40002F90 /end MEASUREMENT
/begin MEASUREMENT isKdLowGov "[OUT] Vettore per setting della durezza del controllo del Low Idle" UWORD TE_TM_LowIdle_Gov_100ms_Symbol_CM_ufix16_En10_adm 0 0 0 10 ECU_ADDRESS 0x40002F5A /end MEASUREMENT
/begin MEASUREMENT isKdLowGovGain "Richiesta da VCM di guadagno per durezza del controllo del Low Idle" UWORD Idle100ms_CM_ufix16_En10_adm 0 0 0 10 ECU_ADDRESS 0x40002F50 /end MEASUREMENT
/begin MEASUREMENT isKdSpdPerDATst "Contributo del controllo derivativo per PD su Anticipo in Low Idle" SWORD TE_TM_Adv_Ctrl4ms_Symbol_CM_sfix16_En4__ 0 0 -100 100 ECU_ADDRESS 0x40002F8E /end MEASUREMENT
/begin MEASUREMENT isKdSpdPerGGTst "Contributo del KD con GEAR attivo" SWORD TE_TM_Cmu_Ctrl4ms_Symbol_CM_sfix16_En4__ 0 0 -100 100 ECU_ADDRESS 0x40002FC8 /end MEASUREMENT
/begin MEASUREMENT isKdSpeedCPerc "Contributo del controllo derivativo per Controllo della Cmu in Idle" SWORD TE_TM_Cmu_Ctrl4ms_Symbol_CM_sfix16_En4__ 0 0 -100 100 ECU_ADDRESS 0x40002FC6 /end MEASUREMENT
/begin MEASUREMENT isKdspdCmCtrl "[OUT] Contributo KD sulla percentuale di Coppia" UWORD TE_TM_Cmu_Ctrl4ms_Symbol_CM_ufix16_En15__s_rpm 0 0 0 1.953125 ECU_ADDRESS 0x40002FBC /end MEASUREMENT
/begin MEASUREMENT isKi1AntiwUpH "[OUT] AntiWindUp superiore del KI" UWORD TE_TM_Cmu_Ctrl4ms_Symbol_CM_ufix16_En4__ 0 0 0 100 ECU_ADDRESS 0x40002FBA /end MEASUREMENT
/begin MEASUREMENT isKi1AntiwUpL "[OUT] AntiWindUp inferiore del KI" SWORD TE_TM_Cmu_Ctrl4ms_Symbol_CM_sfix16_En4__ 0 0 -100 0 ECU_ADDRESS 0x40002FC4 /end MEASUREMENT
/begin MEASUREMENT isKiLowGov "[OUT] Vettore per setting della durezza del controllo del Low Idle" UWORD TE_TM_LowIdle_Gov_100ms_Symbol_CM_ufix16_En10_adm 0 0 0 10 ECU_ADDRESS 0x40002F58 /end MEASUREMENT
/begin MEASUREMENT isKiLowGovGain "Richiesta da VCM di guadagno per durezza del controllo del Low Idle" UWORD Idle100ms_CM_ufix16_En10_adm 0 0 0 10 ECU_ADDRESS 0x40002F52 /end MEASUREMENT
/begin MEASUREMENT isKiSpdPerGGTst "Contributo del KI con GEAR attivo" SLONG TE_TM_Cmu_Ctrl4ms_Symbol_CM_sfix32_En11__ 0 0 -100 100 ECU_ADDRESS 0x40002FD0 /end MEASUREMENT
/begin MEASUREMENT isKiSpeedCPer "ntegral part of PID in closed loop Low Idle engine speed control" SWORD Idle4ms_CM_sfix16_En4__ 0 0 -100 100 ECU_ADDRESS 0x40002F7A /end MEASUREMENT
/begin MEASUREMENT isKiSpeedPercInit "ynamic Init value for Integral part in Low Idle Ctrl PID" SWORD Idle4ms_CM_sfix16_En4__ 0 0 -100 100 ECU_ADDRESS 0x40002F78 /end MEASUREMENT
/begin MEASUREMENT isKispdCmCtrl "[OUT] Contributo KI sulla percentuale di Coppia" UWORD TE_TM_Cmu_Ctrl4ms_Symbol_CM_ufix16_En15___srpm 0 0 0 1.953125 ECU_ADDRESS 0x40002FB8 /end MEASUREMENT
/begin MEASUREMENT isKpDeltaAdv "Delta su anticipo per contributo proporzionale Ctrl PD" SWORD TE_TM_Adv_Ctrl4ms_Symbol_CM_sfix16_En4_degE 0 0 -20 20 ECU_ADDRESS 0x40002F8C /end MEASUREMENT
/begin MEASUREMENT isKpLowGov "[OUT] Vettore per setting della durezza del controllo del Low Idle" UWORD TE_TM_LowIdle_Gov_100ms_Symbol_CM_ufix16_En10_adm 0 0 0 10 ECU_ADDRESS 0x40002F56 /end MEASUREMENT
/begin MEASUREMENT isKpLowGovGain "Richiesta da VCM di guadagno per durezza del controllo del Low Idle" UWORD Idle100ms_CM_ufix16_En10_adm 0 0 0 10 ECU_ADDRESS 0x40002F54 /end MEASUREMENT
/begin MEASUREMENT isKpSpdPerDATst "Contributo del controllo proporzionale per PD su Anticipo in Low Idle" SWORD TE_TM_Adv_Ctrl4ms_Symbol_CM_sfix16_En4__ 0 0 -100 100 ECU_ADDRESS 0x40002F8A /end MEASUREMENT
/begin MEASUREMENT isKpSpdPerGGTst "Contributo del KP con GEAR attivo" SWORD TE_TM_Cmu_Ctrl4ms_Symbol_CM_sfix16_En4__ 0 0 -100 100 ECU_ADDRESS 0x40002FC2 /end MEASUREMENT
/begin MEASUREMENT isKpSpeedPerc "Contributo del controllo proporzionale per Controllo della Cmu in Idle" SWORD TE_TM_Cmu_Ctrl4ms_Symbol_CM_sfix16_En4__ 0 0 -100 100 ECU_ADDRESS 0x40002FC0 /end MEASUREMENT
/begin MEASUREMENT isKpspdCmCtrl "[OUT] Contributo KP sulla percentuale di Coppia" UWORD TE_TM_Cmu_Ctrl4ms_Symbol_CM_ufix16_En15___rpm 0 0 0 1.953125 ECU_ADDRESS 0x40002FB6 /end MEASUREMENT
/begin CHARACTERISTIC isLTD_H_DER50MS "Saturazione superiore alla derivata RPM a 50 ms" VALUE 0xFC5FF8 Scalar_UWORD 0 TE_TM_DerRPM_50ms_CM_uint16_rpm_s 0 32000 /end CHARACTERISTIC
/begin CHARACTERISTIC isLTD_L_DER50MS "Saturazione inferiore alla derivata RPM a 50 ms" VALUE 0xFC5FF6 Scalar_UWORD 0 TE_TM_DerRPM_50ms_CM_ufix16_Bn32000_rpm_s -32000 0 /end CHARACTERISTIC
/begin MEASUREMENT isLtdSmoothDecr "Smoothing Factor 1 -> 0 on inherited Integral init" UWORD TE_TM_InitIntegrIdl4ms_Symbol_CM_ufix16_En10_adm 0 0 0 1 ECU_ADDRESS 0x4000301E /end MEASUREMENT
/begin CHARACTERISTIC isMAN_GEAR_PRES "Calibrazione per indicare la presenza o meno del cambio manuale su allestimento" VALUE 0xFC5D9E Scalar_BOOLEAN 0 TE_TM_FFW4ms_Symbol_CM_boolean_adm 0 1 /end CHARACTERISTIC
/begin MEASUREMENT isManGear_Pres "Cambio Manuale presente su Allestimento" UBYTE DiagSym100ms_CM_boolean_adm 0 0 0 1 ECU_ADDRESS 0x40002F68 /end MEASUREMENT
/begin CHARACTERISTIC isNPMS_NO_IDLE_FR "Numero di PMS per cui attuazione del Controllo Idle viene disabilitata per Temperatura bassa" VALUE 0xFC5D94 Scalar_UWORD 0 TE_TM_Enable_Idle4ms_Symbol_CM_uint16_PMS 0 65535 /end CHARACTERISTIC
/begin CHARACTERISTIC isOFF_REQ_COND "Offset richiesta Coppia Erogata con Condizionatore On" VALUE 0xFC5DAE Scalar_UWORD 0 TE_TM_FFW4ms_Symbol_CM_ufix16_En4__ 0 100 /end CHARACTERISTIC
/begin CHARACTERISTIC isOFF_RPM_COND "Offset in Rpm target al minimo per richiesta condizionatore" VALUE 0xFC5B20 Scalar_UWORD 0 TE_TM_Target4ms_CM_uint16_RPM 0 2000 /end CHARACTERISTIC
/begin CHARACTERISTIC isOFF_RPM_GEAR "Offset in Rpm target al minimo per cambio accoppiato" VALUE 0xFC5B1E Scalar_UWORD 0 TE_TM_Target4ms_CM_uint16_RPM 0 2000 /end CHARACTERISTIC
/begin CHARACTERISTIC isOFF_RPM_GEAR_4EVER "0-> Attiva timeout su Offset di giri su obiettivo statico per cambio accoppiato; 1-> disattiva timeout" VALUE 0xFC5B1C Scalar_BOOLEAN 0 TE_TM_Target4ms_CM_boolean_adm 0 1 /end CHARACTERISTIC
/begin CHARACTERISTIC isOFF_RPM_UND_BR "Offset in Rpm target al minimo per condizione di UnderBraking" VALUE 0xFC5B1A Scalar_UWORD 0 TE_TM_Target4ms_CM_uint16_RPM 0 2000 /end CHARACTERISTIC
/begin MEASUREMENT isOffCAutNgvv "[OUT] Tabella Offset di richiesta Coppia con Cambio Automatico Accoppiato" SWORD TE_TM_FFW4ms_Symbol_CM_sfix16_En4__ 0 0 -100 100 ECU_ADDRESS 0x40003012 /end MEASUREMENT
/begin MEASUREMENT isOffReGCAut "[OUT] Tabella Offset di richiesta Coppia con Cambio Automatico Accoppiato" UWORD TE_TM_FFW4ms_Symbol_CM_ufix16_En4__ 0 0 0 100 ECU_ADDRESS 0x4000300A /end MEASUREMENT
/begin MEASUREMENT isOffReqCondDTst "Richiesta - prima del filtro - Offset sulla Coppia Erogata per Condizionatore On" UWORD TE_TM_FFW4ms_Symbol_CM_ufix16_En4__ 0 0 0 100 ECU_ADDRESS 0x40003008 /end MEASUREMENT
/begin MEASUREMENT isOffReqCondF "Richiesta finale Offset sulla Coppia Erogata per Condizionatore On" UWORD TE_TM_FFW4ms_Symbol_CM_ufix16_En4__ 0 0 0 100 ECU_ADDRESS 0x40003006 /end MEASUREMENT
/begin MEASUREMENT isOffReqGear "[OUT] Tabella Offset di richiesta Coppia con Cambio Manuale Accoppiato" UWORD TE_TM_FFW4ms_Symbol_CM_ufix16_En4__ 0 0 0 100 ECU_ADDRESS 0x40003004 /end MEASUREMENT
/begin MEASUREMENT isOffReqGearDTst "Richiesta - prima del filtro - Offset sulla Coppia Erogata per Cambio accoppiato" UWORD TE_TM_FFW4ms_Symbol_CM_ufix16_En4__ 0 0 0 100 ECU_ADDRESS 0x40003002 /end MEASUREMENT
/begin MEASUREMENT isOff_Veh_Coupled "Offset richiesto per PTO (in  Nm) in funzione della stiffness del Ctrl" UWORD TE_TM_FFW4ms_Symbol_CM_ufix16_En4_Nm 0 0 0 4095 ECU_ADDRESS 0x40003000 /end MEASUREMENT
/begin MEASUREMENT isPIDIdPerCmAD "Feed-Forward in Low Idle in percentuale di Coppia (Cmu Max)" UWORD Idle4ms_CM_ufix16_En4__ 0 0 0 100 ECU_ADDRESS 0x40002F72 /end MEASUREMENT
/begin MEASUREMENT isPID_DAdvIdle "Eventuale contributo di delta anticipo per controllo del Low Idle" SWORD Fuels_CtrlMgmtTDC_CM_sfix16_En4_degree 0 0 -20 60 ECU_ADDRESS 0x40002F7E /end MEASUREMENT
/begin MEASUREMENT isPID_Dadv "Contributo finale di delta Anticipo da PD in Low Idle" SWORD TE_TM_Adv_Ctrl4ms_Symbol_CM_sfix16_En4_degE 0 0 -20 20 ECU_ADDRESS 0x40002F88 /end MEASUREMENT
/begin MEASUREMENT isPID_Per_Id_Tst "Richiesta percentuale (Cmu / Qair) del PID in Idle prima della saturazione" SWORD TE_TM_Cmu_Ctrl4ms_Symbol_CM_sfix16_En4__ 0 0 -100 100 ECU_ADDRESS 0x40002FBE /end MEASUREMENT
/begin MEASUREMENT isPID_PercIdle "Richiesta percentuale (Cmu / Qair) del controllo PID in Idle" SWORD Fuels_CtrlMgmtTDC_CM_sfix16_En4__ 0 0 -100 100 ECU_ADDRESS 0x40002F7C /end MEASUREMENT
/begin CHARACTERISTIC isRIF_IDLE_FILT "Switch per scegliere il filtraggio per Obiettivo di Low Idle (1 NoFilt, 2 FiltDyn, 3 FiltDynFoirced)" VALUE 0xFC5B18 Scalar_UBYTE 0 TE_TM_Target4ms_CM_uint8_adm 1 2 /end CHARACTERISTIC
/begin CHARACTERISTIC isRIT_REQ_COND "Tempo di ritardo applicazione Offset richiesta Coppia Erogata per Richiesta Condizionatore" VALUE 0xFC5DAC Scalar_UWORD 0 TE_TM_FFW4ms_Symbol_CM_ufix16_En10_s 0 50 /end CHARACTERISTIC
/begin CHARACTERISTIC isRIT_RE_GEAR_COUP_DW "Tempo di ritardo applicazione Offset richiesta Coppia Erogata per Cambio Manuale (Rilascio)" VALUE 0xFC5DAA Scalar_UWORD 0 TE_TM_FFW4ms_Symbol_CM_ufix16_En10_s 0 50 /end CHARACTERISTIC
/begin CHARACTERISTIC isRIT_RE_GEAR_COUP_UP "Tempo di ritardo applicazione Offset richiesta Coppia Erogata per Cambio Manuale (Attacco)" VALUE 0xFC5DA8 Scalar_UWORD 0 TE_TM_FFW4ms_Symbol_CM_ufix16_En10_s 0 50 /end CHARACTERISTIC
/begin CHARACTERISTIC isRIT_RE_G_C_AUT_DW "Tempo di ritardo applicazione Offset richiesta Coppia Erogata per Cambio Automatico (Rilascio)" VALUE 0xFC5DA6 Scalar_UWORD 0 TE_TM_FFW4ms_Symbol_CM_ufix16_En10_s 0 50 /end CHARACTERISTIC
/begin CHARACTERISTIC isRIT_RE_G_C_AUT_UP "Tempo di ritardo applicazione Offset richiesta Coppia Erogata per Cambio Automatico (Attacco)" VALUE 0xFC5DA4 Scalar_UWORD 0 TE_TM_FFW4ms_Symbol_CM_ufix16_En10_s 0 50 /end CHARACTERISTIC
/begin CHARACTERISTIC isRPMIN_IDLE "Soglia giri di by-pass Timeout che chiude loop in Feed-Back Ctrl Idle dopo il Cranking" VALUE 0xFC5B82 Scalar_UWORD 0 TE_TM_Cmu_Ctrl4ms_Symbol_CM_uint16_rpm 0 2000 /end CHARACTERISTIC
/begin MEASUREMENT isReAccNoVbatt "Richiesta da Freni, Condizionatore e Cambio di percentuale di Coppia Erogata" UWORD TE_TM_FFW4ms_Symbol_CM_ufix16_En4__ 0 0 0 100 ECU_ADDRESS 0x40002FFE /end MEASUREMENT
/begin MEASUREMENT isReCmuAccesory "" UWORD Idle4ms_CM_ufix16_En4__ 0 0 0 100 ECU_ADDRESS 0x40002F76 /end MEASUREMENT
/begin MEASUREMENT isResetKd "[OUT] Tabella zone di reset del KD" UWORD TE_TM_Cmu_Ctrl4ms_Symbol_CM_uint16_adm 0 0 0 1 ECU_ADDRESS 0x40002FB4 /end MEASUREMENT
/begin MEASUREMENT isRitReGearCoup4ms "Ritardo in Task4ms intervento Offset Coppia per Gear Coupled" UWORD TE_TM_FFW4ms_Symbol_CM_uint16_4ms 0 0 0 12500 ECU_ADDRESS 0x40002FFC /end MEASUREMENT
/begin MEASUREMENT isRitReqCond4ms "Ritardo (nr. Task 4ms) applicazione Offset richiesta Coppia Erogata per Richiesta Condizionatore" UWORD TE_TM_FFW4ms_Symbol_CM_uint16_4ms 0 0 0 12500 ECU_ADDRESS 0x40002FFA /end MEASUREMENT
/begin MEASUREMENT isRpmDeltaVbat "[OUT]   Idle speed control nominal RPM  " UWORD TE_TM_Target4ms_CM_uint16_RPM 0 0 0 2000 ECU_ADDRESS 0x40003052 /end MEASUREMENT
/begin MEASUREMENT isRpmErrLimF "Errore su Target rispetto al Target limitato" SWORD TE_TM_Target4ms_CM_int16_rpm 0 0 -2000 2000 ECU_ADDRESS 0x40003050 /end MEASUREMENT
/begin MEASUREMENT isRpmHiRes "Velocità di rotazione motore (Alta risoluzione, ricostruita dal T6)" UWORD Idle4ms_CM_ufix16_En3_rpm 0 0 0 8000 ECU_ADDRESS 0x40002F6E /end MEASUREMENT
/begin MEASUREMENT isRpmIdleNom "[OUT] Idle speed control nominal RPM target" UWORD TE_TM_Target4ms_CM_uint16_RPM 0 0 0 2000 ECU_ADDRESS 0x4000304E /end MEASUREMENT
/begin MEASUREMENT isRpmObStaNoDiag "Obiettivo Low Idle interno a monte dei contributi per Diagnosi" UWORD TE_TM_Target4ms_CM_uint16_rpm 0 0 0 2000 ECU_ADDRESS 0x4000304C /end MEASUREMENT
/begin MEASUREMENT isRpmObStaNoFilt "Obiettivo Low Idle interno a monte dei contributi per Diagnosi e del filtraggio" UWORD TE_TM_Target4ms_CM_uint16_rpm 0 0 0 2000 ECU_ADDRESS 0x4000304A /end MEASUREMENT
/begin MEASUREMENT isRpmObt "Obiettivo Rpm finale di Low Idle" UWORD Idle4ms_CM_uint16_rpm 0 0 0 2000 ECU_ADDRESS 0x40002F80 /end MEASUREMENT
/begin MEASUREMENT isRpmObtDinam "Obiettivo Rpm dinamico di Low Idle" UWORD Idle4ms_CM_uint16_rpm 0 0 0 2000 ECU_ADDRESS 0x40002F82 /end MEASUREMENT
/begin MEASUREMENT isRpmObtStat "Obiettivo Rpm statico di Low Idle" UWORD Boost_CtrlMgmt50ms_CM_uint16_rpm 0 0 0 2000 ECU_ADDRESS 0x40002F84 /end MEASUREMENT
/begin MEASUREMENT isRpmObtStatDiag "Obiettivo Low Idle interno a valle dei contributi per Diagnosi" UWORD TE_TM_Target4ms_CM_uint16_rpm 0 0 0 2000 ECU_ADDRESS 0x40003048 /end MEASUREMENT
/begin CHARACTERISTIC isSAT_ERR_KI_C_INF "Saturazione inferiore errore di giri in da integrare nel Ctrl PID in Coppia" VALUE 0xFC5B80 Scalar_UWORD 0 TE_TM_Cmu_Ctrl4ms_Symbol_CM_ufix16_Bn2000_rpm -2000 0 /end CHARACTERISTIC
/begin CHARACTERISTIC isSAT_ERR_KI_C_SUP "Saturazione superiore errore di giri in da integrare nel Ctrl PID in Coppia" VALUE 0xFC5B7E Scalar_UWORD 0 TE_TM_Cmu_Ctrl4ms_Symbol_CM_uint16_rpm 0 2000 /end CHARACTERISTIC
/begin CHARACTERISTIC isSAT_ERR_KP_ADV_INF "Saturazione inferiore errore di giri per proporzionale nel Ctrl PD del delta anticipo" VALUE 0xFC5B6A Scalar_UWORD 0 TE_TM_Adv_Ctrl4ms_Symbol_CM_ufix16_Bn2000_rpm -2000 0 /end CHARACTERISTIC
/begin CHARACTERISTIC isSAT_ERR_KP_ADV_SUP "Saturazione superiore errore di giri per proporzionale nel Ctrl PD del delta anticipo" VALUE 0xFC5B68 Scalar_UWORD 0 TE_TM_Adv_Ctrl4ms_Symbol_CM_uint16_rpm 0 2000 /end CHARACTERISTIC
/begin CHARACTERISTIC isSTART_TORQUE "Coppia iniziale di Feed-Back prima della chiusura del loop del Ctrl Idle" VALUE 0xFC5B7C Scalar_UWORD 0 TE_TM_Cmu_Ctrl4ms_Symbol_CM_ufix16_En4__ 0 100 /end CHARACTERISTIC
/begin CHARACTERISTIC isSTEP_OVERTARGET "Numero di passi (4ms) per raccordo tra Rpm e Target statico da un sovraregime" VALUE 0xFC5B16 Scalar_UWORD 0 TE_TM_Target4ms_CM_uint16_4ms 0 4800 /end CHARACTERISTIC
/begin CHARACTERISTIC isSTEP_UNDERTARGET "Numero di passi (4ms) per raccordo tra Rpm e Target statico da un sottoregime" VALUE 0xFC5B14 Scalar_UWORD 0 TE_TM_Target4ms_CM_uint16_4ms 0 4800 /end CHARACTERISTIC
/begin MEASUREMENT isSign_ERpm "rrore sugli RPM obiettivo con segno cambiato, per il Controllo PID in Idle" SWORD Idle4ms_CM_int16_rpm 0 0 -2000 2000 ECU_ADDRESS 0x40002F86 /end MEASUREMENT
/begin MEASUREMENT isSpeed_Err_Int "Integrale errore di giri" SLONG TE_TM_Cmu_Ctrl4ms_Symbol_CM_sfix32_En11_rpm_s 0 0 -7.2001953125 7.2001953125 ECU_ADDRESS 0x40002FCC /end MEASUREMENT
/begin MEASUREMENT isSysGainCToil "[OUT]  " UWORD TE_TM_Cmu_Ctrl4ms_Symbol_CM_ufix16_En10_adm 0 0 0 10 ECU_ADDRESS 0x40002FB2 /end MEASUREMENT
/begin MEASUREMENT isSysGainGearc "[OUT] Guadagno controllo in Coppia in funzione della marcia" UWORD TE_TM_Cmu_Ctrl4ms_Symbol_CM_ufix16_En10_adm 0 0 0 10 ECU_ADDRESS 0x40002FB0 /end MEASUREMENT
/begin CHARACTERISTIC isTAU_COOL_COND "Costante di tempo filtro Offset richiesta Coppia Erogata per Condizionatore" VALUE 0xFC5DA2 Scalar_UWORD 0 TE_TM_FFW4ms_Symbol_CM_ufix16_En10_s 0.00390625 10 /end CHARACTERISTIC
/begin CHARACTERISTIC isTIMEOUT_IDLE "Timeout per chiudere loop in Feed-Back Ctrl Idle dopo il Cranking" VALUE 0xFC5B7A Scalar_UWORD 0 TE_TM_Cmu_Ctrl4ms_Symbol_CM_ufix16_En8_sec 0 4 /end CHARACTERISTIC
/begin CHARACTERISTIC isTIME_RPM_GEAR_ON "Tempo massimo di attivazione di offset giri su obiettivo statico di giri per cambio accoppiato" VALUE 0xFC5B12 Scalar_UWORD 0 TE_TM_Target4ms_CM_ufix16_Sp004_s 0 260 /end CHARACTERISTIC
/begin CHARACTERISTIC isT_HIG_NO_IDLE_FR "Soglia superiore di TH2O che disabilita il Controllo Idle per N/2 PMS" VALUE 0xFC5D92 Scalar_UWORD 0 TE_TM_Enable_Idle4ms_Symbol_CM_ufix16_Bn40__C -40 120 /end CHARACTERISTIC
/begin CHARACTERISTIC isT_LOW_NO_IDLE_FR "Soglia inferiore di TH2O che disabilita il Controllo Idle per N PMS  " VALUE 0xFC5D90 Scalar_UWORD 0 TE_TM_Enable_Idle4ms_Symbol_CM_ufix16_Bn40__C -40 120 /end CHARACTERISTIC
/begin CHARACTERISTIC isVEHIC_PW_OFF "Offset di potenza (in kW) necessario in Low Idle per accoppiamento motore con veicolo" VALUE 0xFC5DA0 Scalar_UWORD 0 TE_TM_FFW4ms_Symbol_CM_ufix16_En4_kW 0 512 /end CHARACTERISTIC
/begin CHARACTERISTIC isVEL_VEIC_NO_IDLE "Velocita veicolo per la quale il controllo Idle si disattiva" VALUE 0xFC5D8E Scalar_UWORD 0 TE_TM_Enable_Idle4ms_Symbol_CM_uint16_km_h 0 250 /end CHARACTERISTIC
/begin MEASUREMENT isVehicCmuOff "ffset in percentuale di coppia dovuto ad accoppiamento motore - veicolo" UWORD Idle4ms_CM_ufix16_En4__ 0 0 0 100 ECU_ADDRESS 0x40002F74 /end MEASUREMENT
/begin CHARACTERISTIC itFEEDFW_CM_OFF "Feed Forward sulla percentuale di coppia di friction attesa al regime obiettivo" MAP 0xFC5E6C Lookup2DSF_UWORD 0 TE_TM_FFW4ms_Symbol_CM_ufix16_En4__ 0 100
 /begin AXIS_DESCR COM_AXIS NO_INPUT_QUANTITY TE_TM_FFW4ms_Symbol_CM_ufix16_Bn40_degC 8 -40 130 AXIS_PTS_REF ikFEEDFW_CM_OFFT /end AXIS_DESCR
 /begin AXIS_DESCR COM_AXIS NO_INPUT_QUANTITY TE_TM_FFW4ms_Symbol_CM_uint16_rpm 12 0 10000 AXIS_PTS_REF ikFEEDFW_CM_OFFN /end AXIS_DESCR
/end CHARACTERISTIC
/begin CHARACTERISTIC itKDSPD_CM_CTRL "Contributo KD sulla percentuale di Coppia" MAP 0xFC5C92 Lookup2DSF_UWORD 0 TE_TM_Cmu_Ctrl4ms_Symbol_CM_ufix16_En15__s_rpm 0 1.953125
 /begin AXIS_DESCR COM_AXIS NO_INPUT_QUANTITY TE_TM_Cmu_Ctrl4ms_Symbol_CM_ufix16_Bn1800_rpm 7 -1800 1800 AXIS_PTS_REF ikKDSPD_CM_ERR /end AXIS_DESCR
 /begin AXIS_DESCR COM_AXIS NO_INPUT_QUANTITY TE_TM_Cmu_Ctrl4ms_Symbol_CM_uint16_rpm 4 0 10000 AXIS_PTS_REF ikKDSPD_CM_GOV /end AXIS_DESCR
/end CHARACTERISTIC
/begin CHARACTERISTIC itKI1_ANTIW_UP_H "AntiWindUp superiore del KI" MAP 0xFC5C60 Lookup2DSF_UWORD 0 TE_TM_Cmu_Ctrl4ms_Symbol_CM_ufix16_En4__ 0 100
 /begin AXIS_DESCR COM_AXIS NO_INPUT_QUANTITY TE_TM_Cmu_Ctrl4ms_Symbol_CM_ufix16_Bn32000_rpm_s 5 -32000 32000 AXIS_PTS_REF ikKI1ANTIWUPH_DN /end AXIS_DESCR
 /begin AXIS_DESCR COM_AXIS NO_INPUT_QUANTITY TE_TM_Cmu_Ctrl4ms_Symbol_CM_ufix16_Bn1800_rpm 5 -1800 1800 AXIS_PTS_REF ikKI1ANTIWUPH_EN /end AXIS_DESCR
/end CHARACTERISTIC
/begin CHARACTERISTIC itKI1_ANTIW_UP_L "AntiWindUp inferiore del KI" MAP 0xFC5D5C Lookup2DSF_WORD 0 TE_TM_Cmu_Ctrl4ms_Symbol_CM_sfix16_En4__ -100 0
 /begin AXIS_DESCR COM_AXIS NO_INPUT_QUANTITY TE_TM_Cmu_Ctrl4ms_Symbol_CM_ufix16_Bn32000_rpm_s 5 -32000 32000 AXIS_PTS_REF ikKI1ANTIWUPL_DN /end AXIS_DESCR
 /begin AXIS_DESCR COM_AXIS NO_INPUT_QUANTITY TE_TM_Cmu_Ctrl4ms_Symbol_CM_ufix16_Bn1800_rpm 5 -1800 1800 AXIS_PTS_REF ikKI1ANTIWUPL_EN /end AXIS_DESCR
/end CHARACTERISTIC
/begin CHARACTERISTIC itKISPD_CM_CTRL "Contributo KI sulla percentuale di Coppia" MAP 0xFC5C28 Lookup2DSF_UWORD 0 TE_TM_Cmu_Ctrl4ms_Symbol_CM_ufix16_En15___srpm 0 1.953125
 /begin AXIS_DESCR COM_AXIS NO_INPUT_QUANTITY TE_TM_Cmu_Ctrl4ms_Symbol_CM_ufix16_Bn1800_rpm 7 -1800 1800 AXIS_PTS_REF ikKISPD_CM_ERR /end AXIS_DESCR
 /begin AXIS_DESCR COM_AXIS NO_INPUT_QUANTITY TE_TM_Cmu_Ctrl4ms_Symbol_CM_uint16_rpm 4 0 10000 AXIS_PTS_REF ikKISPD_CM_NOB /end AXIS_DESCR
/end CHARACTERISTIC
/begin CHARACTERISTIC itKPSPD_CM_CTRL "Contributo KP sulla percentuale di Coppia" MAP 0xFC5BF0 Lookup2DSF_UWORD 0 TE_TM_Cmu_Ctrl4ms_Symbol_CM_ufix16_En15___rpm 0 1.953125
 /begin AXIS_DESCR COM_AXIS NO_INPUT_QUANTITY TE_TM_Cmu_Ctrl4ms_Symbol_CM_ufix16_Bn1800_rpm 7 -1800 1800 AXIS_PTS_REF ikKPSPD_CM_ERR /end AXIS_DESCR
 /begin AXIS_DESCR COM_AXIS NO_INPUT_QUANTITY TE_TM_Cmu_Ctrl4ms_Symbol_CM_uint16_rpm 4 0 10000 AXIS_PTS_REF ikKPSPD_CM_GOV /end AXIS_DESCR
/end CHARACTERISTIC
/begin CHARACTERISTIC itOFF_C_AUT_NGVV "Tabella Offset di richiesta Coppia con Cambio Automatico Accoppiato" MAP 0xFC5FAC Lookup2DSF_WORD 0 TE_TM_FFW4ms_Symbol_CM_sfix16_En4__ -100 100
 /begin AXIS_DESCR COM_AXIS NO_INPUT_QUANTITY TE_TM_FFW4ms_Symbol_CM_uint16_km_h 6 0 250 AXIS_PTS_REF ikOFF_C_AUTVELVE /end AXIS_DESCR
 /begin AXIS_DESCR COM_AXIS NO_INPUT_QUANTITY TE_TM_FFW4ms_Symbol_CM_ufix16_Bn125_adm 6 -125 125 AXIS_PTS_REF ikOFF_C_AUTNGEAR /end AXIS_DESCR
/end CHARACTERISTIC
/begin CHARACTERISTIC itOFF_RE_G_C_AUT "Tabella Offset di richiesta Coppia con Cambio Automatico Accoppiato" MAP 0xFC5DEC Lookup2DSF_UWORD 0 TE_TM_FFW4ms_Symbol_CM_ufix16_En4__ 0 100
 /begin AXIS_DESCR COM_AXIS NO_INPUT_QUANTITY TE_TM_FFW4ms_Symbol_CM_ufix16_Bn40_degC 8 -40 140 AXIS_PTS_REF ikOFF_RE_G_CAUTH /end AXIS_DESCR
 /begin AXIS_DESCR COM_AXIS NO_INPUT_QUANTITY TE_TM_FFW4ms_Symbol_CM_uint16_rpm 8 0 10000 AXIS_PTS_REF ikOFF_RE_G_CAUTN /end AXIS_DESCR
/end CHARACTERISTIC
/begin CHARACTERISTIC itRESET_KD "Tabella zone di reset del KD" MAP 0xFC5BDE Lookup2DSF_UWORD 0 TE_TM_Cmu_Ctrl4ms_Symbol_CM_uint16_adm 0 1
 /begin AXIS_DESCR COM_AXIS NO_INPUT_QUANTITY TE_TM_Cmu_Ctrl4ms_Symbol_CM_ufix16_Bn1_adm 3 -1 1 AXIS_PTS_REF ikRESET_KD_DERR /end AXIS_DESCR
 /begin AXIS_DESCR COM_AXIS NO_INPUT_QUANTITY TE_TM_Cmu_Ctrl4ms_Symbol_CM_ufix16_Bn1_adm 3 -1 1 AXIS_PTS_REF ikRESET_KD_ERR /end AXIS_DESCR
/end CHARACTERISTIC
/begin CHARACTERISTIC ivELECTRIC_LOAD "Richiesta di coppia per carichi elettrici" CURVE 0xFC5DDC Lookup1D_UWORD 0 TE_TM_FFW4ms_Symbol_CM_ufix16_En4__ 0 100
 /begin AXIS_DESCR COM_AXIS NO_INPUT_QUANTITY TE_TM_FFW4ms_Symbol_CM_ufix16_S50_mV 8 12000 36000 AXIS_PTS_REF ikELECTRIC_LOAD /end AXIS_DESCR
/end CHARACTERISTIC
/begin CHARACTERISTIC ivKD_LOW_GOV "Vettore per setting della durezza del controllo del Low Idle" CURVE 0xFC5AC2 Lookup1D_UWORD 0 TE_TM_LowIdle_Gov_100ms_Symbol_CM_ufix16_En10_adm 0 10
 /begin AXIS_DESCR COM_AXIS NO_INPUT_QUANTITY TE_TM_LowIdle_Gov_100ms_Symbol_CM_uint16_adm 4 1 4 AXIS_PTS_REF ikKD_LOW_GOV /end AXIS_DESCR
/end CHARACTERISTIC
/begin CHARACTERISTIC ivKI_LOW_GOV "Vettore per setting della durezza del controllo del Low Idle" CURVE 0xFC5ABA Lookup1D_UWORD 0 TE_TM_LowIdle_Gov_100ms_Symbol_CM_ufix16_En10_adm 0 10
 /begin AXIS_DESCR COM_AXIS NO_INPUT_QUANTITY TE_TM_LowIdle_Gov_100ms_Symbol_CM_uint16_adm 4 1 4 AXIS_PTS_REF ikKI_LOW_GOV /end AXIS_DESCR
/end CHARACTERISTIC
/begin CHARACTERISTIC ivKP_LOW_GOV "Vettore per setting della durezza del controllo del Low Idle" CURVE 0xFC5AB2 Lookup1D_UWORD 0 TE_TM_LowIdle_Gov_100ms_Symbol_CM_ufix16_En10_adm 0 10
 /begin AXIS_DESCR COM_AXIS NO_INPUT_QUANTITY TE_TM_LowIdle_Gov_100ms_Symbol_CM_uint16_adm 4 1 4 AXIS_PTS_REF ikKP_LOW_GOV /end AXIS_DESCR
/end CHARACTERISTIC
/begin CHARACTERISTIC ivOFF_REQ_GEAR "Tabella Offset di richiesta Coppia con Cambio Manuale Accoppiato" CURVE 0xFC5DCC Lookup1D_UWORD 0 TE_TM_FFW4ms_Symbol_CM_ufix16_En4__ 0 100
 /begin AXIS_DESCR COM_AXIS NO_INPUT_QUANTITY TE_TM_FFW4ms_Symbol_CM_uint16_rpm 8 0 10000 AXIS_PTS_REF ikOFF_REQ_GEAR /end AXIS_DESCR
/end CHARACTERISTIC
/begin CHARACTERISTIC ivRPM_DELTA_VBAT "  Idle speed control nominal RPM  " CURVE 0xFC5B02 Lookup1D_UWORD 0 TE_TM_Target4ms_CM_uint16_RPM 0 2000
 /begin AXIS_DESCR COM_AXIS NO_INPUT_QUANTITY TE_TM_Target4ms_CM_ufix16_S50_mV 8 12000 36000 AXIS_PTS_REF ikRPM_DELTA_VBAT /end AXIS_DESCR
/end CHARACTERISTIC
/begin CHARACTERISTIC ivRPM_IDLE_NOM "Idle speed control nominal RPM target" CURVE 0xFC5AE2 Lookup1D_UWORD 0 TE_TM_Target4ms_CM_uint16_RPM 0 2000
 /begin AXIS_DESCR COM_AXIS NO_INPUT_QUANTITY TE_TM_Target4ms_CM_ufix16_Bn40_degC 16 -40 140 AXIS_PTS_REF ikRPM_IDLE_NOM /end AXIS_DESCR
/end CHARACTERISTIC
/begin CHARACTERISTIC ivSYS_GAIN_C_TOIL "" CURVE 0xFC5BD2 Lookup1D_UWORD 0 TE_TM_Cmu_Ctrl4ms_Symbol_CM_ufix16_En10_adm 0 10
 /begin AXIS_DESCR COM_AXIS NO_INPUT_QUANTITY TE_TM_Cmu_Ctrl4ms_Symbol_CM_ufix16_Bn40_degC 6 -40 130 AXIS_PTS_REF ikSYS_GAIN_C_TOIL /end AXIS_DESCR
/end CHARACTERISTIC
/begin CHARACTERISTIC ivSYS_GAIN_GEARC "Guadagno controllo in Coppia in funzione della marcia" CURVE 0xFC5BC2 Lookup1D_UWORD 0 TE_TM_Cmu_Ctrl4ms_Symbol_CM_ufix16_En10_adm 0 10
 /begin AXIS_DESCR COM_AXIS NO_INPUT_QUANTITY TE_TM_Cmu_Ctrl4ms_Symbol_CM_ufix16_Bn125_adm 8 -125 125 AXIS_PTS_REF ikSYS_GAIN_GEARC /end AXIS_DESCR
/end CHARACTERISTIC
/begin CHARACTERISTIC jfADV_BASE_FILT_Enable "[FIX] Fix finale sullo anticipo" VALUE 0xFC71F2 Scalar_UBYTE 0 AdvnTDC_CM_FixEnableT 171 218 /end CHARACTERISTIC
/begin CHARACTERISTIC jfADV_BASE_FILT_Value "[FIX] Fix finale sullo anticipo" VALUE 0xFC71F0 Scalar_SWORD 0 AdvnTDC_CM_sfix16_En4_degree -20 60 /end CHARACTERISTIC
/begin CHARACTERISTIC jfADV_CORR_LAMBASE_Enable "[FIX] Correction on in function of Lambda target (qsLamObtFin)" VALUE 0xFC71EE Scalar_UBYTE 0 AdvnTDC_CM_FixEnableT 171 218 /end CHARACTERISTIC
/begin CHARACTERISTIC jfADV_CORR_LAMBASE_Value "[FIX] Correction on in function of Lambda target (qsLamObtFin)" VALUE 0xFC71EC Scalar_SWORD 0 AdvnTDC_CM_sfix16_En4_degree -20 60 /end CHARACTERISTIC
/begin CHARACTERISTIC jfADV_CRK_Enable "[FIX] Anticipo nel modo motore Crank" VALUE 0xFC71EA Scalar_UBYTE 0 AdvnTDC_CM_FixEnableT 171 218 /end CHARACTERISTIC
/begin CHARACTERISTIC jfADV_CRK_Value "[FIX] Anticipo nel modo motore Crank" VALUE 0xFC71E8 Scalar_SWORD 0 AdvnTDC_CM_sfix16_En4_degree -20 60 /end CHARACTERISTIC
/begin CHARACTERISTIC jfADV_CUTOFF_Enable "[FIX] Anticipo Base in Cutoff" VALUE 0xFC71E6 Scalar_UBYTE 0 AdvnTDC_CM_FixEnableT 171 218 /end CHARACTERISTIC
/begin CHARACTERISTIC jfADV_CUTOFF_Value "[FIX] Anticipo Base in Cutoff" VALUE 0xFC71E4 Scalar_SWORD 0 AdvnTDC_CM_sfix16_En4_degree -20 60 /end CHARACTERISTIC
/begin CHARACTERISTIC jfADV_EGR_COR_Enable "[FIX] Spark Advance Correction due to EGR presence" VALUE 0xFC71E2 Scalar_UBYTE 0 AdvnTDC_CM_FixEnableT 171 218 /end CHARACTERISTIC
/begin CHARACTERISTIC jfADV_EGR_COR_Value "[FIX] Spark Advance Correction due to EGR presence" VALUE 0xFC71E0 Scalar_SWORD 0 AdvnTDC_CM_sfix16_En4_degree -20 60 /end CHARACTERISTIC
/begin CHARACTERISTIC jfADV_Enable "[FIX] Fix finale sull\'anticipo" VALUE 0xFC71DF Scalar_UBYTE 0 AdvnTDC_CM_FixEnableT 171 218 /end CHARACTERISTIC
/begin CHARACTERISTIC jfADV_IDLE_ACC_Enable "[FIX] Anticipo Base in Idle con cambio accoppiato" VALUE 0xFC71DE Scalar_UBYTE 0 AdvnTDC_CM_FixEnableT 171 218 /end CHARACTERISTIC
/begin CHARACTERISTIC jfADV_IDLE_ACC_Value "[FIX] Anticipo Base in Idle con cambio accoppiato" VALUE 0xFC71DC Scalar_SWORD 0 AdvnTDC_CM_sfix16_En4_degree -20 60 /end CHARACTERISTIC
/begin CHARACTERISTIC jfADV_IST_Enable "[FIX] Fix finale sullo delta anticipo" VALUE 0xFC71DA Scalar_UBYTE 0 AdvnTDC_CM_FixEnableT 171 218 /end CHARACTERISTIC
/begin CHARACTERISTIC jfADV_IST_Value "[FIX] Fix finale sullo delta anticipo" VALUE 0xFC71D8 Scalar_SWORD 0 AdvnTDC_CM_sfix16_En4_degree -20 60 /end CHARACTERISTIC
/begin CHARACTERISTIC jfADV_KNOCK_CORR_Enable "[FIX] Fix for the knock control contribute correction on the next cylinder spark advance " VALUE 0xFC71D6 Scalar_UBYTE 0 AdvnTDC_CM_FixEnableT 171 218 /end CHARACTERISTIC
/begin CHARACTERISTIC jfADV_KNOCK_CORR_Value "[FIX] Fix for the knock control contribute correction on the next cylinder spark advance " VALUE 0xFC71D4 Scalar_SWORD 0 AdvnTDC_CM_sfix16_En4_degree -20 60 /end CHARACTERISTIC
/begin CHARACTERISTIC jfADV_MIN_IST_Enable "[FIX] Anticipo minimo permesso - calcolato con motore regimato e lambda = 1 - per avere combustione nei cilindri" VALUE 0xFC71D2 Scalar_UBYTE 0 AdvnTDC_CM_FixEnableT 171 218 /end CHARACTERISTIC
/begin CHARACTERISTIC jfADV_MIN_IST_Value "[FIX] Anticipo minimo permesso - calcolato con motore regimato e lambda = 1 - per avere combustione nei cilindri" VALUE 0xFC71D0 Scalar_SWORD 0 AdvnTDC_CM_sfix16_En4_degree -20 60 /end CHARACTERISTIC
/begin CHARACTERISTIC jfADV_NORMAL_Enable "[FIX] Anticipo in modo Normal (non in Full Load)" VALUE 0xFC71CE Scalar_UBYTE 0 AdvnTDC_CM_FixEnableT 171 218 /end CHARACTERISTIC
/begin CHARACTERISTIC jfADV_NORMAL_Value "[FIX] Anticipo in modo Normal (non in Full Load)" VALUE 0xFC71CC Scalar_SWORD 0 AdvnTDC_CM_sfix16_En4_degree -20 60 /end CHARACTERISTIC
/begin CHARACTERISTIC jfADV_OPT_Enable "[FIX] Fix finale sullo anticipo ottimo a cui si ha la Coppia Erogata massima" VALUE 0xFC71CB Scalar_UBYTE 0 AdvnTDC_CM_FixEnableT 171 218 /end CHARACTERISTIC
/begin CHARACTERISTIC jfADV_OPT_TB_Enable "[FIX] Tabella Anticipo Ottimo" VALUE 0xFC71CA Scalar_UBYTE 0 AdvnTDC_CM_FixEnableT 171 218 /end CHARACTERISTIC
/begin CHARACTERISTIC jfADV_OPT_TB_Value "[FIX] Tabella Anticipo Ottimo" VALUE 0xFC71C8 Scalar_SWORD 0 AdvnTDC_CM_sfix16_En4_degree -20 60 /end CHARACTERISTIC
/begin CHARACTERISTIC jfADV_OPT_Value "[FIX] Fix finale sullo anticipo ottimo a cui si ha la Coppia Erogata massima" VALUE 0xFC71C6 Scalar_SWORD 0 AdvnTDC_CM_sfix16_En4_degree -20 60 /end CHARACTERISTIC
/begin CHARACTERISTIC jfADV_SEMPL_BASE_Enable "[FIX] Tabella Semplificata Anticipo Base" VALUE 0xFC71C4 Scalar_UBYTE 0 AdvnTDC_CM_FixEnableT 171 218 /end CHARACTERISTIC
/begin CHARACTERISTIC jfADV_SEMPL_BASE_Value "[FIX] Tabella Semplificata Anticipo Base" VALUE 0xFC71C2 Scalar_SWORD 0 AdvnTDC_CM_sfix16_En4_degree -20 60 /end CHARACTERISTIC
/begin CHARACTERISTIC jfADV_Value "[FIX] Fix finale sull\'anticipo" VALUE 0xFC71C0 Scalar_SWORD 0 AdvnTDC_CM_sfix16_En4_degree -20 60 /end CHARACTERISTIC
/begin CHARACTERISTIC jfDW_TIME "[FIX] Fix finale sul Dwell Time" VALUE 0xFC7208 Scalar_UWORD 0 DwlTDC_Symbol_CM_ufix16_E1_us 0 6000 /end CHARACTERISTIC
/begin CHARACTERISTIC jfDW_TIME_EnFix "[FIX] Fix finale sul Dwell Time" VALUE 0xFC7206 Scalar_UWORD 0 DwlTDC_Symbol_CM_FixEnableT 171 218 /end CHARACTERISTIC
/begin CHARACTERISTIC jfDW_TIME_OL "[FIX] Vettore di interpolazione per il calcolo del dwell time" VALUE 0xFC7204 Scalar_UWORD 0 DwlTDC_Symbol_CM_ufix16_E1_us 0 6000 /end CHARACTERISTIC
/begin CHARACTERISTIC jfDW_TIME_OL_EnFix "[FIX] Vettore di interpolazione per il calcolo del dwell time" VALUE 0xFC7202 Scalar_UWORD 0 DwlTDC_Symbol_CM_FixEnableT 171 218 /end CHARACTERISTIC
/begin CHARACTERISTIC jfNORM_IN_Enable "[FIX] Passo di incremento del contatore nelle transizioni lente in ingresso al modo Normal" VALUE 0xFC71BE Scalar_UBYTE 0 AdvnTDC_CM_FixEnableT 171 218 /end CHARACTERISTIC
/begin CHARACTERISTIC jfNORM_IN_Value "[FIX] Passo di incremento del contatore nelle transizioni lente in ingresso al modo Normal" VALUE 0xFC71BC Scalar_UWORD 0 AdvnTDC_CM_uint16_adm 0 32000 /end CHARACTERISTIC
/begin CHARACTERISTIC jfNORM_OUT_Enable "[FIX] Passo di incremento del contatore nelle transizioni lente in uscita dal modo Normal" VALUE 0xFC71BA Scalar_UBYTE 0 AdvnTDC_CM_FixEnableT 171 218 /end CHARACTERISTIC
/begin CHARACTERISTIC jfNORM_OUT_Value "[FIX] Passo di incremento del contatore nelle transizioni lente in uscita dal modo Normal" VALUE 0xFC71B8 Scalar_UWORD 0 AdvnTDC_CM_uint16_adm 0 32000 /end CHARACTERISTIC
/begin CHARACTERISTIC jfPID_DADVIDLE_Enable "[FIX] Fix su eventuale contributo PID per Delta anticipo in Low Idle" VALUE 0xFC71B6 Scalar_UBYTE 0 AdvnTDC_CM_FixEnableT 171 218 /end CHARACTERISTIC
/begin CHARACTERISTIC jfPID_DADVIDLE_Value "[FIX] Fix su eventuale contributo PID per Delta anticipo in Low Idle" VALUE 0xFC71B4 Scalar_SWORD 0 AdvnTDC_CM_sfix16_En4_degree -20 60 /end CHARACTERISTIC
/begin CHARACTERISTIC jfTAIR_ETASP_COR_Enable "[FIX] Correzione dello anticipo in funzione di TAir ed ETASP" VALUE 0xFC71B2 Scalar_UBYTE 0 AdvnTDC_CM_FixEnableT 171 218 /end CHARACTERISTIC
/begin CHARACTERISTIC jfTAIR_ETASP_COR_Value "[FIX] Correzione dello anticipo in funzione di TAir ed ETASP" VALUE 0xFC71B0 Scalar_SWORD 0 AdvnTDC_CM_sfix16_En4_degree -20 60 /end CHARACTERISTIC
/begin CHARACTERISTIC jfTAIR_RPM_CORR_Enable "[FIX] Correzione dello anticipo in funzione di TAir e RPM" VALUE 0xFC71AE Scalar_UBYTE 0 AdvnTDC_CM_FixEnableT 171 218 /end CHARACTERISTIC
/begin CHARACTERISTIC jfTAIR_RPM_CORR_Value "[FIX] Correzione dello anticipo in funzione di TAir e RPM" VALUE 0xFC71AC Scalar_SWORD 0 AdvnTDC_CM_sfix16_En4_degree -20 60 /end CHARACTERISTIC
/begin CHARACTERISTIC jfTANK_TORQUE_Enable "[FIX] Riserva di Coppia veloce con delta anticipo" VALUE 0xFC71AA Scalar_UBYTE 0 AdvnTDC_CM_FixEnableT 171 218 /end CHARACTERISTIC
/begin CHARACTERISTIC jfTANK_TORQUE_Value "[FIX] Riserva di Coppia veloce con delta anticipo" VALUE 0xFC71A8 Scalar_SWORD 0 AdvnTDC_CM_sfix16_En4_degree -20 60 /end CHARACTERISTIC
/begin CHARACTERISTIC jfTH2O_ETASP_COR_Enable "[FIX] Correzione dello anticipo in funzione di TH2O ed ETASP" VALUE 0xFC71A6 Scalar_UBYTE 0 AdvnTDC_CM_FixEnableT 171 218 /end CHARACTERISTIC
/begin CHARACTERISTIC jfTH2O_ETASP_COR_Value "[FIX] Correzione dello anticipo in funzione di TH2O ed ETASP" VALUE 0xFC71A4 Scalar_SWORD 0 AdvnTDC_CM_sfix16_En4_degree -20 60 /end CHARACTERISTIC
/begin AXIS_PTS jkADV_IDLE_AC_NR "[YBK] Anticipo Base in Idle con cambio accoppiato" 0xFC7194 NO_INPUT_QUANTITY Lookup2D_X_UWORD 0 AdvnTDC_CM_uint16_rpm 8 0 10000 /end AXIS_PTS
/begin AXIS_PTS jkADV_IDLE_AC_NT "[XBK] Anticipo Base in Idle con cambio accoppiato" 0xFC7184 NO_INPUT_QUANTITY Lookup2D_X_UWORD 0 AdvnTDC_CM_uint16_rpm 8 0 10000 /end AXIS_PTS
/begin AXIS_PTS jkADV_MIN_IST_ET "[XBK] Anticipo minimo permesso - calcolato con motore regimato e lambda = 1 - per avere combustione nei cilindri" 0xFC7174 NO_INPUT_QUANTITY Lookup2D_X_UWORD 0 AdvnTDC_CM_ufix16_En10_adm 8 0 3 /end AXIS_PTS
/begin AXIS_PTS jkADV_MIN_IST_RP "[YBK] Anticipo minimo permesso - calcolato con motore regimato e lambda = 1 - per avere combustione nei cilindri" 0xFC7164 NO_INPUT_QUANTITY Lookup2D_X_UWORD 0 AdvnTDC_CM_uint16_rpm 8 0 10000 /end AXIS_PTS
/begin AXIS_PTS jkETASP_1 "[YBK] Correzione dello anticipo in funzione di TAir ed ETASP" 0xFC714C NO_INPUT_QUANTITY Lookup2D_X_UWORD 0 AdvnTDC_CM_ufix16_En10_adm 12 0 3 /end AXIS_PTS
/begin AXIS_PTS jkETASP_2 "[YBK] Anticipo in modo Normal (non in Full Load)" 0xFC712C NO_INPUT_QUANTITY Lookup2D_X_UWORD 0 AdvnTDC_CM_ufix16_En10_adm 16 0 3 /end AXIS_PTS
/begin AXIS_PTS jkETASP_3 "[YBK] Correzione dello anticipo in funzione di TH2O ed ETASP" 0xFC7114 NO_INPUT_QUANTITY Lookup2D_X_UWORD 0 AdvnTDC_CM_ufix16_En10_adm 12 0 3 /end AXIS_PTS
/begin AXIS_PTS jkETASP_BASE "[YBK] Tabella Semplificata Anticipo Base" 0xFC70F4 NO_INPUT_QUANTITY Lookup2D_X_UWORD 0 AdvnTDC_CM_ufix16_En10_adm 16 0 3 /end AXIS_PTS
/begin AXIS_PTS jkETASP_OPT "[YBK] Tabella Anticipo Ottimo" 0xFC70D4 NO_INPUT_QUANTITY Lookup2D_X_UWORD 0 AdvnTDC_CM_ufix16_En10_adm 16 0 3 /end AXIS_PTS
/begin AXIS_PTS jkETA_TANK_TORQUE "[XBK] Riserva di Coppia veloce con delta anticipo" 0xFC70C4 jsEtaTankTorque Lookup1D_X_UWORD 0 AdvnTDC_CM_ufix16_En7_adm 8 0 1 /end AXIS_PTS
/begin AXIS_PTS jkLAMBOBT "[XBK] Correction on in function of Lambda target (qsLamObtFin)" 0xFC70B4 NO_INPUT_QUANTITY Lookup1D_X_UWORD 0 AdvnTDC_CM_ufix16_En10_adm 8 0.015625 1.599609375 /end AXIS_PTS
/begin AXIS_PTS jkPERC_EGR_OBJ "[YBK] Spark Advance Correction due to EGR presence" 0xFC7094 NO_INPUT_QUANTITY Lookup2D_X_UWORD 0 AdvnTDC_CM_ufix16_En3__ 16 0 100 /end AXIS_PTS
/begin AXIS_PTS jkRPM_1 "[YBK] Correzione dello anticipo in funzione di TAir e RPM" 0xFC7074 NO_INPUT_QUANTITY Lookup2D_X_UWORD 0 AdvnTDC_CM_uint16_rpm 16 0 10000 /end AXIS_PTS
/begin AXIS_PTS jkRPM_3 "[XBK] Spark Advance Correction due to EGR presence" 0xFC7054 NO_INPUT_QUANTITY Lookup2D_X_UWORD 0 AdvnTDC_CM_uint16_rpm 16 0 10000 /end AXIS_PTS
/begin AXIS_PTS jkRPM_4 "[XBK] Passo di incremento del contatore nelle transizioni lente in ingresso al modo Normal" 0xFC7034 NO_INPUT_QUANTITY Lookup1D_X_UWORD 0 AdvnTDC_CM_uint16_rpm 16 0 10000 /end AXIS_PTS
/begin AXIS_PTS jkRPM_5 "[XBK] Passo di incremento del contatore nelle transizioni lente in uscita dal modo Normal" 0xFC7014 NO_INPUT_QUANTITY Lookup1D_X_UWORD 0 AdvnTDC_CM_uint16_rpm 16 0 10000 /end AXIS_PTS
/begin AXIS_PTS jkRPM_6 "[XBK] Anticipo Base in Cutoff" 0xFC6FF4 NO_INPUT_QUANTITY Lookup1D_X_UWORD 0 AdvnTDC_CM_uint16_rpm 16 0 10000 /end AXIS_PTS
/begin AXIS_PTS jkRPM_8 "[XBK] Anticipo nel modo motore Crank" 0xFC6FE4 NO_INPUT_QUANTITY Lookup2D_X_UWORD 0 AdvnTDC_CM_uint16_rpm 8 0 10000 /end AXIS_PTS
/begin AXIS_PTS jkRPM_9 "[XBK] Anticipo in modo Normal (non in Full Load)" 0xFC6FC4 NO_INPUT_QUANTITY Lookup2D_X_UWORD 0 AdvnTDC_CM_uint16_rpm 16 0 10000 /end AXIS_PTS
/begin AXIS_PTS jkRPM_BASE "[XBK] Tabella Semplificata Anticipo Base" 0xFC6FA4 NO_INPUT_QUANTITY Lookup2D_X_UWORD 0 AdvnTDC_CM_uint16_rpm 16 0 10000 /end AXIS_PTS
/begin AXIS_PTS jkRPM_OPT "[XBK] Tabella Anticipo Ottimo" 0xFC6F84 NO_INPUT_QUANTITY Lookup2D_X_UWORD 0 AdvnTDC_CM_uint16_rpm 16 0 10000 /end AXIS_PTS
/begin AXIS_PTS jkTAIR_1 "[XBK] Correzione dello anticipo in funzione di TAir ed ETASP" 0xFC6F64 NO_INPUT_QUANTITY Lookup2D_X_UWORD 0 AdvnTDC_CM_ufix16_Bn40_degC 16 -40 130 /end AXIS_PTS
/begin AXIS_PTS jkTAIR_2 "[XBK] Correzione dello anticipo in funzione di TAir e RPM" 0xFC6F44 NO_INPUT_QUANTITY Lookup2D_X_UWORD 0 AdvnTDC_CM_ufix16_Bn40_degC 16 -40 130 /end AXIS_PTS
/begin AXIS_PTS jkTH2O_1 "[XBK] Correzione dello anticipo in funzione di TH2O ed ETASP" 0xFC6F24 NO_INPUT_QUANTITY Lookup2D_X_UWORD 0 AdvnTDC_CM_ufix16_Bn40_degC 16 -40 140 /end AXIS_PTS
/begin AXIS_PTS jkTH2O_2 "[YBK] Anticipo nel modo motore Crank" 0xFC6F14 NO_INPUT_QUANTITY Lookup2D_X_UWORD 0 AdvnTDC_CM_ufix16_Bn40_degC 8 -40 140 /end AXIS_PTS
/begin AXIS_PTS jkVBPW_1 "[XBK] Vettore di interpolazione per il calcolo del dwell time" 0xFC722A NO_INPUT_QUANTITY Lookup1D_X_UWORD 0 DwlTDC_Symbol_CM_ufix16_S50_mV 16 12000 36000 /end AXIS_PTS
/begin CHARACTERISTIC jsADV_FULL_SEL "Selettore modalità calcolo anticipo (1=modalità vecchia, 0=modalità nuova semplificata)" VALUE 0xFC6F12 Scalar_BOOLEAN 0 AdvnTDC_CM_boolean_adm 0 1 /end CHARACTERISTIC
/begin CHARACTERISTIC jsADV_TDC_CNT "Numero di PMS in cui avvengono le transizioni lente tra modi motore" VALUE 0xFC6F10 Scalar_UWORD 0 AdvnTDC_CM_uint16_adm 1 32000 /end CHARACTERISTIC
/begin MEASUREMENT jsAdv "Anticipo accensione" SWORD DiagSym100ms_CM_sfix16_En4_degree 0 0 -20 60 ECU_ADDRESS 0x40003080 /end MEASUREMENT
/begin MEASUREMENT jsAdvAirRpmC "Test Point sulla variabile jsAdvAirRpmC" SWORD AdvnTDC_CM_sfix16_En4_degree 0 0 -20 60 ECU_ADDRESS 0x40003142 /end MEASUREMENT
/begin MEASUREMENT jsAdvBase "Anticipo base a monte del filtraggio di gradiente" SWORD AdvnTDC_CM_sfix16_En4_degree 0 0 -20 60 ECU_ADDRESS 0x40003140 /end MEASUREMENT
/begin MEASUREMENT jsAdvBaseFilt "Test Point sulla variabile jsAdvBaseFilt" SWORD AdvnTDC_CM_sfix16_En4_degree 0 0 -20 60 ECU_ADDRESS 0x4000313E /end MEASUREMENT
/begin MEASUREMENT jsAdvBaseFull "Anticipo base calcolato attraverso la vecchia modalità completa" SWORD AdvnTDC_CM_sfix16_En4_degree 0 0 -20 60 ECU_ADDRESS 0x4000313C /end MEASUREMENT
/begin MEASUREMENT jsAdvBaseIdle "Anticipo base in Low Idle (pre-contributi di Controllo)" SWORD Idle4ms_CM_sfix16_En4_degree 0 0 -20 60 ECU_ADDRESS 0x4000307C /end MEASUREMENT
/begin MEASUREMENT jsAdvBaseLast "Test Point sulla variabile jsAdvBaseLast" SWORD AdvnTDC_CM_sfix16_En4_degree 0 0 -20 60 ECU_ADDRESS 0x4000313A /end MEASUREMENT
/begin MEASUREMENT jsAdvBaseNorm "Test Point sulla variabile jsAdvBaseNorm" SWORD AdvnTDC_CM_sfix16_En4_degree 0 0 -20 60 ECU_ADDRESS 0x40003138 /end MEASUREMENT
/begin MEASUREMENT jsAdvBaseTmp "Test Point sulla variabile jsAdvBaseTmp" SWORD AdvnTDC_CM_sfix16_En4_degree 0 0 -20 60 ECU_ADDRESS 0x40003136 /end MEASUREMENT
/begin MEASUREMENT jsAdvBaseTrans "Test Point sulla variabile jsAdvBaseTrans" SWORD AdvnTDC_CM_sfix16_En4_degree 0 0 -20 60 ECU_ADDRESS 0x40003134 /end MEASUREMENT
/begin MEASUREMENT jsAdvCorr2Tmp "Test Point successivo alla variabile jsAdvCorrTmp" SWORD AdvnTDC_CM_sfix16_En4_degree 0 0 -20 60 ECU_ADDRESS 0x40003132 /end MEASUREMENT
/begin MEASUREMENT jsAdvCorrLamObt "[OUT] Correction on in function of Lambda target (qsLamObtFin)" SWORD AdvnTDC_CM_sfix16_En4_degree 0 0 -20 60 ECU_ADDRESS 0x40003130 /end MEASUREMENT
/begin MEASUREMENT jsAdvCorrTmp "Test Point sulla variabile jsAdvTemp1" SWORD AdvnTDC_CM_sfix16_En4_degree 0 0 -20 60 ECU_ADDRESS 0x4000312E /end MEASUREMENT
/begin MEASUREMENT jsAdvCorrection "Test Point sulla variabile jsAdvCorrection" SWORD AdvnTDC_CM_sfix16_En4_degree 0 0 -20 60 ECU_ADDRESS 0x4000312C /end MEASUREMENT
/begin MEASUREMENT jsAdvCrk "[OUT] Anticipo nel modo motore Crank" SWORD AdvnTDC_CM_sfix16_En4_degree 0 0 -20 60 ECU_ADDRESS 0x4000312A /end MEASUREMENT
/begin MEASUREMENT jsAdvCutoff "[OUT] Anticipo Base in Cutoff" SWORD AdvnTDC_CM_sfix16_En4_degree 0 0 -20 60 ECU_ADDRESS 0x40003128 /end MEASUREMENT
/begin MEASUREMENT jsAdvEgrCor "[OUT] Spark Advance Correction due to EGR presence" SWORD AdvnTDC_CM_sfix16_En4_degree 0 0 -20 60 ECU_ADDRESS 0x40003126 /end MEASUREMENT
/begin MEASUREMENT jsAdvIdleAcc "[OUT] Anticipo Base in Idle con cambio accoppiato" SWORD AdvnTDC_CM_sfix16_En4_degree 0 0 -20 60 ECU_ADDRESS 0x40003124 /end MEASUREMENT
/begin MEASUREMENT jsAdvMinIst "[OUT] Anticipo minimo permesso - calcolato con motore regimato e lambda = 1 - per avere combustione nei cilindri" SWORD AdvnTDC_CM_sfix16_En4_degree 0 0 -20 60 ECU_ADDRESS 0x40003122 /end MEASUREMENT
/begin MEASUREMENT jsAdvNormal "[OUT] Anticipo in modo Normal (non in Full Load)" SWORD AdvnTDC_CM_sfix16_En4_degree 0 0 -20 60 ECU_ADDRESS 0x40003120 /end MEASUREMENT
/begin MEASUREMENT jsAdvOpt "Anticipo ottimo a cui si ha la Coppia Erogata massima" SWORD IgntTDC_CM_sfix16_En4_degree 0 0 -20 60 ECU_ADDRESS 0x4000307A /end MEASUREMENT
/begin MEASUREMENT jsAdvOptTb "[OUT] Tabella Anticipo Ottimo" SWORD AdvnTDC_CM_sfix16_En4_degree 0 0 -20 60 ECU_ADDRESS 0x4000311E /end MEASUREMENT
/begin MEASUREMENT jsAdvSempl "Anticipo base calcolato attraverso la nuova modalità semplificata" SWORD AdvnTDC_CM_sfix16_En4_degree 0 0 -20 60 ECU_ADDRESS 0x4000311C /end MEASUREMENT
/begin MEASUREMENT jsAdvSemplBase "[OUT] Tabella Semplificata Anticipo Base" SWORD AdvnTDC_CM_sfix16_En4_degree 0 0 -20 60 ECU_ADDRESS 0x4000311A /end MEASUREMENT
/begin MEASUREMENT jsAdvTDCCnt "Test Point sulla variabile jsAdvTDCCnt" UWORD AdvnTDC_CM_uint16_adm 0 0 0 32000 ECU_ADDRESS 0x40003118 /end MEASUREMENT
/begin MEASUREMENT jsAdvTDCCntOld "Test Point sulla variabile jsAdvTDCCntOld" UWORD AdvnTDC_CM_uint16_adm 0 0 0 32000 ECU_ADDRESS 0x40003116 /end MEASUREMENT
/begin MEASUREMENT jsAdvTDCCntTot "Test Point sulla variabile jsAdvTDCCntTot" UWORD AdvnTDC_CM_uint16_adm 0 0 0 32000 ECU_ADDRESS 0x40003114 /end MEASUREMENT
/begin MEASUREMENT jsAdvTemp "Anticipo accensione senza correzione knock control" SWORD IgntTDC_CM_sfix16_En4_degree 0 0 -20 60 ECU_ADDRESS 0x40003078 /end MEASUREMENT
/begin MEASUREMENT jsAdv_FullLift "Anticipo accensione calcolato dal ramo TE-TM" SWORD AdvnTDC_CM_sfix16_En4_degree 0 0 -20 60 ECU_ADDRESS 0x40003112 /end MEASUREMENT
/begin MEASUREMENT jsAdv_VVA "Anticipo accensione calcolato dal ramo TE-TM" SWORD AdvnTDC_CM_sfix16_En4_degree 0 0 -20 60 ECU_ADDRESS 0x40003110 /end MEASUREMENT
/begin MEASUREMENT jsChgMod "Test Point sulla variabile jsChgMod" UBYTE AdvnTDC_CM_boolean_adm 0 0 0 1 ECU_ADDRESS 0x4000310E /end MEASUREMENT
/begin CHARACTERISTIC jsDADV_TANK_TORQUE "Attivazione contributo minimo per attingere dalla riserva di coppia in caso di sottoregimi" VALUE 0xFC6F0E Scalar_BOOLEAN 0 AdvnTDC_CM_boolean_adm 0 1 /end CHARACTERISTIC
/begin MEASUREMENT jsDAdvIst "Delta anticipo (ritardo in gradi rispetto ad anticipo ottimo (a cui si ha la Coppia Erogata massima)" SWORD IgntTDC_CM_sfix16_En4_degree 0 0 -20 60 ECU_ADDRESS 0x4000307E /end MEASUREMENT
/begin MEASUREMENT jsDAdvTankEn "Abilitazione della riserva di coppia al minimo" UBYTE AdvnTDC_CM_boolean_adm 0 0 0 1 ECU_ADDRESS 0x4000310D /end MEASUREMENT
/begin MEASUREMENT jsDwTime "Dwell Time" UWORD IgntTDC_CM_ufix16_E1_us 0 0 0 6000 ECU_ADDRESS 0x40003076 /end MEASUREMENT
/begin MEASUREMENT jsDwTimeOl "[OUT] Vettore di interpolazione per il calcolo del dwell time" UWORD DwlTDC_Symbol_CM_ufix16_E1_us 0 0 0 6000 ECU_ADDRESS 0x40003144 /end MEASUREMENT
/begin MEASUREMENT jsEnabCnt "Test Point sulla variabile jsEnabCnt" UBYTE AdvnTDC_CM_boolean_adm 0 0 0 1 ECU_ADDRESS 0x4000310C /end MEASUREMENT
/begin MEASUREMENT jsEtaTankTorque "Abilitazione della riserva di coppia al minimo" UWORD AdvnTDC_CM_ufix16_En7_adm 0 0 0 1 ECU_ADDRESS 0x4000310A /end MEASUREMENT
/begin MEASUREMENT jsFlagCutEntry "Flag Riconoscimento di fine raccordo anticipo in caso di entrata in cut-off" UBYTE IgntTDC_CM_boolean_adm 0 0 0 1 ECU_ADDRESS 0x40003071 /end MEASUREMENT
/begin MEASUREMENT jsFlagEndTrans "Test Point sulla variabile jsFlagEndTrans" UBYTE AdvnTDC_CM_boolean_adm 0 0 0 1 ECU_ADDRESS 0x40003108 /end MEASUREMENT
/begin CHARACTERISTIC jsGEX_COIL_CRK "Extra guadagno sul dwell time nel modo Crank" VALUE 0xFC7200 Scalar_UWORD 0 DwlTDC_Symbol_CM_ufix16_En7_adm 0 3 /end CHARACTERISTIC
/begin CHARACTERISTIC jsMAX_DELTA_NEG "Massima variazione negativa dello anticipo accensione." VALUE 0xFC6F0C Scalar_UWORD 0 AdvnTDC_CM_ufix16_En4_degree 0 20 /end CHARACTERISTIC
/begin CHARACTERISTIC jsMAX_DELTA_POS "Massima variazione positiva dello anticipo accensione." VALUE 0xFC6F0A Scalar_UWORD 0 AdvnTDC_CM_ufix16_En4_degree 0 20 /end CHARACTERISTIC
/begin CHARACTERISTIC jsMAX_IGN_ADV "Valore massimo dello anticipo accensione" VALUE 0xFC6F08 Scalar_SWORD 0 AdvnTDC_CM_sfix16_En4_degree -20 60 /end CHARACTERISTIC
/begin CHARACTERISTIC jsMIN_IGN_ADV "Valore minimo dello anticipo accensione" VALUE 0xFC6F06 Scalar_SWORD 0 AdvnTDC_CM_sfix16_En4_degree -20 60 /end CHARACTERISTIC
/begin MEASUREMENT jsNormIn "[OUT] Passo di incremento del contatore nelle transizioni lente in ingresso al modo Normal" UWORD AdvnTDC_CM_uint16_adm 0 0 0 32000 ECU_ADDRESS 0x40003106 /end MEASUREMENT
/begin MEASUREMENT jsNormOut "[OUT] Passo di incremento del contatore nelle transizioni lente in uscita dal modo Normal" UWORD AdvnTDC_CM_uint16_adm 0 0 0 32000 ECU_ADDRESS 0x40003104 /end MEASUREMENT
/begin CHARACTERISTIC jsRPM_TANK_TORQUE "Attivazione contributo minimo per attingere dalla riserva di coppia in caso di sottoregimi" VALUE 0xFC6F04 Scalar_UWORD 0 AdvnTDC_CM_uint16_adm 0 10000 /end CHARACTERISTIC
/begin CHARACTERISTIC jsTHROT_ADV_BASE "Soglia sulla posizione farfalla per abilitare transitori veloci" VALUE 0xFC6F02 Scalar_UWORD 0 AdvnTDC_CM_ufix16_En3_degree 0 90 /end CHARACTERISTIC
/begin CHARACTERISTIC jsTHR_TAIR_1 "Soglia superiore di attivazione della correzione dello anticipo in funzione di TAir e RPM" VALUE 0xFC6F00 Scalar_UWORD 0 AdvnTDC_CM_ufix16_Bn40_degC -40 130 /end CHARACTERISTIC
/begin CHARACTERISTIC jsTHR_TAIR_2 "Soglia inferiore di disabilitazione della correzione dello anticipo in funzione di TAir e RPM" VALUE 0xFC6EFE Scalar_UWORD 0 AdvnTDC_CM_ufix16_Bn40_degC -40 130 /end CHARACTERISTIC
/begin MEASUREMENT jsTairEtaspCor "[OUT] Correzione dello anticipo in funzione di TAir ed ETASP" SWORD AdvnTDC_CM_sfix16_En4_degree 0 0 -20 60 ECU_ADDRESS 0x40003102 /end MEASUREMENT
/begin MEASUREMENT jsTairRpmCorr "[OUT] Correzione dello anticipo in funzione di TAir e RPM" SWORD AdvnTDC_CM_sfix16_En4_degree 0 0 -20 60 ECU_ADDRESS 0x40003100 /end MEASUREMENT
/begin MEASUREMENT jsTankTorque "[OUT] Riserva di Coppia veloce con delta anticipo" SWORD AdvnTDC_CM_sfix16_En4_degree 0 0 -20 60 ECU_ADDRESS 0x400030FE /end MEASUREMENT
/begin MEASUREMENT jsTh2oEtaspCor "[OUT] Correzione dello anticipo in funzione di TH2O ed ETASP" SWORD AdvnTDC_CM_sfix16_En4_degree 0 0 -20 60 ECU_ADDRESS 0x400030FC /end MEASUREMENT
/begin CHARACTERISTIC jtADV_CRK "Anticipo nel modo motore Crank" MAP 0xFC6E7E Lookup2D_WORD 0 AdvnTDC_CM_sfix16_En4_degree -20 60
 /begin AXIS_DESCR COM_AXIS NO_INPUT_QUANTITY AdvnTDC_CM_ufix16_Bn40_degC 8 -40 140 AXIS_PTS_REF jkTH2O_2 /end AXIS_DESCR
 /begin AXIS_DESCR COM_AXIS NO_INPUT_QUANTITY AdvnTDC_CM_uint16_rpm 8 0 10000 AXIS_PTS_REF jkRPM_8 /end AXIS_DESCR
/end CHARACTERISTIC
/begin CHARACTERISTIC jtADV_EGR_COR "Spark Advance Correction due to EGR presence" MAP 0xFC6C7E Lookup2D_WORD 0 AdvnTDC_CM_sfix16_En4_degree -20 60
 /begin AXIS_DESCR COM_AXIS NO_INPUT_QUANTITY AdvnTDC_CM_ufix16_En3__ 16 0 100 AXIS_PTS_REF jkPERC_EGR_OBJ /end AXIS_DESCR
 /begin AXIS_DESCR COM_AXIS NO_INPUT_QUANTITY AdvnTDC_CM_uint16_rpm 16 0 10000 AXIS_PTS_REF jkRPM_3 /end AXIS_DESCR
/end CHARACTERISTIC
/begin CHARACTERISTIC jtADV_IDLE_ACC "Anticipo Base in Idle con cambio accoppiato" MAP 0xFC6BFE Lookup2D_WORD 0 AdvnTDC_CM_sfix16_En4_degree -20 60
 /begin AXIS_DESCR COM_AXIS NO_INPUT_QUANTITY AdvnTDC_CM_uint16_rpm 8 0 10000 AXIS_PTS_REF jkADV_IDLE_AC_NR /end AXIS_DESCR
 /begin AXIS_DESCR COM_AXIS NO_INPUT_QUANTITY AdvnTDC_CM_uint16_rpm 8 0 10000 AXIS_PTS_REF jkADV_IDLE_AC_NT /end AXIS_DESCR
/end CHARACTERISTIC
/begin CHARACTERISTIC jtADV_MIN_IST "Anticipo minimo permesso - calcolato con motore regimato e lambda = 1 - per avere combustione nei cilindri" MAP 0xFC6B7E Lookup2D_WORD 0 AdvnTDC_CM_sfix16_En4_degree -20 60
 /begin AXIS_DESCR COM_AXIS NO_INPUT_QUANTITY AdvnTDC_CM_uint16_rpm 8 0 10000 AXIS_PTS_REF jkADV_MIN_IST_RP /end AXIS_DESCR
 /begin AXIS_DESCR COM_AXIS NO_INPUT_QUANTITY AdvnTDC_CM_ufix16_En10_adm 8 0 3 AXIS_PTS_REF jkADV_MIN_IST_ET /end AXIS_DESCR
/end CHARACTERISTIC
/begin CHARACTERISTIC jtADV_NORMAL "Anticipo in modo Normal (non in Full Load)" MAP 0xFC697E Lookup2D_WORD 0 AdvnTDC_CM_sfix16_En4_degree -20 60
 /begin AXIS_DESCR COM_AXIS NO_INPUT_QUANTITY AdvnTDC_CM_ufix16_En10_adm 16 0 3 AXIS_PTS_REF jkETASP_2 /end AXIS_DESCR
 /begin AXIS_DESCR COM_AXIS NO_INPUT_QUANTITY AdvnTDC_CM_uint16_rpm 16 0 10000 AXIS_PTS_REF jkRPM_9 /end AXIS_DESCR
/end CHARACTERISTIC
/begin CHARACTERISTIC jtADV_OPT_TB "Tabella Anticipo Ottimo" MAP 0xFC677E Lookup2D_WORD 0 AdvnTDC_CM_sfix16_En4_degree -20 60
 /begin AXIS_DESCR COM_AXIS NO_INPUT_QUANTITY AdvnTDC_CM_ufix16_En10_adm 16 0 3 AXIS_PTS_REF jkETASP_OPT /end AXIS_DESCR
 /begin AXIS_DESCR COM_AXIS NO_INPUT_QUANTITY AdvnTDC_CM_uint16_rpm 16 0 10000 AXIS_PTS_REF jkRPM_OPT /end AXIS_DESCR
/end CHARACTERISTIC
/begin CHARACTERISTIC jtADV_SEMPL_BASE "Tabella Semplificata Anticipo Base" MAP 0xFC657E Lookup2D_WORD 0 AdvnTDC_CM_sfix16_En4_degree -20 60
 /begin AXIS_DESCR COM_AXIS NO_INPUT_QUANTITY AdvnTDC_CM_ufix16_En10_adm 16 0 3 AXIS_PTS_REF jkETASP_BASE /end AXIS_DESCR
 /begin AXIS_DESCR COM_AXIS NO_INPUT_QUANTITY AdvnTDC_CM_uint16_rpm 16 0 10000 AXIS_PTS_REF jkRPM_BASE /end AXIS_DESCR
/end CHARACTERISTIC
/begin CHARACTERISTIC jtTAIR_ETASP_COR "Correzione dello anticipo in funzione di TAir ed ETASP" MAP 0xFC63FE Lookup2D_WORD 0 AdvnTDC_CM_sfix16_En4_degree -20 60
 /begin AXIS_DESCR COM_AXIS NO_INPUT_QUANTITY AdvnTDC_CM_ufix16_En10_adm 12 0 3 AXIS_PTS_REF jkETASP_1 /end AXIS_DESCR
 /begin AXIS_DESCR COM_AXIS NO_INPUT_QUANTITY AdvnTDC_CM_ufix16_Bn40_degC 16 -40 130 AXIS_PTS_REF jkTAIR_1 /end AXIS_DESCR
/end CHARACTERISTIC
/begin CHARACTERISTIC jtTAIR_RPM_CORR "Correzione dello anticipo in funzione di TAir e RPM" MAP 0xFC61FE Lookup2D_WORD 0 AdvnTDC_CM_sfix16_En4_degree -20 60
 /begin AXIS_DESCR COM_AXIS NO_INPUT_QUANTITY AdvnTDC_CM_uint16_rpm 16 0 10000 AXIS_PTS_REF jkRPM_1 /end AXIS_DESCR
 /begin AXIS_DESCR COM_AXIS NO_INPUT_QUANTITY AdvnTDC_CM_ufix16_Bn40_degC 16 -40 130 AXIS_PTS_REF jkTAIR_2 /end AXIS_DESCR
/end CHARACTERISTIC
/begin CHARACTERISTIC jtTH2O_ETASP_COR "Correzione dello anticipo in funzione di TH2O ed ETASP" MAP 0xFC607E Lookup2D_WORD 0 AdvnTDC_CM_sfix16_En4_degree -20 60
 /begin AXIS_DESCR COM_AXIS NO_INPUT_QUANTITY AdvnTDC_CM_ufix16_En10_adm 12 0 3 AXIS_PTS_REF jkETASP_3 /end AXIS_DESCR
 /begin AXIS_DESCR COM_AXIS NO_INPUT_QUANTITY AdvnTDC_CM_ufix16_Bn40_degC 16 -40 140 AXIS_PTS_REF jkTH2O_1 /end AXIS_DESCR
/end CHARACTERISTIC
/begin CHARACTERISTIC jvADV_CORR_LAMOBT "Correction on in function of Lambda target (qsLamObtFin)" CURVE 0xFC606E Lookup1D_WORD 0 AdvnTDC_CM_sfix16_En4_degree -20 60
 /begin AXIS_DESCR COM_AXIS NO_INPUT_QUANTITY AdvnTDC_CM_ufix16_En10_adm 8 0.015625 1.599609375 AXIS_PTS_REF jkLAMBOBT /end AXIS_DESCR
/end CHARACTERISTIC
/begin CHARACTERISTIC jvADV_CUTOFF "Anticipo Base in Cutoff" CURVE 0xFC604E Lookup1D_WORD 0 AdvnTDC_CM_sfix16_En4_degree -20 60
 /begin AXIS_DESCR COM_AXIS NO_INPUT_QUANTITY AdvnTDC_CM_uint16_rpm 16 0 10000 AXIS_PTS_REF jkRPM_6 /end AXIS_DESCR
/end CHARACTERISTIC
/begin CHARACTERISTIC jvDW_TIME_OL "Vettore di interpolazione per il calcolo del dwell time" CURVE 0xFC720A Lookup1D_UWORD 0 DwlTDC_Symbol_CM_ufix16_E1_us 0 6000
 /begin AXIS_DESCR COM_AXIS NO_INPUT_QUANTITY DwlTDC_Symbol_CM_ufix16_S50_mV 16 12000 36000 AXIS_PTS_REF jkVBPW_1 /end AXIS_DESCR
/end CHARACTERISTIC
/begin CHARACTERISTIC jvNORM_IN "Passo di incremento del contatore nelle transizioni lente in ingresso al modo Normal" CURVE 0xFC602E Lookup1D_UWORD 0 AdvnTDC_CM_uint16_adm 0 32000
 /begin AXIS_DESCR COM_AXIS NO_INPUT_QUANTITY AdvnTDC_CM_uint16_rpm 16 0 10000 AXIS_PTS_REF jkRPM_4 /end AXIS_DESCR
/end CHARACTERISTIC
/begin CHARACTERISTIC jvNORM_OUT "Passo di incremento del contatore nelle transizioni lente in uscita dal modo Normal" CURVE 0xFC600E Lookup1D_UWORD 0 AdvnTDC_CM_uint16_adm 0 32000
 /begin AXIS_DESCR COM_AXIS NO_INPUT_QUANTITY AdvnTDC_CM_uint16_rpm 16 0 10000 AXIS_PTS_REF jkRPM_5 /end AXIS_DESCR
/end CHARACTERISTIC
/begin CHARACTERISTIC jvTANK_TORQUE "Riserva di Coppia veloce con delta anticipo" CURVE 0xFC5FFE Lookup1D_WORD 0 AdvnTDC_CM_sfix16_En4_degree -20 60
 /begin AXIS_DESCR COM_AXIS jsEtaTankTorque AdvnTDC_CM_ufix16_En7_adm 8 0 1 AXIS_PTS_REF jkETA_TANK_TORQUE /end AXIS_DESCR
/end CHARACTERISTIC
/begin CHARACTERISTIC kfADV_KNOCK_CORR1_Enable "[FIX] Knock control contribute for spark advance of cylinder 1" VALUE 0xFC971E Scalar_UBYTE 0 KnockControlTDC_CM_FixEnableT 171 218 /end CHARACTERISTIC
/begin CHARACTERISTIC kfADV_KNOCK_CORR1_Value "[FIX] Knock control contribute for spark advance of cylinder 1" VALUE 0xFC971C Scalar_SWORD 0 KnockControlTDC_CM_sfix16_En4_degree -20 45 /end CHARACTERISTIC
/begin CHARACTERISTIC kfADV_KNOCK_CORR2_Enable "[FIX] Knock control contribute for spark advance of cylinder 2" VALUE 0xFC971A Scalar_UBYTE 0 KnockControlTDC_CM_FixEnableT 171 218 /end CHARACTERISTIC
/begin CHARACTERISTIC kfADV_KNOCK_CORR2_Value "[FIX] Knock control contribute for spark advance of cylinder 2" VALUE 0xFC9718 Scalar_SWORD 0 KnockControlTDC_CM_sfix16_En4_degree -20 45 /end CHARACTERISTIC
/begin CHARACTERISTIC kfADV_KNOCK_CORR3_Enable "[FIX] Knock control contribute for spark advance of cylinder 3" VALUE 0xFC9716 Scalar_UBYTE 0 KnockControlTDC_CM_FixEnableT 171 218 /end CHARACTERISTIC
/begin CHARACTERISTIC kfADV_KNOCK_CORR3_Value "[FIX] Knock control contribute for spark advance of cylinder 3" VALUE 0xFC9714 Scalar_SWORD 0 KnockControlTDC_CM_sfix16_En4_degree -20 45 /end CHARACTERISTIC
/begin CHARACTERISTIC kfADV_KNOCK_CORR4_Enable "[FIX] Knock control contribute for spark advance of cylinder 4" VALUE 0xFC9712 Scalar_UBYTE 0 KnockControlTDC_CM_FixEnableT 171 218 /end CHARACTERISTIC
/begin CHARACTERISTIC kfADV_KNOCK_CORR4_Value "[FIX] Knock control contribute for spark advance of cylinder 4" VALUE 0xFC9710 Scalar_SWORD 0 KnockControlTDC_CM_sfix16_En4_degree -20 45 /end CHARACTERISTIC
/begin CHARACTERISTIC kfADV_KNOCK_CORR5_Enable "[FIX] Knock control contribute for spark advance of cylinder 5" VALUE 0xFC970E Scalar_UBYTE 0 KnockControlTDC_CM_FixEnableT 171 218 /end CHARACTERISTIC
/begin CHARACTERISTIC kfADV_KNOCK_CORR5_Value "[FIX] Knock control contribute for spark advance of cylinder 5" VALUE 0xFC970C Scalar_SWORD 0 KnockControlTDC_CM_sfix16_En4_degree -20 45 /end CHARACTERISTIC
/begin CHARACTERISTIC kfADV_KNOCK_CORR6_Enable "[FIX] Knock control contribute for spark advance of cylinder 6" VALUE 0xFC970A Scalar_UBYTE 0 KnockControlTDC_CM_FixEnableT 171 218 /end CHARACTERISTIC
/begin CHARACTERISTIC kfADV_KNOCK_CORR6_Value "[FIX] Knock control contribute for spark advance of cylinder 6" VALUE 0xFC9708 Scalar_SWORD 0 KnockControlTDC_CM_sfix16_En4_degree -20 45 /end CHARACTERISTIC
/begin CHARACTERISTIC kfADV_KNOCK_CORR7_Enable "[FIX] Knock control contribute for spark advance of cylinder 7" VALUE 0xFC9706 Scalar_UBYTE 0 KnockControlTDC_CM_FixEnableT 171 218 /end CHARACTERISTIC
/begin CHARACTERISTIC kfADV_KNOCK_CORR7_Value "[FIX] Knock control contribute for spark advance of cylinder 7" VALUE 0xFC9704 Scalar_SWORD 0 KnockControlTDC_CM_sfix16_En4_degree -20 45 /end CHARACTERISTIC
/begin CHARACTERISTIC kfADV_KNOCK_CORR8_Enable "[FIX] Knock control contribute for spark advance of cylinder 8" VALUE 0xFC9702 Scalar_UBYTE 0 KnockControlTDC_CM_FixEnableT 171 218 /end CHARACTERISTIC
/begin CHARACTERISTIC kfADV_KNOCK_CORR8_Value "[FIX] Knock control contribute for spark advance of cylinder 8" VALUE 0xFC9700 Scalar_SWORD 0 KnockControlTDC_CM_sfix16_En4_degree -20 45 /end CHARACTERISTIC
/begin CHARACTERISTIC kfADV_WIN_ADV_Enable "[FIX ENABLE] Integration Window advantage for jsAdv compensation" VALUE 0xFC96FE Scalar_UBYTE 0 KnockConfigTDC_CM_FixEnableT 171 218 /end CHARACTERISTIC
/begin CHARACTERISTIC kfADV_WIN_ADV_Value "[FIX VALUE] Integration Window advantage for jsAdv compensation" VALUE 0xFC96FC Scalar_SWORD 0 KnockConfigTDC_CM_sfix16_En4_degree -20 45 /end CHARACTERISTIC
/begin CHARACTERISTIC kfDET_EN_CRANK_Enable "[FIX ENABLE] Bypass for the knock detection enable in function of the cranking state" VALUE 0xFC96FA Scalar_UBYTE 0 KnockDetectionTDC_CM_FixEnableT 171 218 /end CHARACTERISTIC
/begin CHARACTERISTIC kfDET_EN_CRANK_Value "[FIX VALUE] Bypass for the knock detection enable in function of the cranking state" VALUE 0xFC96F9 Scalar_BOOLEAN 0 KnockDetectionTDC_CM_boolean_adm 0 1 /end CHARACTERISTIC
/begin CHARACTERISTIC kfDET_EN_CUTOFF_Enable "[FIX ENABLE] Bypass for the knock detection enable in function of the cut-off state" VALUE 0xFC96F8 Scalar_UBYTE 0 KnockDetectionTDC_CM_FixEnableT 171 218 /end CHARACTERISTIC
/begin CHARACTERISTIC kfDET_EN_CUTOFF_Value "[FIX VALUE] Bypass for the knock detection enable in function of the cut-off state" VALUE 0xFC96F7 Scalar_BOOLEAN 0 KnockDetectionTDC_CM_boolean_adm 0 1 /end CHARACTERISTIC
/begin CHARACTERISTIC kfDET_EN_DER_RPM_Enable "[FIX ENABLE] Bypass for the knock detection enable in function of the RPM derivate" VALUE 0xFC96F6 Scalar_UBYTE 0 KnockDetectionTDC_CM_FixEnableT 171 218 /end CHARACTERISTIC
/begin CHARACTERISTIC kfDET_EN_DER_RPM_Value "[FIX VALUE] Bypass for the knock detection enable in function of the RPM derivate" VALUE 0xFC96F5 Scalar_BOOLEAN 0 KnockDetectionTDC_CM_boolean_adm 0 1 /end CHARACTERISTIC
/begin CHARACTERISTIC kfHARD_KNOCK_THR_CYL1_Enable "[FIX] [OUT] Hard Knock Threshold in function of RPM and Etasp  for Cylinder 1" VALUE 0xFC96F4 Scalar_UBYTE 0 KnockDetectionTDC_CM_FixEnableT 171 218 /end CHARACTERISTIC
/begin CHARACTERISTIC kfHARD_KNOCK_THR_CYL1_Value "[FIX] [OUT] Hard Knock Threshold in function of RPM and Etasp for Cylinder 1" VALUE 0xFC96F0 Scalar_FLOAT32_IEEE 0 KnockDetectionTDC_CM_single_adm 0 10000000000 /end CHARACTERISTIC
/begin CHARACTERISTIC kfHARD_KNOCK_THR_CYL2_Enable "[FIX] [OUT] Hard Knock Threshold in function of RPM and Etasp  for Cylinder 2" VALUE 0xFC96EC Scalar_UBYTE 0 KnockDetectionTDC_CM_FixEnableT 171 218 /end CHARACTERISTIC
/begin CHARACTERISTIC kfHARD_KNOCK_THR_CYL2_Value "[FIX] [OUT] Hard Knock Threshold in function of RPM and Etasp for Cylinder 2" VALUE 0xFC96E8 Scalar_FLOAT32_IEEE 0 KnockDetectionTDC_CM_single_adm 0 10000000000 /end CHARACTERISTIC
/begin CHARACTERISTIC kfHARD_KNOCK_THR_CYL3_Enable "[FIX] [OUT] Hard Knock Threshold in function of RPM and Etasp  for Cylinder 3" VALUE 0xFC96E4 Scalar_UBYTE 0 KnockDetectionTDC_CM_FixEnableT 171 218 /end CHARACTERISTIC
/begin CHARACTERISTIC kfHARD_KNOCK_THR_CYL3_Value "[FIX] [OUT] Hard Knock Threshold in function of RPM and Etasp for Cylinder 3" VALUE 0xFC96E0 Scalar_FLOAT32_IEEE 0 KnockDetectionTDC_CM_single_adm 0 10000000000 /end CHARACTERISTIC
/begin CHARACTERISTIC kfHARD_KNOCK_THR_CYL4_Enable "[FIX] [OUT] Hard Knock Threshold in function of RPM and Etasp  for Cylinder 4" VALUE 0xFC96DC Scalar_UBYTE 0 KnockDetectionTDC_CM_FixEnableT 171 218 /end CHARACTERISTIC
/begin CHARACTERISTIC kfHARD_KNOCK_THR_CYL4_Value "[FIX] [OUT] Hard Knock Threshold in function of RPM and Etasp for Cylinder 4" VALUE 0xFC96D8 Scalar_FLOAT32_IEEE 0 KnockDetectionTDC_CM_single_adm 0 10000000000 /end CHARACTERISTIC
/begin CHARACTERISTIC kfHARD_KNOCK_THR_CYL5_Enable "[FIX] [OUT] Hard Knock Threshold in function of RPM and Etasp  for Cylinder 5" VALUE 0xFC96D4 Scalar_UBYTE 0 KnockDetectionTDC_CM_FixEnableT 171 218 /end CHARACTERISTIC
/begin CHARACTERISTIC kfHARD_KNOCK_THR_CYL5_Value "[FIX] [OUT] Hard Knock Threshold in function of RPM and Etasp for Cylinder 5" VALUE 0xFC96D0 Scalar_FLOAT32_IEEE 0 KnockDetectionTDC_CM_single_adm 0 10000000000 /end CHARACTERISTIC
/begin CHARACTERISTIC kfHARD_KNOCK_THR_CYL6_Enable "[FIX] [OUT] Hard Knock Threshold in function of RPM and Etasp  for Cylinder 6" VALUE 0xFC96CC Scalar_UBYTE 0 KnockDetectionTDC_CM_FixEnableT 171 218 /end CHARACTERISTIC
/begin CHARACTERISTIC kfHARD_KNOCK_THR_CYL6_Value "[FIX] [OUT] Hard Knock Threshold in function of RPM and Etasp for Cylinder 6" VALUE 0xFC96C8 Scalar_FLOAT32_IEEE 0 KnockDetectionTDC_CM_single_adm 0 10000000000 /end CHARACTERISTIC
/begin CHARACTERISTIC kfHARD_KNOCK_THR_CYL7_Enable "[FIX] [OUT] Hard Knock Threshold in function of RPM and Etasp  for Cylinder 7" VALUE 0xFC96C4 Scalar_UBYTE 0 KnockDetectionTDC_CM_FixEnableT 171 218 /end CHARACTERISTIC
/begin CHARACTERISTIC kfHARD_KNOCK_THR_CYL7_Value "[FIX] [OUT] Hard Knock Threshold in function of RPM and Etasp for Cylinder 7" VALUE 0xFC96C0 Scalar_FLOAT32_IEEE 0 KnockDetectionTDC_CM_single_adm 0 10000000000 /end CHARACTERISTIC
/begin CHARACTERISTIC kfHARD_KNOCK_THR_CYL8_Enable "[FIX] [OUT] Hard Knock Threshold in function of RPM and Etasp  for Cylinder 8" VALUE 0xFC96BC Scalar_UBYTE 0 KnockDetectionTDC_CM_FixEnableT 171 218 /end CHARACTERISTIC
/begin CHARACTERISTIC kfHARD_KNOCK_THR_CYL8_Value "[FIX] [OUT] Hard Knock Threshold in function of RPM and Etasp for Cylinder 8" VALUE 0xFC96B8 Scalar_FLOAT32_IEEE 0 KnockDetectionTDC_CM_single_adm 0 10000000000 /end CHARACTERISTIC
/begin CHARACTERISTIC kfHARD_KNOCK_THR_Enable "[FIX] hard Knock Threshold in function of RPM and Etasp" VALUE 0xFC96B4 Scalar_UBYTE 0 KnockDetectionTDC_CM_FixEnableT 171 218 /end CHARACTERISTIC
/begin CHARACTERISTIC kfHARD_KNOCK_THR_Value "[FIX] Hard Knock Threshold in function of RPM and Etasp" VALUE 0xFC96B0 Scalar_FLOAT32_IEEE 0 KnockDetectionTDC_CM_single_adm 0 10000000000 /end CHARACTERISTIC
/begin CHARACTERISTIC kfSOFT_KNOCK_THR_CYL1_Enable "[FIX] [OUT] Soft Knock Threshold in function of RPM and Etasp  for Cylinder 1" VALUE 0xFC96AC Scalar_UBYTE 0 KnockDetectionTDC_CM_FixEnableT 171 218 /end CHARACTERISTIC
/begin CHARACTERISTIC kfSOFT_KNOCK_THR_CYL1_Value "[FIX] [OUT] Soft Knock Threshold in function of RPM and Etasp for Cylinder 1" VALUE 0xFC96A8 Scalar_FLOAT32_IEEE 0 KnockDetectionTDC_CM_single_adm 0 10000000000 /end CHARACTERISTIC
/begin CHARACTERISTIC kfSOFT_KNOCK_THR_CYL2_Enable "[FIX] [OUT] Soft Knock Threshold in function of RPM and Etasp  for Cylinder 2" VALUE 0xFC96A4 Scalar_UBYTE 0 KnockDetectionTDC_CM_FixEnableT 171 218 /end CHARACTERISTIC
/begin CHARACTERISTIC kfSOFT_KNOCK_THR_CYL2_Value "[FIX] [OUT] Soft Knock Threshold in function of RPM and Etasp for Cylinder 2" VALUE 0xFC96A0 Scalar_FLOAT32_IEEE 0 KnockDetectionTDC_CM_single_adm 0 10000000000 /end CHARACTERISTIC
/begin CHARACTERISTIC kfSOFT_KNOCK_THR_CYL3_Enable "[FIX] [OUT] Soft Knock Threshold in function of RPM and Etasp  for Cylinder 3" VALUE 0xFC969C Scalar_UBYTE 0 KnockDetectionTDC_CM_FixEnableT 171 218 /end CHARACTERISTIC
/begin CHARACTERISTIC kfSOFT_KNOCK_THR_CYL3_Value "[FIX] [OUT] Soft Knock Threshold in function of RPM and Etasp for Cylinder 3" VALUE 0xFC9698 Scalar_FLOAT32_IEEE 0 KnockDetectionTDC_CM_single_adm 0 10000000000 /end CHARACTERISTIC
/begin CHARACTERISTIC kfSOFT_KNOCK_THR_CYL4_Enable "[FIX] [OUT] Soft Knock Threshold in function of RPM and Etasp  for Cylinder 4" VALUE 0xFC9694 Scalar_UBYTE 0 KnockDetectionTDC_CM_FixEnableT 171 218 /end CHARACTERISTIC
/begin CHARACTERISTIC kfSOFT_KNOCK_THR_CYL4_Value "[FIX] [OUT] Soft Knock Threshold in function of RPM and Etasp for Cylinder 4" VALUE 0xFC9690 Scalar_FLOAT32_IEEE 0 KnockDetectionTDC_CM_single_adm 0 10000000000 /end CHARACTERISTIC
/begin CHARACTERISTIC kfSOFT_KNOCK_THR_CYL5_Enable "[FIX] [OUT] Soft Knock Threshold in function of RPM and Etasp  for Cylinder 5" VALUE 0xFC968C Scalar_UBYTE 0 KnockDetectionTDC_CM_FixEnableT 171 218 /end CHARACTERISTIC
/begin CHARACTERISTIC kfSOFT_KNOCK_THR_CYL5_Value "[FIX] [OUT] Soft Knock Threshold in function of RPM and Etasp for Cylinder 5" VALUE 0xFC9688 Scalar_FLOAT32_IEEE 0 KnockDetectionTDC_CM_single_adm 0 10000000000 /end CHARACTERISTIC
/begin CHARACTERISTIC kfSOFT_KNOCK_THR_CYL6_Enable "[FIX] [OUT] Soft Knock Threshold in function of RPM and Etasp  for Cylinder 6" VALUE 0xFC9684 Scalar_UBYTE 0 KnockDetectionTDC_CM_FixEnableT 171 218 /end CHARACTERISTIC
/begin CHARACTERISTIC kfSOFT_KNOCK_THR_CYL6_Value "[FIX] [OUT] Soft Knock Threshold in function of RPM and Etasp for Cylinder 6" VALUE 0xFC9680 Scalar_FLOAT32_IEEE 0 KnockDetectionTDC_CM_single_adm 0 10000000000 /end CHARACTERISTIC
/begin CHARACTERISTIC kfSOFT_KNOCK_THR_CYL7_Enable "[FIX] [OUT] Soft Knock Threshold in function of RPM and Etasp  for Cylinder 7" VALUE 0xFC967C Scalar_UBYTE 0 KnockDetectionTDC_CM_FixEnableT 171 218 /end CHARACTERISTIC
/begin CHARACTERISTIC kfSOFT_KNOCK_THR_CYL7_Value "[FIX] [OUT] Soft Knock Threshold in function of RPM and Etasp for Cylinder 7" VALUE 0xFC9678 Scalar_FLOAT32_IEEE 0 KnockDetectionTDC_CM_single_adm 0 10000000000 /end CHARACTERISTIC
/begin CHARACTERISTIC kfSOFT_KNOCK_THR_CYL8_Enable "[FIX] [OUT] Soft Knock Threshold in function of RPM and Etasp  for Cylinder 8" VALUE 0xFC9674 Scalar_UBYTE 0 KnockDetectionTDC_CM_FixEnableT 171 218 /end CHARACTERISTIC
/begin CHARACTERISTIC kfSOFT_KNOCK_THR_CYL8_Value "[FIX] [OUT] Soft Knock Threshold in function of RPM and Etasp for Cylinder 8" VALUE 0xFC9670 Scalar_FLOAT32_IEEE 0 KnockDetectionTDC_CM_single_adm 0 10000000000 /end CHARACTERISTIC
/begin CHARACTERISTIC kfSOFT_KNOCK_THR_Enable "[FIX] Soft Knock Threshold in function of RPM and Etasp" VALUE 0xFC966C Scalar_UBYTE 0 KnockDetectionTDC_CM_FixEnableT 171 218 /end CHARACTERISTIC
/begin CHARACTERISTIC kfSOFT_KNOCK_THR_Value "[FIX] Soft Knock Threshold in function of RPM and Etasp" VALUE 0xFC9668 Scalar_FLOAT32_IEEE 0 KnockDetectionTDC_CM_single_adm 0 10000000000 /end CHARACTERISTIC
/begin CHARACTERISTIC kfSRI_GAIN_CORR_Enable "[FIX ENABLE] Gain for SRI normalization" VALUE 0xFC9664 Scalar_UBYTE 0 KnockDetectionTDC_CM_FixEnableT 171 218 /end CHARACTERISTIC
/begin CHARACTERISTIC kfSRI_GAIN_CORR_Value "[FIX VALUE] Gain for SRI normalization" VALUE 0xFC9660 Scalar_FLOAT32_IEEE 0 KnockDetectionTDC_CM_single_adm 0 1 /end CHARACTERISTIC
/begin CHARACTERISTIC kfSRI_LOG10_MEAN_Enable "[FIX ENABLE] Mean Value that must be subtracted to the Log10(SRI) value in order to normalize the distribution in function of the engine working point" VALUE 0xFC965C Scalar_UBYTE 0 KnockDetectionTDC_CM_FixEnableT 171 218 /end CHARACTERISTIC
/begin CHARACTERISTIC kfSRI_LOG10_MEAN_Value "[FIX VALUE] Mean Value that must be subtracted to the Log10(SRI) value in order to normalize the distribution in function of the engine working point" VALUE 0xFC9658 Scalar_FLOAT32_IEEE 0 KnockDetectionTDC_CM_single_adm 0 10000000000 /end CHARACTERISTIC
/begin CHARACTERISTIC kfSRI_OFFSET_CORR_Enable "[FIX ENABLE] Offset for SRI normalization" VALUE 0xFC9654 Scalar_UBYTE 0 KnockDetectionTDC_CM_FixEnableT 171 218 /end CHARACTERISTIC
/begin CHARACTERISTIC kfSRI_OFFSET_CORR_Value "[FIX VALUE] Offset for SRI normalization" VALUE 0xFC9650 Scalar_FLOAT32_IEEE 0 KnockDetectionTDC_CM_single_adm -20 20 /end CHARACTERISTIC
/begin AXIS_PTS kkETASP "[Y_BKP] Rendimento Volumetrico, breakpoints per definizione soglie Soft Knock" 0xFC9640 NO_INPUT_QUANTITY Lookup2D_X_UWORD 0 KnockDetectionTDC_CM_ufix16_En10_adm 8 0 3 /end AXIS_PTS
/begin AXIS_PTS kkRPM "[X_BKP] Velocitá di rotazione motore, breakpoints per definizione soglie Soft Knock" 0xFC9630 NO_INPUT_QUANTITY Lookup2D_X_UWORD 0 KnockDetectionTDC_CM_uint16_rpm 8 0 10000 /end AXIS_PTS
/begin CHARACTERISTIC ksABS_VAL_EN "Selector for the log10 filtering structure: 0 = only positive values; 1 = absolute values " VALUE 0xFC962E Scalar_BOOLEAN 0 KnockDetectionTDC_CM_boolean_adm 0 1 /end CHARACTERISTIC
/begin CHARACTERISTIC ksADV_DECREMENT "Knock control spark advance Decrement " VALUE 0xFC962C Scalar_SWORD 0 KnockControlTDC_CM_sfix16_En4_degree 0 10 /end CHARACTERISTIC
/begin CHARACTERISTIC ksADV_INCREMENT "Knock control spark advance increment" VALUE 0xFC962A Scalar_SWORD 0 KnockControlTDC_CM_sfix16_En4_degree 0 10 /end CHARACTERISTIC
/begin MEASUREMENT ksAdvKnockCorr "Knock control correction for the next cylinder" SWORD IgntTDC_CM_sfix16_En4_degree 0 0 -20 45 ECU_ADDRESS 0x40003470 /end MEASUREMENT
/begin CHARACTERISTIC ksCONTROL_ENABLE "Knock control Enable" VALUE 0xFC9628 Scalar_BOOLEAN 0 KnockControlTDC_CM_boolean_adm 0 1 /end CHARACTERISTIC
/begin CHARACTERISTIC ksCYL_GAIN_COEFF "Vector for the association between cylinders and actual Gain (Coefficient B0) of gain stage of the Knock decimation filters chain." VAL_BLK 0xFC9608 Scalar_LONG 0 KnockConfigTDC_CM_sfix32_En23_adm -1 0.999999880791 MATRIX_DIM 8 /end CHARACTERISTIC
/begin CHARACTERISTIC ksCYL_PREGAIN "Vector for the association between cylinders and PreGain of gain stage of the Knock decimation filters chain." VAL_BLK 0xFC9600 Scalar_UBYTE 0 KnockConfigTDC_CM_tKnockEqadcPreGain_adm 0 2 MATRIX_DIM 8 /end CHARACTERISTIC
/begin CHARACTERISTIC ksCYL_SCALE_FACTOR "Vector for the association between cylinders and scale factor of gain stage of the Knock decimation filters chain." VAL_BLK 0xFC95F8 Scalar_UBYTE 0 KnockConfigTDC_CM_tKnockScaleFactor_adm 0 4 MATRIX_DIM 8 /end CHARACTERISTIC
/begin CHARACTERISTIC ksCYL_SENSOR_DAN "Vector for the association between cylinders and knockSensor." VAL_BLK 0xFC95F0 Scalar_UBYTE 0 KnockConfigTDC_CM_tKnockEqadcDan_adm 0 1 MATRIX_DIM 8 /end CHARACTERISTIC
/begin MEASUREMENT ksControlEnable "Knock control activation flag" UBYTE KnockTDC_CM_boolean_adm 0 0 0 1 ECU_ADDRESS 0x4000346B /end MEASUREMENT
/begin MEASUREMENT ksCylSensorDAN "Channel Knock Sensor corresponding to next cylinder analysis." UBYTE KnockTDC_CM_tKnockEqadcDan_adm 0 0 0 1 ECU_ADDRESS 0x4000346A /end MEASUREMENT
/begin CHARACTERISTIC ksDER_RPM_MAX "Maximum value for the RPM derivate in order to enable the knock detection" VALUE 0xFC95EC Scalar_SWORD 0 KnockDetectionTDC_CM_int16_rpm_s -32000 32000 /end CHARACTERISTIC
/begin CHARACTERISTIC ksDER_RPM_MIN "Minimum value for the RPM derivate in order to enable the knock detection" VALUE 0xFC95EA Scalar_SWORD 0 KnockDetectionTDC_CM_int16_rpm_s -32000 32000 /end CHARACTERISTIC
/begin CHARACTERISTIC ksDETECTION_ENABLE "Knock Detection Enable" VALUE 0xFC95E8 Scalar_BOOLEAN 0 KnockDetectionTDC_CM_boolean_adm 0 1 /end CHARACTERISTIC
/begin CHARACTERISTIC ksDET_ETASP_MIN "Min value of ETASP to activate the knock Detection" VALUE 0xFC95E6 Scalar_UWORD 0 KnockDetectionTDC_CM_ufix16_En10_adm 0 3 /end CHARACTERISTIC
/begin CHARACTERISTIC ksDET_RPM_MIN "Min value of RPM to activate the knock Detection" VALUE 0xFC95E4 Scalar_UWORD 0 KnockDetectionTDC_CM_uint16_rpm 0 10000 /end CHARACTERISTIC
/begin MEASUREMENT ksDetEnable "Flag that indicates Knock Detection enabling conditions are satisfied" UBYTE KnockDetectionTDC_CM_boolean_adm 0 0 0 1 ECU_ADDRESS 0x400036AC /end MEASUREMENT
/begin CHARACTERISTIC ksETASP_MAX "Max value of ETASP to activate the knock Control" VALUE 0xFC95E2 Scalar_UWORD 0 KnockControlTDC_CM_ufix16_En10_adm 0 3 /end CHARACTERISTIC
/begin CHARACTERISTIC ksETASP_MIN "Min value of ETASP to activate the knock Control" VALUE 0xFC95E0 Scalar_UWORD 0 KnockControlTDC_CM_ufix16_En10_adm 0 3 /end CHARACTERISTIC
/begin CHARACTERISTIC ksGAIN_CORR_CYL "Gain vector for SRI normalization in function of cylinder" VAL_BLK 0xFC95C0 Scalar_FLOAT32_IEEE 0 KnockDetectionTDC_CM_single_adm 0 1000 MATRIX_DIM 8 /end CHARACTERISTIC
/begin CHARACTERISTIC ksHPF_COEFF "Coefficients for the HPF stage of the Knock decimation filters chain." VAL_BLK 0xFC959C Scalar_LONG 0 KnockConfigTDC_CM_sfix32_En23_adm -1 0.999999880791 MATRIX_DIM 9 /end CHARACTERISTIC
/begin CHARACTERISTIC ksHPF_SCALE_FACTOR "Scale factor for the HPF stage of the Knock decimation filters chain." VALUE 0xFC9598 Scalar_UBYTE 0 KnockConfigTDC_CM_tKnockScaleFactor_adm 0 4 /end CHARACTERISTIC
/begin MEASUREMENT ksHardKnockThrCyl1 "[OUT] Hard Knock Threshold in function of RPM and Etasp for Cylinder 1" FLOAT32_IEEE KnockDetectionTDC_CM_single_adm 0 0 0 10000000000 ECU_ADDRESS 0x400036A8 /end MEASUREMENT
/begin MEASUREMENT ksHardKnockThrCyl2 "[OUT] Hard Knock Threshold in function of RPM and Etasp for Cylinder 2" FLOAT32_IEEE KnockDetectionTDC_CM_single_adm 0 0 0 10000000000 ECU_ADDRESS 0x400036A4 /end MEASUREMENT
/begin MEASUREMENT ksHardKnockThrCyl3 "[OUT] Hard Knock Threshold in function of RPM and Etasp for Cylinder 3" FLOAT32_IEEE KnockDetectionTDC_CM_single_adm 0 0 0 10000000000 ECU_ADDRESS 0x400036A0 /end MEASUREMENT
/begin MEASUREMENT ksHardKnockThrCyl4 "[OUT] Hard Knock Threshold in function of RPM and Etasp for Cylinder 4" FLOAT32_IEEE KnockDetectionTDC_CM_single_adm 0 0 0 10000000000 ECU_ADDRESS 0x4000369C /end MEASUREMENT
/begin MEASUREMENT ksHardKnockThrCyl5 "[OUT] Hard Knock Threshold in function of RPM and Etasp for Cylinder 5" FLOAT32_IEEE KnockDetectionTDC_CM_single_adm 0 0 0 10000000000 ECU_ADDRESS 0x40003698 /end MEASUREMENT
/begin MEASUREMENT ksHardKnockThrCyl6 "[OUT] Hard Knock Threshold in function of RPM and Etasp for Cylinder 6" FLOAT32_IEEE KnockDetectionTDC_CM_single_adm 0 0 0 10000000000 ECU_ADDRESS 0x40003694 /end MEASUREMENT
/begin MEASUREMENT ksHardKnockThrCyl7 "[OUT] Hard Knock Threshold in function of RPM and Etasp for Cylinder 7" FLOAT32_IEEE KnockDetectionTDC_CM_single_adm 0 0 0 10000000000 ECU_ADDRESS 0x40003690 /end MEASUREMENT
/begin MEASUREMENT ksHardKnockThrCyl8 "[OUT] Hard Knock Threshold in function of RPM and Etasp for Cylinder 8" FLOAT32_IEEE KnockDetectionTDC_CM_single_adm 0 0 0 10000000000 ECU_ADDRESS 0x4000368C /end MEASUREMENT
/begin CHARACTERISTIC ksKF_PRE_SRI_NORM "Constant of digital LP Filter for Pre SRI Normalization " VALUE 0xFC9594 Scalar_FLOAT32_IEEE 0 KnockDetectionTDC_CM_single_adm 0 1 /end CHARACTERISTIC
/begin CHARACTERISTIC ksKF_SRI_NORM "Constant of digital LP Filter for SRI normalization" VALUE 0xFC9590 Scalar_FLOAT32_IEEE 0 KnockDetectionTDC_CM_single_adm 0 1 /end CHARACTERISTIC
/begin MEASUREMENT ksKnockDetVector "Vector of Knock Detected Level for all cylinders " UBYTE KnockTDC_CM_tKnockLevel_adm 0 0 0 2 ECU_ADDRESS 0x40003460 MATRIX_DIM 8 /end MEASUREMENT
/begin MEASUREMENT ksKnockDetectionEn "Knock detection enabled when integration window length is greater than 0." UBYTE KnockTDC_CM_boolean_adm 0 0 0 1 ECU_ADDRESS 0x4000346C /end MEASUREMENT
/begin CHARACTERISTIC ksLPF_COEFF "Coefficients for the LPF stage of the Knock decimation filters chain." VAL_BLK 0xFC956C Scalar_LONG 0 KnockConfigTDC_CM_sfix32_En23_adm -1 0.999999880791 MATRIX_DIM 9 /end CHARACTERISTIC
/begin CHARACTERISTIC ksLPF_SCALE_FACTOR "Scale factor for the LPF stage of the Knock decimation filters chain." VALUE 0xFC9568 Scalar_UBYTE 0 KnockConfigTDC_CM_tKnockScaleFactor_adm 0 4 /end CHARACTERISTIC
/begin MEASUREMENT ksNextCyl "Next cylinder for knock management" UBYTE KnockTDC_CM_uint8_adm 0 0 0 7 ECU_ADDRESS 0x4000346F /end MEASUREMENT
/begin MEASUREMENT ksNextTdcIdx "Next TDC index" UBYTE KnockConfigTDC_CM_uint8_adm 0 0 0 7 ECU_ADDRESS 0x40003481 /end MEASUREMENT
/begin CHARACTERISTIC ksOFFSET_CORR_CYL "Offset vector for SRI normalization in function of cylinder" VAL_BLK 0xFC9548 Scalar_FLOAT32_IEEE 0 KnockDetectionTDC_CM_single_adm -10 10 MATRIX_DIM 8 /end CHARACTERISTIC
/begin CHARACTERISTIC ksRPM_MAX "Max value of RPM to activate the knock Control" VALUE 0xFC9546 Scalar_UWORD 0 KnockControlTDC_CM_uint16_rpm 0 10000 /end CHARACTERISTIC
/begin CHARACTERISTIC ksRPM_MIN "Min value of RPM to activate the knock Control" VALUE 0xFC9544 Scalar_UWORD 0 KnockControlTDC_CM_uint16_rpm 0 10000 /end CHARACTERISTIC
/begin CHARACTERISTIC ksSOFT_AUTH_LW_THR "Knock control spark advance authority lower threshold in case of soft knock detection." VALUE 0xFC9542 Scalar_SWORD 0 KnockControlTDC_CM_sfix16_En4_degree -20 20 /end CHARACTERISTIC
/begin CHARACTERISTIC ksSOFT_AUTH_UP_THR "Knock control spark advance authority upper threshold in case of soft knock detection." VALUE 0xFC9540 Scalar_SWORD 0 KnockControlTDC_CM_sfix16_En4_degree -20 20 /end CHARACTERISTIC
/begin MEASUREMENT ksSRILogFiltVect "SRI vector normalized by log10 and mean value subtraction" FLOAT32_IEEE KnockDetectionTDC_CM_single 0 0 0 10000000000 ECU_ADDRESS 0x4000366C MATRIX_DIM 8 /end MEASUREMENT
/begin MEASUREMENT ksSRINormVect "SRI vector normalized to overcome MAPO dynamics" FLOAT32_IEEE KnockDetectionTDC_CM_single 0 0 0 10000000000 ECU_ADDRESS 0x4000364C MATRIX_DIM 8 /end MEASUREMENT
/begin MEASUREMENT ksSRIValidData "Flag that indicates the validity for current cylinder SRI analysis." UBYTE KnockDetectionTDC_CM_boolean_adm 0 0 0 1 ECU_ADDRESS 0x40003644 MATRIX_DIM 8 /end MEASUREMENT
/begin MEASUREMENT ksSRIVect "SRI Vector pre filtered" FLOAT32_IEEE KnockDetectionTDC_CM_single 0 0 0 10000000000 ECU_ADDRESS 0x40003624 MATRIX_DIM 8 /end MEASUREMENT
/begin MEASUREMENT ksSoftKnockThrCyl1 "[OUT] Soft Knock Threshold in function of RPM and Etasp for Cylinder 1" FLOAT32_IEEE KnockDetectionTDC_CM_single_adm 0 0 0 10000000000 ECU_ADDRESS 0x40003620 /end MEASUREMENT
/begin MEASUREMENT ksSoftKnockThrCyl2 "[OUT] Soft Knock Threshold in function of RPM and Etasp for Cylinder 2" FLOAT32_IEEE KnockDetectionTDC_CM_single_adm 0 0 0 10000000000 ECU_ADDRESS 0x4000361C /end MEASUREMENT
/begin MEASUREMENT ksSoftKnockThrCyl3 "[OUT] Soft Knock Threshold in function of RPM and Etasp for Cylinder 3" FLOAT32_IEEE KnockDetectionTDC_CM_single_adm 0 0 0 10000000000 ECU_ADDRESS 0x40003618 /end MEASUREMENT
/begin MEASUREMENT ksSoftKnockThrCyl4 "[OUT] Soft Knock Threshold in function of RPM and Etasp for Cylinder 4" FLOAT32_IEEE KnockDetectionTDC_CM_single_adm 0 0 0 10000000000 ECU_ADDRESS 0x40003614 /end MEASUREMENT
/begin MEASUREMENT ksSoftKnockThrCyl5 "[OUT] Soft Knock Threshold in function of RPM and Etasp for Cylinder 5" FLOAT32_IEEE KnockDetectionTDC_CM_single_adm 0 0 0 10000000000 ECU_ADDRESS 0x40003610 /end MEASUREMENT
/begin MEASUREMENT ksSoftKnockThrCyl6 "[OUT] Soft Knock Threshold in function of RPM and Etasp for Cylinder 6" FLOAT32_IEEE KnockDetectionTDC_CM_single_adm 0 0 0 10000000000 ECU_ADDRESS 0x4000360C /end MEASUREMENT
/begin MEASUREMENT ksSoftKnockThrCyl7 "[OUT] Soft Knock Threshold in function of RPM and Etasp for Cylinder 7" FLOAT32_IEEE KnockDetectionTDC_CM_single_adm 0 0 0 10000000000 ECU_ADDRESS 0x40003608 /end MEASUREMENT
/begin MEASUREMENT ksSoftKnockThrCyl8 "[OUT] Soft Knock Threshold in function of RPM and Etasp for Cylinder 8" FLOAT32_IEEE KnockDetectionTDC_CM_single_adm 0 0 0 10000000000 ECU_ADDRESS 0x40003604 /end MEASUREMENT
/begin CHARACTERISTIC ksWIN_ADV "Advance with respect to TDC, for the current cylinder, for the starting angle of the knock integration window." VALUE 0xFC953E Scalar_SWORD 0 KnockConfigTDC_CM_sfix16_Sp1_degree -45 45 /end CHARACTERISTIC
/begin CHARACTERISTIC ksWIN_LENGTH "Knock integration window length." VALUE 0xFC953C Scalar_UWORD 0 KnockConfigTDC_CM_ufix16_Sp1_degree 0 84 /end CHARACTERISTIC
/begin CHARACTERISTIC ktHARD_KNOCK_THR_CYL1 "Hard Knock Threshold in function of RPM and Etasp  for Cylinder 1" MAP 0xFC943C Lookup2D_FLOAT32_IEEE 0 KnockDetectionTDC_CM_single_adm 0 10000000000
 /begin AXIS_DESCR COM_AXIS NO_INPUT_QUANTITY KnockDetectionTDC_CM_ufix16_En10_adm 8 0 3 AXIS_PTS_REF kkETASP /end AXIS_DESCR
 /begin AXIS_DESCR COM_AXIS NO_INPUT_QUANTITY KnockDetectionTDC_CM_uint16_rpm 8 0 10000 AXIS_PTS_REF kkRPM /end AXIS_DESCR
/end CHARACTERISTIC
/begin CHARACTERISTIC ktHARD_KNOCK_THR_CYL2 "Hard Knock Threshold in function of RPM and Etasp  for Cylinder 2" MAP 0xFC933C Lookup2D_FLOAT32_IEEE 0 KnockDetectionTDC_CM_single_adm 0 10000000000
 /begin AXIS_DESCR COM_AXIS NO_INPUT_QUANTITY KnockDetectionTDC_CM_ufix16_En10_adm 8 0 3 AXIS_PTS_REF kkETASP /end AXIS_DESCR
 /begin AXIS_DESCR COM_AXIS NO_INPUT_QUANTITY KnockDetectionTDC_CM_uint16_rpm 8 0 10000 AXIS_PTS_REF kkRPM /end AXIS_DESCR
/end CHARACTERISTIC
/begin CHARACTERISTIC ktHARD_KNOCK_THR_CYL3 "Hard Knock Threshold in function of RPM and Etasp  for Cylinder 3" MAP 0xFC923C Lookup2D_FLOAT32_IEEE 0 KnockDetectionTDC_CM_single_adm 0 10000000000
 /begin AXIS_DESCR COM_AXIS NO_INPUT_QUANTITY KnockDetectionTDC_CM_ufix16_En10_adm 8 0 3 AXIS_PTS_REF kkETASP /end AXIS_DESCR
 /begin AXIS_DESCR COM_AXIS NO_INPUT_QUANTITY KnockDetectionTDC_CM_uint16_rpm 8 0 10000 AXIS_PTS_REF kkRPM /end AXIS_DESCR
/end CHARACTERISTIC
/begin CHARACTERISTIC ktHARD_KNOCK_THR_CYL4 "Hard Knock Threshold in function of RPM and Etasp  for Cylinder 4" MAP 0xFC913C Lookup2D_FLOAT32_IEEE 0 KnockDetectionTDC_CM_single_adm 0 10000000000
 /begin AXIS_DESCR COM_AXIS NO_INPUT_QUANTITY KnockDetectionTDC_CM_ufix16_En10_adm 8 0 3 AXIS_PTS_REF kkETASP /end AXIS_DESCR
 /begin AXIS_DESCR COM_AXIS NO_INPUT_QUANTITY KnockDetectionTDC_CM_uint16_rpm 8 0 10000 AXIS_PTS_REF kkRPM /end AXIS_DESCR
/end CHARACTERISTIC
/begin CHARACTERISTIC ktHARD_KNOCK_THR_CYL5 "Hard Knock Threshold in function of RPM and Etasp  for Cylinder 5" MAP 0xFC903C Lookup2D_FLOAT32_IEEE 0 KnockDetectionTDC_CM_single_adm 0 10000000000
 /begin AXIS_DESCR COM_AXIS NO_INPUT_QUANTITY KnockDetectionTDC_CM_ufix16_En10_adm 8 0 3 AXIS_PTS_REF kkETASP /end AXIS_DESCR
 /begin AXIS_DESCR COM_AXIS NO_INPUT_QUANTITY KnockDetectionTDC_CM_uint16_rpm 8 0 10000 AXIS_PTS_REF kkRPM /end AXIS_DESCR
/end CHARACTERISTIC
/begin CHARACTERISTIC ktHARD_KNOCK_THR_CYL6 "Hard Knock Threshold in function of RPM and Etasp  for Cylinder 6" MAP 0xFC8F3C Lookup2D_FLOAT32_IEEE 0 KnockDetectionTDC_CM_single_adm 0 10000000000
 /begin AXIS_DESCR COM_AXIS NO_INPUT_QUANTITY KnockDetectionTDC_CM_ufix16_En10_adm 8 0 3 AXIS_PTS_REF kkETASP /end AXIS_DESCR
 /begin AXIS_DESCR COM_AXIS NO_INPUT_QUANTITY KnockDetectionTDC_CM_uint16_rpm 8 0 10000 AXIS_PTS_REF kkRPM /end AXIS_DESCR
/end CHARACTERISTIC
/begin CHARACTERISTIC ktHARD_KNOCK_THR_CYL7 "Hard Knock Threshold in function of RPM and Etasp  for Cylinder 7" MAP 0xFC8E3C Lookup2D_FLOAT32_IEEE 0 KnockDetectionTDC_CM_single_adm 0 10000000000
 /begin AXIS_DESCR COM_AXIS NO_INPUT_QUANTITY KnockDetectionTDC_CM_ufix16_En10_adm 8 0 3 AXIS_PTS_REF kkETASP /end AXIS_DESCR
 /begin AXIS_DESCR COM_AXIS NO_INPUT_QUANTITY KnockDetectionTDC_CM_uint16_rpm 8 0 10000 AXIS_PTS_REF kkRPM /end AXIS_DESCR
/end CHARACTERISTIC
/begin CHARACTERISTIC ktHARD_KNOCK_THR_CYL8 "Hard Knock Threshold in function of RPM and Etasp  for Cylinder 8" MAP 0xFC8D3C Lookup2D_FLOAT32_IEEE 0 KnockDetectionTDC_CM_single_adm 0 10000000000
 /begin AXIS_DESCR COM_AXIS NO_INPUT_QUANTITY KnockDetectionTDC_CM_ufix16_En10_adm 8 0 3 AXIS_PTS_REF kkETASP /end AXIS_DESCR
 /begin AXIS_DESCR COM_AXIS NO_INPUT_QUANTITY KnockDetectionTDC_CM_uint16_rpm 8 0 10000 AXIS_PTS_REF kkRPM /end AXIS_DESCR
/end CHARACTERISTIC
/begin CHARACTERISTIC ktSOFT_KNOCK_THR_CYL1 "Soft Knock Threshold in function of RPM and Etasp  for Cylinder 2" MAP 0xFC8C3C Lookup2D_FLOAT32_IEEE 0 KnockDetectionTDC_CM_single_adm 0 10000000000
 /begin AXIS_DESCR COM_AXIS NO_INPUT_QUANTITY KnockDetectionTDC_CM_ufix16_En10_adm 8 0 3 AXIS_PTS_REF kkETASP /end AXIS_DESCR
 /begin AXIS_DESCR COM_AXIS NO_INPUT_QUANTITY KnockDetectionTDC_CM_uint16_rpm 8 0 10000 AXIS_PTS_REF kkRPM /end AXIS_DESCR
/end CHARACTERISTIC
/begin CHARACTERISTIC ktSOFT_KNOCK_THR_CYL2 "Soft Knock Threshold in function of RPM and Etasp  for Cylinder 2" MAP 0xFC8B3C Lookup2D_FLOAT32_IEEE 0 KnockDetectionTDC_CM_single_adm 0 10000000000
 /begin AXIS_DESCR COM_AXIS NO_INPUT_QUANTITY KnockDetectionTDC_CM_ufix16_En10_adm 8 0 3 AXIS_PTS_REF kkETASP /end AXIS_DESCR
 /begin AXIS_DESCR COM_AXIS NO_INPUT_QUANTITY KnockDetectionTDC_CM_uint16_rpm 8 0 10000 AXIS_PTS_REF kkRPM /end AXIS_DESCR
/end CHARACTERISTIC
/begin CHARACTERISTIC ktSOFT_KNOCK_THR_CYL3 "Soft Knock Threshold in function of RPM and Etasp  for Cylinder 3" MAP 0xFC8A3C Lookup2D_FLOAT32_IEEE 0 KnockDetectionTDC_CM_single_adm 0 10000000000
 /begin AXIS_DESCR COM_AXIS NO_INPUT_QUANTITY KnockDetectionTDC_CM_ufix16_En10_adm 8 0 3 AXIS_PTS_REF kkETASP /end AXIS_DESCR
 /begin AXIS_DESCR COM_AXIS NO_INPUT_QUANTITY KnockDetectionTDC_CM_uint16_rpm 8 0 10000 AXIS_PTS_REF kkRPM /end AXIS_DESCR
/end CHARACTERISTIC
/begin CHARACTERISTIC ktSOFT_KNOCK_THR_CYL4 "Soft Knock Threshold in function of RPM and Etasp  for Cylinder 4" MAP 0xFC893C Lookup2D_FLOAT32_IEEE 0 KnockDetectionTDC_CM_single_adm 0 10000000000
 /begin AXIS_DESCR COM_AXIS NO_INPUT_QUANTITY KnockDetectionTDC_CM_ufix16_En10_adm 8 0 3 AXIS_PTS_REF kkETASP /end AXIS_DESCR
 /begin AXIS_DESCR COM_AXIS NO_INPUT_QUANTITY KnockDetectionTDC_CM_uint16_rpm 8 0 10000 AXIS_PTS_REF kkRPM /end AXIS_DESCR
/end CHARACTERISTIC
/begin CHARACTERISTIC ktSOFT_KNOCK_THR_CYL5 "Soft Knock Threshold in function of RPM and Etasp  for Cylinder 5" MAP 0xFC883C Lookup2D_FLOAT32_IEEE 0 KnockDetectionTDC_CM_single_adm 0 10000000000
 /begin AXIS_DESCR COM_AXIS NO_INPUT_QUANTITY KnockDetectionTDC_CM_ufix16_En10_adm 8 0 3 AXIS_PTS_REF kkETASP /end AXIS_DESCR
 /begin AXIS_DESCR COM_AXIS NO_INPUT_QUANTITY KnockDetectionTDC_CM_uint16_rpm 8 0 10000 AXIS_PTS_REF kkRPM /end AXIS_DESCR
/end CHARACTERISTIC
/begin CHARACTERISTIC ktSOFT_KNOCK_THR_CYL6 "Soft Knock Threshold in function of RPM and Etasp  for Cylinder 6" MAP 0xFC873C Lookup2D_FLOAT32_IEEE 0 KnockDetectionTDC_CM_single_adm 0 10000000000
 /begin AXIS_DESCR COM_AXIS NO_INPUT_QUANTITY KnockDetectionTDC_CM_ufix16_En10_adm 8 0 3 AXIS_PTS_REF kkETASP /end AXIS_DESCR
 /begin AXIS_DESCR COM_AXIS NO_INPUT_QUANTITY KnockDetectionTDC_CM_uint16_rpm 8 0 10000 AXIS_PTS_REF kkRPM /end AXIS_DESCR
/end CHARACTERISTIC
/begin CHARACTERISTIC ktSOFT_KNOCK_THR_CYL7 "Soft Knock Threshold in function of RPM and Etasp  for Cylinder 7" MAP 0xFC863C Lookup2D_FLOAT32_IEEE 0 KnockDetectionTDC_CM_single_adm 0 10000000000
 /begin AXIS_DESCR COM_AXIS NO_INPUT_QUANTITY KnockDetectionTDC_CM_ufix16_En10_adm 8 0 3 AXIS_PTS_REF kkETASP /end AXIS_DESCR
 /begin AXIS_DESCR COM_AXIS NO_INPUT_QUANTITY KnockDetectionTDC_CM_uint16_rpm 8 0 10000 AXIS_PTS_REF kkRPM /end AXIS_DESCR
/end CHARACTERISTIC
/begin CHARACTERISTIC ktSOFT_KNOCK_THR_CYL8 "Soft Knock Threshold in function of RPM and Etasp  for Cylinder 8" MAP 0xFC853C Lookup2D_FLOAT32_IEEE 0 KnockDetectionTDC_CM_single_adm 0 10000000000
 /begin AXIS_DESCR COM_AXIS NO_INPUT_QUANTITY KnockDetectionTDC_CM_ufix16_En10_adm 8 0 3 AXIS_PTS_REF kkETASP /end AXIS_DESCR
 /begin AXIS_DESCR COM_AXIS NO_INPUT_QUANTITY KnockDetectionTDC_CM_uint16_rpm 8 0 10000 AXIS_PTS_REF kkRPM /end AXIS_DESCR
/end CHARACTERISTIC
/begin CHARACTERISTIC mfCRK_PHASE "[FIX] Fix sulla fase di crank" VALUE 0xFC4D4A Scalar_UWORD 0 EngineModeTDC_Symbol_CM_uint8_adm 0 4 /end CHARACTERISTIC
/begin CHARACTERISTIC mfCRK_PHASE_EnFix "[FIX] Fix sulla fase di crank" VALUE 0xFC4D48 Scalar_UWORD 0 EngineModeTDC_Symbol_CM_FixEnableT 171 218 /end CHARACTERISTIC
/begin CHARACTERISTIC mfCUTOFF_STATE "[FIX] Fix sulla fase di cut off" VALUE 0xFC4D46 Scalar_UWORD 0 EngineModeTDC_Symbol_CM_uint8_adm 0 4 /end CHARACTERISTIC
/begin CHARACTERISTIC mfCUTOFF_STATE_EnFix "[FIX] Fix sulla fase di cut off" VALUE 0xFC4D44 Scalar_UWORD 0 EngineModeTDC_Symbol_CM_FixEnableT 171 218 /end CHARACTERISTIC
/begin CHARACTERISTIC mfENG_MOD "[FIX] Fix sul modo motore" VALUE 0xFC4D42 Scalar_UWORD 0 EngineModeTDC_Symbol_CM_uint8_adm 0 4 /end CHARACTERISTIC
/begin CHARACTERISTIC mfENG_MOD_EnFix "[FIX] Fix sul modo motore" VALUE 0xFC4D40 Scalar_UWORD 0 EngineModeTDC_Symbol_CM_FixEnableT 171 218 /end CHARACTERISTIC
/begin CHARACTERISTIC mfIDLE_RPM_DER_OFFST "[FIX] Offset si giri per ingresso in idle con derivata di giri molto negativa" VALUE 0xFC4D3E Scalar_UWORD 0 EngineModeTDC_Symbol_CM_uint16_rpm 0 500 /end CHARACTERISTIC
/begin CHARACTERISTIC mfIDLE_RPM_DER_OFFST_EnFix "[FIX] Offset si giri per ingresso in idle con derivata di giri molto negativa" VALUE 0xFC4D3C Scalar_UWORD 0 EngineModeTDC_Symbol_CM_FixEnableT 171 218 /end CHARACTERISTIC
/begin CHARACTERISTIC mfOFF_RPM_IDLE "[FIX] Fix su Offset da sommare alla soglia superiore del Low Idle" VALUE 0xFC4D3A Scalar_UWORD 0 EngineModeTDC_Symbol_CM_uint16_rpm 0 2000 /end CHARACTERISTIC
/begin CHARACTERISTIC mfOFF_RPM_IDLE_EnFix "[FIX] Fix su Offset da sommare alla soglia superiore del Low Idle" VALUE 0xFC4D38 Scalar_UWORD 0 EngineModeTDC_Symbol_CM_FixEnableT 171 218 /end CHARACTERISTIC
/begin CHARACTERISTIC mfPH2_PMS_CNT "[FIX] Fix sul contatore di PMS in Phase 2" VALUE 0xFC4D36 Scalar_UWORD 0 EngineModeTDC_Symbol_CM_uint16_tdc 0 65535 /end CHARACTERISTIC
/begin CHARACTERISTIC mfPH2_PMS_CNT_EnFix "[FIX] Fix sul contatore di PMS in Phase 2" VALUE 0xFC4D34 Scalar_UWORD 0 EngineModeTDC_Symbol_CM_FixEnableT 171 218 /end CHARACTERISTIC
/begin CHARACTERISTIC mfRPM_CUTOFF "[FIX] Tabella soglia di velocitá di rotazione motore per ingresso CutOff" VALUE 0xFC4D32 Scalar_UWORD 0 EngineModeTDC_Symbol_CM_uint16_rpm 0 10000 /end CHARACTERISTIC
/begin CHARACTERISTIC mfRPM_CUTOFF_EnFix "[FIX] Tabella soglia di velocitá di rotazione motore per ingresso CutOff" VALUE 0xFC4D30 Scalar_UWORD 0 EngineModeTDC_Symbol_CM_FixEnableT 171 218 /end CHARACTERISTIC
/begin CHARACTERISTIC mfRPM_IDLE "[FIX] Tabella soglia giri riconoscimento Minimo per con start in modalitá standard" VALUE 0xFC4D2E Scalar_UWORD 0 EngineModeTDC_Symbol_CM_uint16_rpm 0 10000 /end CHARACTERISTIC
/begin CHARACTERISTIC mfRPM_IDLE_EnFix "[FIX] Tabella soglia giri riconoscimento Minimo per con start in modalitá standard" VALUE 0xFC4D2C Scalar_UWORD 0 EngineModeTDC_Symbol_CM_FixEnableT 171 218 /end CHARACTERISTIC
/begin AXIS_PTS mkRPM_DER_BKP "[XBK] Offset si giri per ingresso in idle con derivata di giri molto negativa" 0xFC4D94 NO_INPUT_QUANTITY Lookup1D_X_UWORD 0 EngineModeTDC_Symbol_CM_ufix16_Bn32000_rpm_s 4 -32000 0 /end AXIS_PTS
/begin AXIS_PTS mkTH20_1 "[XBK] Tabella soglia giri riconoscimento Minimo per con start in modalitá standard" 0xFC4D84 NO_INPUT_QUANTITY Lookup1D_X_UWORD 0 EngineModeTDC_Symbol_CM_ufix16_Bn40_degC 8 -40 140 /end AXIS_PTS
/begin AXIS_PTS mkTH20_2 "[XBK] Tabella soglia di velocitá di rotazione motore per ingresso CutOff" 0xFC4D74 NO_INPUT_QUANTITY Lookup1D_X_UWORD 0 EngineModeTDC_Symbol_CM_ufix16_Bn40_degC 8 -40 140 /end AXIS_PTS
/begin MEASUREMENT msCrkPhase "Fase nel modo crank" UBYTE DiagSym4ms_CM_ePhCrank_adm 0 0 0 4 ECU_ADDRESS 0x40002A73 /end MEASUREMENT
/begin MEASUREMENT msCrkPhaseTmp "Test Point su StateFLow outport msCrkPhaseTmp" UBYTE EngineModeTDC_Symbol_CM_uint8_adm 0 0 0 4 ECU_ADDRESS 0x40002A82 /end MEASUREMENT
/begin MEASUREMENT msCutOffState "Fase nel modo cut-off" UBYTE EgmdTDC_CM_eCutOff_adm 0 0 0 4 ECU_ADDRESS 0x40002A72 /end MEASUREMENT
/begin MEASUREMENT msCutOffStateTmp "Test Point su StateFLow outport msCutOffStateTmp" UBYTE EngineModeTDC_Symbol_CM_uint8_adm 0 0 0 4 ECU_ADDRESS 0x40002A81 /end MEASUREMENT
/begin MEASUREMENT msEngMod "Modo motore" UBYTE Airq4ms_CM_eEGMD_adm 0 0 0 4 ECU_ADDRESS 0x40002A74 /end MEASUREMENT
/begin MEASUREMENT msEngModTmp "Test Point su StateFLow outport msEngModTmp" UBYTE EngineModeTDC_Symbol_CM_uint8_adm 0 0 0 4 ECU_ADDRESS 0x40002A80 /end MEASUREMENT
/begin MEASUREMENT msIdleRpmDerOffst "[OUT] Offset si giri per ingresso in idle con derivata di giri molto negativa" UWORD EngineModeTDC_Symbol_CM_uint16_rpm 0 0 0 500 ECU_ADDRESS 0x40002A8A /end MEASUREMENT
/begin MEASUREMENT msPh2PMSCnt "Test Point su StateFLow outport msPh2PMSCnt" UWORD EngineModeTDC_Symbol_CM_uint16_tdc 0 0 0 65535 ECU_ADDRESS 0x40002A88 /end MEASUREMENT
/begin MEASUREMENT msPhase2PMSCnt "Contatore di PMS in modo crank fase 2" UWORD EgmdTDC_CM_uint16_tdc 0 0 0 65535 ECU_ADDRESS 0x40002A78 /end MEASUREMENT
/begin CHARACTERISTIC msRPM_CUTOFF_HYS "Isteresi sulla soglia di velocitá di rotazione motore per uscita CutOff" VALUE 0xFC4D2A Scalar_UWORD 0 EngineModeTDC_Symbol_CM_uint16_rpm 0 10000 /end CHARACTERISTIC
/begin CHARACTERISTIC msRPM_IDLE_HYS "Isteresi sulla soglia di velocitá di rotazione motore per uscita Minimo" VALUE 0xFC4D28 Scalar_UWORD 0 EngineModeTDC_Symbol_CM_uint16_rpm 0 10000 /end CHARACTERISTIC
/begin MEASUREMENT msRpmCutoff "[OUT] Tabella soglia di velocitá di rotazione motore per ingresso CutOff" UWORD EngineModeTDC_Symbol_CM_uint16_rpm 0 0 0 10000 ECU_ADDRESS 0x40002A86 /end MEASUREMENT
/begin MEASUREMENT msRpmIdle "[OUT] Tabella soglia giri riconoscimento Minimo per con start in modalitá standard" UWORD EngineModeTDC_Symbol_CM_uint16_rpm 0 0 0 10000 ECU_ADDRESS 0x40002A84 /end MEASUREMENT
/begin CHARACTERISTIC msTEMP_CUTOFF "Soglia di temperatura motore per ingresso CutOff" VALUE 0xFC4D26 Scalar_UWORD 0 EngineModeTDC_Symbol_CM_ufix16_Bn40_degC -40 140 /end CHARACTERISTIC
/begin MEASUREMENT msThrRpmIdle "Soglia di velocitá di rotazione motore per uscita Minimo" UWORD EgmdTDC_CM_uint16_rpm 0 0 0 2000 ECU_ADDRESS 0x40002A76 /end MEASUREMENT
/begin CHARACTERISTIC mvIDLE_RPM_DER_OFFST "Offset si giri per ingresso in idle con derivata di giri molto negativa" CURVE 0xFC4D6C Lookup1D_UWORD 0 EngineModeTDC_Symbol_CM_uint16_rpm 0 500
 /begin AXIS_DESCR COM_AXIS NO_INPUT_QUANTITY EngineModeTDC_Symbol_CM_ufix16_Bn32000_rpm_s 4 -32000 0 AXIS_PTS_REF mkRPM_DER_BKP /end AXIS_DESCR
/end CHARACTERISTIC
/begin CHARACTERISTIC mvRPM_CUTOFF "Tabella soglia di velocitá di rotazione motore per ingresso CutOff" CURVE 0xFC4D5C Lookup1D_UWORD 0 EngineModeTDC_Symbol_CM_uint16_rpm 0 10000
 /begin AXIS_DESCR COM_AXIS NO_INPUT_QUANTITY EngineModeTDC_Symbol_CM_ufix16_Bn40_degC 8 -40 140 AXIS_PTS_REF mkTH20_2 /end AXIS_DESCR
/end CHARACTERISTIC
/begin CHARACTERISTIC mvRPM_IDLE "Tabella soglia giri riconoscimento Minimo per con start in modalitá standard" CURVE 0xFC4D4C Lookup1D_UWORD 0 EngineModeTDC_Symbol_CM_uint16_rpm 0 10000
 /begin AXIS_DESCR COM_AXIS NO_INPUT_QUANTITY EngineModeTDC_Symbol_CM_ufix16_Bn40_degC 8 -40 140 AXIS_PTS_REF mkTH20_1 /end AXIS_DESCR
/end CHARACTERISTIC
/begin CHARACTERISTIC nfCOEF_PRPM_LIM "[FIX] Fix uscita coeff peso su lambda per Limitazione RPM per fuorigiri" VALUE 0xFCC624 Scalar_UWORD 0 TE_TM_RpmLimitTDC_Symbol_CM_ufix16_En10_adm 0 10 /end CHARACTERISTIC
/begin CHARACTERISTIC nfCOEF_PRPM_LIM_EnFix "[FIX] Fix uscita coeff peso su lambda per Limitazione RPM per fuorigiri" VALUE 0xFCC622 Scalar_UWORD 0 TE_TM_RpmLimitTDC_Symbol_CM_FixEnableT 171 218 /end CHARACTERISTIC
/begin CHARACTERISTIC nfTJ_ZERO_FLAG "[FIX] Fix uscita del Time injection zero" VALUE 0xFCC620 Scalar_UWORD 0 TE_TM_RpmLimitTDC_Symbol_CM_boolean_adm 0 1 /end CHARACTERISTIC
/begin CHARACTERISTIC nfTJ_ZERO_FLAG_EnFix "[FIX] Fix uscita del Time injection zero" VALUE 0xFCC61E Scalar_UWORD 0 TE_TM_RpmLimitTDC_Symbol_CM_FixEnableT 171 218 /end CHARACTERISTIC
/begin MEASUREMENT nsCoefPesoRpmLim "Weithing coefficient for RPM limitation" UWORD InjtTDC_CM_ufix16_En10_adm 0 0 0 10 ECU_ADDRESS 0x40004516 /end MEASUREMENT
/begin CHARACTERISTIC nsLAMMAX_RPM_LIM "Lambda Max che assicura corretta combustione per limitatore RPM" VALUE 0xFCC61C Scalar_UWORD 0 TE_TM_RpmLimitTDC_Symbol_CM_ufix16_En10_adm 0 10 /end CHARACTERISTIC
/begin MEASUREMENT nsP2EndSpeedGov "Valore massimo dei giri a cui il T_inj non viene ancora tagliato" UWORD Trqm_CtrlMgmt4ms_CM_uint16_rpm 0 0 0 10000 ECU_ADDRESS 0x40004518 /end MEASUREMENT
/begin MEASUREMENT nsP6HighIdle "Valore massimo dei giri a cui il T_inj viene portato a zero" UWORD Trqm_CtrlMgmt1s_CM_uint16_rpm 0 0 0 10000 ECU_ADDRESS 0x4000451A /end MEASUREMENT
/begin CHARACTERISTIC nsSOGLIA_RPM0 "RPM Threshold 0 for RPM limitation" VALUE 0xFCC61A Scalar_UWORD 0 TE_TM_RpmLimitTDC_Symbol_CM_uint16_rpm 0 10000 /end CHARACTERISTIC
/begin CHARACTERISTIC nsSOGLIA_RPM1 "RPM Threshold 1 for RPM limitation" VALUE 0xFCC618 Scalar_UWORD 0 TE_TM_RpmLimitTDC_Symbol_CM_uint16_rpm 0 10000 /end CHARACTERISTIC
/begin CHARACTERISTIC nsSOGLIA_RPM2 "RPM Threshold 2 for RPM limitation" VALUE 0xFCC616 Scalar_UWORD 0 TE_TM_RpmLimitTDC_Symbol_CM_uint16_rpm 0 10000 /end CHARACTERISTIC
/begin CHARACTERISTIC nsSOGLIA_RPM3 "RPM Threshold 3 for RPM limitation" VALUE 0xFCC614 Scalar_UWORD 0 TE_TM_RpmLimitTDC_Symbol_CM_uint16_rpm 0 10000 /end CHARACTERISTIC
/begin MEASUREMENT nsStatoRpmLim "Stato RPM limite" UBYTE TE_TM_RpmLimitTDC_Symbol_CM_uint8_adm 0 0 1 4 ECU_ADDRESS 0x4000451F /end MEASUREMENT
/begin MEASUREMENT nsTjZeroFlag "Zero Tinj flag for RPM limitation" UBYTE InjtTDC_CM_boolean_adm 0 0 0 1 ECU_ADDRESS 0x40004514 /end MEASUREMENT
/begin MEASUREMENT nsTjZeroFlagTmp "Zero Tinj flag for RPM limitation (uscita FSM)" UBYTE TE_TM_RpmLimitTDC_Symbol_CM_boolean_adm 0 0 0 1 ECU_ADDRESS 0x4000451E /end MEASUREMENT
/begin CHARACTERISTIC ofAB_CALC_RIP "[FIX] Fix sul flag osAbCalcRip di abilitazione del test di ripartizione" VALUE 0xFC5A16 Scalar_UWORD 0 Test_RipCarica_TDC_Symbol_CM_boolean_adm 0 1 /end CHARACTERISTIC
/begin CHARACTERISTIC ofAB_CALC_RIP_EnFix "[FIX] Fix sul flag osAbCalcRip di abilitazione del test di ripartizione" VALUE 0xFC5A14 Scalar_UWORD 0 Test_RipCarica_TDC_Symbol_CM_FixEnableT 171 218 /end CHARACTERISTIC
/begin CHARACTERISTIC ofAB_CALC_SAT "[FIX] Fix sul flag osAbCalcSat di abilitazione sul test del KO2 in battuta" VALUE 0xFC59F2 Scalar_UWORD 0 Test_KO2_TDC_Symbol_CM_boolean_adm 0 1 /end CHARACTERISTIC
/begin CHARACTERISTIC ofAB_CALC_SAT_EnFix "[FIX] Fix sul flag osAbCalcSat di abilitazione sul test del KO2 in battuta" VALUE 0xFC59F0 Scalar_UWORD 0 Test_KO2_TDC_Symbol_CM_FixEnableT 171 218 /end CHARACTERISTIC
/begin CHARACTERISTIC ofAB_GAIN_CALC "[FIX] Fix sul flag osAbGainCalc di abilitazione della calcolo dei guadagni adattativi" VALUE 0xFC59B0 Scalar_UWORD 0 Abilitazione_DFSLY_100ms_Symbol_CM_boolean_adm 0 1 /end CHARACTERISTIC
/begin CHARACTERISTIC ofAB_GAIN_CALC_EnFix "[FIX] Fix sul flag osAbGainCalc di abilitazione della calcolo dei guadagni adattativi" VALUE 0xFC59AE Scalar_UWORD 0 Abilitazione_DFSLY_100ms_Symbol_CM_FixEnableT 171 218 /end CHARACTERISTIC
/begin CHARACTERISTIC ofAB_GA_CY_CAL "[FIX] Fix sul flag osAbGaCyCal di abilitazione per il calcolo dei guadagni adattativi in zona ciclo" VALUE 0xFC59D2 Scalar_UWORD 0 CalcGain_Adat_100ms_Symbol_CM_boolean_adm 0 1 /end CHARACTERISTIC
/begin CHARACTERISTIC ofAB_GA_CY_CAL_EnFix "[FIX] Fix sul flag osAbGaCyCal di abilitazione per il calcolo dei guadagni adattativi in zona ciclo" VALUE 0xFC59D0 Scalar_UWORD 0 CalcGain_Adat_100ms_Symbol_CM_FixEnableT 171 218 /end CHARACTERISTIC
/begin CHARACTERISTIC ofAB_GA_ID_CAL "[FIX] Fix sul flag osAbGaIdCal di abilitazione per il calcolo dei guadagni adattativi in zona idle" VALUE 0xFC59CE Scalar_UWORD 0 CalcGain_Adat_100ms_Symbol_CM_boolean_adm 0 1 /end CHARACTERISTIC
/begin CHARACTERISTIC ofAB_GA_ID_CAL_EnFix "[FIX] Fix sul flag osAbGaIdCal di abilitazione per il calcolo dei guadagni adattativi in zona idle" VALUE 0xFC59CC Scalar_UWORD 0 CalcGain_Adat_100ms_Symbol_CM_FixEnableT 171 218 /end CHARACTERISTIC
/begin CHARACTERISTIC ofADAT_GA_DONE "[FIX] Fix sul flag osAdatGaDone di segnalazione fine dei calcoli dei guadagni adattativi" VALUE 0xFC59CA Scalar_UWORD 0 CalcGain_Adat_100ms_Symbol_CM_boolean_adm 0 1 /end CHARACTERISTIC
/begin CHARACTERISTIC ofADAT_GA_DONE_EnFix "[FIX] Fix sul flag osAdatGaDone di segnalazione fine dei calcoli dei guadagni adattativi" VALUE 0xFC59C8 Scalar_UWORD 0 CalcGain_Adat_100ms_Symbol_CM_FixEnableT 171 218 /end CHARACTERISTIC
/begin CHARACTERISTIC ofAD_CYC "[FIX] Fix sul flag osAdCyc di zona motore ciclo per il calcolo dei guadagni adattativi" VALUE 0xFC59C4 Scalar_UWORD 0 CalcADCYC_ADIDL_100ms_Symbol_CM_boolean_adm 0 1 /end CHARACTERISTIC
/begin CHARACTERISTIC ofAD_CYC_EnFix "[FIX] Fix sul flag osAdCyc di zona motore ciclo per il calcolo dei guadagni adattativi" VALUE 0xFC59C2 Scalar_UWORD 0 CalcADCYC_ADIDL_100ms_Symbol_CM_FixEnableT 171 218 /end CHARACTERISTIC
/begin CHARACTERISTIC ofAD_IDL "[FIX] Fix sul flag osAdIdl di zona motore idle per il calcolo dei guadagni adattativi" VALUE 0xFC59C0 Scalar_UWORD 0 CalcADCYC_ADIDL_100ms_Symbol_CM_boolean_adm 0 1 /end CHARACTERISTIC
/begin CHARACTERISTIC ofAD_IDL_EnFix "[FIX] Fix sul flag osAdIdl di zona motore idle per il calcolo dei guadagni adattativi" VALUE 0xFC59BE Scalar_UWORD 0 CalcADCYC_ADIDL_100ms_Symbol_CM_FixEnableT 171 218 /end CHARACTERISTIC
/begin CHARACTERISTIC ofAIRFLOW_ENMISF_Enable "[FIX] [OUT] Table for enabling misfire detection in case of low air mass flow rate" VALUE 0xFCAA54 Scalar_UBYTE 0 MisfireDetectionTDC_CM_FixEnableT 171 218 /end CHARACTERISTIC
/begin CHARACTERISTIC ofAIRFLOW_ENMISF_Value "[FIX] [OUT] Table for enabling misfire detection in case of low air mass flow rate" VALUE 0xFCAA52 Scalar_UWORD 0 MisfireDetectionTDC_CM_ufix16_En3_mg_cc 0 8191 /end CHARACTERISTIC
/begin CHARACTERISTIC ofAUTOCATAG "[FIX] Tabella indice soglia per abilitazione diagnosi catalizzatore" VALUE 0xFC4858 Scalar_UWORD 0 Cata100ms_Symbol_CM_ufix16_En7__ 0 100 /end CHARACTERISTIC
/begin CHARACTERISTIC ofAUTOCATAG_EnFix "[FIX] Tabella indice soglia per abilitazione diagnosi catalizzatore" VALUE 0xFC4856 Scalar_UWORD 0 Cata100ms_Symbol_CM_FixEnableT 171 218 /end CHARACTERISTIC
/begin CHARACTERISTIC ofAUTOSOND "[FIX] Mappa delle soglie di frequenza diagnosi sonda lambda monte" VALUE 0xFC49CE Scalar_UWORD 0 VarMgmDLAM100ms_Symbol_CM_ufix16_Sp01_hz 0 655.35 /end CHARACTERISTIC
/begin CHARACTERISTIC ofAUTOSOND_EnFix "[FIX] Mappa delle soglie di frequenza diagnosi sonda lambda monte" VALUE 0xFC49CC Scalar_UWORD 0 VarMgmDLAM100ms_Symbol_CM_FixEnableT 171 218 /end CHARACTERISTIC
/begin CHARACTERISTIC ofDCAT_COND_G "[FIX] Fix sul flag di abilitazione osDCatCondG della diagnosi catalizzatore" VALUE 0xFC4854 Scalar_UWORD 0 Cata100ms_Symbol_CM_boolean_adm 0 1 /end CHARACTERISTIC
/begin CHARACTERISTIC ofDCAT_COND_G_EnFix "[FIX] Fix sul flag di abilitazione osDCatCondG della diagnosi catalizzatore" VALUE 0xFC4852 Scalar_UWORD 0 Cata100ms_Symbol_CM_FixEnableT 171 218 /end CHARACTERISTIC
/begin CHARACTERISTIC ofDCAT_GEN_ST_G "[FIX] Fix sullo stato osDCatGenStG di sincronizzazione dei calcoli di indice efficienza catalizzatore" VALUE 0xFC4850 Scalar_UWORD 0 Cata100ms_Symbol_CM_uint8_adm 0 8 /end CHARACTERISTIC
/begin CHARACTERISTIC ofDCAT_GEN_ST_G_EnFix "[FIX] Fix sullo stato osDCatGenStG di sincronizzazione dei calcoli di indice efficienza catalizzatore" VALUE 0xFC484E Scalar_UWORD 0 Cata100ms_Symbol_CM_FixEnableT 171 218 /end CHARACTERISTIC
/begin CHARACTERISTIC ofDERDN_TH "[FIX] Tabelle soglie di dissemetria inferiore (Diagnosi Sonda Lambda Monte)" VALUE 0xFC49D6 Scalar_SWORD 0 VarMgmDLAM100ms_Symbol_CM_int16__ -32768 32767 /end CHARACTERISTIC
/begin CHARACTERISTIC ofDERDN_TH_EnFix "[FIX] Tabelle soglie di dissemetria inferiore (Diagnosi Sonda Lambda Monte)" VALUE 0xFC49D4 Scalar_SWORD 0 VarMgmDLAM100ms_Symbol_CM_FixEnableT 171 218 /end CHARACTERISTIC
/begin CHARACTERISTIC ofDERUP_TH "[FIX] Tabelle soglie di dissemetria inferiore (Diagnosi Sonda Lambda Monte)" VALUE 0xFC49D2 Scalar_SWORD 0 VarMgmDLAM100ms_Symbol_CM_int16__ -32768 32767 /end CHARACTERISTIC
/begin CHARACTERISTIC ofDERUP_TH_EnFix "[FIX] Tabelle soglie di dissemetria inferiore (Diagnosi Sonda Lambda Monte)" VALUE 0xFC49D0 Scalar_SWORD 0 VarMgmDLAM100ms_Symbol_CM_FixEnableT 171 218 /end CHARACTERISTIC
/begin CHARACTERISTIC ofDLAMEN "[FIX] Fix sul flag di abilitazione osDLamEn della diagnosi lambda monte" VALUE 0xFC47F8 Scalar_UWORD 0 AbilitazioneDLAM100ms_Symbol_CM_boolean_adm 0 1 /end CHARACTERISTIC
/begin CHARACTERISTIC ofDLAMEN_EnFix "[FIX] Fix sul flag di abilitazione osDLamEn della diagnosi lambda monte" VALUE 0xFC47F6 Scalar_UWORD 0 AbilitazioneDLAM100ms_Symbol_CM_FixEnableT 171 218 /end CHARACTERISTIC
/begin CHARACTERISTIC ofENABLE_MISF_DET_Enable "[FIX] Misfire detection enable flag" VALUE 0xFCAA50 Scalar_UBYTE 0 MisfireDetectionTDC_CM_FixEnableT 171 218 /end CHARACTERISTIC
/begin CHARACTERISTIC ofENABLE_MISF_DET_Value "[FIX] Misfire detection enable flag" VALUE 0xFCAA4F Scalar_BOOLEAN 0 MisfireDetectionTDC_CM_boolean_adm 0 1 /end CHARACTERISTIC
/begin CHARACTERISTIC ofENGPOINT_ENMISF_Enable "[FIX] [OUT] Table for enabling misfire detection in accord to engine working point" VALUE 0xFCAA4E Scalar_UBYTE 0 MisfireDetectionTDC_CM_FixEnableT 171 218 /end CHARACTERISTIC
/begin CHARACTERISTIC ofENGPOINT_ENMISF_Value "[FIX] [OUT] Table for enabling misfire detection in accord to engine working point" VALUE 0xFCAA4D Scalar_UBYTE 0 MisfireDetectionTDC_CM_uint8_adm 0 1 /end CHARACTERISTIC
/begin CHARACTERISTIC ofEN_DC_MV "[FIX] Fix per forzare la diagnosi monte-valle" VALUE 0xFC49BA Scalar_UWORD 0 DCmvInterface100ms_Symbol_CM_boolean_adm 0 1 /end CHARACTERISTIC
/begin CHARACTERISTIC ofEN_DC_MV_EnFix "[FIX] Fix per forzare la diagnosi monte-valle" VALUE 0xFC49B8 Scalar_UWORD 0 DCmvInterface100ms_Symbol_CM_FixEnableT 171 218 /end CHARACTERISTIC
/begin CHARACTERISTIC ofFIX_GEAR_C "[FIX] Fix di informazione di cambio accoppiato" VALUE 0xFC484C Scalar_UWORD 0 Cata100ms_Symbol_CM_boolean_adm 0 1 /end CHARACTERISTIC
/begin CHARACTERISTIC ofFIX_GEAR_C_EnFix "[FIX] Fix di informazione di cambio accoppiato" VALUE 0xFC484A Scalar_UWORD 0 Cata100ms_Symbol_CM_FixEnableT 171 218 /end CHARACTERISTIC
/begin CHARACTERISTIC ofFL_EN_AD "[FIX] Fix sul flag osFlEnAd di abilitazione della diagnosi autoadattativita" VALUE 0xFC59AC Scalar_UWORD 0 Abilitazione_DFSLY_100ms_Symbol_CM_boolean_adm 0 1 /end CHARACTERISTIC
/begin CHARACTERISTIC ofFL_EN_AD_EnFix "[FIX] Fix sul flag osFlEnAd di abilitazione della diagnosi autoadattativita" VALUE 0xFC59AA Scalar_UWORD 0 Abilitazione_DFSLY_100ms_Symbol_CM_FixEnableT 171 218 /end CHARACTERISTIC
/begin CHARACTERISTIC ofMEDOC_OK_G_Enable "[FIX] Flag di correzione ruota fonica effettuata" VALUE 0xFCAA4C Scalar_UBYTE 0 FlywheelCorrTDC_CM_FixEnableT 171 218 /end CHARACTERISTIC
/begin CHARACTERISTIC ofMEDOC_OK_G_Value "[FIX] Flag di correzione ruota fonica effettuata" VALUE 0xFCAA4B Scalar_BOOLEAN 0 FlywheelCorrTDC_CM_boolean_adm 0 1 /end CHARACTERISTIC
/begin CHARACTERISTIC ofQAC_MAIN_DELAYED_Enable "[FIX]  Fix for the inspired intake air in order to define thresholds for Cic_1 and Cic_Cec computation" VALUE 0xFCAA4A Scalar_UBYTE 0 MisfireDetectionTDC_CM_FixEnableT 171 218 /end CHARACTERISTIC
/begin CHARACTERISTIC ofQAC_MAIN_DELAYED_Value "[FIX]  Fix for the inspired intake air in order to define thresholds for Cic_1 and Cic_Cec computation" VALUE 0xFCAA48 Scalar_UWORD 0 MisfireDetectionTDC_CM_ufix16_En3_mg_cc 0 8191 /end CHARACTERISTIC
/begin CHARACTERISTIC ofTAB_TCAT "[FIX] Tabella Stima temperatura catalizzatore" VALUE 0xFC4844 Scalar_UWORD 0 Cata100ms_Symbol_CM_ufix16_Bn40_degC -40 1200 /end CHARACTERISTIC
/begin CHARACTERISTIC ofTAB_TCAT_EnFix "[FIX] Tabella Stima temperatura catalizzatore" VALUE 0xFC4842 Scalar_UWORD 0 Cata100ms_Symbol_CM_FixEnableT 171 218 /end CHARACTERISTIC
/begin CHARACTERISTIC ofTB_MAP_NOM "[FIX] Tabella per calcolo pressione nominale in funzione della temperatura" VALUE 0xFC5A12 Scalar_UWORD 0 Test_RipCarica_TDC_Symbol_CM_uint16_mbar 150 2000 /end CHARACTERISTIC
/begin CHARACTERISTIC ofTB_MAP_NOM_EnFix "[FIX] Tabella per calcolo pressione nominale in funzione della temperatura" VALUE 0xFC5A10 Scalar_UWORD 0 Test_RipCarica_TDC_Symbol_CM_FixEnableT 171 218 /end CHARACTERISTIC
/begin CHARACTERISTIC ofTHR_CYL_MISF1000_Enable "[FIX] [OUT] Maximum number of misfire event on single cylinder allowed in last 1000 rpm" VALUE 0xFCAA46 Scalar_UBYTE 0 FaultChkMDxTDC_CM_FixEnableT 171 218 /end CHARACTERISTIC
/begin CHARACTERISTIC ofTHR_CYL_MISF1000_Value "[FIX] [OUT] Maximum number of misfire event  on single cylinder allowed in last 1000 rpm" VALUE 0xFCAA44 Scalar_UWORD 0 FaultChkMDxTDC_CM_uint16_adm 0 500 /end CHARACTERISTIC
/begin CHARACTERISTIC ofTHR_CYL_MISF200_Enable "[FIX] [OUT] Maximum number of misfire event on single cylinder allowed in last 200 rpm" VALUE 0xFCAA42 Scalar_UBYTE 0 FaultChkMDxTDC_CM_FixEnableT 171 218 /end CHARACTERISTIC
/begin CHARACTERISTIC ofTHR_CYL_MISF200_Value "[FIX] [OUT] Maximum number of misfire event on single cylinder allowed in last 200 rpm" VALUE 0xFCAA41 Scalar_UBYTE 0 FaultChkMDxTDC_CM_uint8_adm 0 100 /end CHARACTERISTIC
/begin CHARACTERISTIC ofTHR_RND_MISF1000_Enable "[FIX] [OUT] Maximum number of overall misfire event  on cingle cylinder allowed in last 1000 rpm" VALUE 0xFCAA40 Scalar_UBYTE 0 FaultChkMDxTDC_CM_FixEnableT 171 218 /end CHARACTERISTIC
/begin CHARACTERISTIC ofTHR_RND_MISF1000_Value "[FIX] [OUT] Maximum number of overall misfire event allowed in last 1000 rpm" VALUE 0xFCAA3E Scalar_UWORD 0 FaultChkMDxTDC_CM_uint16_adm 0 4000 /end CHARACTERISTIC
/begin CHARACTERISTIC ofTHR_RND_MISF200_Enable "[FIX] [OUT] Maximum number of overall misfire event  on cingle cylinder allowed in last 200 rpm" VALUE 0xFCAA3C Scalar_UBYTE 0 FaultChkMDxTDC_CM_FixEnableT 171 218 /end CHARACTERISTIC
/begin CHARACTERISTIC ofTHR_RND_MISF200_Value "[FIX] [OUT] Maximum number of overall misfire event allowed in last 200 rpm" VALUE 0xFCAA3A Scalar_UWORD 0 FaultChkMDxTDC_CM_uint16_adm 0 800 /end CHARACTERISTIC
/begin CHARACTERISTIC ofTRIP_CALC "[FIX] Fix sul flag di abilitazione osTripCalc dei calcoli di indice efficienza catalizzatore e paramatri di chiamata al supervisore" VALUE 0xFC4848 Scalar_UWORD 0 Cata100ms_Symbol_CM_boolean_adm 0 1 /end CHARACTERISTIC
/begin CHARACTERISTIC ofTRIP_CALC_EnFix "[FIX] Fix sul flag di abilitazione osTripCalc dei calcoli di indice efficienza catalizzatore e paramatri di chiamata al supervisore" VALUE 0xFC4846 Scalar_UWORD 0 Cata100ms_Symbol_CM_FixEnableT 171 218 /end CHARACTERISTIC
/begin CHARACTERISTIC ofTTHCIC_1G_Enable "[FIX] [OUT] Table for threshold computation related to cyclicity CIC1" VALUE 0xFCAA38 Scalar_UBYTE 0 MisfireDetectionTDC_CM_FixEnableT 171 218 /end CHARACTERISTIC
/begin CHARACTERISTIC ofTTHCIC_1G_Value "[FIX] [OUT] Table for threshold computation related to cyclicity CIC1" VALUE 0xFCAA36 Scalar_SWORD 0 MisfireDetectionTDC_CM_int16_adm -820 820 /end CHARACTERISTIC
/begin CHARACTERISTIC ofTTHCIC_CEC_Enable "[FIX] [OUT] Table for threshold computation related to cyclicity CICHEC" VALUE 0xFCAA34 Scalar_UBYTE 0 MisfireDetectionTDC_CM_FixEnableT 171 218 /end CHARACTERISTIC
/begin CHARACTERISTIC ofTTHCIC_CEC_Value "[FIX] [OUT] Table for threshold computation related to cyclicity CICHEC" VALUE 0xFCAA32 Scalar_SWORD 0 MisfireDetectionTDC_CM_int16_adm -820 820 /end CHARACTERISTIC
/begin CHARACTERISTIC ofTWAMISG_Enable "[FIX] [OUT] Gain for threshold misfire detection" VALUE 0xFCAA30 Scalar_UBYTE 0 MisfireDetectionTDC_CM_FixEnableT 171 218 /end CHARACTERISTIC
/begin CHARACTERISTIC ofTWAMISG_Value "[FIX] [OUT] Gain for threshold misfire detection" VALUE 0xFCAA2E Scalar_UWORD 0 MisfireDetectionTDC_CM_ufix16_En9_adm 0 3 /end CHARACTERISTIC
/begin CHARACTERISTIC ofVLTR2 "[FIX] Tabella per il calcolo della soglia di transizione sonda lambda post catalizzatore" VALUE 0xFC4AD4 Scalar_UWORD 0 CataTDC_Symbol_CM_uint16_mV 0 1000 /end CHARACTERISTIC
/begin CHARACTERISTIC ofVLTR2_EnFix "[FIX] Tabella per il calcolo della soglia di transizione sonda lambda post catalizzatore" VALUE 0xFC4AD2 Scalar_UWORD 0 CataTDC_Symbol_CM_FixEnableT 171 218 /end CHARACTERISTIC
/begin CHARACTERISTIC osAIR_IDLE_THR "Soglia di apertura aria addizionale per disabilitare la diagnosi ripartizione (Diagnosi Fuel System)" VALUE 0xFC5A0E Scalar_UWORD 0 Test_RipCarica_TDC_Symbol_CM_ufix16_En4__ 0 100 /end CHARACTERISTIC
/begin MEASUREMENT osAbCalcRip "bilitazione del test di ripartizione (Diagnosi Fuel System)" UBYTE Fuels_CtrlMgmtTDC_CM_boolean_adm 0 0 0 1 ECU_ADDRESS 0x40002E66 /end MEASUREMENT
/begin MEASUREMENT osAbCalcRipVect "Vettore delle condizioni del flag osAbCalcRip di abilitazione del test di ripartizione" UWORD Test_RipCarica_TDC_Symbol_CM_uint16_adm 0 0 0 65535 ECU_ADDRESS 0x40002F28 /end MEASUREMENT
/begin MEASUREMENT osAbCalcSat "Abilitazione ai calcoli di saturazione del KO2" UBYTE Test_KO2_TDC_Symbol_CM_boolean_adm 0 0 0 1 ECU_ADDRESS 0x40002EDC /end MEASUREMENT
/begin MEASUREMENT osAbCalcSatVect "Vettore delle condizioni del flag osAbCalcSat di abilitazione sul test del KO2 in battuta" UBYTE Test_KO2_TDC_Symbol_CM_uint8_adm 0 0 0 255 ECU_ADDRESS 0x40002EDB /end MEASUREMENT
/begin MEASUREMENT osAbGaCyCal "Abilitazione dei calcoli dei guadagni autoadattativi in zona ciclo (Diagnosi Fuel System)" UBYTE CalcGain_Adat_100ms_Symbol_CM_boolean_adm 0 0 0 1 ECU_ADDRESS 0x40002E5D /end MEASUREMENT
/begin MEASUREMENT osAbGaCyCalVect "Vettore delle condizioni del flag osAdIdl di zona motore idle per il calcolo dei guadagni adattativi" UBYTE CalcGain_Adat_100ms_Symbol_CM_uint8_adm 0 0 0 255 ECU_ADDRESS 0x40002E5C /end MEASUREMENT
/begin MEASUREMENT osAbGaIdCal "Abilitazione dei calcoli dei guadagni autoadattativi in zona idle (Diagnosi Fuel System)" UBYTE CalcGain_Adat_100ms_Symbol_CM_boolean_adm 0 0 0 1 ECU_ADDRESS 0x40002E5B /end MEASUREMENT
/begin MEASUREMENT osAbGaIdCalVect "Vettore delle condizioni del flag osAbGaIdCal di abilitazione per il calcolo dei guadagni adattativi in zona idle" UBYTE CalcGain_Adat_100ms_Symbol_CM_uint8_adm 0 0 0 255 ECU_ADDRESS 0x40002E5A /end MEASUREMENT
/begin MEASUREMENT osAbGainCalc "bilitazione generale del calcolo dei guadagni autoadattativi (Diagnosi Fuel System)" UBYTE Fuels_CtrlMgmt100ms_CM_boolean_adm 0 0 0 1 ECU_ADDRESS 0x40002E3C /end MEASUREMENT
/begin MEASUREMENT osAbGainCalcVect "Vettore delle condizioni del flag osAbGainCalc abilitazione dei calcoli dei guadagni adattativi" UBYTE Abilitazione_DFSLY_100ms_Symbol_CM_uint8_adm 0 0 0 255 ECU_ADDRESS 0x40002E43 /end MEASUREMENT
/begin MEASUREMENT osAbsTimerStab "Tempo assoluto di inizio periodo stabilizzato" ULONG Cata100ms_Symbol_CM_ufix32_Sp1_s 0 0 0 429496700 ECU_ADDRESS 0x400027BC /end MEASUREMENT
/begin MEASUREMENT osAdCyc "lag zona motore ciclo per il calcolo dei guadagni autoadattativi (Diagnosi Fuel System)" UBYTE Fuels_CtrlMgmt100ms_CM_boolean_adm 0 0 0 1 ECU_ADDRESS 0x40002E39 /end MEASUREMENT
/begin MEASUREMENT osAdCycVect "Vettore delle condizioni del flag osAdCyc di zona motore ciclo per il calcolo dei guadagni adattativi" UBYTE CalcADCYC_ADIDL_100ms_Symbol_CM_uint8_adm 0 0 0 255 ECU_ADDRESS 0x40002E45 /end MEASUREMENT
/begin MEASUREMENT osAdFlCalc "Vettore delle condizioni del flag osAbGaCyCal di abilitazione per il calcolo dei guadagni adattativi in zona ciclo" UBYTE CalcGain_Adat_100ms_Symbol_CM_boolean_adm 0 0 0 1 ECU_ADDRESS 0x40002E59 /end MEASUREMENT
/begin MEASUREMENT osAdIdl "lag zona motore idle per il calcolo dei guadagni autoadattativi (Diagnosi Fuel System)" UBYTE Fuels_CtrlMgmt100ms_CM_boolean_adm 0 0 0 1 ECU_ADDRESS 0x40002E38 /end MEASUREMENT
/begin MEASUREMENT osAdIdlVect "Vettore delle condizioni del flag osAdIdl di zona motore idle per il calcolo dei guadagni adattativi" UBYTE CalcADCYC_ADIDL_100ms_Symbol_CM_uint8_adm 0 0 0 255 ECU_ADDRESS 0x40002E44 /end MEASUREMENT
/begin MEASUREMENT osAdatGaDone "lag di segnalazione di diagnosi Fuel System gain idle/cycle completata" UBYTE Fuels_CtrlMgmt100ms_CM_boolean_adm 0 0 0 1 ECU_ADDRESS 0x40002E35 /end MEASUREMENT
/begin MEASUREMENT osAdatGaDoneVect "Vettore delle condizioni del flag osAdatGaDone di segnalazione di fine dei calcoli dei guadagni adattativi" UBYTE CalcGain_Adat_100ms_Symbol_CM_uint8_adm 0 0 0 255 ECU_ADDRESS 0x40002E58 /end MEASUREMENT
/begin MEASUREMENT osAdvIdlEn "Abilitazione della diagnosi di ripartizione in base alla correzione anticipo controllo minimo (Diagnosi Fuel System)" UBYTE Test_RipCarica_TDC_Symbol_CM_boolean_adm 0 0 0 1 ECU_ADDRESS 0x40002F1F /end MEASUREMENT
/begin MEASUREMENT osAirIdleEn "Abilitazione della diagnosi di ripartizione in base alla percentuale aria controllo minimo (Diagnosi Fuel System)" UBYTE Test_RipCarica_TDC_Symbol_CM_boolean_adm 0 0 0 1 ECU_ADDRESS 0x40002F1E /end MEASUREMENT
/begin MEASUREMENT osAmpFasceG "RPM band amplitude for flywheel correction" UWORD FlywheelCorrTDC_CM_uint16_rpm 0 0 0 10000 ECU_ADDRESS 0x40003AC8 /end MEASUREMENT
/begin MEASUREMENT osAutocatag "[OUT] Tabella indice soglia per abilitazione diagnosi catalizzatore" UWORD Cata100ms_Symbol_CM_ufix16_En7__ 0 0 0 100 ECU_ADDRESS 0x4000279C /end MEASUREMENT
/begin MEASUREMENT osAutosond "[OUT] Mappa delle soglie di frequenza diagnosi sonda lambda monte" UWORD VarMgmDLAM100ms_Symbol_CM_ufix16_Sp01_hz 0 0 0 655.35 ECU_ADDRESS 0x400028BE /end MEASUREMENT
/begin MEASUREMENT osAutosondOut "Soglia per il test di frequenza della sonda lambda monte (Diagnosi Sonda Lambda Monte)" UWORD Dcat_Diagnosis100ms_CM_ufix16_Sp01_hz 0 0 0 655.35 ECU_ADDRESS 0x4000264C /end MEASUREMENT
/begin MEASUREMENT osCAdaCyc "Contatore di aggiornamenti autoadattativi per validazione su zona ciclo (Diagnosi Fuel System)" UBYTE CalcGain_Adat_100ms_Symbol_CM_uint8_adm 0 0 0 255 ECU_ADDRESS 0x40002E57 /end MEASUREMENT
/begin MEASUREMENT osCAdaIdl "Contatore di aggiornamenti autoadattativi per validazione su zona idle (Diagnosi Fuel System)" UBYTE CalcGain_Adat_100ms_Symbol_CM_uint8_adm 0 0 0 255 ECU_ADDRESS 0x40002E56 /end MEASUREMENT
/begin CHARACTERISTIC osCIC_SELECTOR "Cyclicity selector for diag: 1 = CIC1; 2 = CICICec; 3 = CICSB; 4 = (CIC1 or CICCec or CICSB); Other = NO cyclicity" VALUE 0xFCA93E Scalar_UBYTE 0 MisfireCntTDC_CM_uint8_adm 1 4 /end CHARACTERISTIC
/begin CHARACTERISTIC osCIC_TDC_DELAY "Cyclicity amplitude" VALUE 0xFCA93D Scalar_UBYTE 0 MisfireDetectionTDC_CM_uint8_TDC 1 6 /end CHARACTERISTIC
/begin CHARACTERISTIC osCLSO2MNG "Soglia minima di KO2 per la disattivazione della diagnosi catalizzatore" VALUE 0xFC4840 Scalar_UWORD 0 Cata100ms_Symbol_CM_ufix16_En15_adm 0.75 1.25 /end CHARACTERISTIC
/begin CHARACTERISTIC osCLSO2MXG "Soglia massima di KO2 per la disattivazione della diagnosi catalizzatore" VALUE 0xFC483E Scalar_UWORD 0 Cata100ms_Symbol_CM_ufix16_En15_adm 0.75 1.25 /end CHARACTERISTIC
/begin MEASUREMENT osCMedocG "Indice di base per il calcolo degli indici di ciclicità" FLOAT32_IEEE MisfdTDC_CM_single_adm 0 0 -100000 100000 ECU_ADDRESS 0x40003800 /end MEASUREMENT
/begin CHARACTERISTIC osCYCLICITY_GAIN "Gain for cyclicity computation" VALUE 0xFCA93C Scalar_UBYTE 0 MisfireDetectionTDC_CM_uint8_TDC 2 10 /end CHARACTERISTIC
/begin MEASUREMENT osCalcSegment "lag di abilitazione Calc Segment (Diagnosi Sonda Lambda Monte)" UBYTE Dcat_Diagnosis100ms_CM_boolean_adm 0 0 0 1 ECU_ADDRESS 0x40002639 /end MEASUREMENT
/begin MEASUREMENT osCalcStartTime "Tempo registrato alla partenza del segmento di calcolo (Diagnosi Sonda Lambda Monte)" ULONG VarMgmDLAM100ms_Symbol_CM_ufix32_Sp1_s 0 0 0 429496729.5 ECU_ADDRESS 0x400028C8 /end MEASUREMENT
/begin MEASUREMENT osCic1MisfDetect "Misfire detected from Cyclicity 1 index" UBYTE MisfdTDC_CM_boolean_adm 0 0 0 1 ECU_ADDRESS 0x400037AB /end MEASUREMENT
/begin MEASUREMENT osCicCecMisfDetect "Misfire detected from Cyclicity Cec index" UBYTE MisfdTDC_CM_boolean_adm 0 0 0 1 ECU_ADDRESS 0x400037AA /end MEASUREMENT
/begin MEASUREMENT osCicSBMisfDetect "Misfire detected from Cyclicity SB index" UBYTE MisfdTDC_CM_boolean_adm 0 0 0 1 ECU_ADDRESS 0x400037A9 /end MEASUREMENT
/begin MEASUREMENT osCic_1 "Cyclicity 1 tdc by tdc" FLOAT32_IEEE MisfireDetectionTDC_CM_single_adm 0 0 -3.4E+38 3.4E+38 ECU_ADDRESS 0x40003E88 /end MEASUREMENT
/begin MEASUREMENT osCic_1Vect "Cyclicity 1 vector tdc by tdc" FLOAT32_IEEE MisfireDetectionTDC_CM_single_adm 0 0 -3.4E+38 3.4E+38 ECU_ADDRESS 0x40003E68 MATRIX_DIM 8 /end MEASUREMENT
/begin MEASUREMENT osCic_1fG "ciclicita intera filtrata" SLONG MisfdTDC_CM_int32_adm 0 0 -500000000 500000000 ECU_ADDRESS 0x400037F8 /end MEASUREMENT
/begin MEASUREMENT osCic_1fGVect "Filtered Cyclicity 1 vector tdc by tdc" FLOAT32_IEEE MisfireDetectionTDC_CM_single_adm 0 0 -3.4E+38 3.4E+38 ECU_ADDRESS 0x40003E48 MATRIX_DIM 8 /end MEASUREMENT
/begin MEASUREMENT osCic_Cec "Cyclicity Cec tdc by tdc" FLOAT32_IEEE MisfireDetectionTDC_CM_single_adm 0 0 -3.4E+38 3.4E+38 ECU_ADDRESS 0x40003E44 /end MEASUREMENT
/begin MEASUREMENT osCic_CecVect "Cyclicity Cec vector tdc by tdc" FLOAT32_IEEE MisfireDetectionTDC_CM_single_adm 0 0 -3.4E+38 3.4E+38 ECU_ADDRESS 0x40003E24 MATRIX_DIM 8 /end MEASUREMENT
/begin MEASUREMENT osCic_CecfG "iclicita terzi filtrata" SLONG MisfdTDC_CM_int32_adm 0 0 -500000000 500000000 ECU_ADDRESS 0x400037F0 /end MEASUREMENT
/begin MEASUREMENT osCic_CecfGVect "Filtered Cyclicity Cec vector tdc by tdc" FLOAT32_IEEE MisfireDetectionTDC_CM_single_adm 0 0 -3.4E+38 3.4E+38 ECU_ADDRESS 0x40003E04 MATRIX_DIM 8 /end MEASUREMENT
/begin MEASUREMENT osCic_SB "Cyclicity SB tdc by tdc" FLOAT32_IEEE MisfireDetectionTDC_CM_single_adm 0 0 -3.4E+38 3.4E+38 ECU_ADDRESS 0x40003E00 /end MEASUREMENT
/begin MEASUREMENT osCic_SBVect "Cyclicity SB vector tdc by tdc" FLOAT32_IEEE MisfireDetectionTDC_CM_single_adm 0 0 -3.4E+38 3.4E+38 ECU_ADDRESS 0x40003DE0 MATRIX_DIM 8 /end MEASUREMENT
/begin MEASUREMENT osCic_SBfG "Filtered cyclicity SB (Bank 1)" SLONG MisfdTDC_CM_int32_adm 0 0 -500000000 500000000 ECU_ADDRESS 0x400037EC /end MEASUREMENT
/begin MEASUREMENT osCic_SBfGVect "Filtered Cyclicity SB vector tdc by tdc" FLOAT32_IEEE MisfireDetectionTDC_CM_single_adm 0 0 -3.4E+38 3.4E+38 ECU_ADDRESS 0x40003DC0 MATRIX_DIM 8 /end MEASUREMENT
/begin MEASUREMENT osCntDerDn "Flag di decremento del contatore di dissimetria (Diagnosi Sonda Lambda Monte)" UBYTE Dcat_Diagnosis100ms_CM_boolean_adm 0 0 0 1 ECU_ADDRESS 0x40002635 /end MEASUREMENT
/begin MEASUREMENT osCntDerUp "Flag di incremento del contatore di dissimetria (Diagnosi Sonda Lambda Monte)" UBYTE Dcat_Diagnosis100ms_CM_boolean_adm 0 0 0 1 ECU_ADDRESS 0x40002636 /end MEASUREMENT
/begin MEASUREMENT osCntLamPost "Contatore assoluto di transizioni della sonda lambda valle" ULONG Dcat_Diagnosis100ms_CM_uint32_adm 0 0 0 1000000000 ECU_ADDRESS 0x400028D8 /end MEASUREMENT
/begin MEASUREMENT osCntLamPre "Contatore assoluto di transizioni della sonda lambda monte" ULONG Dcat_Diagnosis100ms_CM_uint32_adm 0 0 0 1000000000 ECU_ADDRESS 0x400028DC /end MEASUREMENT
/begin MEASUREMENT osCntSatLean "Contatore delle occorrenze per la validazione del fault Soglia di fault DTC 0130 \"Sonda guasta magra\" per la segnalazione del guasto" UBYTE Test_KO2_TDC_Symbol_CM_uint8_adm 0 0 0 255 ECU_ADDRESS 0x40002EDA /end MEASUREMENT
/begin MEASUREMENT osCntSatRich "Contatore delle occorrenze per la validazione del fault Soglia di fault DTC 0130 \"Sonda guasta ricca\" per la segnalazione del guasto" UBYTE Test_KO2_TDC_Symbol_CM_uint8_adm 0 0 0 255 ECU_ADDRESS 0x40002ED9 /end MEASUREMENT
/begin MEASUREMENT osCondAtt "Activation flag for flywheel correction computation" UBYTE FlywheelCorrTDC_CM_boolean_adm 0 0 0 1 ECU_ADDRESS 0x40003AC7 /end MEASUREMENT
/begin CHARACTERISTIC osDADV_IDLE_THR "Soglia di anticipo LQI per disabilitare la diagnosi della ripartizione (Diagnosi Fuel System)" VALUE 0xFC5A0C Scalar_UWORD 0 Test_RipCarica_TDC_Symbol_CM_ufix16_En4_deg 0 60 /end CHARACTERISTIC
/begin CHARACTERISTIC osDCATNBDGG "Numero minimo di diagnosi catalizzatore per effettuare la chiamata al supervisore" VALUE 0xFC483C Scalar_UWORD 0 Cata100ms_Symbol_CM_uint16_adm 0 65535 /end CHARACTERISTIC
/begin CHARACTERISTIC osDCATNBZNG "Numero minimo di zone in cui è stata eseguita la diagnosi catalizzatore per effettuare la chiamata al supervisore" VALUE 0xFC4804 Scalar_UBYTE 0 Cata100ms_Symbol_CM_uint8_adm 0 30 /end CHARACTERISTIC
/begin CHARACTERISTIC osDCATSINDG "Soglia di percentuale di fault rilevati diagnosi catalizzatore per la segnalazione al supervisore" VALUE 0xFC483A Scalar_UWORD 0 Cata100ms_Symbol_CM_ufix16_Sp01__ 0 100 /end CHARACTERISTIC
/begin CHARACTERISTIC osDCMV_INTH "Soglia su % di test con fault per attivare il Flag di diagnosi monte-valle" VALUE 0xFC49B6 Scalar_UWORD 0 DCmvInterface100ms_Symbol_CM_ufix16_Sp01__ 0 100 /end CHARACTERISTIC
/begin CHARACTERISTIC osDCMV_LEV "Soglia per su KO22 fitrato per valore troppo grande in diagnosi monte-valle" VALUE 0xFC49B4 Scalar_UWORD 0 DCmvInterface100ms_Symbol_CM_ufix16_Sp01__ 0 25 /end CHARACTERISTIC
/begin CHARACTERISTIC osDCMV_MATE "Soglia contatore massimo di test diagnosi monte-valle" VALUE 0xFC49AD Scalar_UBYTE 0 DCmvInterface100ms_Symbol_CM_uint8_adm 0 255 /end CHARACTERISTIC
/begin CHARACTERISTIC osDCMV_THRE "Soglia intermedia di test su cui eseguire il calcolo % di Fault per diagnosi monte-valle" VALUE 0xFC49AC Scalar_UBYTE 0 DCmvInterface100ms_Symbol_CM_uint8_adm 0 255 /end CHARACTERISTIC
/begin CHARACTERISTIC osDC_THR_INIT "Indice soglia catalizzatore di inizializzazione (valore temporaneo)" VALUE 0xFC4838 Scalar_UWORD 0 Cata100ms_Symbol_CM_ufix16_En7__ 0 100 /end CHARACTERISTIC
/begin MEASUREMENT osDCaIndStG "Indice ultimo periodo stabilizzato" UWORD Dcat_Diagnosis100ms_CM_ufix16_En6__ 0 0 0 100 ECU_ADDRESS 0x40002648 /end MEASUREMENT
/begin MEASUREMENT osDCaIntPostO "Integrale nel periodo stabilizzato del quadrato del segnale lambda valle" ULONG Cata100ms_Symbol_CM_uint32_mV_2 0 0 0 4294967000 ECU_ADDRESS 0x400027B8 /end MEASUREMENT
/begin MEASUREMENT osDCaIntPreO "Integrale nel periodo stabilizzato del quadrato del segnale lambda monte" ULONG Cata100ms_Symbol_CM_uint32_mV_2 0 0 0 4294967000 ECU_ADDRESS 0x400027B4 /end MEASUREMENT
/begin MEASUREMENT osDCaStabTGM "Tempo di calcolo del periodo stabilizzato memorizzato" UWORD Cata100ms_Symbol_CM_ufix16_Sp1_s 0 0 0 6553.5 ECU_ADDRESS 0x4000279A /end MEASUREMENT
/begin MEASUREMENT osDCaStabTGO "empo di calcolo del periodo stabilizzato in uscita dal blocco di calcolo degli integrali DCAINTEGGCalc" UWORD Dcat_Diagnosis100ms_CM_ufix16_Sp1_s 0 0 0 6553.5 ECU_ADDRESS 0x40002646 /end MEASUREMENT
/begin MEASUREMENT osDCaThrInGM "Indice soglia catalizzatore memorizzato" UWORD Cata100ms_Symbol_CM_ufix16_En7__ 0 0 0 100 ECU_ADDRESS 0x40002798 /end MEASUREMENT
/begin MEASUREMENT osDCaThrInGO "ndice soglia catalizzatore in uscita dal blocco di calcolo degli integrali DCAINTEGGCalc" UWORD Dcat_Diagnosis100ms_CM_ufix16_En7__ 0 0 0 100 ECU_ADDRESS 0x4000264A /end MEASUREMENT
/begin MEASUREMENT osDCatCataEnable "Flag di enable per la registrazione dei parametri ambientali temporanei da parte della diagnosi catalizzatore\r\n      ( ! osDCatStoreParAmb && osDCatEobdCall1)" UBYTE Dcat_Diagnosis100ms_CM_boolean_adm 0 0 0 1 ECU_ADDRESS 0x4000261E /end MEASUREMENT
/begin MEASUREMENT osDCatCondG "Flag condizioni di attivazione per la diagnosi catalizzatore" UBYTE Cata100ms_Symbol_CM_boolean_adm 0 0 0 1 ECU_ADDRESS 0x40002788 /end MEASUREMENT
/begin MEASUREMENT osDCatCondVect "Vettore delle condizioni di abilitazione della diagnosi catalizzatore" UWORD Cata100ms_Symbol_CM_uint16_adm 0 0 0 65535 ECU_ADDRESS 0x40002796 /end MEASUREMENT
/begin MEASUREMENT osDCatDone "Flag di segnalazione della diagnosi catalizzatore terminata" UBYTE Dcat_Diagnosis100ms_CM_boolean_adm 0 0 0 1 ECU_ADDRESS 0x4000262D /end MEASUREMENT
/begin MEASUREMENT osDCatEobdCall1 "Flag della prima chiamata al supervisore da parte della diagnosi catalizzatore" UBYTE Dcat_Diagnosis100ms_CM_boolean_adm 0 0 0 1 ECU_ADDRESS 0x4000262F /end MEASUREMENT
/begin MEASUREMENT osDCatEobdCall2 "Flag della seconda chiamata al supervisore da parte della diagnosi catalizzatore" UBYTE Dcat_Diagnosis100ms_CM_boolean_adm 0 0 0 1 ECU_ADDRESS 0x4000262E /end MEASUREMENT
/begin MEASUREMENT osDCatEobdIndex "ndice risultato della diagnosi catalizzatore indicante la percentuale di fault rilevati" UWORD Dcat_Diagnosis100ms_CM_ufix16_Sp01__ 0 0 0 100 ECU_ADDRESS 0x4000265C /end MEASUREMENT
/begin MEASUREMENT osDCatFcnt "ontatore dei fault rilevati dalla diagnosi catalizzatore" UWORD Dcat_Diagnosis100ms_CM_uint16_adm 0 0 0 65535 ECU_ADDRESS 0x40002670 /end MEASUREMENT
/begin MEASUREMENT osDCatFreqGM "Frequenza di oscillazione della lambda a monte memorizzato" UWORD Cata100ms_Symbol_CM_ufix16_En7_hz 0 0 0 511.9921875 ECU_ADDRESS 0x40002794 /end MEASUREMENT
/begin MEASUREMENT osDCatFrqNGM "Frequenza nominale del catalizzatore memorizzato" UWORD Cata100ms_Symbol_CM_ufix16_En7_hz 0 0 0 511.9921875 ECU_ADDRESS 0x40002792 /end MEASUREMENT
/begin MEASUREMENT osDCatGenStG "Macchina a stati per la gestione della sicronizzazione delle operazioni eseguite dalla diagnosi catalizzatore" UBYTE Cata100ms_Symbol_CM_uint8_adm 0 0 0 8 ECU_ADDRESS 0x40002787 /end MEASUREMENT
/begin MEASUREMENT osDCatIntTmpPostM "Integrale nel periodo stabilizzato del quadrato del segnale lambda post-cat filtrato e memorizzato" ULONG Cata100ms_Symbol_CM_uint32_adm 0 0 0 4294967000 ECU_ADDRESS 0x400027B0 /end MEASUREMENT
/begin MEASUREMENT osDCatIntTmpPreM "Integrale nel periodo stabilizzato del quadrato del segnale lambda pre-cat filtrato e memorizzato" ULONG Cata100ms_Symbol_CM_uint32_adm 0 0 0 4294967000 ECU_ADDRESS 0x400027AC /end MEASUREMENT
/begin MEASUREMENT osDCatLaFPost "Tensione della sonda lambda valle filtrata per la diagnosi catalizzatore" SWORD Cata100ms_Symbol_CM_int16_mV 0 0 -1000 1000 ECU_ADDRESS 0x400027A2 /end MEASUREMENT
/begin MEASUREMENT osDCatLaFPre "Tensione della sonda lambda monte filtrata per la diagnosi catalizzatore" SWORD Cata100ms_Symbol_CM_int16_mV 0 0 -1000 1000 ECU_ADDRESS 0x400027A0 /end MEASUREMENT
/begin MEASUREMENT osDCatLaFSt "Stato del filtraggio delle tensioni lambda monte-valle per la diagnosi catalizzatore" UBYTE Cata100ms_Symbol_CM_uint8_adm 0 0 0 2 ECU_ADDRESS 0x40002786 /end MEASUREMENT
/begin MEASUREMENT osDCatSFMState "Stato di avanzamento della diagnosi catalizzatore (nel driving cycle corrente)" UBYTE Dcat_Diagnosis100ms_CM_uint8_adm 0 0 1 4 ECU_ADDRESS 0x40002641 /end MEASUREMENT
/begin MEASUREMENT osDCatSInd "oglia Indice risultato dalla diagnosi EOBD catalizzatore" UWORD Dcat_Diagnosis100ms_CM_ufix16_Sp01__ 0 0 0 100 ECU_ADDRESS 0x4000265A /end MEASUREMENT
/begin MEASUREMENT osDCatStoreParAmb "Flag di chiamata per la registrazione dei parametri ambientali temporanei da parte della diagnosi catalizzatore" UBYTE Dcat_Diagnosis100ms_CM_boolean_adm 0 0 0 1 ECU_ADDRESS 0x40002630 /end MEASUREMENT
/begin MEASUREMENT osDCmvDone "Flag di segnalazione della diagnosi monte-valle terminata" UBYTE Dcat_Diagnosis100ms_CM_boolean_adm 0 0 0 1 ECU_ADDRESS 0x40002629 /end MEASUREMENT
/begin MEASUREMENT osDCmvEobdCall1 "Flag della prima chiamata al supervisore da parte della diagnosi monte-valle" UBYTE Dcat_Diagnosis100ms_CM_boolean_adm 0 0 0 1 ECU_ADDRESS 0x4000262B /end MEASUREMENT
/begin MEASUREMENT osDCmvEobdCall2 "Flag della seconda chiamata al supervisore da parte della diagnosi monte-valle" UBYTE Dcat_Diagnosis100ms_CM_boolean_adm 0 0 0 1 ECU_ADDRESS 0x4000262A /end MEASUREMENT
/begin MEASUREMENT osDCmvEobdIndex "Indice risultato dalla diagnosi EOBD congruenza sonde lambda monte-valle" UWORD Dcat_Diagnosis100ms_CM_ufix16_Sp01__ 0 0 0 100 ECU_ADDRESS 0x40002658 /end MEASUREMENT
/begin MEASUREMENT osDCmvFlt "Contatore di test KO22 con valore troppo grande per diagnosi monte-valle" UBYTE DCmvInterface100ms_Symbol_CM_uint8_adm 0 0 0 255 ECU_ADDRESS 0x4000281D /end MEASUREMENT
/begin MEASUREMENT osDCmvInd "Valore % di test con Fault per diagnosi monte-valle" UWORD DCmvInterface100ms_Symbol_CM_ufix16_Sp01__ 0 0 0 100 ECU_ADDRESS 0x4000281E /end MEASUREMENT
/begin MEASUREMENT osDCmvInterfaceEnable "flag di enable per la registrazione dei parametri ambientali temporanei da parte della diagnosi monte-valle\r\n      (! osDCmvStoreParAmb && osDcmvEobdCall1)" UBYTE Dcat_Diagnosis100ms_CM_boolean_adm 0 0 0 1 ECU_ADDRESS 0x4000261D /end MEASUREMENT
/begin MEASUREMENT osDCmvSFMState "Stato di avanzamento della diagnosi monte-valle (nel driving cycle corrente)" UBYTE Dcat_Diagnosis100ms_CM_uint8_adm 0 0 1 4 ECU_ADDRESS 0x40002640 /end MEASUREMENT
/begin MEASUREMENT osDCmvSInd "Flag di chiamata al supervisore da parte della diagnosi monte-valle" UWORD Dcat_Diagnosis100ms_CM_ufix16_Sp01__ 0 0 0 100 ECU_ADDRESS 0x40002656 /end MEASUREMENT
/begin MEASUREMENT osDCmvStoreParAmb "lag di chiamata per la registrazione dei parametri ambientali temporanei da parte della diagnosi monte-valle" UBYTE Dcat_Diagnosis100ms_CM_boolean_adm 0 0 0 1 ECU_ADDRESS 0x4000262C /end MEASUREMENT
/begin MEASUREMENT osDCmvTest "Contatore totale di tutti i test consecutivi che sono eseguiti sul KO22 per diagnosi monte-valle" UBYTE DCmvInterface100ms_Symbol_CM_uint8_adm 0 0 0 255 ECU_ADDRESS 0x4000281C /end MEASUREMENT
/begin MEASUREMENT osDCtAbsCntInStM "Contatore di transizioni a monte nel periodo stabilizzato memorizzato" ULONG Cata100ms_Symbol_CM_uint32_adm 0 0 0 4294967000 ECU_ADDRESS 0x400027A8 /end MEASUREMENT
/begin MEASUREMENT osDCtAbsCntLstM " Ultimo valore memorizzato di transizioni effettuate dalla sonda lambda monte memorizzato" ULONG Cata100ms_Symbol_CM_uint32_adm 0 0 0 4294967000 ECU_ADDRESS 0x400027A4 /end MEASUREMENT
/begin MEASUREMENT osDCtFrqNomTmpM "Frequenza nominale del catalizzatore (valore temporaneo) memorizzato" UWORD Cata100ms_Symbol_CM_ufix16_En7_hz 0 0 0 511.9921875 ECU_ADDRESS 0x40002790 /end MEASUREMENT
/begin MEASUREMENT osDCtThrTmpM "Indice soglia catalizzatore (valore temporaneo) memorizzato" UWORD Cata100ms_Symbol_CM_ufix16_En7__ 0 0 0 100 ECU_ADDRESS 0x4000278E /end MEASUREMENT
/begin MEASUREMENT osDFLFenable "Flag della prima chiamata al supervisore da parte della diagnosi fuelsystem - ripartizione - segnale di enable per abilitare l\'automa associato (linea DFLL)" UBYTE Fuels_CtrlMgmtTDC_CM_boolean_adm 0 0 0 1 ECU_ADDRESS 0x40002E62 /end MEASUREMENT
/begin MEASUREMENT osDFLLenable "Flag della prima chiamata al supervisore da parte della diagnosi fuelsystem - ripartizione - segnale di enable per abilitare l\'automa associato (linea DFLL)" UBYTE Fuels_CtrlMgmtTDC_CM_boolean_adm 0 0 0 1 ECU_ADDRESS 0x40002E61 /end MEASUREMENT
/begin MEASUREMENT osDFLRenable "Flag della prima chiamata al supervisore da parte della diagnosi fuelsystem - ripartizione - segnale di enable per abilitare l\'automa associato (linea DFLR)" UBYTE Fuels_CtrlMgmtTDC_CM_boolean_adm 0 0 0 1 ECU_ADDRESS 0x40002E60 /end MEASUREMENT
/begin CHARACTERISTIC osDFLSY_IN_IDL "Valore di abilitazione per ingresso in idle (Diagnosi Fuel System)" VALUE 0xFC5A0A Scalar_UWORD 0 Test_RipCarica_TDC_Symbol_CM_uint16_adm 0 65535 /end CHARACTERISTIC
/begin CHARACTERISTIC osDFLSY_TAIR "Soglia di temperatura aria per abilitazione diagnosi ripartizione (Diagnosi Fuel System)" VALUE 0xFC59F8 Scalar_UBYTE 0 Test_RipCarica_TDC_Symbol_CM_ufix8_Bn40_degC -40 140 /end CHARACTERISTIC
/begin CHARACTERISTIC osDFLSY_TH2O "Soglia di temperatura motore per abilitazione diagnosi fuel system (Diagnosi Fuel System)" VALUE 0xFC59A8 Scalar_UBYTE 0 Abilitazione_DFSLY_100ms_Symbol_CM_ufix8_Bn40_degC -40 140 /end CHARACTERISTIC
/begin CHARACTERISTIC osDFLSY_TWAT_NRG "Periodo di attesa in PMS per abilitazione della diagnosi ripartizione (Diagnosi Fuel System)" VALUE 0xFC5A08 Scalar_UWORD 0 Test_RipCarica_TDC_Symbol_CM_uint16_adm 0 65535 /end CHARACTERISTIC
/begin MEASUREMENT osDFlfDone "Flag di segnalazione della diagnosi fuelsystem - ripartizione terminata" UBYTE Fuels_CtrlMgmtTDC_CM_boolean_adm 0 0 0 1 ECU_ADDRESS 0x40002E69 /end MEASUREMENT
/begin MEASUREMENT osDFlfEobdCall1 "Flag della prima chiamata al supervisore da parte della diagnosi fuelsystem - ripartizione" UBYTE Fuels_CtrlMgmtTDC_CM_boolean_adm 0 0 0 1 ECU_ADDRESS 0x40002E76 /end MEASUREMENT
/begin MEASUREMENT osDFlfEobdCall2 "Flag della seconda chiamata al supervisore da parte della diagnosi fuelsystem - ripartizione" UBYTE Fuels_CtrlMgmtTDC_CM_boolean_adm 0 0 0 1 ECU_ADDRESS 0x40002E6D /end MEASUREMENT
/begin MEASUREMENT osDFlfSFMState "Stato di avanzamento della diagnosi fuelsystem - ripartizione (nel driving cycle corrente)" UBYTE Fuels_CtrlMgmtTDC_CM_uint8_adm 0 0 1 4 ECU_ADDRESS 0x40002E7B /end MEASUREMENT
/begin MEASUREMENT osDFlfStoreParAmb "Flag di chiamata per la registrazione dei parametri ambientali temporanei da parte della diagnosi fuelsystem - ripartizione" UBYTE Fuels_CtrlMgmtTDC_CM_boolean_adm 0 0 0 1 ECU_ADDRESS 0x40002E75 /end MEASUREMENT
/begin MEASUREMENT osDFllDone "Flag di segnalazione della diagnosi fuelsystem - lean terminata" UBYTE Fuels_CtrlMgmtTDC_CM_boolean_adm 0 0 0 1 ECU_ADDRESS 0x40002E6A /end MEASUREMENT
/begin MEASUREMENT osDFllEobdCall1 "Flag della prima chiamata al supervisore da parte della diagnosi fuelsystem - lean" UBYTE Fuels_CtrlMgmtTDC_CM_boolean_adm 0 0 0 1 ECU_ADDRESS 0x40002E73 /end MEASUREMENT
/begin MEASUREMENT osDFllEobdCall2 "Flag della seconda chiamata al supervisore da parte della diagnosi fuelsystem - lean" UBYTE Fuels_CtrlMgmtTDC_CM_boolean_adm 0 0 0 1 ECU_ADDRESS 0x40002E6E /end MEASUREMENT
/begin MEASUREMENT osDFllSFMState "Stato di avanzamento della diagnosi fuelsystem - lean (nel driving cycle corrente)" UBYTE Fuels_CtrlMgmtTDC_CM_uint8_adm 0 0 1 4 ECU_ADDRESS 0x40002E7A /end MEASUREMENT
/begin MEASUREMENT osDFllStoreParAmb "lag di chiamata per la registrazione dei parametri ambientali temporanei da parte della diagnosi fuelsystem - lean" UBYTE Fuels_CtrlMgmtTDC_CM_boolean_adm 0 0 0 1 ECU_ADDRESS 0x40002E72 /end MEASUREMENT
/begin MEASUREMENT osDFlrDone "Flag di segnalazione della diagnosi fuelsystem - rich terminata" UBYTE Fuels_CtrlMgmtTDC_CM_boolean_adm 0 0 0 1 ECU_ADDRESS 0x40002E6B /end MEASUREMENT
/begin MEASUREMENT osDFlrEobdCall1 "Flag della prima chiamata al supervisore al supervisore da parte della diagnosi fuelsystem - rich" UBYTE Fuels_CtrlMgmtTDC_CM_boolean_adm 0 0 0 1 ECU_ADDRESS 0x40002E70 /end MEASUREMENT
/begin MEASUREMENT osDFlrEobdCall2 "Flag della seconda chiamata al supervisore al supervisore da parte della diagnosi fuelsystem - rich" UBYTE Fuels_CtrlMgmtTDC_CM_boolean_adm 0 0 0 1 ECU_ADDRESS 0x40002E6C /end MEASUREMENT
/begin MEASUREMENT osDFlrSFMState "Stato di avanzamento della diagnosi fuelsystem - rich (nel driving cycle corrente)" UBYTE Fuels_CtrlMgmtTDC_CM_uint8_adm 0 0 1 4 ECU_ADDRESS 0x40002E79 /end MEASUREMENT
/begin MEASUREMENT osDFlrStoreParAmb "lag di chiamata per la registrazione dei parametri ambientali temporanei da parte della diagnosi fuelsystem - rich" UBYTE Fuels_CtrlMgmtTDC_CM_boolean_adm 0 0 0 1 ECU_ADDRESS 0x40002E6F /end MEASUREMENT
/begin MEASUREMENT osDFlsLamL "lag di segnalazione di fault sonda lambda monte magra da parte della diagnosi fuelsystem - lean" UBYTE Ctit_LambdaPreDiag4ms_CM_boolean_adm 0 0 0 1 ECU_ADDRESS 0x40002E74 /end MEASUREMENT
/begin MEASUREMENT osDFlsLamR "lag di segnalazione di fault sonda lambda monte ricca da parte della diagnosi fuelsystem - rich" UBYTE Ctit_LambdaPreDiag4ms_CM_boolean_adm 0 0 0 1 ECU_ADDRESS 0x40002E71 /end MEASUREMENT
/begin MEASUREMENT osDFlsyCIdl "Contatore di PMS dall ingresso in idle per abilitazione diagnosi ripartizione (Diagnosi Fuel System)" UWORD Test_RipCarica_TDC_Symbol_CM_uint16_adm 0 0 0 65535 ECU_ADDRESS 0x40002F26 /end MEASUREMENT
/begin MEASUREMENT osDFlsyEnabOut "Abilitazione della diagnosi Fuel System da calibrazione" UBYTE Fuels_CtrlMgmt100ms_CM_boolean_adm 0 0 0 1 ECU_ADDRESS 0x40002E3B /end MEASUREMENT
/begin MEASUREMENT osDFlsyEobdIndex "ndice risultato dalla diagnosi EOBD fuel system" UWORD Fuels_CtrlMgmtTDC_CM_ufix16_Sp01__ 0 0 0 100 ECU_ADDRESS 0x40002E7E /end MEASUREMENT
/begin MEASUREMENT osDFlsyIdlEn "Flag abilitazione diagnosi ripartizione carica in idle (Diagnosi Fuel System)" UBYTE Test_RipCarica_TDC_Symbol_CM_boolean_adm 0 0 0 1 ECU_ADDRESS 0x40002F1D /end MEASUREMENT
/begin MEASUREMENT osDFlsyTh2oOut "oglia di temperatura motore in calibrazione per abilitazione diagnosi fuel system" UBYTE Fuels_CtrlMgmt100ms_CM_ufix8_Bn40_degC 0 0 -40 140 ECU_ADDRESS 0x40002E34 /end MEASUREMENT
/begin CHARACTERISTIC osDLAMNBDGG "Numero minimo di diagnosi sonda lambda monte per effettuare la chiamata al supervisore" VALUE 0xFC49C0 Scalar_UBYTE 0 ExitCalcDLAM100ms_Symbol_CM_uint8_adm 0 100 /end CHARACTERISTIC
/begin CHARACTERISTIC osDLAMNBZNG "Numero minimo di zone in cui è stata eseguita la diagnosi sonda lambda monte per effettuare la chiamata al supervisore" VALUE 0xFC49BF Scalar_UBYTE 0 ExitCalcDLAM100ms_Symbol_CM_uint8_adm 0 30 /end CHARACTERISTIC
/begin CHARACTERISTIC osDLAM_AVE_EN "Abilitazione del test sul valor medio del segnale sonda lambda monte (Diagnosi Sonda Lambda Monte)" VALUE 0xFC49BE Scalar_BOOLEAN 0 ExitCalcDLAM100ms_Symbol_CM_boolean_adm 0 1 /end CHARACTERISTIC
/begin CHARACTERISTIC osDLAM_DER_EN "Abilitazione del test sulla asimettria del segnale sonda lambda monte (Diagnosi Sonda Lambda Monte)" VALUE 0xFC49BD Scalar_BOOLEAN 0 ExitCalcDLAM100ms_Symbol_CM_boolean_adm 0 1 /end CHARACTERISTIC
/begin CHARACTERISTIC osDLAM_DGIRI "Massima variazione giri permessa per abilitazione della diagnosi sonda lambda monte" VALUE 0xFC47F4 Scalar_UWORD 0 AbilitazioneDLAM100ms_Symbol_CM_uint16_rpm 0 10000 /end CHARACTERISTIC
/begin CHARACTERISTIC osDLAM_DMAP "Massima variazione pressione aria nel collettore permessa per abilitazione della diagnosi sonda lambda monte" VALUE 0xFC47F2 Scalar_UWORD 0 AbilitazioneDLAM100ms_Symbol_CM_uint16_mbar 0 2350 /end CHARACTERISTIC
/begin CHARACTERISTIC osDLAM_FILT "Selezione tensione lambda monte filtrata (non filtrata =0, filtrata=1)(Diagnosi Sonda Lambda Monte)" VALUE 0xFC49C8 Scalar_BOOLEAN 0 VarMgmDLAM100ms_Symbol_CM_boolean_adm 0 1 /end CHARACTERISTIC
/begin CHARACTERISTIC osDLAM_FREQ_EN "Abilitazione del test sulla frequenza del segnale sonda lambda monte (Diagnosi Sonda Lambda Monte)" VALUE 0xFC49BC Scalar_BOOLEAN 0 ExitCalcDLAM100ms_Symbol_CM_boolean_adm 0 1 /end CHARACTERISTIC
/begin CHARACTERISTIC osDLAM_HYST_V "Isteresi sulla tensione sonda lambda monte per l aggiornamento del contatore di dissimetria (Diagnosi Sonda Lambda Monte)" VALUE 0xFC47FE Scalar_UBYTE 0 CalcDLAM100ms_Symbol_CM_uint8_mV 0 250 /end CHARACTERISTIC
/begin CHARACTERISTIC osDLAM_RPM_H "Soglia superiore di giri motore per abilitazione della diagnosi sonda lambda monte" VALUE 0xFC47F0 Scalar_UWORD 0 AbilitazioneDLAM100ms_Symbol_CM_uint16_rpm 0 10000 /end CHARACTERISTIC
/begin CHARACTERISTIC osDLAM_RPM_L "Soglia inferiore di giri motore per abilitazione della diagnosi sonda lambda monte" VALUE 0xFC47EE Scalar_UWORD 0 AbilitazioneDLAM100ms_Symbol_CM_uint16_rpm 0 10000 /end CHARACTERISTIC
/begin CHARACTERISTIC osDLAM_SIND "Soglia di percentuale di fault rilevati diagnosi sonda lambda monte per la segnalazione al supervisore" VALUE 0xFC49C6 Scalar_UWORD 0 ExitCalcDLAM100ms_Symbol_CM_ufix16_Sp01__ 0 100 /end CHARACTERISTIC
/begin CHARACTERISTIC osDLAM_TIME_MAX "Durata massima dei calcoli della diagnosi sonda lambda monte" VALUE 0xFC47FC Scalar_UWORD 0 ActivationTableDLAM100ms_Symbol_CM_ufix16_Sp1_s 0 6553.5 /end CHARACTERISTIC
/begin CHARACTERISTIC osDLAM_TIME_MIN "Durata minima dei calcoli della diagnosi sonda lambda monte" VALUE 0xFC47FA Scalar_UWORD 0 ActivationTableDLAM100ms_Symbol_CM_ufix16_Sp1_s 0 6553.5 /end CHARACTERISTIC
/begin CHARACTERISTIC osDLAM_VAVE_MAX "Soglia superiore di valor medio di segnale sonda lambda monte (Diagnosi Sonda Lambda Monte)" VALUE 0xFC49C4 Scalar_UWORD 0 ExitCalcDLAM100ms_Symbol_CM_uint16_mV 0 1000 /end CHARACTERISTIC
/begin CHARACTERISTIC osDLAM_VAVE_MIN "Soglia inferiore di valor medio di segnale sonda lambda monte (Diagnosi Sonda Lambda Monte)" VALUE 0xFC49C2 Scalar_UWORD 0 ExitCalcDLAM100ms_Symbol_CM_uint16_mV 0 1000 /end CHARACTERISTIC
/begin MEASUREMENT osDLamCalc "lag di abilitazione dei calcoli della diagnosi sonda lambda monte" UBYTE Dcat_Diagnosis100ms_CM_boolean_adm 0 0 0 1 ECU_ADDRESS 0x40002622 /end MEASUREMENT
/begin MEASUREMENT osDLamCalcRes1 "Reset 1, in caso di diagnosi abortita, del flag di abilitazione ai calcoli della diagnosi sonda lambda monte" UBYTE Dcat_Diagnosis100ms_CM_boolean_adm 0 0 0 1 ECU_ADDRESS 0x40002628 /end MEASUREMENT
/begin MEASUREMENT osDLamCalcRes2 "Reset 2, in caso di uscita dal segmento di calcolo, del flag di abilitazione ai calcoli della diagnosi sonda lambda monte" UBYTE Dcat_Diagnosis100ms_CM_boolean_adm 0 0 0 1 ECU_ADDRESS 0x40002627 /end MEASUREMENT
/begin MEASUREMENT osDLamCalcTime "urata dei calcoli della diagnosi sonda lambda monte" UWORD Dcat_Diagnosis100ms_CM_ufix16_Sp1_s 0 0 0 6553.5 ECU_ADDRESS 0x40002644 /end MEASUREMENT
/begin MEASUREMENT osDLamCntTran "ontatore di transizioni sonda lambda monte a partire dalla sicronizzazione (Diagnosi Sonda Lambda Monte)" UWORD Dcat_Diagnosis100ms_CM_uint16_adm 0 0 0 65535 ECU_ADDRESS 0x4000266A /end MEASUREMENT
/begin MEASUREMENT osDLamCntTranOld "ontatore di transizioni sonda lambda monte a partire dalla sicronizzazione, al campione precedente (Diagnosi Sonda Lambda Monte)" UWORD Dcat_Diagnosis100ms_CM_uint16_adm 0 0 0 65535 ECU_ADDRESS 0x40002668 /end MEASUREMENT
/begin MEASUREMENT osDLamCondVect "Vettore delle condizioni di abilitazione della diagnosi lambda monte" UWORD AbilitazioneDLAM100ms_Symbol_CM_uint16_adm 0 0 0 65535 ECU_ADDRESS 0x4000268C /end MEASUREMENT
/begin MEASUREMENT osDLamDerCnt "ontatore di asimettria del segnale sonda lambda (Diagnosi Sonda Lambda Monte)" SWORD Dcat_Diagnosis100ms_CM_int16_adm 0 0 -32768 32767 ECU_ADDRESS 0x4000267E /end MEASUREMENT
/begin MEASUREMENT osDLamDerDnTh "Soglia di asimettria inferiore validata (Diagnosi Sonda Lambda Monte)" SWORD Dcat_Diagnosis100ms_CM_int16__ 0 0 -32768 32767 ECU_ADDRESS 0x40002676 /end MEASUREMENT
/begin MEASUREMENT osDLamDerDnThTemp "Soglia di asimettria inferiore temporanea (Diagnosi Sonda Lambda Monte)" SWORD Dcat_Diagnosis100ms_CM_int16__ 0 0 -32768 32767 ECU_ADDRESS 0x40002678 /end MEASUREMENT
/begin MEASUREMENT osDLamDerUpTh "Soglia di asimettria superiore validata (Diagnosi Sonda Lambda Monte)" SWORD Dcat_Diagnosis100ms_CM_int16__ 0 0 -32768 32767 ECU_ADDRESS 0x4000267A /end MEASUREMENT
/begin MEASUREMENT osDLamDerUpThTemp "Soglia di asimettria superiore temporanea (Diagnosi Sonda Lambda Monte)" SWORD Dcat_Diagnosis100ms_CM_int16__ 0 0 -32768 32767 ECU_ADDRESS 0x4000267C /end MEASUREMENT
/begin MEASUREMENT osDLamDerive "Percentuale di dissimetria del segnale sonda lambda monte (Diagnosi Sonda Lambda Monte)" SWORD Dcat_Diagnosis100ms_CM_int16__ 0 0 -32768 32767 ECU_ADDRESS 0x40002680 /end MEASUREMENT
/begin MEASUREMENT osDLamDone "Flag di segnalazione della diagnosi sonda lambda terminata" UBYTE Dcat_Diagnosis100ms_CM_boolean_adm 0 0 0 1 ECU_ADDRESS 0x40002623 /end MEASUREMENT
/begin MEASUREMENT osDLamEn "lag di abilitazione calcoli della diagnosi sonda lambda monte" UBYTE Dcat_Diagnosis100ms_CM_boolean_adm 0 0 0 1 ECU_ADDRESS 0x4000263C /end MEASUREMENT
/begin MEASUREMENT osDLamEobdCall1 "Flag della prima chiamata al supervisore da parte della diagnosi sonda lambda monte" UBYTE Dcat_Diagnosis100ms_CM_boolean_adm 0 0 0 1 ECU_ADDRESS 0x40002625 /end MEASUREMENT
/begin MEASUREMENT osDLamEobdCall2 "Flag della seconda chiamata al supervisore da parte della diagnosi sonda lambda monte" UBYTE Dcat_Diagnosis100ms_CM_boolean_adm 0 0 0 1 ECU_ADDRESS 0x40002624 /end MEASUREMENT
/begin MEASUREMENT osDLamEobdIndex "ndice risultato dalla diagnosi EOBD sonda lambda monte" UWORD Dcat_Diagnosis100ms_CM_ufix16_Sp01__ 0 0 0 100 ECU_ADDRESS 0x40002654 /end MEASUREMENT
/begin MEASUREMENT osDLamExitCalcEnable "Flag di enable per la registrazione dei parametri ambientali temporanei da parte della diagnosi sonda lambda monte\r\n      ( ! osDLamStoreParAmb && osDLamEobdCall1)" UBYTE Dcat_Diagnosis100ms_CM_boolean_adm 0 0 0 1 ECU_ADDRESS 0x4000261C /end MEASUREMENT
/begin MEASUREMENT osDLamFcnt "Init:[0];Contatore dei fault rilevati dalla diagnosi sonda lambda monte" UWORD ExitCalcDLAM100ms_Symbol_CM_uint16_adm 0 0 0 65535 ECU_ADDRESS 0x40002880 /end MEASUREMENT
/begin COMPU_METHOD AbilitazioneDLAM100ms_Symbol_CM_FixEnableT "Enumerated data type: FixEnableT" TAB_VERB "%0.6" "" COMPU_TAB_REF VTAB_FOR_AbilitazioneDLAM100ms_Symbol_CM_FixEnableT /end COMPU_METHOD
/begin COMPU_METHOD AbilitazioneDLAM100ms_Symbol_CM_boolean_adm "Q = V" RAT_FUNC "%1.0" "adm" COEFFS 0 1 0 0 0 1 /end COMPU_METHOD
/begin COMPU_METHOD AbilitazioneDLAM100ms_Symbol_CM_uint16_adm "Q = V" RAT_FUNC "%5.0" "adm" COEFFS 0 1 0 0 0 1 /end COMPU_METHOD
/begin COMPU_METHOD AbilitazioneDLAM100ms_Symbol_CM_uint16_mbar "Q = V" RAT_FUNC "%5.0" "mbar" COEFFS 0 1 0 0 0 1 /end COMPU_METHOD
/begin COMPU_METHOD AbilitazioneDLAM100ms_Symbol_CM_uint16_rpm "Q = V" RAT_FUNC "%5.0" "rpm" COEFFS 0 1 0 0 0 1 /end COMPU_METHOD
/begin COMPU_METHOD Abilitazione_DFSLY_100ms_Symbol_CM_FixEnableT "Enumerated data type: FixEnableT" TAB_VERB "%0.6" "" COMPU_TAB_REF VTAB_FOR_Abilitazione_DFSLY_100ms_Symbol_CM_FixEnableT /end COMPU_METHOD
/begin COMPU_METHOD Abilitazione_DFSLY_100ms_Symbol_CM_boolean_adm "Q = V" RAT_FUNC "%1.0" "adm" COEFFS 0 1 0 0 0 1 /end COMPU_METHOD
/begin COMPU_METHOD Abilitazione_DFSLY_100ms_Symbol_CM_ufix8_Bn40_degC "Q = (V+40.000000)/1.000000" RAT_FUNC "%0.6" "degC" COEFFS 0 1 40 0 0 1 /end COMPU_METHOD
/begin COMPU_METHOD Abilitazione_DFSLY_100ms_Symbol_CM_uint8_adm "Q = V" RAT_FUNC "%3.0" "adm" COEFFS 0 1 0 0 0 1 /end COMPU_METHOD
/begin COMPU_METHOD ActivationTableDLAM100ms_Symbol_CM_ufix16_Sp1_s "Q = V*10.000000" RAT_FUNC "%0.6" "s" COEFFS 0 10 0 0 0 1 /end COMPU_METHOD
/begin COMPU_METHOD AdvnTDC_CM_FixEnableT "Enumerated data type: FixEnableT" TAB_VERB "%0.6" "" COMPU_TAB_REF VTAB_FOR_AdvnTDC_CM_FixEnableT /end COMPU_METHOD
/begin COMPU_METHOD AdvnTDC_CM_boolean_adm "Q = V" RAT_FUNC "%1.0" "adm" COEFFS 0 1 0 0 0 1 /end COMPU_METHOD
/begin COMPU_METHOD AdvnTDC_CM_sfix16_En4_degree "Q = V*16.000000" RAT_FUNC "%8.4" "degree" COEFFS 0 16 0 0 0 1 /end COMPU_METHOD
/begin COMPU_METHOD AdvnTDC_CM_ufix16_Bn40_degC "Q = (V+40.000000)/1.000000" RAT_FUNC "%0.6" "degC" COEFFS 0 1 40 0 0 1 /end COMPU_METHOD
/begin COMPU_METHOD AdvnTDC_CM_ufix16_En10_adm "Q = V*1024.000000" RAT_FUNC "%12.10" "adm" COEFFS 0 1024 0 0 0 1 /end COMPU_METHOD
/begin COMPU_METHOD AdvnTDC_CM_ufix16_En3__ "Q = V*8.000000" RAT_FUNC "%7.3" "%" COEFFS 0 8 0 0 0 1 /end COMPU_METHOD
/begin COMPU_METHOD AdvnTDC_CM_ufix16_En3_degree "Q = V*8.000000" RAT_FUNC "%7.3" "degree" COEFFS 0 8 0 0 0 1 /end COMPU_METHOD
/begin COMPU_METHOD AdvnTDC_CM_ufix16_En4_degree "Q = V*16.000000" RAT_FUNC "%8.4" "degree" COEFFS 0 16 0 0 0 1 /end COMPU_METHOD
/begin COMPU_METHOD AdvnTDC_CM_ufix16_En7_adm "Q = V*128.000000" RAT_FUNC "%10.7" "adm" COEFFS 0 128 0 0 0 1 /end COMPU_METHOD
/begin COMPU_METHOD AdvnTDC_CM_uint16_adm "Q = V" RAT_FUNC "%5.0" "adm" COEFFS 0 1 0 0 0 1 /end COMPU_METHOD
/begin COMPU_METHOD AdvnTDC_CM_uint16_rpm "Q = V" RAT_FUNC "%5.0" "rpm" COEFFS 0 1 0 0 0 1 /end COMPU_METHOD
/begin COMPU_METHOD Airq4ms_CM_boolean_adm "Q = V" RAT_FUNC "%1.0" "adm" COEFFS 0 1 0 0 0 1 /end COMPU_METHOD
/begin COMPU_METHOD Airq4ms_CM_eEGMD_adm "Enumerated data type: eEGMD" TAB_VERB "%0.6" "adm" COMPU_TAB_REF VTAB_FOR_Airq4ms_CM_eEGMD_adm /end COMPU_METHOD
/begin COMPU_METHOD Boost_CtrlMgmt50ms_CM_uint16_rpm "Q = V" RAT_FUNC "%5.0" "rpm" COEFFS 0 1 0 0 0 1 /end COMPU_METHOD
/begin COMPU_METHOD CalcADCYC_ADIDL_100ms_Symbol_CM_FixEnableT "Enumerated data type: FixEnableT" TAB_VERB "%0.6" "" COMPU_TAB_REF VTAB_FOR_CalcADCYC_ADIDL_100ms_Symbol_CM_FixEnableT /end COMPU_METHOD
/begin COMPU_METHOD CalcADCYC_ADIDL_100ms_Symbol_CM_boolean_adm "Q = V" RAT_FUNC "%1.0" "adm" COEFFS 0 1 0 0 0 1 /end COMPU_METHOD
/begin COMPU_METHOD CalcADCYC_ADIDL_100ms_Symbol_CM_uint8_adm "Q = V" RAT_FUNC "%3.0" "adm" COEFFS 0 1 0 0 0 1 /end COMPU_METHOD
/begin COMPU_METHOD CalcDLAM100ms_Symbol_CM_uint8_mV "Q = V" RAT_FUNC "%3.0" "mV" COEFFS 0 1 0 0 0 1 /end COMPU_METHOD
/begin COMPU_METHOD CalcGain_Adat_100ms_Symbol_CM_FixEnableT "Enumerated data type: FixEnableT" TAB_VERB "%0.6" "" COMPU_TAB_REF VTAB_FOR_CalcGain_Adat_100ms_Symbol_CM_FixEnableT /end COMPU_METHOD
/begin COMPU_METHOD CalcGain_Adat_100ms_Symbol_CM_boolean_adm "Q = V" RAT_FUNC "%1.0" "adm" COEFFS 0 1 0 0 0 1 /end COMPU_METHOD
/begin COMPU_METHOD CalcGain_Adat_100ms_Symbol_CM_uint8_adm "Q = V" RAT_FUNC "%3.0" "adm" COEFFS 0 1 0 0 0 1 /end COMPU_METHOD
/begin COMPU_METHOD Cata100ms_Symbol_CM_FixEnableT "Enumerated data type: FixEnableT" TAB_VERB "%0.6" "" COMPU_TAB_REF VTAB_FOR_Cata100ms_Symbol_CM_FixEnableT /end COMPU_METHOD
/begin COMPU_METHOD Cata100ms_Symbol_CM_boolean_adm "Q = V" RAT_FUNC "%1.0" "adm" COEFFS 0 1 0 0 0 1 /end COMPU_METHOD
/begin COMPU_METHOD Cata100ms_Symbol_CM_int16_mV "Q = V" RAT_FUNC "%5.0" "mV" COEFFS 0 1 0 0 0 1 /end COMPU_METHOD
/begin COMPU_METHOD Cata100ms_Symbol_CM_ufix16_Bn40_degC "Q = (V+40.000000)/1.000000" RAT_FUNC "%0.6" "degC" COEFFS 0 1 40 0 0 1 /end COMPU_METHOD
/begin COMPU_METHOD Cata100ms_Symbol_CM_ufix16_En15_adm "Q = V*32768.000000" RAT_FUNC "%16.15" "adm" COEFFS 0 32768 0 0 0 1 /end COMPU_METHOD
/begin COMPU_METHOD Cata100ms_Symbol_CM_ufix16_En7__ "Q = V*128.000000" RAT_FUNC "%10.7" "%" COEFFS 0 128 0 0 0 1 /end COMPU_METHOD
/begin COMPU_METHOD Cata100ms_Symbol_CM_ufix16_En7_hz "Q = V*128.000000" RAT_FUNC "%10.7" "hz" COEFFS 0 128 0 0 0 1 /end COMPU_METHOD
/begin COMPU_METHOD Cata100ms_Symbol_CM_ufix16_Sp01__ "Q = V*100.000000" RAT_FUNC "%0.6" "%" COEFFS 0 100 0 0 0 1 /end COMPU_METHOD
/begin COMPU_METHOD Cata100ms_Symbol_CM_ufix16_Sp1_s "Q = V*10.000000" RAT_FUNC "%0.6" "s" COEFFS 0 10 0 0 0 1 /end COMPU_METHOD
/begin COMPU_METHOD Cata100ms_Symbol_CM_ufix32_Sp1_s "Q = V*10.000000" RAT_FUNC "%0.6" "s" COEFFS 0 10 0 0 0 1 /end COMPU_METHOD
/begin COMPU_METHOD Cata100ms_Symbol_CM_uint16_adm "Q = V" RAT_FUNC "%5.0" "adm" COEFFS 0 1 0 0 0 1 /end COMPU_METHOD
/begin COMPU_METHOD Cata100ms_Symbol_CM_uint32_adm "Q = V" RAT_FUNC "%10.0" "adm" COEFFS 0 1 0 0 0 1 /end COMPU_METHOD
/begin COMPU_METHOD Cata100ms_Symbol_CM_uint32_mV_2 "Q = V" RAT_FUNC "%10.0" "mV^2" COEFFS 0 1 0 0 0 1 /end COMPU_METHOD
/begin COMPU_METHOD Cata100ms_Symbol_CM_uint8_adm "Q = V" RAT_FUNC "%3.0" "adm" COEFFS 0 1 0 0 0 1 /end COMPU_METHOD
/begin COMPU_METHOD CataTDC_Symbol_CM_FixEnableT "Enumerated data type: FixEnableT" TAB_VERB "%0.6" "" COMPU_TAB_REF VTAB_FOR_CataTDC_Symbol_CM_FixEnableT /end COMPU_METHOD
/begin COMPU_METHOD CataTDC_Symbol_CM_uint16_mV "Q = V" RAT_FUNC "%5.0" "mV" COEFFS 0 1 0 0 0 1 /end COMPU_METHOD
/begin COMPU_METHOD Ctit_LambdaPreDiag4ms_CM_boolean_adm "Q = V" RAT_FUNC "%1.0" "adm" COEFFS 0 1 0 0 0 1 /end COMPU_METHOD
/begin COMPU_METHOD DCmvInterface100ms_Symbol_CM_FixEnableT "Enumerated data type: FixEnableT" TAB_VERB "%0.6" "" COMPU_TAB_REF VTAB_FOR_DCmvInterface100ms_Symbol_CM_FixEnableT /end COMPU_METHOD
/begin COMPU_METHOD DCmvInterface100ms_Symbol_CM_boolean_adm "Q = V" RAT_FUNC "%1.0" "adm" COEFFS 0 1 0 0 0 1 /end COMPU_METHOD
/begin COMPU_METHOD DCmvInterface100ms_Symbol_CM_ufix16_Sp01__ "Q = V*100.000000" RAT_FUNC "%0.6" "%" COEFFS 0 100 0 0 0 1 /end COMPU_METHOD
/begin COMPU_METHOD DCmvInterface100ms_Symbol_CM_uint8_adm "Q = V" RAT_FUNC "%3.0" "adm" COEFFS 0 1 0 0 0 1 /end COMPU_METHOD
/begin COMPU_METHOD Dcat_Diagnosis100ms_CM_boolean_adm "Q = V" RAT_FUNC "%1.0" "adm" COEFFS 0 1 0 0 0 1 /end COMPU_METHOD
/begin COMPU_METHOD Dcat_Diagnosis100ms_CM_int16__ "Q = V" RAT_FUNC "%5.0" "%" COEFFS 0 1 0 0 0 1 /end COMPU_METHOD
/begin COMPU_METHOD Dcat_Diagnosis100ms_CM_int16_adm "Q = V" RAT_FUNC "%5.0" "adm" COEFFS 0 1 0 0 0 1 /end COMPU_METHOD
/begin COMPU_METHOD Dcat_Diagnosis100ms_CM_ufix16_En6__ "Q = V*64.000000" RAT_FUNC "%10.6" "%" COEFFS 0 64 0 0 0 1 /end COMPU_METHOD
/begin COMPU_METHOD Dcat_Diagnosis100ms_CM_ufix16_En7__ "Q = V*128.000000" RAT_FUNC "%10.7" "%" COEFFS 0 128 0 0 0 1 /end COMPU_METHOD
/begin COMPU_METHOD Dcat_Diagnosis100ms_CM_ufix16_Sp01__ "Q = V*100.000000" RAT_FUNC "%0.6" "%" COEFFS 0 100 0 0 0 1 /end COMPU_METHOD
/begin COMPU_METHOD Dcat_Diagnosis100ms_CM_ufix16_Sp01_hz "Q = V*100.000000" RAT_FUNC "%0.6" "hz" COEFFS 0 100 0 0 0 1 /end COMPU_METHOD
/begin COMPU_METHOD Dcat_Diagnosis100ms_CM_ufix16_Sp1_s "Q = V*10.000000" RAT_FUNC "%0.6" "s" COEFFS 0 10 0 0 0 1 /end COMPU_METHOD
/begin COMPU_METHOD Dcat_Diagnosis100ms_CM_uint16_adm "Q = V" RAT_FUNC "%5.0" "adm" COEFFS 0 1 0 0 0 1 /end COMPU_METHOD
/begin COMPU_METHOD Dcat_Diagnosis100ms_CM_uint32_adm "Q = V" RAT_FUNC "%10.0" "adm" COEFFS 0 1 0 0 0 1 /end COMPU_METHOD
/begin COMPU_METHOD Dcat_Diagnosis100ms_CM_uint8_adm "Q = V" RAT_FUNC "%3.0" "adm" COEFFS 0 1 0 0 0 1 /end COMPU_METHOD
/begin COMPU_METHOD DiagSym100ms_CM_boolean_adm "Q = V" RAT_FUNC "%1.0" "adm" COEFFS 0 1 0 0 0 1 /end COMPU_METHOD
/begin COMPU_METHOD DiagSym100ms_CM_sfix16_En4_degree "Q = V*16.000000" RAT_FUNC "%8.4" "degree" COEFFS 0 16 0 0 0 1 /end COMPU_METHOD
/begin COMPU_METHOD DiagSym4ms_CM_ePhCrank_adm "Enumerated data type: ePhCrank" TAB_VERB "%0.6" "adm" COMPU_TAB_REF VTAB_FOR_DiagSym4ms_CM_ePhCrank_adm /end COMPU_METHOD
/begin COMPU_METHOD DwlTDC_Symbol_CM_FixEnableT "Enumerated data type: FixEnableT" TAB_VERB "%0.6" "" COMPU_TAB_REF VTAB_FOR_DwlTDC_Symbol_CM_FixEnableT /end COMPU_METHOD
/begin COMPU_METHOD DwlTDC_Symbol_CM_ufix16_E1_us "Q = V/2.000000" RAT_FUNC "%5.0" "us" COEFFS 0 1 0 0 0 2 /end COMPU_METHOD
/begin COMPU_METHOD DwlTDC_Symbol_CM_ufix16_En7_adm "Q = V*128.000000" RAT_FUNC "%10.7" "adm" COEFFS 0 128 0 0 0 1 /end COMPU_METHOD
/begin COMPU_METHOD DwlTDC_Symbol_CM_ufix16_S50_mV "Q = V/50.000000" RAT_FUNC "%0.6" "mV" COEFFS 0 1 0 0 0 50 /end COMPU_METHOD
/begin COMPU_METHOD EgmdTDC_CM_eCutOff_adm "Enumerated data type: eCutOff" TAB_VERB "%0.6" "adm" COMPU_TAB_REF VTAB_FOR_EgmdTDC_CM_eCutOff_adm /end COMPU_METHOD
/begin COMPU_METHOD EgmdTDC_CM_uint16_rpm "Q = V" RAT_FUNC "%5.0" "rpm" COEFFS 0 1 0 0 0 1 /end COMPU_METHOD
/begin COMPU_METHOD EgmdTDC_CM_uint16_tdc "Q = V" RAT_FUNC "%5.0" "tdc" COEFFS 0 1 0 0 0 1 /end COMPU_METHOD
/begin COMPU_METHOD EngineModeTDC_Symbol_CM_FixEnableT "Enumerated data type: FixEnableT" TAB_VERB "%0.6" "" COMPU_TAB_REF VTAB_FOR_EngineModeTDC_Symbol_CM_FixEnableT /end COMPU_METHOD
/begin COMPU_METHOD EngineModeTDC_Symbol_CM_ufix16_Bn32000_rpm_s "Q = (V+32000.000000)/1.000000" RAT_FUNC "%0.6" "rpm/s" COEFFS 0 1 32000 0 0 1 /end COMPU_METHOD
/begin COMPU_METHOD EngineModeTDC_Symbol_CM_ufix16_Bn40_degC "Q = (V+40.000000)/1.000000" RAT_FUNC "%0.6" "degC" COEFFS 0 1 40 0 0 1 /end COMPU_METHOD
/begin COMPU_METHOD EngineModeTDC_Symbol_CM_uint16_rpm "Q = V" RAT_FUNC "%5.0" "rpm" COEFFS 0 1 0 0 0 1 /end COMPU_METHOD
/begin COMPU_METHOD EngineModeTDC_Symbol_CM_uint16_tdc "Q = V" RAT_FUNC "%5.0" "tdc" COEFFS 0 1 0 0 0 1 /end COMPU_METHOD
/begin COMPU_METHOD EngineModeTDC_Symbol_CM_uint8_adm "Q = V" RAT_FUNC "%3.0" "adm" COEFFS 0 1 0 0 0 1 /end COMPU_METHOD
/begin COMPU_METHOD ExitCalcDLAM100ms_Symbol_CM_boolean_adm "Q = V" RAT_FUNC "%1.0" "adm" COEFFS 0 1 0 0 0 1 /end COMPU_METHOD
/begin COMPU_METHOD ExitCalcDLAM100ms_Symbol_CM_ufix16_Sp01__ "Q = V*100.000000" RAT_FUNC "%0.6" "%" COEFFS 0 100 0 0 0 1 /end COMPU_METHOD
/begin COMPU_METHOD ExitCalcDLAM100ms_Symbol_CM_uint16_adm "Q = V" RAT_FUNC "%5.0" "adm" COEFFS 0 1 0 0 0 1 /end COMPU_METHOD
/begin COMPU_METHOD ExitCalcDLAM100ms_Symbol_CM_uint16_mV "Q = V" RAT_FUNC "%5.0" "mV" COEFFS 0 1 0 0 0 1 /end COMPU_METHOD
/begin COMPU_METHOD ExitCalcDLAM100ms_Symbol_CM_uint8_adm "Q = V" RAT_FUNC "%3.0" "adm" COEFFS 0 1 0 0 0 1 /end COMPU_METHOD
/begin COMPU_METHOD FaultChkMDxTDC_CM_FixEnableT "Enumerated data type: FixEnableT" TAB_VERB "%0.6" "" COMPU_TAB_REF VTAB_FOR_FaultChkMDxTDC_CM_FixEnableT /end COMPU_METHOD
/begin COMPU_METHOD FaultChkMDxTDC_CM_uint16_adm "Q = V" RAT_FUNC "%5.0" "adm" COEFFS 0 1 0 0 0 1 /end COMPU_METHOD
/begin COMPU_METHOD FaultChkMDxTDC_CM_uint8_adm "Q = V" RAT_FUNC "%3.0" "adm" COEFFS 0 1 0 0 0 1 /end COMPU_METHOD
/begin COMPU_METHOD FlywheelCorrTDC_CM_FixEnableT "Enumerated data type: FixEnableT" TAB_VERB "%0.6" "" COMPU_TAB_REF VTAB_FOR_FlywheelCorrTDC_CM_FixEnableT /end COMPU_METHOD
/begin COMPU_METHOD FlywheelCorrTDC_CM_boolean_adm "Q = V" RAT_FUNC "%1.0" "adm" COEFFS 0 1 0 0 0 1 /end COMPU_METHOD
/begin COMPU_METHOD FlywheelCorrTDC_CM_uint16_rpm "Q = V" RAT_FUNC "%5.0" "rpm" COEFFS 0 1 0 0 0 1 /end COMPU_METHOD
/begin COMPU_METHOD Fuels_CtrlMgmt100ms_CM_boolean_adm "Q = V" RAT_FUNC "%1.0" "adm" COEFFS 0 1 0 0 0 1 /end COMPU_METHOD
/begin COMPU_METHOD Fuels_CtrlMgmt100ms_CM_ufix8_Bn40_degC "Q = (V+40.000000)/1.000000" RAT_FUNC "%0.6" "degC" COEFFS 0 1 40 0 0 1 /end COMPU_METHOD
/begin COMPU_METHOD Fuels_CtrlMgmtTDC_CM_boolean_adm "Q = V" RAT_FUNC "%1.0" "adm" COEFFS 0 1 0 0 0 1 /end COMPU_METHOD
/begin COMPU_METHOD Fuels_CtrlMgmtTDC_CM_sfix16_En4__ "Q = V*16.000000" RAT_FUNC "%8.4" "%" COEFFS 0 16 0 0 0 1 /end COMPU_METHOD
/begin COMPU_METHOD Fuels_CtrlMgmtTDC_CM_sfix16_En4_degree "Q = V*16.000000" RAT_FUNC "%8.4" "degree" COEFFS 0 16 0 0 0 1 /end COMPU_METHOD
/begin COMPU_METHOD Fuels_CtrlMgmtTDC_CM_ufix16_Sp01__ "Q = V*100.000000" RAT_FUNC "%0.6" "%" COEFFS 0 100 0 0 0 1 /end COMPU_METHOD
/begin COMPU_METHOD Fuels_CtrlMgmtTDC_CM_uint8_adm "Q = V" RAT_FUNC "%3.0" "adm" COEFFS 0 1 0 0 0 1 /end COMPU_METHOD
/begin COMPU_METHOD Idle100ms_CM_ufix16_En10_adm "Q = V*1024.000000" RAT_FUNC "%12.10" "adm" COEFFS 0 1024 0 0 0 1 /end COMPU_METHOD
/begin COMPU_METHOD Idle4ms_CM_boolean_adm "Q = V" RAT_FUNC "%1.0" "adm" COEFFS 0 1 0 0 0 1 /end COMPU_METHOD
/begin COMPU_METHOD Idle4ms_CM_int16_rpm "Q = V" RAT_FUNC "%5.0" "rpm" COEFFS 0 1 0 0 0 1 /end COMPU_METHOD
/begin COMPU_METHOD Idle4ms_CM_sfix16_En4__ "Q = V*16.000000" RAT_FUNC "%8.4" "%" COEFFS 0 16 0 0 0 1 /end COMPU_METHOD
/begin COMPU_METHOD Idle4ms_CM_sfix16_En4_degree "Q = V*16.000000" RAT_FUNC "%8.4" "degree" COEFFS 0 16 0 0 0 1 /end COMPU_METHOD
/begin COMPU_METHOD Idle4ms_CM_ufix16_En3_rpm "Q = V*8.000000" RAT_FUNC "%7.3" "rpm" COEFFS 0 8 0 0 0 1 /end COMPU_METHOD
/begin COMPU_METHOD Idle4ms_CM_ufix16_En4__ "Q = V*16.000000" RAT_FUNC "%8.4" "%" COEFFS 0 16 0 0 0 1 /end COMPU_METHOD
/begin COMPU_METHOD Idle4ms_CM_uint16_rpm "Q = V" RAT_FUNC "%5.0" "rpm" COEFFS 0 1 0 0 0 1 /end COMPU_METHOD
/begin COMPU_METHOD IgntTDC_CM_boolean_adm "Q = V" RAT_FUNC "%1.0" "adm" COEFFS 0 1 0 0 0 1 /end COMPU_METHOD
/begin COMPU_METHOD IgntTDC_CM_sfix16_En4_degree "Q = V*16.000000" RAT_FUNC "%8.4" "degree" COEFFS 0 16 0 0 0 1 /end COMPU_METHOD
/begin COMPU_METHOD IgntTDC_CM_ufix16_E1_us "Q = V/2.000000" RAT_FUNC "%5.0" "us" COEFFS 0 1 0 0 0 2 /end COMPU_METHOD
/begin COMPU_METHOD InjtTDC_CM_boolean_adm "Q = V" RAT_FUNC "%1.0" "adm" COEFFS 0 1 0 0 0 1 /end COMPU_METHOD
/begin COMPU_METHOD InjtTDC_CM_ufix16_En10_adm "Q = V*1024.000000" RAT_FUNC "%12.10" "adm" COEFFS 0 1024 0 0 0 1 /end COMPU_METHOD
/begin COMPU_METHOD KnockConfigTDC_CM_FixEnableT "Enumerated data type: FixEnableT" TAB_VERB "%0.6" "" COMPU_TAB_REF VTAB_FOR_KnockConfigTDC_CM_FixEnableT /end COMPU_METHOD
/begin COMPU_METHOD KnockConfigTDC_CM_sfix16_En4_degree "Q = V*16.000000" RAT_FUNC "%8.4" "degree" COEFFS 0 16 0 0 0 1 /end COMPU_METHOD
/begin COMPU_METHOD KnockConfigTDC_CM_sfix16_Sp1_degree "Q = V*10.000000" RAT_FUNC "%0.6" "degree" COEFFS 0 10 0 0 0 1 /end COMPU_METHOD
/begin COMPU_METHOD KnockConfigTDC_CM_sfix32_En23_adm "Q = V*8388608.000000" RAT_FUNC "%26.16" "adm" COEFFS 0 8388608 0 0 0 1 /end COMPU_METHOD
/begin COMPU_METHOD KnockConfigTDC_CM_tKnockEqadcDan_adm "Enumerated data type: tKnockEqadcDan" TAB_VERB "%0.6" "adm" COMPU_TAB_REF VTAB_FOR_KnockConfigTDC_CM_tKnockEqadcDan_adm /end COMPU_METHOD
/begin COMPU_METHOD KnockConfigTDC_CM_tKnockEqadcPreGain_adm "Enumerated data type: tKnockEqadcPreGain" TAB_VERB "%0.6" "adm" COMPU_TAB_REF VTAB_FOR_KnockConfigTDC_CM_tKnockEqadcPreGain_adm /end COMPU_METHOD
/begin COMPU_METHOD KnockConfigTDC_CM_tKnockScaleFactor_adm "Enumerated data type: tKnockScaleFactor" TAB_VERB "%0.6" "adm" COMPU_TAB_REF VTAB_FOR_KnockConfigTDC_CM_tKnockScaleFactor_adm /end COMPU_METHOD
/begin COMPU_METHOD KnockConfigTDC_CM_ufix16_Sp1_degree "Q = V*10.000000" RAT_FUNC "%0.6" "degree" COEFFS 0 10 0 0 0 1 /end COMPU_METHOD
/begin COMPU_METHOD KnockConfigTDC_CM_uint8_adm "Q = V" RAT_FUNC "%3.0" "adm" COEFFS 0 1 0 0 0 1 /end COMPU_METHOD
/begin COMPU_METHOD KnockControlTDC_CM_FixEnableT "Enumerated data type: FixEnableT" TAB_VERB "%0.6" "" COMPU_TAB_REF VTAB_FOR_KnockControlTDC_CM_FixEnableT /end COMPU_METHOD
/begin COMPU_METHOD KnockControlTDC_CM_boolean_adm "Q = V" RAT_FUNC "%1.0" "adm" COEFFS 0 1 0 0 0 1 /end COMPU_METHOD
/begin COMPU_METHOD KnockControlTDC_CM_sfix16_En4_degree "Q = V*16.000000" RAT_FUNC "%8.4" "degree" COEFFS 0 16 0 0 0 1 /end COMPU_METHOD
/begin COMPU_METHOD KnockControlTDC_CM_ufix16_En10_adm "Q = V*1024.000000" RAT_FUNC "%12.10" "adm" COEFFS 0 1024 0 0 0 1 /end COMPU_METHOD
/begin COMPU_METHOD KnockControlTDC_CM_uint16_rpm "Q = V" RAT_FUNC "%5.0" "rpm" COEFFS 0 1 0 0 0 1 /end COMPU_METHOD
/begin COMPU_METHOD KnockDetectionTDC_CM_FixEnableT "Enumerated data type: FixEnableT" TAB_VERB "%0.6" "" COMPU_TAB_REF VTAB_FOR_KnockDetectionTDC_CM_FixEnableT /end COMPU_METHOD
/begin COMPU_METHOD KnockDetectionTDC_CM_boolean_adm "Q = V" RAT_FUNC "%1.0" "adm" COEFFS 0 1 0 0 0 1 /end COMPU_METHOD
/begin COMPU_METHOD KnockDetectionTDC_CM_int16_rpm_s "Q = V" RAT_FUNC "%5.0" "rpm/s" COEFFS 0 1 0 0 0 1 /end COMPU_METHOD
/begin COMPU_METHOD KnockDetectionTDC_CM_single "Q = V" RAT_FUNC "%8.6" "" COEFFS 0 1 0 0 0 1 /end COMPU_METHOD
/begin COMPU_METHOD KnockDetectionTDC_CM_single_adm "Q = V" RAT_FUNC "%8.6" "adm" COEFFS 0 1 0 0 0 1 /end COMPU_METHOD
/begin COMPU_METHOD KnockDetectionTDC_CM_ufix16_En10_adm "Q = V*1024.000000" RAT_FUNC "%12.10" "adm" COEFFS 0 1024 0 0 0 1 /end COMPU_METHOD
/begin COMPU_METHOD KnockDetectionTDC_CM_uint16_rpm "Q = V" RAT_FUNC "%5.0" "rpm" COEFFS 0 1 0 0 0 1 /end COMPU_METHOD
/begin COMPU_METHOD KnockTDC_CM_boolean_adm "Q = V" RAT_FUNC "%1.0" "adm" COEFFS 0 1 0 0 0 1 /end COMPU_METHOD
/begin COMPU_METHOD KnockTDC_CM_tKnockEqadcDan_adm "Enumerated data type: tKnockEqadcDan" TAB_VERB "%0.6" "adm" COMPU_TAB_REF VTAB_FOR_KnockTDC_CM_tKnockEqadcDan_adm /end COMPU_METHOD
/begin COMPU_METHOD KnockTDC_CM_tKnockLevel_adm "Enumerated data type: tKnockLevel" TAB_VERB "%0.6" "adm" COMPU_TAB_REF VTAB_FOR_KnockTDC_CM_tKnockLevel_adm /end COMPU_METHOD
/begin COMPU_METHOD KnockTDC_CM_uint8_adm "Q = V" RAT_FUNC "%3.0" "adm" COEFFS 0 1 0 0 0 1 /end COMPU_METHOD
/begin COMPU_METHOD MisfdTDC_CM_boolean_adm "Q = V" RAT_FUNC "%1.0" "adm" COEFFS 0 1 0 0 0 1 /end COMPU_METHOD
/begin COMPU_METHOD MisfdTDC_CM_int32_adm "Q = V" RAT_FUNC "%10.0" "adm" COEFFS 0 1 0 0 0 1 /end COMPU_METHOD
/begin COMPU_METHOD MisfdTDC_CM_single_adm "Q = V" RAT_FUNC "%8.6" "adm" COEFFS 0 1 0 0 0 1 /end COMPU_METHOD
/begin COMPU_METHOD MisfireCntTDC_CM_uint8_adm "Q = V" RAT_FUNC "%3.0" "adm" COEFFS 0 1 0 0 0 1 /end COMPU_METHOD
/begin COMPU_METHOD MisfireDetectionTDC_CM_FixEnableT "Enumerated data type: FixEnableT" TAB_VERB "%0.6" "" COMPU_TAB_REF VTAB_FOR_MisfireDetectionTDC_CM_FixEnableT /end COMPU_METHOD
/begin COMPU_METHOD MisfireDetectionTDC_CM_boolean_adm "Q = V" RAT_FUNC "%1.0" "adm" COEFFS 0 1 0 0 0 1 /end COMPU_METHOD
/begin COMPU_METHOD MisfireDetectionTDC_CM_int16_adm "Q = V" RAT_FUNC "%5.0" "adm" COEFFS 0 1 0 0 0 1 /end COMPU_METHOD
/begin COMPU_METHOD MisfireDetectionTDC_CM_single_adm "Q = V" RAT_FUNC "%8.6" "adm" COEFFS 0 1 0 0 0 1 /end COMPU_METHOD
/begin COMPU_METHOD MisfireDetectionTDC_CM_ufix16_En3_mg_cc "Q = V*8.000000" RAT_FUNC "%7.3" "mg/cc" COEFFS 0 8 0 0 0 1 /end COMPU_METHOD
/begin COMPU_METHOD MisfireDetectionTDC_CM_ufix16_En9_adm "Q = V*512.000000" RAT_FUNC "%12.9" "adm" COEFFS 0 512 0 0 0 1 /end COMPU_METHOD
/begin COMPU_METHOD MisfireDetectionTDC_CM_uint8_TDC "Q = V" RAT_FUNC "%3.0" "TDC" COEFFS 0 1 0 0 0 1 /end COMPU_METHOD
/begin COMPU_METHOD MisfireDetectionTDC_CM_uint8_adm "Q = V" RAT_FUNC "%3.0" "adm" COEFFS 0 1 0 0 0 1 /end COMPU_METHOD
/begin COMPU_METHOD Mpre4ms_CM_tKeyState_adm "Enumerated data type: tKeyState" TAB_VERB "%0.6" "adm" COMPU_TAB_REF VTAB_FOR_Mpre4ms_CM_tKeyState_adm /end COMPU_METHOD
/begin COMPU_METHOD Mpre4ms_CM_ufix16_En3_degF "Q = V*8.000000" RAT_FUNC "%7.3" "degF" COEFFS 0 8 0 0 0 1 /end COMPU_METHOD
/begin COMPU_METHOD Oilp100ms_CM_tKeyState_adm "Enumerated data type: tKeyState" TAB_VERB "%0.6" "adm" COMPU_TAB_REF VTAB_FOR_Oilp100ms_CM_tKeyState_adm /end COMPU_METHOD
/begin COMPU_METHOD Oilp100ms_CM_ufix16_Bn40_degC "Q = (V+40.000000)/1.000000" RAT_FUNC "%0.6" "degC" COEFFS 0 1 40 0 0 1 /end COMPU_METHOD
/begin COMPU_METHOD Oilt100ms_CM_tKeyState_adm "Enumerated data type: tKeyState" TAB_VERB "%0.6" "adm" COMPU_TAB_REF VTAB_FOR_Oilt100ms_CM_tKeyState_adm /end COMPU_METHOD
/begin COMPU_METHOD Pacc4ms_CM_tKeyState_adm "Enumerated data type: tKeyState" TAB_VERB "%0.6" "adm" COMPU_TAB_REF VTAB_FOR_Pacc4ms_CM_tKeyState_adm /end COMPU_METHOD
/begin COMPU_METHOD Pacc4ms_CM_ufix8_Sp392__ "Q = V*2.551020" RAT_FUNC "%0.6" "%" COEFFS 0 2.55102 0 0 0 1 /end COMPU_METHOD
/begin COMPU_METHOD Pacc4ms_CM_uint16_km_h "Q = V" RAT_FUNC "%5.0" "km/h" COEFFS 0 1 0 0 0 1 /end COMPU_METHOD
/begin COMPU_METHOD Prvc4ms_CM_eEGST_adm "Enumerated data type: eEGST" TAB_VERB "%0.6" "adm" COMPU_TAB_REF VTAB_FOR_Prvc4ms_CM_eEGST_adm /end COMPU_METHOD
/begin COMPU_METHOD Prvc4ms_CM_tDiagStat_adm "Enumerated data type: tDiagStat" TAB_VERB "%0.6" "adm" COMPU_TAB_REF VTAB_FOR_Prvc4ms_CM_tDiagStat_adm /end COMPU_METHOD
/begin COMPU_METHOD Pwrl4ms_CM_eActDiagPh_adm "Enumerated data type: eActDiagPh" TAB_VERB "%0.6" "adm" COMPU_TAB_REF VTAB_FOR_Pwrl4ms_CM_eActDiagPh_adm /end COMPU_METHOD
/begin COMPU_METHOD Pwrl4ms_CM_eEGST_adm "Enumerated data type: eEGST" TAB_VERB "%0.6" "adm" COMPU_TAB_REF VTAB_FOR_Pwrl4ms_CM_eEGST_adm /end COMPU_METHOD
/begin COMPU_METHOD Pwrl4ms_CM_tActDiagStat_adm "Enumerated data type: tActDiagStat" TAB_VERB "%0.6" "adm" COMPU_TAB_REF VTAB_FOR_Pwrl4ms_CM_tActDiagStat_adm /end COMPU_METHOD
/begin COMPU_METHOD Pwrl4ms_CM_tDiagStat_adm "Enumerated data type: tDiagStat" TAB_VERB "%0.6" "adm" COMPU_TAB_REF VTAB_FOR_Pwrl4ms_CM_tDiagStat_adm /end COMPU_METHOD
/begin COMPU_METHOD Pwrl4ms_CM_ufix16_S50_mV "Q = V/50.000000" RAT_FUNC "%0.6" "mV" COEFFS 0 1 0 0 0 50 /end COMPU_METHOD
/begin COMPU_METHOD Rpre4ms_CM_tKeyState_adm "Enumerated data type: tKeyState" TAB_VERB "%0.6" "adm" COMPU_TAB_REF VTAB_FOR_Rpre4ms_CM_tKeyState_adm /end COMPU_METHOD
/begin COMPU_METHOD Saf3_50ms_CM_eEGST_adm "Enumerated data type: eEGST" TAB_VERB "%0.6" "adm" COMPU_TAB_REF VTAB_FOR_Saf3_50ms_CM_eEGST_adm /end COMPU_METHOD
/begin COMPU_METHOD Svs4ms_CM_ufix16_En10_V "Q = V*1024.000000" RAT_FUNC "%12.10" "V" COEFFS 0 1024 0 0 0 1 /end COMPU_METHOD
/begin COMPU_METHOD TE_TM_Adv_Ctrl4ms_Symbol_CM_sfix16_En4__ "Q = V*16.000000" RAT_FUNC "%8.4" "%" COEFFS 0 16 0 0 0 1 /end COMPU_METHOD
/begin COMPU_METHOD TE_TM_Adv_Ctrl4ms_Symbol_CM_sfix16_En4_degE "Q = V*16.000000" RAT_FUNC "%8.4" "degE" COEFFS 0 16 0 0 0 1 /end COMPU_METHOD
/begin COMPU_METHOD TE_TM_Adv_Ctrl4ms_Symbol_CM_ufix16_Bn2000_rpm "Q = (V+2000.000000)/1.000000" RAT_FUNC "%0.6" "rpm" COEFFS 0 1 2000 0 0 1 /end COMPU_METHOD
/begin COMPU_METHOD TE_TM_Adv_Ctrl4ms_Symbol_CM_ufix16_En15___rpm "Q = V*32768.000000" RAT_FUNC "%16.15" "%/rpm" COEFFS 0 32768 0 0 0 1 /end COMPU_METHOD
/begin COMPU_METHOD TE_TM_Adv_Ctrl4ms_Symbol_CM_ufix16_En15__s_rpm "Q = V*32768.000000" RAT_FUNC "%16.15" "%s/rpm" COEFFS 0 32768 0 0 0 1 /end COMPU_METHOD
/begin COMPU_METHOD TE_TM_Adv_Ctrl4ms_Symbol_CM_uint16_rpm "Q = V" RAT_FUNC "%5.0" "rpm" COEFFS 0 1 0 0 0 1 /end COMPU_METHOD
/begin COMPU_METHOD TE_TM_Cmu_Ctrl4ms_Symbol_CM_sfix16_En4__ "Q = V*16.000000" RAT_FUNC "%8.4" "%" COEFFS 0 16 0 0 0 1 /end COMPU_METHOD
/begin COMPU_METHOD TE_TM_Cmu_Ctrl4ms_Symbol_CM_sfix32_En11__ "Q = V*2048.000000" RAT_FUNC "%18.11" "%" COEFFS 0 2048 0 0 0 1 /end COMPU_METHOD
/begin COMPU_METHOD TE_TM_Cmu_Ctrl4ms_Symbol_CM_sfix32_En11_rpm_s "Q = V*2048.000000" RAT_FUNC "%18.11" "rpm*s" COEFFS 0 2048 0 0 0 1 /end COMPU_METHOD
/begin COMPU_METHOD TE_TM_Cmu_Ctrl4ms_Symbol_CM_ufix16_Bn125_adm "Q = (V+125.000000)/1.000000" RAT_FUNC "%0.6" "adm" COEFFS 0 1 125 0 0 1 /end COMPU_METHOD
/begin COMPU_METHOD TE_TM_Cmu_Ctrl4ms_Symbol_CM_ufix16_Bn1800_rpm "Q = (V+1800.000000)/1.000000" RAT_FUNC "%0.6" "rpm" COEFFS 0 1 1800 0 0 1 /end COMPU_METHOD
/begin COMPU_METHOD TE_TM_Cmu_Ctrl4ms_Symbol_CM_ufix16_Bn1_adm "Q = (V+1.000000)/1.000000" RAT_FUNC "%0.6" "adm" COEFFS 0 1 1 0 0 1 /end COMPU_METHOD
/begin COMPU_METHOD TE_TM_Cmu_Ctrl4ms_Symbol_CM_ufix16_Bn2000_rpm "Q = (V+2000.000000)/1.000000" RAT_FUNC "%0.6" "rpm" COEFFS 0 1 2000 0 0 1 /end COMPU_METHOD
/begin COMPU_METHOD TE_TM_Cmu_Ctrl4ms_Symbol_CM_ufix16_Bn32000_rpm_s "Q = (V+32000.000000)/1.000000" RAT_FUNC "%0.6" "rpm/s" COEFFS 0 1 32000 0 0 1 /end COMPU_METHOD
/begin COMPU_METHOD TE_TM_Cmu_Ctrl4ms_Symbol_CM_ufix16_Bn40_degC "Q = (V+40.000000)/1.000000" RAT_FUNC "%0.6" "degC" COEFFS 0 1 40 0 0 1 /end COMPU_METHOD
/begin COMPU_METHOD TE_TM_Cmu_Ctrl4ms_Symbol_CM_ufix16_En10_adm "Q = V*1024.000000" RAT_FUNC "%12.10" "adm" COEFFS 0 1024 0 0 0 1 /end COMPU_METHOD
/begin COMPU_METHOD TE_TM_Cmu_Ctrl4ms_Symbol_CM_ufix16_En15___rpm "Q = V*32768.000000" RAT_FUNC "%16.15" "%/rpm" COEFFS 0 32768 0 0 0 1 /end COMPU_METHOD
/begin COMPU_METHOD TE_TM_Cmu_Ctrl4ms_Symbol_CM_ufix16_En15___srpm "Q = V*32768.000000" RAT_FUNC "%16.15" "%/srpm" COEFFS 0 32768 0 0 0 1 /end COMPU_METHOD
/begin COMPU_METHOD TE_TM_Cmu_Ctrl4ms_Symbol_CM_ufix16_En15__s_rpm "Q = V*32768.000000" RAT_FUNC "%16.15" "%s/rpm" COEFFS 0 32768 0 0 0 1 /end COMPU_METHOD
/begin COMPU_METHOD TE_TM_Cmu_Ctrl4ms_Symbol_CM_ufix16_En4__ "Q = V*16.000000" RAT_FUNC "%8.4" "%" COEFFS 0 16 0 0 0 1 /end COMPU_METHOD
/begin COMPU_METHOD TE_TM_Cmu_Ctrl4ms_Symbol_CM_ufix16_En8_sec "Q = V*256.000000" RAT_FUNC "%11.8" "sec" COEFFS 0 256 0 0 0 1 /end COMPU_METHOD
/begin COMPU_METHOD TE_TM_Cmu_Ctrl4ms_Symbol_CM_uint16_adm "Q = V" RAT_FUNC "%5.0" "adm" COEFFS 0 1 0 0 0 1 /end COMPU_METHOD
/begin COMPU_METHOD TE_TM_Cmu_Ctrl4ms_Symbol_CM_uint16_rpm "Q = V" RAT_FUNC "%5.0" "rpm" COEFFS 0 1 0 0 0 1 /end COMPU_METHOD
/begin COMPU_METHOD TE_TM_DerRPM_50ms_CM_ufix16_Bn32000_rpm_s "Q = (V+32000.000000)/1.000000" RAT_FUNC "%0.6" "rpm/s" COEFFS 0 1 32000 0 0 1 /end COMPU_METHOD
/begin COMPU_METHOD TE_TM_DerRPM_50ms_CM_uint16_rpm_s "Q = V" RAT_FUNC "%5.0" "rpm/s" COEFFS 0 1 0 0 0 1 /end COMPU_METHOD
/begin COMPU_METHOD TE_TM_Enable_Idle4ms_Symbol_CM_ufix16_Bn40__C "Q = (V+40.000000)/1.000000" RAT_FUNC "%0.6" "°C" COEFFS 0 1 40 0 0 1 /end COMPU_METHOD
/begin COMPU_METHOD TE_TM_Enable_Idle4ms_Symbol_CM_uint16_PMS "Q = V" RAT_FUNC "%5.0" "PMS" COEFFS 0 1 0 0 0 1 /end COMPU_METHOD
/begin COMPU_METHOD TE_TM_Enable_Idle4ms_Symbol_CM_uint16_km_h "Q = V" RAT_FUNC "%5.0" "km/h" COEFFS 0 1 0 0 0 1 /end COMPU_METHOD
/begin COMPU_METHOD TE_TM_FFW4ms_Symbol_CM_boolean_adm "Q = V" RAT_FUNC "%1.0" "adm" COEFFS 0 1 0 0 0 1 /end COMPU_METHOD
/begin COMPU_METHOD TE_TM_FFW4ms_Symbol_CM_sfix16_En4__ "Q = V*16.000000" RAT_FUNC "%8.4" "%" COEFFS 0 16 0 0 0 1 /end COMPU_METHOD
/begin COMPU_METHOD TE_TM_FFW4ms_Symbol_CM_ufix16_Bn125_adm "Q = (V+125.000000)/1.000000" RAT_FUNC "%0.6" "adm" COEFFS 0 1 125 0 0 1 /end COMPU_METHOD
/begin COMPU_METHOD TE_TM_FFW4ms_Symbol_CM_ufix16_Bn40_degC "Q = (V+40.000000)/1.000000" RAT_FUNC "%0.6" "degC" COEFFS 0 1 40 0 0 1 /end COMPU_METHOD
/begin COMPU_METHOD TE_TM_FFW4ms_Symbol_CM_ufix16_En10_adm "Q = V*1024.000000" RAT_FUNC "%12.10" "adm" COEFFS 0 1024 0 0 0 1 /end COMPU_METHOD
/begin COMPU_METHOD TE_TM_FFW4ms_Symbol_CM_ufix16_En10_s "Q = V*1024.000000" RAT_FUNC "%12.10" "s" COEFFS 0 1024 0 0 0 1 /end COMPU_METHOD
/begin COMPU_METHOD TE_TM_FFW4ms_Symbol_CM_ufix16_En4_Nm "Q = V*16.000000" RAT_FUNC "%8.4" "Nm" COEFFS 0 16 0 0 0 1 /end COMPU_METHOD
/begin COMPU_METHOD TE_TM_FFW4ms_Symbol_CM_ufix16_En4__ "Q = V*16.000000" RAT_FUNC "%8.4" "%" COEFFS 0 16 0 0 0 1 /end COMPU_METHOD
/begin COMPU_METHOD TE_TM_FFW4ms_Symbol_CM_ufix16_En4_kW "Q = V*16.000000" RAT_FUNC "%8.4" "kW" COEFFS 0 16 0 0 0 1 /end COMPU_METHOD
/begin COMPU_METHOD TE_TM_FFW4ms_Symbol_CM_ufix16_S50_mV "Q = V/50.000000" RAT_FUNC "%0.6" "mV" COEFFS 0 1 0 0 0 50 /end COMPU_METHOD
/begin COMPU_METHOD TE_TM_FFW4ms_Symbol_CM_uint16_4ms "Q = V" RAT_FUNC "%5.0" "4ms" COEFFS 0 1 0 0 0 1 /end COMPU_METHOD
/begin COMPU_METHOD TE_TM_FFW4ms_Symbol_CM_uint16_km_h "Q = V" RAT_FUNC "%5.0" "km/h" COEFFS 0 1 0 0 0 1 /end COMPU_METHOD
/begin COMPU_METHOD TE_TM_FFW4ms_Symbol_CM_uint16_rpm "Q = V" RAT_FUNC "%5.0" "rpm" COEFFS 0 1 0 0 0 1 /end COMPU_METHOD
/begin COMPU_METHOD TE_TM_InitIntegrIdl4ms_Symbol_CM_ufix16_En10_adm "Q = V*1024.000000" RAT_FUNC "%12.10" "adm" COEFFS 0 1024 0 0 0 1 /end COMPU_METHOD
/begin COMPU_METHOD TE_TM_LowIdle_Gov_100ms_Symbol_CM_ufix16_En10_adm "Q = V*1024.000000" RAT_FUNC "%12.10" "adm" COEFFS 0 1024 0 0 0 1 /end COMPU_METHOD
/begin COMPU_METHOD TE_TM_LowIdle_Gov_100ms_Symbol_CM_uint16_adm "Q = V" RAT_FUNC "%5.0" "adm" COEFFS 0 1 0 0 0 1 /end COMPU_METHOD
/begin COMPU_METHOD TE_TM_RpmLimitTDC_Symbol_CM_FixEnableT "Enumerated data type: FixEnableT" TAB_VERB "%0.6" "" COMPU_TAB_REF VTAB_FOR_TE_TM_RpmLimitTDC_Symbol_CM_FixEnableT /end COMPU_METHOD
/begin COMPU_METHOD TE_TM_RpmLimitTDC_Symbol_CM_boolean_adm "Q = V" RAT_FUNC "%1.0" "adm" COEFFS 0 1 0 0 0 1 /end COMPU_METHOD
/begin COMPU_METHOD TE_TM_RpmLimitTDC_Symbol_CM_ufix16_En10_adm "Q = V*1024.000000" RAT_FUNC "%12.10" "adm" COEFFS 0 1024 0 0 0 1 /end COMPU_METHOD
/begin COMPU_METHOD TE_TM_RpmLimitTDC_Symbol_CM_uint16_rpm "Q = V" RAT_FUNC "%5.0" "rpm" COEFFS 0 1 0 0 0 1 /end COMPU_METHOD
/begin COMPU_METHOD TE_TM_RpmLimitTDC_Symbol_CM_uint8_adm "Q = V" RAT_FUNC "%3.0" "adm" COEFFS 0 1 0 0 0 1 /end COMPU_METHOD
/begin COMPU_METHOD TE_TM_Target4ms_CM_boolean_adm "Q = V" RAT_FUNC "%1.0" "adm" COEFFS 0 1 0 0 0 1 /end COMPU_METHOD
/begin COMPU_METHOD TE_TM_Target4ms_CM_int16_rpm "Q = V" RAT_FUNC "%5.0" "rpm" COEFFS 0 1 0 0 0 1 /end COMPU_METHOD
/begin COMPU_METHOD TE_TM_Target4ms_CM_ufix16_Bn40_degC "Q = (V+40.000000)/1.000000" RAT_FUNC "%0.6" "degC" COEFFS 0 1 40 0 0 1 /end COMPU_METHOD
/begin COMPU_METHOD TE_TM_Target4ms_CM_ufix16_En10_adm "Q = V*1024.000000" RAT_FUNC "%12.10" "adm" COEFFS 0 1024 0 0 0 1 /end COMPU_METHOD
/begin COMPU_METHOD TE_TM_Target4ms_CM_ufix16_S50_mV "Q = V/50.000000" RAT_FUNC "%0.6" "mV" COEFFS 0 1 0 0 0 50 /end COMPU_METHOD
/begin COMPU_METHOD TE_TM_Target4ms_CM_ufix16_Sp004_s "Q = V*250.000000" RAT_FUNC "%0.6" "s" COEFFS 0 250 0 0 0 1 /end COMPU_METHOD
/begin COMPU_METHOD TE_TM_Target4ms_CM_uint16_4ms "Q = V" RAT_FUNC "%5.0" "4ms" COEFFS 0 1 0 0 0 1 /end COMPU_METHOD
/begin COMPU_METHOD TE_TM_Target4ms_CM_uint16_RPM "Q = V" RAT_FUNC "%5.0" "RPM" COEFFS 0 1 0 0 0 1 /end COMPU_METHOD
/begin COMPU_METHOD TE_TM_Target4ms_CM_uint16_rpm "Q = V" RAT_FUNC "%5.0" "rpm" COEFFS 0 1 0 0 0 1 /end COMPU_METHOD
/begin COMPU_METHOD TE_TM_Target4ms_CM_uint8_adm "Q = V" RAT_FUNC "%3.0" "adm" COEFFS 0 1 0 0 0 1 /end COMPU_METHOD
/begin COMPU_METHOD Test_KO2_TDC_Symbol_CM_FixEnableT "Enumerated data type: FixEnableT" TAB_VERB "%0.6" "" COMPU_TAB_REF VTAB_FOR_Test_KO2_TDC_Symbol_CM_FixEnableT /end COMPU_METHOD
/begin COMPU_METHOD Test_KO2_TDC_Symbol_CM_boolean_adm "Q = V" RAT_FUNC "%1.0" "adm" COEFFS 0 1 0 0 0 1 /end COMPU_METHOD
/begin COMPU_METHOD Test_KO2_TDC_Symbol_CM_uint8_adm "Q = V" RAT_FUNC "%3.0" "adm" COEFFS 0 1 0 0 0 1 /end COMPU_METHOD
/begin COMPU_METHOD Test_RipCarica_TDC_Symbol_CM_FixEnableT "Enumerated data type: FixEnableT" TAB_VERB "%0.6" "" COMPU_TAB_REF VTAB_FOR_Test_RipCarica_TDC_Symbol_CM_FixEnableT /end COMPU_METHOD
/begin COMPU_METHOD Test_RipCarica_TDC_Symbol_CM_boolean_adm "Q = V" RAT_FUNC "%1.0" "adm" COEFFS 0 1 0 0 0 1 /end COMPU_METHOD
/begin COMPU_METHOD Test_RipCarica_TDC_Symbol_CM_ufix16_En4__ "Q = V*16.000000" RAT_FUNC "%8.4" "%" COEFFS 0 16 0 0 0 1 /end COMPU_METHOD
/begin COMPU_METHOD Test_RipCarica_TDC_Symbol_CM_ufix16_En4_deg "Q = V*16.000000" RAT_FUNC "%8.4" "deg" COEFFS 0 16 0 0 0 1 /end COMPU_METHOD
/begin COMPU_METHOD Test_RipCarica_TDC_Symbol_CM_ufix8_Bn40_degC "Q = (V+40.000000)/1.000000" RAT_FUNC "%0.6" "degC" COEFFS 0 1 40 0 0 1 /end COMPU_METHOD
/begin COMPU_METHOD Test_RipCarica_TDC_Symbol_CM_uint16_adm "Q = V" RAT_FUNC "%5.0" "adm" COEFFS 0 1 0 0 0 1 /end COMPU_METHOD
/begin COMPU_METHOD Test_RipCarica_TDC_Symbol_CM_uint16_mbar "Q = V" RAT_FUNC "%5.0" "mbar" COEFFS 0 1 0 0 0 1 /end COMPU_METHOD
/begin COMPU_METHOD Thrp4ms_CM_eEGST_adm "Enumerated data type: eEGST" TAB_VERB "%0.6" "adm" COMPU_TAB_REF VTAB_FOR_Thrp4ms_CM_eEGST_adm /end COMPU_METHOD
/begin COMPU_METHOD Thrp4ms_CM_eTHRP_adm "Enumerated data type: eTHRP" TAB_VERB "%0.6" "adm" COMPU_TAB_REF VTAB_FOR_Thrp4ms_CM_eTHRP_adm /end COMPU_METHOD
/begin COMPU_METHOD Thrp4ms_CM_sfix16_En4__ "Q = V*16.000000" RAT_FUNC "%8.4" "%" COEFFS 0 16 0 0 0 1 /end COMPU_METHOD
/begin COMPU_METHOD Thrp4ms_CM_sfix16_En8__ "Q = V*256.000000" RAT_FUNC "%11.8" "%" COEFFS 0 256 0 0 0 1 /end COMPU_METHOD
/begin COMPU_METHOD Thrp4ms_CM_tKeyState_adm "Enumerated data type: tKeyState" TAB_VERB "%0.6" "adm" COMPU_TAB_REF VTAB_FOR_Thrp4ms_CM_tKeyState_adm /end COMPU_METHOD
/begin COMPU_METHOD Thrp4ms_CM_ufix16_Bn40_degC "Q = (V+40.000000)/1.000000" RAT_FUNC "%0.6" "degC" COEFFS 0 1 40 0 0 1 /end COMPU_METHOD
/begin COMPU_METHOD Thrp4ms_CM_ufix16_En10_adm "Q = V*1024.000000" RAT_FUNC "%12.10" "adm" COEFFS 0 1024 0 0 0 1 /end COMPU_METHOD
/begin COMPU_METHOD Thrp4ms_CM_ufix16_En3_mg_cc "Q = V*8.000000" RAT_FUNC "%7.3" "mg/cc" COEFFS 0 8 0 0 0 1 /end COMPU_METHOD
/begin COMPU_METHOD Thrp4ms_CM_ufix16_En4_cc "Q = V*16.000000" RAT_FUNC "%8.4" "cc" COEFFS 0 16 0 0 0 1 /end COMPU_METHOD
/begin COMPU_METHOD Thrp4ms_CM_ufix16_En8__ "Q = V*256.000000" RAT_FUNC "%11.8" "%" COEFFS 0 256 0 0 0 1 /end COMPU_METHOD
/begin COMPU_METHOD Thrp4ms_CM_ufix16_En8_adm "Q = V*256.000000" RAT_FUNC "%11.8" "adm" COEFFS 0 256 0 0 0 1 /end COMPU_METHOD
/begin COMPU_METHOD Thrp4ms_CM_uint16__ "Q = V" RAT_FUNC "%5.0" "%" COEFFS 0 1 0 0 0 1 /end COMPU_METHOD
/begin COMPU_METHOD Thrp4ms_CM_uint16_mbar "Q = V" RAT_FUNC "%5.0" "mbar" COEFFS 0 1 0 0 0 1 /end COMPU_METHOD
/begin COMPU_METHOD Thrp_Mgmt50ms_CM_tKeyState_adm "Enumerated data type: tKeyState" TAB_VERB "%0.6" "adm" COMPU_TAB_REF VTAB_FOR_Thrp_Mgmt50ms_CM_tKeyState_adm /end COMPU_METHOD
/begin COMPU_METHOD Thrp_Mgmt50ms_CM_ufix16_Bn40_degC "Q = (V+40.000000)/1.000000" RAT_FUNC "%0.6" "degC" COEFFS 0 1 40 0 0 1 /end COMPU_METHOD
/begin COMPU_METHOD Trqm_CtrlMgmt1s_CM_uint16_rpm "Q = V" RAT_FUNC "%5.0" "rpm" COEFFS 0 1 0 0 0 1 /end COMPU_METHOD
/begin COMPU_METHOD Trqm_CtrlMgmt4ms_CM_uint16_rpm "Q = V" RAT_FUNC "%5.0" "rpm" COEFFS 0 1 0 0 0 1 /end COMPU_METHOD
/begin COMPU_METHOD VarMgmDLAM100ms_Symbol_CM_FixEnableT "Enumerated data type: FixEnableT" TAB_VERB "%0.6" "" COMPU_TAB_REF VTAB_FOR_VarMgmDLAM100ms_Symbol_CM_FixEnableT /end COMPU_METHOD
/begin COMPU_METHOD VarMgmDLAM100ms_Symbol_CM_boolean_adm "Q = V" RAT_FUNC "%1.0" "adm" COEFFS 0 1 0 0 0 1 /end COMPU_METHOD
/begin COMPU_METHOD VarMgmDLAM100ms_Symbol_CM_int16__ "Q = V" RAT_FUNC "%5.0" "%" COEFFS 0 1 0 0 0 1 /end COMPU_METHOD
/begin COMPU_METHOD VarMgmDLAM100ms_Symbol_CM_ufix16_Sp01_hz "Q = V*100.000000" RAT_FUNC "%0.6" "hz" COEFFS 0 100 0 0 0 1 /end COMPU_METHOD
/begin COMPU_METHOD VarMgmDLAM100ms_Symbol_CM_ufix32_Sp1_s "Q = V*10.000000" RAT_FUNC "%0.6" "s" COEFFS 0 10 0 0 0 1 /end COMPU_METHOD
/begin COMPU_VTAB VTAB_FOR_AbilitazioneDLAM100ms_Symbol_CM_FixEnableT "Enumerated data type: FixEnableT" TAB_VERB 2 171 "Enable" 218 "Disable" /end COMPU_VTAB
/begin COMPU_VTAB VTAB_FOR_Abilitazione_DFSLY_100ms_Symbol_CM_FixEnableT "Enumerated data type: FixEnableT" TAB_VERB 2 171 "Enable" 218 "Disable" /end COMPU_VTAB
/begin COMPU_VTAB VTAB_FOR_AdvnTDC_CM_FixEnableT "Enumerated data type: FixEnableT" TAB_VERB 2 171 "Enable" 218 "Disable" /end COMPU_VTAB
/begin COMPU_VTAB VTAB_FOR_Airq4ms_CM_eEGMD_adm "Enumerated data type: eEGMD" TAB_VERB 5 0 "NOT_DETERM" 1 "CRANK" 2 "IDLE" 3 "NORMAL" 4 "CUT_OFF" /end COMPU_VTAB
/begin COMPU_VTAB VTAB_FOR_CalcADCYC_ADIDL_100ms_Symbol_CM_FixEnableT "Enumerated data type: FixEnableT" TAB_VERB 2 171 "Enable" 218 "Disable" /end COMPU_VTAB
/begin COMPU_VTAB VTAB_FOR_CalcGain_Adat_100ms_Symbol_CM_FixEnableT "Enumerated data type: FixEnableT" TAB_VERB 2 171 "Enable" 218 "Disable" /end COMPU_VTAB
/begin COMPU_VTAB VTAB_FOR_Cata100ms_Symbol_CM_FixEnableT "Enumerated data type: FixEnableT" TAB_VERB 2 171 "Enable" 218 "Disable" /end COMPU_VTAB
/begin COMPU_VTAB VTAB_FOR_CataTDC_Symbol_CM_FixEnableT "Enumerated data type: FixEnableT" TAB_VERB 2 171 "Enable" 218 "Disable" /end COMPU_VTAB
/begin COMPU_VTAB VTAB_FOR_DCmvInterface100ms_Symbol_CM_FixEnableT "Enumerated data type: FixEnableT" TAB_VERB 2 171 "Enable" 218 "Disable" /end COMPU_VTAB
/begin COMPU_VTAB VTAB_FOR_DiagSym4ms_CM_ePhCrank_adm "Enumerated data type: ePhCrank" TAB_VERB 5 0 "PH_NULL" 1 "PHASE1" 2 "PHASE2" 3 "PHASE3" 4 "END_CRANK" /end COMPU_VTAB
/begin COMPU_VTAB VTAB_FOR_DwlTDC_Symbol_CM_FixEnableT "Enumerated data type: FixEnableT" TAB_VERB 2 171 "Enable" 218 "Disable" /end COMPU_VTAB
/begin COMPU_VTAB VTAB_FOR_EgmdTDC_CM_eCutOff_adm "Enumerated data type: eCutOff" TAB_VERB 5 0 "WAIT_CUT_OFF" 1 "CUT_OFF_ENTRY" 2 "CUT_OFF_ACTIVE" 3 "EXIT_CUT_OFF_RPM" 4 "EXIT_CUT_OFF_THROT" /end COMPU_VTAB
/begin COMPU_VTAB VTAB_FOR_EngineModeTDC_Symbol_CM_FixEnableT "Enumerated data type: FixEnableT" TAB_VERB 2 171 "Enable" 218 "Disable" /end COMPU_VTAB
/begin COMPU_VTAB VTAB_FOR_FaultChkMDxTDC_CM_FixEnableT "Enumerated data type: FixEnableT" TAB_VERB 2 171 "Enable" 218 "Disable" /end COMPU_VTAB
/begin COMPU_VTAB VTAB_FOR_FlywheelCorrTDC_CM_FixEnableT "Enumerated data type: FixEnableT" TAB_VERB 2 171 "Enable" 218 "Disable" /end COMPU_VTAB
/begin COMPU_VTAB VTAB_FOR_KnockConfigTDC_CM_FixEnableT "Enumerated data type: FixEnableT" TAB_VERB 2 171 "Enable" 218 "Disable" /end COMPU_VTAB
/begin COMPU_VTAB VTAB_FOR_KnockConfigTDC_CM_tKnockEqadcDan_adm "Enumerated data type: tKnockEqadcDan" TAB_VERB 2 0 "MBSL_KNOCK_SENSOR_0" 1 "MBSL_KNOCK_SENSOR_1" /end COMPU_VTAB
/begin COMPU_VTAB VTAB_FOR_KnockConfigTDC_CM_tKnockEqadcPreGain_adm "Enumerated data type: tKnockEqadcPreGain" TAB_VERB 3 0 "MBSL_KNOCK_PREGAIN_1" 1 "MBSL_KNOCK_PREGAIN_2" 2 "MBSL_KNOCK_PREGAIN_4" /end COMPU_VTAB
/begin COMPU_VTAB VTAB_FOR_KnockConfigTDC_CM_tKnockScaleFactor_adm "Enumerated data type: tKnockScaleFactor" TAB_VERB 5 0 "MBSL_DECFILTER_SCALE_FACTOR_1" 1 "MBSL_DECFILTER_SCALE_FACTOR_4" 2 "MBSL_DECFILTER_SCALE_FACTOR_8" 3 "MBSL_DECFILTER_SCALE_FACTOR_16" 4 "MBSL_DECFILTER_SCALE_FACTOR_NULL" /end COMPU_VTAB
/begin COMPU_VTAB VTAB_FOR_KnockControlTDC_CM_FixEnableT "Enumerated data type: FixEnableT" TAB_VERB 2 171 "Enable" 218 "Disable" /end COMPU_VTAB
/begin COMPU_VTAB VTAB_FOR_KnockDetectionTDC_CM_FixEnableT "Enumerated data type: FixEnableT" TAB_VERB 2 171 "Enable" 218 "Disable" /end COMPU_VTAB
/begin COMPU_VTAB VTAB_FOR_KnockTDC_CM_tKnockEqadcDan_adm "Enumerated data type: tKnockEqadcDan" TAB_VERB 2 0 "MBSL_KNOCK_SENSOR_0" 1 "MBSL_KNOCK_SENSOR_1" /end COMPU_VTAB
/begin COMPU_VTAB VTAB_FOR_KnockTDC_CM_tKnockLevel_adm "Enumerated data type: tKnockLevel" TAB_VERB 3 0 "MBSL_NO_KNOCK" 1 "MBSL_SOFT_KNOCK" 2 "MBSL_HARD_KNOCK" /end COMPU_VTAB
/begin COMPU_VTAB VTAB_FOR_MisfireDetectionTDC_CM_FixEnableT "Enumerated data type: FixEnableT" TAB_VERB 2 171 "Enable" 218 "Disable" /end COMPU_VTAB
/begin COMPU_VTAB VTAB_FOR_Mpre4ms_CM_tKeyState_adm "Enumerated data type: tKeyState" TAB_VERB 2 0 "KEY_OFF" 1 "KEY_ON" /end COMPU_VTAB
/begin COMPU_VTAB VTAB_FOR_Oilp100ms_CM_tKeyState_adm "Enumerated data type: tKeyState" TAB_VERB 2 0 "KEY_OFF" 1 "KEY_ON" /end COMPU_VTAB
/begin COMPU_VTAB VTAB_FOR_Oilt100ms_CM_tKeyState_adm "Enumerated data type: tKeyState" TAB_VERB 2 0 "KEY_OFF" 1 "KEY_ON" /end COMPU_VTAB
/begin COMPU_VTAB VTAB_FOR_Pacc4ms_CM_tKeyState_adm "Enumerated data type: tKeyState" TAB_VERB 2 0 "KEY_OFF" 1 "KEY_ON" /end COMPU_VTAB
/begin COMPU_VTAB VTAB_FOR_Prvc4ms_CM_eEGST_adm "Enumerated data type: eEGST" TAB_VERB 7 0 "POWER_ON" 1 "WAIT" 2 "RUN" 3 "POWER_LATCH" 4 "POWER_OFF" 5 "SHUTDOWN" 6 "ACTDIAG_WAIT" /end COMPU_VTAB
/begin COMPU_VTAB VTAB_FOR_Prvc4ms_CM_tDiagStat_adm "Enumerated data type: tDiagStat" TAB_VERB 4 0 "ENTRY" 1 "DURING" 2 "END" 39 "UNKNOWN_DIAGSTAT" /end COMPU_VTAB
/begin COMPU_VTAB VTAB_FOR_Pwrl4ms_CM_eActDiagPh_adm "Enumerated data type: eActDiagPh" TAB_VERB 3 0 "ACTDIAG_ENTRY" 1 "ACTDIAG_RUN" 2 "ACTDIAG_END" /end COMPU_VTAB
/begin COMPU_VTAB VTAB_FOR_Pwrl4ms_CM_eEGST_adm "Enumerated data type: eEGST" TAB_VERB 8 0 "POWER_ON" 1 "WAIT" 2 "RUN" 3 "POWER_LATCH" 4 "POWER_OFF" 5 "SHUTDOWN" 6 "ACTDIAG_WAIT" 7 "SAFETY_CHECK" /end COMPU_VTAB
/begin COMPU_VTAB VTAB_FOR_Pwrl4ms_CM_tActDiagStat_adm "Enumerated data type: tActDiagStat" TAB_VERB 5 0 "STOPPED_AD" 1 "DURING_AD" 2 "END_AD" 3 "IMPOSSIBLE_AD" 39 "UNKNOWN_AD" /end COMPU_VTAB
/begin COMPU_VTAB VTAB_FOR_Pwrl4ms_CM_tDiagStat_adm "Enumerated data type: tDiagStat" TAB_VERB 4 0 "ENTRY" 1 "DURING" 2 "END" 39 "UNKNOWN_DIAGSTAT" /end COMPU_VTAB
/begin COMPU_VTAB VTAB_FOR_Rpre4ms_CM_tKeyState_adm "Enumerated data type: tKeyState" TAB_VERB 2 0 "KEY_OFF" 1 "KEY_ON" /end COMPU_VTAB
/begin COMPU_VTAB VTAB_FOR_Saf3_50ms_CM_eEGST_adm "Enumerated data type: eEGST" TAB_VERB 8 0 "POWER_ON" 1 "WAIT" 2 "RUN" 3 "POWER_LATCH" 4 "POWER_OFF" 5 "SHUTDOWN" 6 "ACTDIAG_WAIT" 7 "SAFETY_CHECK" /end COMPU_VTAB
/begin COMPU_VTAB VTAB_FOR_TE_TM_RpmLimitTDC_Symbol_CM_FixEnableT "Enumerated data type: FixEnableT" TAB_VERB 2 171 "Enable" 218 "Disable" /end COMPU_VTAB
/begin COMPU_VTAB VTAB_FOR_Test_KO2_TDC_Symbol_CM_FixEnableT "Enumerated data type: FixEnableT" TAB_VERB 2 171 "Enable" 218 "Disable" /end COMPU_VTAB
/begin COMPU_VTAB VTAB_FOR_Test_RipCarica_TDC_Symbol_CM_FixEnableT "Enumerated data type: FixEnableT" TAB_VERB 2 171 "Enable" 218 "Disable" /end COMPU_VTAB
/begin COMPU_VTAB VTAB_FOR_Thrp4ms_CM_eEGST_adm "Enumerated data type: eEGST" TAB_VERB 8 0 "POWER_ON" 1 "WAIT" 2 "RUN" 3 "POWER_LATCH" 4 "POWER_OFF" 5 "SHUTDOWN" 6 "ACTDIAG_WAIT" 7 "SAFETY_CHECK" /end COMPU_VTAB
/begin COMPU_VTAB VTAB_FOR_Thrp4ms_CM_eTHRP_adm "Enumerated data type: eTHRP" TAB_VERB 3 0 "CLOSED_THROTTLE" 1 "MEDIUM_THROTTLE" 2 "OPEN_THROTTLE" /end COMPU_VTAB
/begin COMPU_VTAB VTAB_FOR_Thrp4ms_CM_tKeyState_adm "Enumerated data type: tKeyState" TAB_VERB 2 0 "KEY_OFF" 1 "KEY_ON" /end COMPU_VTAB
/begin COMPU_VTAB VTAB_FOR_Thrp_Mgmt50ms_CM_tKeyState_adm "Enumerated data type: tKeyState" TAB_VERB 2 0 "KEY_OFF" 1 "KEY_ON" /end COMPU_VTAB
/begin COMPU_VTAB VTAB_FOR_VarMgmDLAM100ms_Symbol_CM_FixEnableT "Enumerated data type: FixEnableT" TAB_VERB 2 171 "Enable" 218 "Disable" /end COMPU_VTAB
/begin RECORD_LAYOUT Lookup1D_UWORD FNC_VALUES 1 UWORD COLUMN_DIR DIRECT /end RECORD_LAYOUT
/begin RECORD_LAYOUT Lookup1D_WORD FNC_VALUES 1 SWORD COLUMN_DIR DIRECT /end RECORD_LAYOUT
/begin RECORD_LAYOUT Lookup1D_X_UWORD AXIS_PTS_X 1 UWORD INDEX_INCR DIRECT /end RECORD_LAYOUT
/begin RECORD_LAYOUT Lookup2DSF_UWORD FNC_VALUES 1 UWORD ROW_DIR DIRECT /end RECORD_LAYOUT
/begin RECORD_LAYOUT Lookup2DSF_WORD FNC_VALUES 1 SWORD ROW_DIR DIRECT /end RECORD_LAYOUT
/begin RECORD_LAYOUT Lookup2D_FLOAT32_IEEE FNC_VALUES 1 FLOAT32_IEEE COLUMN_DIR DIRECT /end RECORD_LAYOUT
/begin RECORD_LAYOUT Lookup2D_WORD FNC_VALUES 1 SWORD COLUMN_DIR DIRECT /end RECORD_LAYOUT
/begin RECORD_LAYOUT Lookup2D_X_UWORD AXIS_PTS_X 1 UWORD INDEX_INCR DIRECT /end RECORD_LAYOUT
/begin RECORD_LAYOUT Scalar_BOOLEAN FNC_VALUES 1 UBYTE COLUMN_DIR DIRECT /end RECORD_LAYOUT
/begin RECORD_LAYOUT Scalar_FLOAT32_IEEE FNC_VALUES 1 FLOAT32_IEEE COLUMN_DIR DIRECT /end RECORD_LAYOUT
/begin RECORD_LAYOUT Scalar_LONG FNC_VALUES 1 SLONG COLUMN_DIR DIRECT /end RECORD_LAYOUT
/begin RECORD_LAYOUT Scalar_SWORD FNC_VALUES 1 SWORD COLUMN_DIR DIRECT /end RECORD_LAYOUT
/begin RECORD_LAYOUT Scalar_UBYTE FNC_VALUES 1 UBYTE COLUMN_DIR DIRECT /end RECORD_LAYOUT
/begin RECORD_LAYOUT Scalar_UWORD FNC_VALUES 1 UWORD COLUMN_DIR DIRECT /end RECORD_LAYOUT
/end MODULE
/end PROJECT
