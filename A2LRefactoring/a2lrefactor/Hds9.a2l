ASAP2_VERSION 1 70
/begin PROJECT XCPonCANFD "Generated for ETAS and Vector "
/begin MODULE XCPonCANFD "Generated for ETAS and Vector "
/begin MOD_COMMON "XCPonCANFD" BYTE_ORDER MSB_FIRST ALIGNMENT_BYTE 1 ALIGNMENT_WORD 2 ALIGNMENT_LONG 4 ALIGNMENT_FLOAT32_IEEE 4 ALIGNMENT_FLOAT64_IEEE 8 ALIGNMENT_INT64 8 /end MOD_COMMON
/begin AXIS_PTS wkETASP "[Y_BKP] Rendimento Volumetrico" 0xFC54FA NO_INPUT_QUANTITY Lookup2D_X_UWORD 0 TE_HBEgrValveCtrl4ms_CM_ufix16_En10_adm 16 0 3 /end AXIS_PTS
/begin AXIS_PTS wkETASP_CO "[Y_BKP] Rendimento Volumetrico" 0xFC54DA NO_INPUT_QUANTITY Lookup2D_X_UWORD 0 TE_HBEgrValveCtrl4ms_CM_ufix16_En10_adm 16 0 3 /end AXIS_PTS
/begin AXIS_PTS wkRPM "[X_BKP] Velocitá di rotazione motore" 0xFC549A NO_INPUT_QUANTITY Lookup2D_X_UWORD 0 TE_HBEgrValveCtrl4ms_CM_uint16_rpm 16 0 10000 /end AXIS_PTS
/begin AXIS_PTS wkRPM_CO "[X_BKP] Velocitá di rotazione motore" 0xFC547A NO_INPUT_QUANTITY Lookup2D_X_UWORD 0 TE_HBEgrValveCtrl4ms_CM_uint16_rpm 16 0 10000 /end AXIS_PTS
/begin CHARACTERISTIC wtPERC_EGR_OBJ "EGR target percentage (with respect of Air Main mass flow)" MAP 0xFC502A Lookup2D_UWORD 0 TE_HBEgrValveCtrl4ms_CM_ufix16_En3__ 0 100
 /begin AXIS_DESCR COM_AXIS NO_INPUT_QUANTITY TE_HBEgrValveCtrl4ms_CM_ufix16_En10_adm 16 0 3 AXIS_PTS_REF wkETASP /end AXIS_DESCR
 /begin AXIS_DESCR COM_AXIS NO_INPUT_QUANTITY TE_HBEgrValveCtrl4ms_CM_uint16_rpm 16 0 10000 AXIS_PTS_REF wkRPM /end AXIS_DESCR
/end CHARACTERISTIC
/begin CHARACTERISTIC wtPERC_EGR_OBJ_CO "EGR target percentage (with respect of Air Main mass flow) during cut-off" MAP 0xFC4E2A Lookup2D_UWORD 0 TE_HBEgrValveCtrl4ms_CM_ufix16_En3__ 0 100
 /begin AXIS_DESCR COM_AXIS NO_INPUT_QUANTITY TE_HBEgrValveCtrl4ms_CM_ufix16_En10_adm 16 0 3 AXIS_PTS_REF wkETASP_CO /end AXIS_DESCR
 /begin AXIS_DESCR COM_AXIS NO_INPUT_QUANTITY TE_HBEgrValveCtrl4ms_CM_uint16_rpm 16 0 10000 AXIS_PTS_REF wkRPM_CO /end AXIS_DESCR
/end CHARACTERISTIC
/begin CHARACTERISTIC STH_CAL.usrConf2Deval "Transition from CONFIRMED to DEVALIDATED - Number of NO_FAULT" VALUE 0xFCC9A4 __UWORD_Z 0 NO_COMPU_METHOD 0 65535 SYMBOL_LINK "xAdiaCalDataB" 4 /end CHARACTERISTIC
/begin CHARACTERISTIC STH_CAL.usrDeb2Conf "Transition from DEBOUNCING to CONFIRMED - Number of Fault" VALUE 0xFCC9A6 __UWORD_Z 0 NO_COMPU_METHOD 0 65535 SYMBOL_LINK "xAdiaCalDataB" 6 /end CHARACTERISTIC
/begin CHARACTERISTIC STH_CAL.usrFilt2Conf " Transition from FILTERING to CONFIRM - Counter threshold" VALUE 0xFCC9AA __UWORD_Z 0 NO_COMPU_METHOD 0 65535 SYMBOL_LINK "xAdiaCalDataB" 10 /end CHARACTERISTIC
/begin CHARACTERISTIC STH_CAL.usrInConfOld "Init counter value in CONFIRMED_OLD status" VALUE 0xFCC9AC __UWORD_Z 0 NO_COMPU_METHOD 0 65535 SYMBOL_LINK "xAdiaCalDataB" 12 /end CHARACTERISTIC
/begin CHARACTERISTIC STH_CAL.usrStep "Counter increment value from DEBOUNCING to CONFIRMED status and init value in the FILTERING status" VALUE 0xFCC9A8 __UBYTE_Z 0 NO_COMPU_METHOD 0 255 SYMBOL_LINK "xAdiaCalDataB" 8 /end CHARACTERISTIC
/begin CHARACTERISTIC STH_CAL.usrWucCntIni "Transition from DEVALIDATED to NO_ERROR - Number of warm-up cycles" VALUE 0xFCC9A2 __UBYTE_Z 0 NO_COMPU_METHOD 0 255 SYMBOL_LINK "xAdiaCalDataB" 2 /end CHARACTERISTIC
/begin CHARACTERISTIC STH_CAL.xFlg.AdiaConfWord "Adia Configuration Word" VALUE 0xFCC9A0 __UWORD_Z 0 NO_COMPU_METHOD 0 65535 SYMBOL_LINK "xAdiaCalDataB" 0 /end CHARACTERISTIC
/begin CHARACTERISTIC MD6_CAL.usrConf2Deval "Transition from CONFIRMED to DEVALIDATED - Number of NO_FAULT" VALUE 0xFCCF1C __UWORD_Z 0 NO_COMPU_METHOD 0 65535 SYMBOL_LINK "xAdiaCalDataB" 1404 /end CHARACTERISTIC
/begin CHARACTERISTIC MD6_CAL.usrDeb2Conf "Transition from DEBOUNCING to CONFIRMED - Number of Fault" VALUE 0xFCCF1E __UWORD_Z 0 NO_COMPU_METHOD 0 65535 SYMBOL_LINK "xAdiaCalDataB" 1406 /end CHARACTERISTIC
/begin CHARACTERISTIC MD6_CAL.usrFilt2Conf " Transition from FILTERING to CONFIRM - Counter threshold" VALUE 0xFCCF22 __UWORD_Z 0 NO_COMPU_METHOD 0 65535 SYMBOL_LINK "xAdiaCalDataB" 1410 /end CHARACTERISTIC
/begin CHARACTERISTIC MD6_CAL.usrInConfOld "Init counter value in CONFIRMED_OLD status" VALUE 0xFCCF24 __UWORD_Z 0 NO_COMPU_METHOD 0 65535 SYMBOL_LINK "xAdiaCalDataB" 1412 /end CHARACTERISTIC
/begin CHARACTERISTIC MD6_CAL.usrStep "Counter increment value from DEBOUNCING to CONFIRMED status and init value in the FILTERING status" VALUE 0xFCCF20 __UBYTE_Z 0 NO_COMPU_METHOD 0 255 SYMBOL_LINK "xAdiaCalDataB" 1408 /end CHARACTERISTIC
/begin CHARACTERISTIC MD6_CAL.usrWucCntIni "Transition from DEVALIDATED to NO_ERROR - Number of warm-up cycles" VALUE 0xFCCF1A __UBYTE_Z 0 NO_COMPU_METHOD 0 255 SYMBOL_LINK "xAdiaCalDataB" 1402 /end CHARACTERISTIC
/begin CHARACTERISTIC MD6_CAL.xFlg.AdiaConfWord "Adia Configuration Word" VALUE 0xFCCF18 __UWORD_Z 0 NO_COMPU_METHOD 0 65535 SYMBOL_LINK "xAdiaCalDataB" 1400 /end CHARACTERISTIC
/begin CHARACTERISTIC MD7_CAL.usrConf2Deval "Transition from CONFIRMED to DEVALIDATED - Number of NO_FAULT" VALUE 0xFCCF2A __UWORD_Z 0 NO_COMPU_METHOD 0 65535 SYMBOL_LINK "xAdiaCalDataB" 1418 /end CHARACTERISTIC
/begin CHARACTERISTIC MD7_CAL.usrDeb2Conf "Transition from DEBOUNCING to CONFIRMED - Number of Fault" VALUE 0xFCCF2C __UWORD_Z 0 NO_COMPU_METHOD 0 65535 SYMBOL_LINK "xAdiaCalDataB" 1420 /end CHARACTERISTIC
/begin CHARACTERISTIC MD7_CAL.usrFilt2Conf " Transition from FILTERING to CONFIRM - Counter threshold" VALUE 0xFCCF30 __UWORD_Z 0 NO_COMPU_METHOD 0 65535 SYMBOL_LINK "xAdiaCalDataB" 1424 /end CHARACTERISTIC
/begin CHARACTERISTIC MD7_CAL.usrInConfOld "Init counter value in CONFIRMED_OLD status" VALUE 0xFCCF32 __UWORD_Z 0 NO_COMPU_METHOD 0 65535 SYMBOL_LINK "xAdiaCalDataB" 1426 /end CHARACTERISTIC
/begin CHARACTERISTIC MD7_CAL.usrStep "Counter increment value from DEBOUNCING to CONFIRMED status and init value in the FILTERING status" VALUE 0xFCCF2E __UBYTE_Z 0 NO_COMPU_METHOD 0 255 SYMBOL_LINK "xAdiaCalDataB" 1422 /end CHARACTERISTIC
/begin CHARACTERISTIC MD7_CAL.usrWucCntIni "Transition from DEVALIDATED to NO_ERROR - Number of warm-up cycles" VALUE 0xFCCF28 __UBYTE_Z 0 NO_COMPU_METHOD 0 255 SYMBOL_LINK "xAdiaCalDataB" 1416 /end CHARACTERISTIC
/begin CHARACTERISTIC MD7_CAL.xFlg.AdiaConfWord "Adia Configuration Word" VALUE 0xFCCF26 __UWORD_Z 0 NO_COMPU_METHOD 0 65535 SYMBOL_LINK "xAdiaCalDataB" 1414 /end CHARACTERISTIC
/begin CHARACTERISTIC MD8_CAL.usrConf2Deval "Transition from CONFIRMED to DEVALIDATED - Number of NO_FAULT" VALUE 0xFCCF38 __UWORD_Z 0 NO_COMPU_METHOD 0 65535 SYMBOL_LINK "xAdiaCalDataB" 1432 /end CHARACTERISTIC
/begin CHARACTERISTIC MD8_CAL.usrDeb2Conf "Transition from DEBOUNCING to CONFIRMED - Number of Fault" VALUE 0xFCCF3A __UWORD_Z 0 NO_COMPU_METHOD 0 65535 SYMBOL_LINK "xAdiaCalDataB" 1434 /end CHARACTERISTIC
/begin CHARACTERISTIC MD8_CAL.usrFilt2Conf " Transition from FILTERING to CONFIRM - Counter threshold" VALUE 0xFCCF3E __UWORD_Z 0 NO_COMPU_METHOD 0 65535 SYMBOL_LINK "xAdiaCalDataB" 1438 /end CHARACTERISTIC
/begin CHARACTERISTIC MD8_CAL.usrInConfOld "Init counter value in CONFIRMED_OLD status" VALUE 0xFCCF40 __UWORD_Z 0 NO_COMPU_METHOD 0 65535 SYMBOL_LINK "xAdiaCalDataB" 1440 /end CHARACTERISTIC
/begin CHARACTERISTIC MD8_CAL.usrStep "Counter increment value from DEBOUNCING to CONFIRMED status and init value in the FILTERING status" VALUE 0xFCCF3C __UBYTE_Z 0 NO_COMPU_METHOD 0 255 SYMBOL_LINK "xAdiaCalDataB" 1436 /end CHARACTERISTIC
/begin CHARACTERISTIC MD8_CAL.usrWucCntIni "Transition from DEVALIDATED to NO_ERROR - Number of warm-up cycles" VALUE 0xFCCF36 __UBYTE_Z 0 NO_COMPU_METHOD 0 255 SYMBOL_LINK "xAdiaCalDataB" 1430 /end CHARACTERISTIC
/begin CHARACTERISTIC MD8_CAL.xFlg.AdiaConfWord "Adia Configuration Word" VALUE 0xFCCF34 __UWORD_Z 0 NO_COMPU_METHOD 0 65535 SYMBOL_LINK "xAdiaCalDataB" 1428 /end CHARACTERISTIC
/begin CHARACTERISTIC MDR_CAL.usrConf2Deval "Transition from CONFIRMED to DEVALIDATED - Number of NO_FAULT" VALUE 0xFCCF46 __UWORD_Z 0 NO_COMPU_METHOD 0 65535 SYMBOL_LINK "xAdiaCalDataB" 1446 /end CHARACTERISTIC
/begin CHARACTERISTIC MDR_CAL.usrDeb2Conf "Transition from DEBOUNCING to CONFIRMED - Number of Fault" VALUE 0xFCCF48 __UWORD_Z 0 NO_COMPU_METHOD 0 65535 SYMBOL_LINK "xAdiaCalDataB" 1448 /end CHARACTERISTIC
/begin CHARACTERISTIC MDR_CAL.usrFilt2Conf " Transition from FILTERING to CONFIRM - Counter threshold" VALUE 0xFCCF4C __UWORD_Z 0 NO_COMPU_METHOD 0 65535 SYMBOL_LINK "xAdiaCalDataB" 1452 /end CHARACTERISTIC
/begin CHARACTERISTIC MDR_CAL.usrInConfOld "Init counter value in CONFIRMED_OLD status" VALUE 0xFCCF4E __UWORD_Z 0 NO_COMPU_METHOD 0 65535 SYMBOL_LINK "xAdiaCalDataB" 1454 /end CHARACTERISTIC
/begin CHARACTERISTIC MDR_CAL.usrStep "Counter increment value from DEBOUNCING to CONFIRMED status and init value in the FILTERING status" VALUE 0xFCCF4A __UBYTE_Z 0 NO_COMPU_METHOD 0 255 SYMBOL_LINK "xAdiaCalDataB" 1450 /end CHARACTERISTIC
/begin CHARACTERISTIC MDR_CAL.usrWucCntIni "Transition from DEVALIDATED to NO_ERROR - Number of warm-up cycles" VALUE 0xFCCF44 __UBYTE_Z 0 NO_COMPU_METHOD 0 255 SYMBOL_LINK "xAdiaCalDataB" 1444 /end CHARACTERISTIC
/begin CHARACTERISTIC MDR_CAL.xFlg.AdiaConfWord "Adia Configuration Word" VALUE 0xFCCF42 __UWORD_Z 0 NO_COMPU_METHOD 0 65535 SYMBOL_LINK "xAdiaCalDataB" 1442 /end CHARACTERISTIC
/begin CHARACTERISTIC SPM2H_CAL.usrConf2Deval "Transition from CONFIRMED to DEVALIDATED - Number of NO_FAULT" VALUE 0xFCCF54 __UWORD_Z 0 NO_COMPU_METHOD 0 65535 SYMBOL_LINK "xAdiaCalDataB" 1460 /end CHARACTERISTIC
/begin CHARACTERISTIC SPM2H_CAL.usrDeb2Conf "Transition from DEBOUNCING to CONFIRMED - Number of Fault" VALUE 0xFCCF56 __UWORD_Z 0 NO_COMPU_METHOD 0 65535 SYMBOL_LINK "xAdiaCalDataB" 1462 /end CHARACTERISTIC
/begin CHARACTERISTIC SPM2H_CAL.usrFilt2Conf " Transition from FILTERING to CONFIRM - Counter threshold" VALUE 0xFCCF5A __UWORD_Z 0 NO_COMPU_METHOD 0 65535 SYMBOL_LINK "xAdiaCalDataB" 1466 /end CHARACTERISTIC
/begin CHARACTERISTIC SPM2H_CAL.usrInConfOld "Init counter value in CONFIRMED_OLD status" VALUE 0xFCCF5C __UWORD_Z 0 NO_COMPU_METHOD 0 65535 SYMBOL_LINK "xAdiaCalDataB" 1468 /end CHARACTERISTIC
/begin CHARACTERISTIC SPM2H_CAL.usrStep "Counter increment value from DEBOUNCING to CONFIRMED status and init value in the FILTERING status" VALUE 0xFCCF58 __UBYTE_Z 0 NO_COMPU_METHOD 0 255 SYMBOL_LINK "xAdiaCalDataB" 1464 /end CHARACTERISTIC
/begin CHARACTERISTIC SPM2H_CAL.usrWucCntIni "Transition from DEVALIDATED to NO_ERROR - Number of warm-up cycles" VALUE 0xFCCF52 __UBYTE_Z 0 NO_COMPU_METHOD 0 255 SYMBOL_LINK "xAdiaCalDataB" 1458 /end CHARACTERISTIC
/begin CHARACTERISTIC SPM2H_CAL.xFlg.AdiaConfWord "Adia Configuration Word" VALUE 0xFCCF50 __UWORD_Z 0 NO_COMPU_METHOD 0 65535 SYMBOL_LINK "xAdiaCalDataB" 1456 /end CHARACTERISTIC
/begin CHARACTERISTIC KSP1_CAL.usrConf2Deval "Transition from CONFIRMED to DEVALIDATED - Number of NO_FAULT" VALUE 0xFCCF62 __UWORD_Z 0 NO_COMPU_METHOD 0 65535 SYMBOL_LINK "xAdiaCalDataB" 1474 /end CHARACTERISTIC
/begin CHARACTERISTIC KSP1_CAL.usrDeb2Conf "Transition from DEBOUNCING to CONFIRMED - Number of Fault" VALUE 0xFCCF64 __UWORD_Z 0 NO_COMPU_METHOD 0 65535 SYMBOL_LINK "xAdiaCalDataB" 1476 /end CHARACTERISTIC
/begin CHARACTERISTIC KSP1_CAL.usrFilt2Conf " Transition from FILTERING to CONFIRM - Counter threshold" VALUE 0xFCCF68 __UWORD_Z 0 NO_COMPU_METHOD 0 65535 SYMBOL_LINK "xAdiaCalDataB" 1480 /end CHARACTERISTIC
/begin CHARACTERISTIC KSP1_CAL.usrInConfOld "Init counter value in CONFIRMED_OLD status" VALUE 0xFCCF6A __UWORD_Z 0 NO_COMPU_METHOD 0 65535 SYMBOL_LINK "xAdiaCalDataB" 1482 /end CHARACTERISTIC
/begin CHARACTERISTIC KSP1_CAL.usrStep "Counter increment value from DEBOUNCING to CONFIRMED status and init value in the FILTERING status" VALUE 0xFCCF66 __UBYTE_Z 0 NO_COMPU_METHOD 0 255 SYMBOL_LINK "xAdiaCalDataB" 1478 /end CHARACTERISTIC
/begin CHARACTERISTIC KSP1_CAL.usrWucCntIni "Transition from DEVALIDATED to NO_ERROR - Number of warm-up cycles" VALUE 0xFCCF60 __UBYTE_Z 0 NO_COMPU_METHOD 0 255 SYMBOL_LINK "xAdiaCalDataB" 1472 /end CHARACTERISTIC
/begin CHARACTERISTIC KSP1_CAL.xFlg.AdiaConfWord "Adia Configuration Word" VALUE 0xFCCF5E __UWORD_Z 0 NO_COMPU_METHOD 0 65535 SYMBOL_LINK "xAdiaCalDataB" 1470 /end CHARACTERISTIC
/begin CHARACTERISTIC KSP2_CAL.usrConf2Deval "Transition from CONFIRMED to DEVALIDATED - Number of NO_FAULT" VALUE 0xFCCF70 __UWORD_Z 0 NO_COMPU_METHOD 0 65535 SYMBOL_LINK "xAdiaCalDataB" 1488 /end CHARACTERISTIC
/begin CHARACTERISTIC KSP2_CAL.usrDeb2Conf "Transition from DEBOUNCING to CONFIRMED - Number of Fault" VALUE 0xFCCF72 __UWORD_Z 0 NO_COMPU_METHOD 0 65535 SYMBOL_LINK "xAdiaCalDataB" 1490 /end CHARACTERISTIC
/begin CHARACTERISTIC KSP2_CAL.usrFilt2Conf " Transition from FILTERING to CONFIRM - Counter threshold" VALUE 0xFCCF76 __UWORD_Z 0 NO_COMPU_METHOD 0 65535 SYMBOL_LINK "xAdiaCalDataB" 1494 /end CHARACTERISTIC
/begin CHARACTERISTIC KSP2_CAL.usrInConfOld "Init counter value in CONFIRMED_OLD status" VALUE 0xFCCF78 __UWORD_Z 0 NO_COMPU_METHOD 0 65535 SYMBOL_LINK "xAdiaCalDataB" 1496 /end CHARACTERISTIC
/begin CHARACTERISTIC KSP2_CAL.usrStep "Counter increment value from DEBOUNCING to CONFIRMED status and init value in the FILTERING status" VALUE 0xFCCF74 __UBYTE_Z 0 NO_COMPU_METHOD 0 255 SYMBOL_LINK "xAdiaCalDataB" 1492 /end CHARACTERISTIC
/begin CHARACTERISTIC KSP2_CAL.usrWucCntIni "Transition from DEVALIDATED to NO_ERROR - Number of warm-up cycles" VALUE 0xFCCF6E __UBYTE_Z 0 NO_COMPU_METHOD 0 255 SYMBOL_LINK "xAdiaCalDataB" 1486 /end CHARACTERISTIC
/begin CHARACTERISTIC KSP2_CAL.xFlg.AdiaConfWord "Adia Configuration Word" VALUE 0xFCCF6C __UWORD_Z 0 NO_COMPU_METHOD 0 65535 SYMBOL_LINK "xAdiaCalDataB" 1484 /end CHARACTERISTIC
/begin CHARACTERISTIC EGRP_CAL.usrConf2Deval "Transition from CONFIRMED to DEVALIDATED - Number of NO_FAULT" VALUE 0xFCCF7E __UWORD_Z 0 NO_COMPU_METHOD 0 65535 SYMBOL_LINK "xAdiaCalDataB" 1502 /end CHARACTERISTIC
/begin CHARACTERISTIC EGRP_CAL.usrDeb2Conf "Transition from DEBOUNCING to CONFIRMED - Number of Fault" VALUE 0xFCCF80 __UWORD_Z 0 NO_COMPU_METHOD 0 65535 SYMBOL_LINK "xAdiaCalDataB" 1504 /end CHARACTERISTIC
/begin CHARACTERISTIC EGRP_CAL.usrFilt2Conf " Transition from FILTERING to CONFIRM - Counter threshold" VALUE 0xFCCF84 __UWORD_Z 0 NO_COMPU_METHOD 0 65535 SYMBOL_LINK "xAdiaCalDataB" 1508 /end CHARACTERISTIC
/begin CHARACTERISTIC EGRP_CAL.usrInConfOld "Init counter value in CONFIRMED_OLD status" VALUE 0xFCCF86 __UWORD_Z 0 NO_COMPU_METHOD 0 65535 SYMBOL_LINK "xAdiaCalDataB" 1510 /end CHARACTERISTIC
/begin CHARACTERISTIC EGRP_CAL.usrStep "Counter increment value from DEBOUNCING to CONFIRMED status and init value in the FILTERING status" VALUE 0xFCCF82 __UBYTE_Z 0 NO_COMPU_METHOD 0 255 SYMBOL_LINK "xAdiaCalDataB" 1506 /end CHARACTERISTIC
/begin CHARACTERISTIC EGRP_CAL.usrWucCntIni "Transition from DEVALIDATED to NO_ERROR - Number of warm-up cycles" VALUE 0xFCCF7C __UBYTE_Z 0 NO_COMPU_METHOD 0 255 SYMBOL_LINK "xAdiaCalDataB" 1500 /end CHARACTERISTIC
/begin CHARACTERISTIC EGRP_CAL.xFlg.AdiaConfWord "Adia Configuration Word" VALUE 0xFCCF7A __UWORD_Z 0 NO_COMPU_METHOD 0 65535 SYMBOL_LINK "xAdiaCalDataB" 1498 /end CHARACTERISTIC
/begin CHARACTERISTIC EGRV_CAL.usrConf2Deval "Transition from CONFIRMED to DEVALIDATED - Number of NO_FAULT" VALUE 0xFCCF8C __UWORD_Z 0 NO_COMPU_METHOD 0 65535 SYMBOL_LINK "xAdiaCalDataB" 1516 /end CHARACTERISTIC
/begin CHARACTERISTIC EGRV_CAL.usrDeb2Conf "Transition from DEBOUNCING to CONFIRMED - Number of Fault" VALUE 0xFCCF8E __UWORD_Z 0 NO_COMPU_METHOD 0 65535 SYMBOL_LINK "xAdiaCalDataB" 1518 /end CHARACTERISTIC
/begin CHARACTERISTIC EGRV_CAL.usrFilt2Conf " Transition from FILTERING to CONFIRM - Counter threshold" VALUE 0xFCCF92 __UWORD_Z 0 NO_COMPU_METHOD 0 65535 SYMBOL_LINK "xAdiaCalDataB" 1522 /end CHARACTERISTIC
/begin CHARACTERISTIC EGRV_CAL.usrInConfOld "Init counter value in CONFIRMED_OLD status" VALUE 0xFCCF94 __UWORD_Z 0 NO_COMPU_METHOD 0 65535 SYMBOL_LINK "xAdiaCalDataB" 1524 /end CHARACTERISTIC
/begin CHARACTERISTIC EGRV_CAL.usrStep "Counter increment value from DEBOUNCING to CONFIRMED status and init value in the FILTERING status" VALUE 0xFCCF90 __UBYTE_Z 0 NO_COMPU_METHOD 0 255 SYMBOL_LINK "xAdiaCalDataB" 1520 /end CHARACTERISTIC
/begin CHARACTERISTIC EGRV_CAL.usrWucCntIni "Transition from DEVALIDATED to NO_ERROR - Number of warm-up cycles" VALUE 0xFCCF8A __UBYTE_Z 0 NO_COMPU_METHOD 0 255 SYMBOL_LINK "xAdiaCalDataB" 1514 /end CHARACTERISTIC
/begin CHARACTERISTIC EGRV_CAL.xFlg.AdiaConfWord "Adia Configuration Word" VALUE 0xFCCF88 __UWORD_Z 0 NO_COMPU_METHOD 0 65535 SYMBOL_LINK "xAdiaCalDataB" 1512 /end CHARACTERISTIC
/begin CHARACTERISTIC EGRC_CAL.usrConf2Deval "Transition from CONFIRMED to DEVALIDATED - Number of NO_FAULT" VALUE 0xFCCF9A __UWORD_Z 0 NO_COMPU_METHOD 0 65535 SYMBOL_LINK "xAdiaCalDataB" 1530 /end CHARACTERISTIC
/begin CHARACTERISTIC EGRC_CAL.usrDeb2Conf "Transition from DEBOUNCING to CONFIRMED - Number of Fault" VALUE 0xFCCF9C __UWORD_Z 0 NO_COMPU_METHOD 0 65535 SYMBOL_LINK "xAdiaCalDataB" 1532 /end CHARACTERISTIC
/begin CHARACTERISTIC EGRC_CAL.usrFilt2Conf " Transition from FILTERING to CONFIRM - Counter threshold" VALUE 0xFCCFA0 __UWORD_Z 0 NO_COMPU_METHOD 0 65535 SYMBOL_LINK "xAdiaCalDataB" 1536 /end CHARACTERISTIC
/begin CHARACTERISTIC EGRC_CAL.usrInConfOld "Init counter value in CONFIRMED_OLD status" VALUE 0xFCCFA2 __UWORD_Z 0 NO_COMPU_METHOD 0 65535 SYMBOL_LINK "xAdiaCalDataB" 1538 /end CHARACTERISTIC
/begin CHARACTERISTIC EGRC_CAL.usrStep "Counter increment value from DEBOUNCING to CONFIRMED status and init value in the FILTERING status" VALUE 0xFCCF9E __UBYTE_Z 0 NO_COMPU_METHOD 0 255 SYMBOL_LINK "xAdiaCalDataB" 1534 /end CHARACTERISTIC
/begin CHARACTERISTIC EGRC_CAL.usrWucCntIni "Transition from DEVALIDATED to NO_ERROR - Number of warm-up cycles" VALUE 0xFCCF98 __UBYTE_Z 0 NO_COMPU_METHOD 0 255 SYMBOL_LINK "xAdiaCalDataB" 1528 /end CHARACTERISTIC
/begin CHARACTERISTIC EGRC_CAL.xFlg.AdiaConfWord "Adia Configuration Word" VALUE 0xFCCF96 __UWORD_Z 0 NO_COMPU_METHOD 0 65535 SYMBOL_LINK "xAdiaCalDataB" 1526 /end CHARACTERISTIC
/begin CHARACTERISTIC FAR01_CAL.usrConf2Deval "Transition from CONFIRMED to DEVALIDATED - Number of NO_FAULT" VALUE 0xFCCA30 __UWORD_Z 0 NO_COMPU_METHOD 0 65535 SYMBOL_LINK "xAdiaCalDataB" 144 /end CHARACTERISTIC
/begin CHARACTERISTIC FAR01_CAL.usrDeb2Conf "Transition from DEBOUNCING to CONFIRMED - Number of Fault" VALUE 0xFCCA32 __UWORD_Z 0 NO_COMPU_METHOD 0 65535 SYMBOL_LINK "xAdiaCalDataB" 146 /end CHARACTERISTIC
/begin CHARACTERISTIC FAR01_CAL.usrFilt2Conf " Transition from FILTERING to CONFIRM - Counter threshold" VALUE 0xFCCA36 __UWORD_Z 0 NO_COMPU_METHOD 0 65535 SYMBOL_LINK "xAdiaCalDataB" 150 /end CHARACTERISTIC
/begin CHARACTERISTIC FAR01_CAL.usrInConfOld "Init counter value in CONFIRMED_OLD status" VALUE 0xFCCA38 __UWORD_Z 0 NO_COMPU_METHOD 0 65535 SYMBOL_LINK "xAdiaCalDataB" 152 /end CHARACTERISTIC
/begin CHARACTERISTIC FAR01_CAL.usrStep "Counter increment value from DEBOUNCING to CONFIRMED status and init value in the FILTERING status" VALUE 0xFCCA34 __UBYTE_Z 0 NO_COMPU_METHOD 0 255 SYMBOL_LINK "xAdiaCalDataB" 148 /end CHARACTERISTIC
/begin CHARACTERISTIC FAR01_CAL.usrWucCntIni "Transition from DEVALIDATED to NO_ERROR - Number of warm-up cycles" VALUE 0xFCCA2E __UBYTE_Z 0 NO_COMPU_METHOD 0 255 SYMBOL_LINK "xAdiaCalDataB" 142 /end CHARACTERISTIC
/begin CHARACTERISTIC FAR01_CAL.xFlg.AdiaConfWord "Adia Configuration Word" VALUE 0xFCCA2C __UWORD_Z 0 NO_COMPU_METHOD 0 65535 SYMBOL_LINK "xAdiaCalDataB" 140 /end CHARACTERISTIC
/begin CHARACTERISTIC ENGBRK_CAL.usrConf2Deval "Transition from CONFIRMED to DEVALIDATED - Number of NO_FAULT" VALUE 0xFCCFA8 __UWORD_Z 0 NO_COMPU_METHOD 0 65535 SYMBOL_LINK "xAdiaCalDataB" 1544 /end CHARACTERISTIC
/begin CHARACTERISTIC ENGBRK_CAL.usrDeb2Conf "Transition from DEBOUNCING to CONFIRMED - Number of Fault" VALUE 0xFCCFAA __UWORD_Z 0 NO_COMPU_METHOD 0 65535 SYMBOL_LINK "xAdiaCalDataB" 1546 /end CHARACTERISTIC
/begin CHARACTERISTIC ENGBRK_CAL.usrFilt2Conf " Transition from FILTERING to CONFIRM - Counter threshold" VALUE 0xFCCFAE __UWORD_Z 0 NO_COMPU_METHOD 0 65535 SYMBOL_LINK "xAdiaCalDataB" 1550 /end CHARACTERISTIC
/begin CHARACTERISTIC ENGBRK_CAL.usrInConfOld "Init counter value in CONFIRMED_OLD status" VALUE 0xFCCFB0 __UWORD_Z 0 NO_COMPU_METHOD 0 65535 SYMBOL_LINK "xAdiaCalDataB" 1552 /end CHARACTERISTIC
/begin CHARACTERISTIC ENGBRK_CAL.usrStep "Counter increment value from DEBOUNCING to CONFIRMED status and init value in the FILTERING status" VALUE 0xFCCFAC __UBYTE_Z 0 NO_COMPU_METHOD 0 255 SYMBOL_LINK "xAdiaCalDataB" 1548 /end CHARACTERISTIC
/begin CHARACTERISTIC ENGBRK_CAL.usrWucCntIni "Transition from DEVALIDATED to NO_ERROR - Number of warm-up cycles" VALUE 0xFCCFA6 __UBYTE_Z 0 NO_COMPU_METHOD 0 255 SYMBOL_LINK "xAdiaCalDataB" 1542 /end CHARACTERISTIC
/begin CHARACTERISTIC ENGBRK_CAL.xFlg.AdiaConfWord "Adia Configuration Word" VALUE 0xFCCFA4 __UWORD_Z 0 NO_COMPU_METHOD 0 65535 SYMBOL_LINK "xAdiaCalDataB" 1540 /end CHARACTERISTIC
/begin CHARACTERISTIC DFLF_CAL.usrConf2Deval "Transition from CONFIRMED to DEVALIDATED - Number of NO_FAULT" VALUE 0xFCCFB6 __UWORD_Z 0 NO_COMPU_METHOD 0 65535 SYMBOL_LINK "xAdiaCalDataB" 1558 /end CHARACTERISTIC
/begin CHARACTERISTIC DFLF_CAL.usrDeb2Conf "Transition from DEBOUNCING to CONFIRMED - Number of Fault" VALUE 0xFCCFB8 __UWORD_Z 0 NO_COMPU_METHOD 0 65535 SYMBOL_LINK "xAdiaCalDataB" 1560 /end CHARACTERISTIC
/begin CHARACTERISTIC DFLF_CAL.usrFilt2Conf " Transition from FILTERING to CONFIRM - Counter threshold" VALUE 0xFCCFBC __UWORD_Z 0 NO_COMPU_METHOD 0 65535 SYMBOL_LINK "xAdiaCalDataB" 1564 /end CHARACTERISTIC
/begin CHARACTERISTIC DFLF_CAL.usrInConfOld "Init counter value in CONFIRMED_OLD status" VALUE 0xFCCFBE __UWORD_Z 0 NO_COMPU_METHOD 0 65535 SYMBOL_LINK "xAdiaCalDataB" 1566 /end CHARACTERISTIC
/begin CHARACTERISTIC DFLF_CAL.usrStep "Counter increment value from DEBOUNCING to CONFIRMED status and init value in the FILTERING status" VALUE 0xFCCFBA __UBYTE_Z 0 NO_COMPU_METHOD 0 255 SYMBOL_LINK "xAdiaCalDataB" 1562 /end CHARACTERISTIC
/begin CHARACTERISTIC DFLF_CAL.usrWucCntIni "Transition from DEVALIDATED to NO_ERROR - Number of warm-up cycles" VALUE 0xFCCFB4 __UBYTE_Z 0 NO_COMPU_METHOD 0 255 SYMBOL_LINK "xAdiaCalDataB" 1556 /end CHARACTERISTIC
/begin CHARACTERISTIC DFLF_CAL.xFlg.AdiaConfWord "Adia Configuration Word" VALUE 0xFCCFB2 __UWORD_Z 0 NO_COMPU_METHOD 0 65535 SYMBOL_LINK "xAdiaCalDataB" 1554 /end CHARACTERISTIC
/begin CHARACTERISTIC DFLL_CAL.usrConf2Deval "Transition from CONFIRMED to DEVALIDATED - Number of NO_FAULT" VALUE 0xFCCFC4 __UWORD_Z 0 NO_COMPU_METHOD 0 65535 SYMBOL_LINK "xAdiaCalDataB" 1572 /end CHARACTERISTIC
/begin CHARACTERISTIC DFLL_CAL.usrDeb2Conf "Transition from DEBOUNCING to CONFIRMED - Number of Fault" VALUE 0xFCCFC6 __UWORD_Z 0 NO_COMPU_METHOD 0 65535 SYMBOL_LINK "xAdiaCalDataB" 1574 /end CHARACTERISTIC
/begin CHARACTERISTIC DFLL_CAL.usrFilt2Conf " Transition from FILTERING to CONFIRM - Counter threshold" VALUE 0xFCCFCA __UWORD_Z 0 NO_COMPU_METHOD 0 65535 SYMBOL_LINK "xAdiaCalDataB" 1578 /end CHARACTERISTIC
/begin CHARACTERISTIC DFLL_CAL.usrInConfOld "Init counter value in CONFIRMED_OLD status" VALUE 0xFCCFCC __UWORD_Z 0 NO_COMPU_METHOD 0 65535 SYMBOL_LINK "xAdiaCalDataB" 1580 /end CHARACTERISTIC
/begin CHARACTERISTIC DFLL_CAL.usrStep "Counter increment value from DEBOUNCING to CONFIRMED status and init value in the FILTERING status" VALUE 0xFCCFC8 __UBYTE_Z 0 NO_COMPU_METHOD 0 255 SYMBOL_LINK "xAdiaCalDataB" 1576 /end CHARACTERISTIC
/begin CHARACTERISTIC DFLL_CAL.usrWucCntIni "Transition from DEVALIDATED to NO_ERROR - Number of warm-up cycles" VALUE 0xFCCFC2 __UBYTE_Z 0 NO_COMPU_METHOD 0 255 SYMBOL_LINK "xAdiaCalDataB" 1570 /end CHARACTERISTIC
/begin CHARACTERISTIC DFLL_CAL.xFlg.AdiaConfWord "Adia Configuration Word" VALUE 0xFCCFC0 __UWORD_Z 0 NO_COMPU_METHOD 0 65535 SYMBOL_LINK "xAdiaCalDataB" 1568 /end CHARACTERISTIC
/begin CHARACTERISTIC DFLR_CAL.usrConf2Deval "Transition from CONFIRMED to DEVALIDATED - Number of NO_FAULT" VALUE 0xFCCFD2 __UWORD_Z 0 NO_COMPU_METHOD 0 65535 SYMBOL_LINK "xAdiaCalDataB" 1586 /end CHARACTERISTIC
/begin CHARACTERISTIC DFLR_CAL.usrDeb2Conf "Transition from DEBOUNCING to CONFIRMED - Number of Fault" VALUE 0xFCCFD4 __UWORD_Z 0 NO_COMPU_METHOD 0 65535 SYMBOL_LINK "xAdiaCalDataB" 1588 /end CHARACTERISTIC
/begin CHARACTERISTIC DFLR_CAL.usrFilt2Conf " Transition from FILTERING to CONFIRM - Counter threshold" VALUE 0xFCCFD8 __UWORD_Z 0 NO_COMPU_METHOD 0 65535 SYMBOL_LINK "xAdiaCalDataB" 1592 /end CHARACTERISTIC
/begin CHARACTERISTIC DFLR_CAL.usrInConfOld "Init counter value in CONFIRMED_OLD status" VALUE 0xFCCFDA __UWORD_Z 0 NO_COMPU_METHOD 0 65535 SYMBOL_LINK "xAdiaCalDataB" 1594 /end CHARACTERISTIC
/begin CHARACTERISTIC DFLR_CAL.usrStep "Counter increment value from DEBOUNCING to CONFIRMED status and init value in the FILTERING status" VALUE 0xFCCFD6 __UBYTE_Z 0 NO_COMPU_METHOD 0 255 SYMBOL_LINK "xAdiaCalDataB" 1590 /end CHARACTERISTIC
/begin CHARACTERISTIC DFLR_CAL.usrWucCntIni "Transition from DEVALIDATED to NO_ERROR - Number of warm-up cycles" VALUE 0xFCCFD0 __UBYTE_Z 0 NO_COMPU_METHOD 0 255 SYMBOL_LINK "xAdiaCalDataB" 1584 /end CHARACTERISTIC
/begin CHARACTERISTIC DFLR_CAL.xFlg.AdiaConfWord "Adia Configuration Word" VALUE 0xFCCFCE __UWORD_Z 0 NO_COMPU_METHOD 0 65535 SYMBOL_LINK "xAdiaCalDataB" 1582 /end CHARACTERISTIC
/begin CHARACTERISTIC DCAT_CAL.usrConf2Deval "Transition from CONFIRMED to DEVALIDATED - Number of NO_FAULT" VALUE 0xFCCFE0 __UWORD_Z 0 NO_COMPU_METHOD 0 65535 SYMBOL_LINK "xAdiaCalDataB" 1600 /end CHARACTERISTIC
/begin CHARACTERISTIC DCAT_CAL.usrDeb2Conf "Transition from DEBOUNCING to CONFIRMED - Number of Fault" VALUE 0xFCCFE2 __UWORD_Z 0 NO_COMPU_METHOD 0 65535 SYMBOL_LINK "xAdiaCalDataB" 1602 /end CHARACTERISTIC
/begin CHARACTERISTIC DCAT_CAL.usrFilt2Conf " Transition from FILTERING to CONFIRM - Counter threshold" VALUE 0xFCCFE6 __UWORD_Z 0 NO_COMPU_METHOD 0 65535 SYMBOL_LINK "xAdiaCalDataB" 1606 /end CHARACTERISTIC
/begin CHARACTERISTIC DCAT_CAL.usrInConfOld "Init counter value in CONFIRMED_OLD status" VALUE 0xFCCFE8 __UWORD_Z 0 NO_COMPU_METHOD 0 65535 SYMBOL_LINK "xAdiaCalDataB" 1608 /end CHARACTERISTIC
/begin CHARACTERISTIC DCAT_CAL.usrStep "Counter increment value from DEBOUNCING to CONFIRMED status and init value in the FILTERING status" VALUE 0xFCCFE4 __UBYTE_Z 0 NO_COMPU_METHOD 0 255 SYMBOL_LINK "xAdiaCalDataB" 1604 /end CHARACTERISTIC
/begin CHARACTERISTIC DCAT_CAL.usrWucCntIni "Transition from DEVALIDATED to NO_ERROR - Number of warm-up cycles" VALUE 0xFCCFDE __UBYTE_Z 0 NO_COMPU_METHOD 0 255 SYMBOL_LINK "xAdiaCalDataB" 1598 /end CHARACTERISTIC
/begin CHARACTERISTIC DCAT_CAL.xFlg.AdiaConfWord "Adia Configuration Word" VALUE 0xFCCFDC __UWORD_Z 0 NO_COMPU_METHOD 0 65535 SYMBOL_LINK "xAdiaCalDataB" 1596 /end CHARACTERISTIC
/begin CHARACTERISTIC DCMV_CAL.usrConf2Deval "Transition from CONFIRMED to DEVALIDATED - Number of NO_FAULT" VALUE 0xFCCFEE __UWORD_Z 0 NO_COMPU_METHOD 0 65535 SYMBOL_LINK "xAdiaCalDataB" 1614 /end CHARACTERISTIC
/begin CHARACTERISTIC DCMV_CAL.usrDeb2Conf "Transition from DEBOUNCING to CONFIRMED - Number of Fault" VALUE 0xFCCFF0 __UWORD_Z 0 NO_COMPU_METHOD 0 65535 SYMBOL_LINK "xAdiaCalDataB" 1616 /end CHARACTERISTIC
/begin CHARACTERISTIC DCMV_CAL.usrFilt2Conf " Transition from FILTERING to CONFIRM - Counter threshold" VALUE 0xFCCFF4 __UWORD_Z 0 NO_COMPU_METHOD 0 65535 SYMBOL_LINK "xAdiaCalDataB" 1620 /end CHARACTERISTIC
/begin CHARACTERISTIC DCMV_CAL.usrInConfOld "Init counter value in CONFIRMED_OLD status" VALUE 0xFCCFF6 __UWORD_Z 0 NO_COMPU_METHOD 0 65535 SYMBOL_LINK "xAdiaCalDataB" 1622 /end CHARACTERISTIC
/begin CHARACTERISTIC DCMV_CAL.usrStep "Counter increment value from DEBOUNCING to CONFIRMED status and init value in the FILTERING status" VALUE 0xFCCFF2 __UBYTE_Z 0 NO_COMPU_METHOD 0 255 SYMBOL_LINK "xAdiaCalDataB" 1618 /end CHARACTERISTIC
/begin CHARACTERISTIC DCMV_CAL.usrWucCntIni "Transition from DEVALIDATED to NO_ERROR - Number of warm-up cycles" VALUE 0xFCCFEC __UBYTE_Z 0 NO_COMPU_METHOD 0 255 SYMBOL_LINK "xAdiaCalDataB" 1612 /end CHARACTERISTIC
/begin CHARACTERISTIC DCMV_CAL.xFlg.AdiaConfWord "Adia Configuration Word" VALUE 0xFCCFEA __UWORD_Z 0 NO_COMPU_METHOD 0 65535 SYMBOL_LINK "xAdiaCalDataB" 1610 /end CHARACTERISTIC
/begin CHARACTERISTIC DLAM_CAL.usrConf2Deval "Transition from CONFIRMED to DEVALIDATED - Number of NO_FAULT" VALUE 0xFCCFFC __UWORD_Z 0 NO_COMPU_METHOD 0 65535 SYMBOL_LINK "xAdiaCalDataB" 1628 /end CHARACTERISTIC
/begin CHARACTERISTIC DLAM_CAL.usrDeb2Conf "Transition from DEBOUNCING to CONFIRMED - Number of Fault" VALUE 0xFCCFFE __UWORD_Z 0 NO_COMPU_METHOD 0 65535 SYMBOL_LINK "xAdiaCalDataB" 1630 /end CHARACTERISTIC
/begin CHARACTERISTIC DLAM_CAL.usrFilt2Conf " Transition from FILTERING to CONFIRM - Counter threshold" VALUE 0xFCD002 __UWORD_Z 0 NO_COMPU_METHOD 0 65535 SYMBOL_LINK "xAdiaCalDataB" 1634 /end CHARACTERISTIC
/begin CHARACTERISTIC DLAM_CAL.usrInConfOld "Init counter value in CONFIRMED_OLD status" VALUE 0xFCD004 __UWORD_Z 0 NO_COMPU_METHOD 0 65535 SYMBOL_LINK "xAdiaCalDataB" 1636 /end CHARACTERISTIC
/begin CHARACTERISTIC DLAM_CAL.usrStep "Counter increment value from DEBOUNCING to CONFIRMED status and init value in the FILTERING status" VALUE 0xFCD000 __UBYTE_Z 0 NO_COMPU_METHOD 0 255 SYMBOL_LINK "xAdiaCalDataB" 1632 /end CHARACTERISTIC
/begin CHARACTERISTIC DLAM_CAL.usrWucCntIni "Transition from DEVALIDATED to NO_ERROR - Number of warm-up cycles" VALUE 0xFCCFFA __UBYTE_Z 0 NO_COMPU_METHOD 0 255 SYMBOL_LINK "xAdiaCalDataB" 1626 /end CHARACTERISTIC
/begin CHARACTERISTIC DLAM_CAL.xFlg.AdiaConfWord "Adia Configuration Word" VALUE 0xFCCFF8 __UWORD_Z 0 NO_COMPU_METHOD 0 65535 SYMBOL_LINK "xAdiaCalDataB" 1624 /end CHARACTERISTIC
/begin CHARACTERISTIC SPA_CAL.usrConf2Deval "Transition from CONFIRMED to DEVALIDATED - Number of NO_FAULT" VALUE 0xFCCA3E __UWORD_Z 0 NO_COMPU_METHOD 0 65535 SYMBOL_LINK "xAdiaCalDataB" 158 /end CHARACTERISTIC
/begin CHARACTERISTIC SPA_CAL.usrDeb2Conf "Transition from DEBOUNCING to CONFIRMED - Number of Fault" VALUE 0xFCCA40 __UWORD_Z 0 NO_COMPU_METHOD 0 65535 SYMBOL_LINK "xAdiaCalDataB" 160 /end CHARACTERISTIC
/begin CHARACTERISTIC SPA_CAL.usrFilt2Conf " Transition from FILTERING to CONFIRM - Counter threshold" VALUE 0xFCCA44 __UWORD_Z 0 NO_COMPU_METHOD 0 65535 SYMBOL_LINK "xAdiaCalDataB" 164 /end CHARACTERISTIC
/begin CHARACTERISTIC SPA_CAL.usrInConfOld "Init counter value in CONFIRMED_OLD status" VALUE 0xFCCA46 __UWORD_Z 0 NO_COMPU_METHOD 0 65535 SYMBOL_LINK "xAdiaCalDataB" 166 /end CHARACTERISTIC
/begin CHARACTERISTIC SPA_CAL.usrStep "Counter increment value from DEBOUNCING to CONFIRMED status and init value in the FILTERING status" VALUE 0xFCCA42 __UBYTE_Z 0 NO_COMPU_METHOD 0 255 SYMBOL_LINK "xAdiaCalDataB" 162 /end CHARACTERISTIC
/begin CHARACTERISTIC SPA_CAL.usrWucCntIni "Transition from DEVALIDATED to NO_ERROR - Number of warm-up cycles" VALUE 0xFCCA3C __UBYTE_Z 0 NO_COMPU_METHOD 0 255 SYMBOL_LINK "xAdiaCalDataB" 156 /end CHARACTERISTIC
/begin CHARACTERISTIC SPA_CAL.xFlg.AdiaConfWord "Adia Configuration Word" VALUE 0xFCCA3A __UWORD_Z 0 NO_COMPU_METHOD 0 65535 SYMBOL_LINK "xAdiaCalDataB" 154 /end CHARACTERISTIC
/begin CHARACTERISTIC BAT_CAL.usrConf2Deval "Transition from CONFIRMED to DEVALIDATED - Number of NO_FAULT" VALUE 0xFCCA4C __UWORD_Z 0 NO_COMPU_METHOD 0 65535 SYMBOL_LINK "xAdiaCalDataB" 172 /end CHARACTERISTIC
/begin CHARACTERISTIC BAT_CAL.usrDeb2Conf "Transition from DEBOUNCING to CONFIRMED - Number of Fault" VALUE 0xFCCA4E __UWORD_Z 0 NO_COMPU_METHOD 0 65535 SYMBOL_LINK "xAdiaCalDataB" 174 /end CHARACTERISTIC
/begin CHARACTERISTIC BAT_CAL.usrFilt2Conf " Transition from FILTERING to CONFIRM - Counter threshold" VALUE 0xFCCA52 __UWORD_Z 0 NO_COMPU_METHOD 0 65535 SYMBOL_LINK "xAdiaCalDataB" 178 /end CHARACTERISTIC
/begin CHARACTERISTIC BAT_CAL.usrInConfOld "Init counter value in CONFIRMED_OLD status" VALUE 0xFCCA54 __UWORD_Z 0 NO_COMPU_METHOD 0 65535 SYMBOL_LINK "xAdiaCalDataB" 180 /end CHARACTERISTIC
/begin CHARACTERISTIC BAT_CAL.usrStep "Counter increment value from DEBOUNCING to CONFIRMED status and init value in the FILTERING status" VALUE 0xFCCA50 __UBYTE_Z 0 NO_COMPU_METHOD 0 255 SYMBOL_LINK "xAdiaCalDataB" 176 /end CHARACTERISTIC
/begin CHARACTERISTIC BAT_CAL.usrWucCntIni "Transition from DEVALIDATED to NO_ERROR - Number of warm-up cycles" VALUE 0xFCCA4A __UBYTE_Z 0 NO_COMPU_METHOD 0 255 SYMBOL_LINK "xAdiaCalDataB" 170 /end CHARACTERISTIC
/begin CHARACTERISTIC BAT_CAL.xFlg.AdiaConfWord "Adia Configuration Word" VALUE 0xFCCA48 __UWORD_Z 0 NO_COMPU_METHOD 0 65535 SYMBOL_LINK "xAdiaCalDataB" 168 /end CHARACTERISTIC
/begin CHARACTERISTIC VBP_CAL.usrConf2Deval "Transition from CONFIRMED to DEVALIDATED - Number of NO_FAULT" VALUE 0xFCCA5A __UWORD_Z 0 NO_COMPU_METHOD 0 65535 SYMBOL_LINK "xAdiaCalDataB" 186 /end CHARACTERISTIC
/begin CHARACTERISTIC VBP_CAL.usrDeb2Conf "Transition from DEBOUNCING to CONFIRMED - Number of Fault" VALUE 0xFCCA5C __UWORD_Z 0 NO_COMPU_METHOD 0 65535 SYMBOL_LINK "xAdiaCalDataB" 188 /end CHARACTERISTIC
/begin CHARACTERISTIC VBP_CAL.usrFilt2Conf " Transition from FILTERING to CONFIRM - Counter threshold" VALUE 0xFCCA60 __UWORD_Z 0 NO_COMPU_METHOD 0 65535 SYMBOL_LINK "xAdiaCalDataB" 192 /end CHARACTERISTIC
/begin CHARACTERISTIC VBP_CAL.usrInConfOld "Init counter value in CONFIRMED_OLD status" VALUE 0xFCCA62 __UWORD_Z 0 NO_COMPU_METHOD 0 65535 SYMBOL_LINK "xAdiaCalDataB" 194 /end CHARACTERISTIC
/begin CHARACTERISTIC VBP_CAL.usrStep "Counter increment value from DEBOUNCING to CONFIRMED status and init value in the FILTERING status" VALUE 0xFCCA5E __UBYTE_Z 0 NO_COMPU_METHOD 0 255 SYMBOL_LINK "xAdiaCalDataB" 190 /end CHARACTERISTIC
/begin CHARACTERISTIC VBP_CAL.usrWucCntIni "Transition from DEVALIDATED to NO_ERROR - Number of warm-up cycles" VALUE 0xFCCA58 __UBYTE_Z 0 NO_COMPU_METHOD 0 255 SYMBOL_LINK "xAdiaCalDataB" 184 /end CHARACTERISTIC
/begin CHARACTERISTIC VBP_CAL.xFlg.AdiaConfWord "Adia Configuration Word" VALUE 0xFCCA56 __UWORD_Z 0 NO_COMPU_METHOD 0 65535 SYMBOL_LINK "xAdiaCalDataB" 182 /end CHARACTERISTIC
/begin CHARACTERISTIC WGT_CAL.usrConf2Deval "Transition from CONFIRMED to DEVALIDATED - Number of NO_FAULT" VALUE 0xFCCA68 __UWORD_Z 0 NO_COMPU_METHOD 0 65535 SYMBOL_LINK "xAdiaCalDataB" 200 /end CHARACTERISTIC
/begin CHARACTERISTIC WGT_CAL.usrDeb2Conf "Transition from DEBOUNCING to CONFIRMED - Number of Fault" VALUE 0xFCCA6A __UWORD_Z 0 NO_COMPU_METHOD 0 65535 SYMBOL_LINK "xAdiaCalDataB" 202 /end CHARACTERISTIC
/begin CHARACTERISTIC WGT_CAL.usrFilt2Conf " Transition from FILTERING to CONFIRM - Counter threshold" VALUE 0xFCCA6E __UWORD_Z 0 NO_COMPU_METHOD 0 65535 SYMBOL_LINK "xAdiaCalDataB" 206 /end CHARACTERISTIC
/begin CHARACTERISTIC WGT_CAL.usrInConfOld "Init counter value in CONFIRMED_OLD status" VALUE 0xFCCA70 __UWORD_Z 0 NO_COMPU_METHOD 0 65535 SYMBOL_LINK "xAdiaCalDataB" 208 /end CHARACTERISTIC
/begin CHARACTERISTIC WGT_CAL.usrStep "Counter increment value from DEBOUNCING to CONFIRMED status and init value in the FILTERING status" VALUE 0xFCCA6C __UBYTE_Z 0 NO_COMPU_METHOD 0 255 SYMBOL_LINK "xAdiaCalDataB" 204 /end CHARACTERISTIC
/begin CHARACTERISTIC WGT_CAL.usrWucCntIni "Transition from DEVALIDATED to NO_ERROR - Number of warm-up cycles" VALUE 0xFCCA66 __UBYTE_Z 0 NO_COMPU_METHOD 0 255 SYMBOL_LINK "xAdiaCalDataB" 198 /end CHARACTERISTIC
/begin CHARACTERISTIC WGT_CAL.xFlg.AdiaConfWord "Adia Configuration Word" VALUE 0xFCCA64 __UWORD_Z 0 NO_COMPU_METHOD 0 65535 SYMBOL_LINK "xAdiaCalDataB" 196 /end CHARACTERISTIC
/begin CHARACTERISTIC COIL1_CAL.usrConf2Deval "Transition from CONFIRMED to DEVALIDATED - Number of NO_FAULT" VALUE 0xFCCA76 __UWORD_Z 0 NO_COMPU_METHOD 0 65535 SYMBOL_LINK "xAdiaCalDataB" 214 /end CHARACTERISTIC
/begin CHARACTERISTIC COIL1_CAL.usrDeb2Conf "Transition from DEBOUNCING to CONFIRMED - Number of Fault" VALUE 0xFCCA78 __UWORD_Z 0 NO_COMPU_METHOD 0 65535 SYMBOL_LINK "xAdiaCalDataB" 216 /end CHARACTERISTIC
/begin CHARACTERISTIC COIL1_CAL.usrFilt2Conf " Transition from FILTERING to CONFIRM - Counter threshold" VALUE 0xFCCA7C __UWORD_Z 0 NO_COMPU_METHOD 0 65535 SYMBOL_LINK "xAdiaCalDataB" 220 /end CHARACTERISTIC
/begin CHARACTERISTIC COIL1_CAL.usrInConfOld "Init counter value in CONFIRMED_OLD status" VALUE 0xFCCA7E __UWORD_Z 0 NO_COMPU_METHOD 0 65535 SYMBOL_LINK "xAdiaCalDataB" 222 /end CHARACTERISTIC
/begin CHARACTERISTIC COIL1_CAL.usrStep "Counter increment value from DEBOUNCING to CONFIRMED status and init value in the FILTERING status" VALUE 0xFCCA7A __UBYTE_Z 0 NO_COMPU_METHOD 0 255 SYMBOL_LINK "xAdiaCalDataB" 218 /end CHARACTERISTIC
/begin CHARACTERISTIC COIL1_CAL.usrWucCntIni "Transition from DEVALIDATED to NO_ERROR - Number of warm-up cycles" VALUE 0xFCCA74 __UBYTE_Z 0 NO_COMPU_METHOD 0 255 SYMBOL_LINK "xAdiaCalDataB" 212 /end CHARACTERISTIC
/begin CHARACTERISTIC COIL1_CAL.xFlg.AdiaConfWord "Adia Configuration Word" VALUE 0xFCCA72 __UWORD_Z 0 NO_COMPU_METHOD 0 65535 SYMBOL_LINK "xAdiaCalDataB" 210 /end CHARACTERISTIC
/begin CHARACTERISTIC COIL2_CAL.usrConf2Deval "Transition from CONFIRMED to DEVALIDATED - Number of NO_FAULT" VALUE 0xFCCA84 __UWORD_Z 0 NO_COMPU_METHOD 0 65535 SYMBOL_LINK "xAdiaCalDataB" 228 /end CHARACTERISTIC
/begin CHARACTERISTIC COIL2_CAL.usrDeb2Conf "Transition from DEBOUNCING to CONFIRMED - Number of Fault" VALUE 0xFCCA86 __UWORD_Z 0 NO_COMPU_METHOD 0 65535 SYMBOL_LINK "xAdiaCalDataB" 230 /end CHARACTERISTIC
/begin CHARACTERISTIC COIL2_CAL.usrFilt2Conf " Transition from FILTERING to CONFIRM - Counter threshold" VALUE 0xFCCA8A __UWORD_Z 0 NO_COMPU_METHOD 0 65535 SYMBOL_LINK "xAdiaCalDataB" 234 /end CHARACTERISTIC
/begin CHARACTERISTIC COIL2_CAL.usrInConfOld "Init counter value in CONFIRMED_OLD status" VALUE 0xFCCA8C __UWORD_Z 0 NO_COMPU_METHOD 0 65535 SYMBOL_LINK "xAdiaCalDataB" 236 /end CHARACTERISTIC
/begin CHARACTERISTIC COIL2_CAL.usrStep "Counter increment value from DEBOUNCING to CONFIRMED status and init value in the FILTERING status" VALUE 0xFCCA88 __UBYTE_Z 0 NO_COMPU_METHOD 0 255 SYMBOL_LINK "xAdiaCalDataB" 232 /end CHARACTERISTIC
/begin CHARACTERISTIC COIL2_CAL.usrWucCntIni "Transition from DEVALIDATED to NO_ERROR - Number of warm-up cycles" VALUE 0xFCCA82 __UBYTE_Z 0 NO_COMPU_METHOD 0 255 SYMBOL_LINK "xAdiaCalDataB" 226 /end CHARACTERISTIC
/begin CHARACTERISTIC COIL2_CAL.xFlg.AdiaConfWord "Adia Configuration Word" VALUE 0xFCCA80 __UWORD_Z 0 NO_COMPU_METHOD 0 65535 SYMBOL_LINK "xAdiaCalDataB" 224 /end CHARACTERISTIC
/begin CHARACTERISTIC COIL3_CAL.usrConf2Deval "Transition from CONFIRMED to DEVALIDATED - Number of NO_FAULT" VALUE 0xFCCA92 __UWORD_Z 0 NO_COMPU_METHOD 0 65535 SYMBOL_LINK "xAdiaCalDataB" 242 /end CHARACTERISTIC
/begin CHARACTERISTIC COIL3_CAL.usrDeb2Conf "Transition from DEBOUNCING to CONFIRMED - Number of Fault" VALUE 0xFCCA94 __UWORD_Z 0 NO_COMPU_METHOD 0 65535 SYMBOL_LINK "xAdiaCalDataB" 244 /end CHARACTERISTIC
/begin CHARACTERISTIC COIL3_CAL.usrFilt2Conf " Transition from FILTERING to CONFIRM - Counter threshold" VALUE 0xFCCA98 __UWORD_Z 0 NO_COMPU_METHOD 0 65535 SYMBOL_LINK "xAdiaCalDataB" 248 /end CHARACTERISTIC
/begin CHARACTERISTIC COIL3_CAL.usrInConfOld "Init counter value in CONFIRMED_OLD status" VALUE 0xFCCA9A __UWORD_Z 0 NO_COMPU_METHOD 0 65535 SYMBOL_LINK "xAdiaCalDataB" 250 /end CHARACTERISTIC
/begin CHARACTERISTIC COIL3_CAL.usrStep "Counter increment value from DEBOUNCING to CONFIRMED status and init value in the FILTERING status" VALUE 0xFCCA96 __UBYTE_Z 0 NO_COMPU_METHOD 0 255 SYMBOL_LINK "xAdiaCalDataB" 246 /end CHARACTERISTIC
/begin CHARACTERISTIC COIL3_CAL.usrWucCntIni "Transition from DEVALIDATED to NO_ERROR - Number of warm-up cycles" VALUE 0xFCCA90 __UBYTE_Z 0 NO_COMPU_METHOD 0 255 SYMBOL_LINK "xAdiaCalDataB" 240 /end CHARACTERISTIC
/begin CHARACTERISTIC COIL3_CAL.xFlg.AdiaConfWord "Adia Configuration Word" VALUE 0xFCCA8E __UWORD_Z 0 NO_COMPU_METHOD 0 65535 SYMBOL_LINK "xAdiaCalDataB" 238 /end CHARACTERISTIC
/begin CHARACTERISTIC COIL4_CAL.usrConf2Deval "Transition from CONFIRMED to DEVALIDATED - Number of NO_FAULT" VALUE 0xFCCAA0 __UWORD_Z 0 NO_COMPU_METHOD 0 65535 SYMBOL_LINK "xAdiaCalDataB" 256 /end CHARACTERISTIC
/begin CHARACTERISTIC COIL4_CAL.usrDeb2Conf "Transition from DEBOUNCING to CONFIRMED - Number of Fault" VALUE 0xFCCAA2 __UWORD_Z 0 NO_COMPU_METHOD 0 65535 SYMBOL_LINK "xAdiaCalDataB" 258 /end CHARACTERISTIC
/begin CHARACTERISTIC COIL4_CAL.usrFilt2Conf " Transition from FILTERING to CONFIRM - Counter threshold" VALUE 0xFCCAA6 __UWORD_Z 0 NO_COMPU_METHOD 0 65535 SYMBOL_LINK "xAdiaCalDataB" 262 /end CHARACTERISTIC
/begin CHARACTERISTIC COIL4_CAL.usrInConfOld "Init counter value in CONFIRMED_OLD status" VALUE 0xFCCAA8 __UWORD_Z 0 NO_COMPU_METHOD 0 65535 SYMBOL_LINK "xAdiaCalDataB" 264 /end CHARACTERISTIC
/begin CHARACTERISTIC COIL4_CAL.usrStep "Counter increment value from DEBOUNCING to CONFIRMED status and init value in the FILTERING status" VALUE 0xFCCAA4 __UBYTE_Z 0 NO_COMPU_METHOD 0 255 SYMBOL_LINK "xAdiaCalDataB" 260 /end CHARACTERISTIC
/begin CHARACTERISTIC COIL4_CAL.usrWucCntIni "Transition from DEVALIDATED to NO_ERROR - Number of warm-up cycles" VALUE 0xFCCA9E __UBYTE_Z 0 NO_COMPU_METHOD 0 255 SYMBOL_LINK "xAdiaCalDataB" 254 /end CHARACTERISTIC
/begin CHARACTERISTIC COIL4_CAL.xFlg.AdiaConfWord "Adia Configuration Word" VALUE 0xFCCA9C __UWORD_Z 0 NO_COMPU_METHOD 0 65535 SYMBOL_LINK "xAdiaCalDataB" 252 /end CHARACTERISTIC
/begin CHARACTERISTIC COIL5_CAL.usrConf2Deval "Transition from CONFIRMED to DEVALIDATED - Number of NO_FAULT" VALUE 0xFCCAAE __UWORD_Z 0 NO_COMPU_METHOD 0 65535 SYMBOL_LINK "xAdiaCalDataB" 270 /end CHARACTERISTIC
/begin CHARACTERISTIC COIL5_CAL.usrDeb2Conf "Transition from DEBOUNCING to CONFIRMED - Number of Fault" VALUE 0xFCCAB0 __UWORD_Z 0 NO_COMPU_METHOD 0 65535 SYMBOL_LINK "xAdiaCalDataB" 272 /end CHARACTERISTIC
/begin CHARACTERISTIC COIL5_CAL.usrFilt2Conf " Transition from FILTERING to CONFIRM - Counter threshold" VALUE 0xFCCAB4 __UWORD_Z 0 NO_COMPU_METHOD 0 65535 SYMBOL_LINK "xAdiaCalDataB" 276 /end CHARACTERISTIC
/begin CHARACTERISTIC COIL5_CAL.usrInConfOld "Init counter value in CONFIRMED_OLD status" VALUE 0xFCCAB6 __UWORD_Z 0 NO_COMPU_METHOD 0 65535 SYMBOL_LINK "xAdiaCalDataB" 278 /end CHARACTERISTIC
/begin CHARACTERISTIC COIL5_CAL.usrStep "Counter increment value from DEBOUNCING to CONFIRMED status and init value in the FILTERING status" VALUE 0xFCCAB2 __UBYTE_Z 0 NO_COMPU_METHOD 0 255 SYMBOL_LINK "xAdiaCalDataB" 274 /end CHARACTERISTIC
/begin CHARACTERISTIC COIL5_CAL.usrWucCntIni "Transition from DEVALIDATED to NO_ERROR - Number of warm-up cycles" VALUE 0xFCCAAC __UBYTE_Z 0 NO_COMPU_METHOD 0 255 SYMBOL_LINK "xAdiaCalDataB" 268 /end CHARACTERISTIC
/begin CHARACTERISTIC COIL5_CAL.xFlg.AdiaConfWord "Adia Configuration Word" VALUE 0xFCCAAA __UWORD_Z 0 NO_COMPU_METHOD 0 65535 SYMBOL_LINK "xAdiaCalDataB" 266 /end CHARACTERISTIC
/begin CHARACTERISTIC STO_CAL.usrConf2Deval "Transition from CONFIRMED to DEVALIDATED - Number of NO_FAULT" VALUE 0xFCC9B2 __UWORD_Z 0 NO_COMPU_METHOD 0 65535 SYMBOL_LINK "xAdiaCalDataB" 18 /end CHARACTERISTIC
/begin CHARACTERISTIC STO_CAL.usrDeb2Conf "Transition from DEBOUNCING to CONFIRMED - Number of Fault" VALUE 0xFCC9B4 __UWORD_Z 0 NO_COMPU_METHOD 0 65535 SYMBOL_LINK "xAdiaCalDataB" 20 /end CHARACTERISTIC
/begin CHARACTERISTIC STO_CAL.usrFilt2Conf " Transition from FILTERING to CONFIRM - Counter threshold" VALUE 0xFCC9B8 __UWORD_Z 0 NO_COMPU_METHOD 0 65535 SYMBOL_LINK "xAdiaCalDataB" 24 /end CHARACTERISTIC
/begin CHARACTERISTIC STO_CAL.usrInConfOld "Init counter value in CONFIRMED_OLD status" VALUE 0xFCC9BA __UWORD_Z 0 NO_COMPU_METHOD 0 65535 SYMBOL_LINK "xAdiaCalDataB" 26 /end CHARACTERISTIC
/begin CHARACTERISTIC STO_CAL.usrStep "Counter increment value from DEBOUNCING to CONFIRMED status and init value in the FILTERING status" VALUE 0xFCC9B6 __UBYTE_Z 0 NO_COMPU_METHOD 0 255 SYMBOL_LINK "xAdiaCalDataB" 22 /end CHARACTERISTIC
/begin CHARACTERISTIC STO_CAL.usrWucCntIni "Transition from DEVALIDATED to NO_ERROR - Number of warm-up cycles" VALUE 0xFCC9B0 __UBYTE_Z 0 NO_COMPU_METHOD 0 255 SYMBOL_LINK "xAdiaCalDataB" 16 /end CHARACTERISTIC
/begin CHARACTERISTIC STO_CAL.xFlg.AdiaConfWord "Adia Configuration Word" VALUE 0xFCC9AE __UWORD_Z 0 NO_COMPU_METHOD 0 65535 SYMBOL_LINK "xAdiaCalDataB" 14 /end CHARACTERISTIC
/begin CHARACTERISTIC COIL6_CAL.usrConf2Deval "Transition from CONFIRMED to DEVALIDATED - Number of NO_FAULT" VALUE 0xFCCABC __UWORD_Z 0 NO_COMPU_METHOD 0 65535 SYMBOL_LINK "xAdiaCalDataB" 284 /end CHARACTERISTIC
/begin CHARACTERISTIC COIL6_CAL.usrDeb2Conf "Transition from DEBOUNCING to CONFIRMED - Number of Fault" VALUE 0xFCCABE __UWORD_Z 0 NO_COMPU_METHOD 0 65535 SYMBOL_LINK "xAdiaCalDataB" 286 /end CHARACTERISTIC
/begin CHARACTERISTIC COIL6_CAL.usrFilt2Conf " Transition from FILTERING to CONFIRM - Counter threshold" VALUE 0xFCCAC2 __UWORD_Z 0 NO_COMPU_METHOD 0 65535 SYMBOL_LINK "xAdiaCalDataB" 290 /end CHARACTERISTIC
/begin CHARACTERISTIC COIL6_CAL.usrInConfOld "Init counter value in CONFIRMED_OLD status" VALUE 0xFCCAC4 __UWORD_Z 0 NO_COMPU_METHOD 0 65535 SYMBOL_LINK "xAdiaCalDataB" 292 /end CHARACTERISTIC
/begin CHARACTERISTIC COIL6_CAL.usrStep "Counter increment value from DEBOUNCING to CONFIRMED status and init value in the FILTERING status" VALUE 0xFCCAC0 __UBYTE_Z 0 NO_COMPU_METHOD 0 255 SYMBOL_LINK "xAdiaCalDataB" 288 /end CHARACTERISTIC
/begin CHARACTERISTIC COIL6_CAL.usrWucCntIni "Transition from DEVALIDATED to NO_ERROR - Number of warm-up cycles" VALUE 0xFCCABA __UBYTE_Z 0 NO_COMPU_METHOD 0 255 SYMBOL_LINK "xAdiaCalDataB" 282 /end CHARACTERISTIC
/begin CHARACTERISTIC COIL6_CAL.xFlg.AdiaConfWord "Adia Configuration Word" VALUE 0xFCCAB8 __UWORD_Z 0 NO_COMPU_METHOD 0 65535 SYMBOL_LINK "xAdiaCalDataB" 280 /end CHARACTERISTIC
/begin CHARACTERISTIC COIL7_CAL.usrConf2Deval "Transition from CONFIRMED to DEVALIDATED - Number of NO_FAULT" VALUE 0xFCCACA __UWORD_Z 0 NO_COMPU_METHOD 0 65535 SYMBOL_LINK "xAdiaCalDataB" 298 /end CHARACTERISTIC
/begin CHARACTERISTIC COIL7_CAL.usrDeb2Conf "Transition from DEBOUNCING to CONFIRMED - Number of Fault" VALUE 0xFCCACC __UWORD_Z 0 NO_COMPU_METHOD 0 65535 SYMBOL_LINK "xAdiaCalDataB" 300 /end CHARACTERISTIC
/begin CHARACTERISTIC COIL7_CAL.usrFilt2Conf " Transition from FILTERING to CONFIRM - Counter threshold" VALUE 0xFCCAD0 __UWORD_Z 0 NO_COMPU_METHOD 0 65535 SYMBOL_LINK "xAdiaCalDataB" 304 /end CHARACTERISTIC
/begin CHARACTERISTIC COIL7_CAL.usrInConfOld "Init counter value in CONFIRMED_OLD status" VALUE 0xFCCAD2 __UWORD_Z 0 NO_COMPU_METHOD 0 65535 SYMBOL_LINK "xAdiaCalDataB" 306 /end CHARACTERISTIC
/begin CHARACTERISTIC COIL7_CAL.usrStep "Counter increment value from DEBOUNCING to CONFIRMED status and init value in the FILTERING status" VALUE 0xFCCACE __UBYTE_Z 0 NO_COMPU_METHOD 0 255 SYMBOL_LINK "xAdiaCalDataB" 302 /end CHARACTERISTIC
/begin CHARACTERISTIC COIL7_CAL.usrWucCntIni "Transition from DEVALIDATED to NO_ERROR - Number of warm-up cycles" VALUE 0xFCCAC8 __UBYTE_Z 0 NO_COMPU_METHOD 0 255 SYMBOL_LINK "xAdiaCalDataB" 296 /end CHARACTERISTIC
/begin CHARACTERISTIC COIL7_CAL.xFlg.AdiaConfWord "Adia Configuration Word" VALUE 0xFCCAC6 __UWORD_Z 0 NO_COMPU_METHOD 0 65535 SYMBOL_LINK "xAdiaCalDataB" 294 /end CHARACTERISTIC
/begin CHARACTERISTIC COIL8_CAL.usrConf2Deval "Transition from CONFIRMED to DEVALIDATED - Number of NO_FAULT" VALUE 0xFCCAD8 __UWORD_Z 0 NO_COMPU_METHOD 0 65535 SYMBOL_LINK "xAdiaCalDataB" 312 /end CHARACTERISTIC
/begin CHARACTERISTIC COIL8_CAL.usrDeb2Conf "Transition from DEBOUNCING to CONFIRMED - Number of Fault" VALUE 0xFCCADA __UWORD_Z 0 NO_COMPU_METHOD 0 65535 SYMBOL_LINK "xAdiaCalDataB" 314 /end CHARACTERISTIC
/begin CHARACTERISTIC COIL8_CAL.usrFilt2Conf " Transition from FILTERING to CONFIRM - Counter threshold" VALUE 0xFCCADE __UWORD_Z 0 NO_COMPU_METHOD 0 65535 SYMBOL_LINK "xAdiaCalDataB" 318 /end CHARACTERISTIC
/begin CHARACTERISTIC COIL8_CAL.usrInConfOld "Init counter value in CONFIRMED_OLD status" VALUE 0xFCCAE0 __UWORD_Z 0 NO_COMPU_METHOD 0 65535 SYMBOL_LINK "xAdiaCalDataB" 320 /end CHARACTERISTIC
/begin CHARACTERISTIC COIL8_CAL.usrStep "Counter increment value from DEBOUNCING to CONFIRMED status and init value in the FILTERING status" VALUE 0xFCCADC __UBYTE_Z 0 NO_COMPU_METHOD 0 255 SYMBOL_LINK "xAdiaCalDataB" 316 /end CHARACTERISTIC
/begin CHARACTERISTIC COIL8_CAL.usrWucCntIni "Transition from DEVALIDATED to NO_ERROR - Number of warm-up cycles" VALUE 0xFCCAD6 __UBYTE_Z 0 NO_COMPU_METHOD 0 255 SYMBOL_LINK "xAdiaCalDataB" 310 /end CHARACTERISTIC
/begin CHARACTERISTIC COIL8_CAL.xFlg.AdiaConfWord "Adia Configuration Word" VALUE 0xFCCAD4 __UWORD_Z 0 NO_COMPU_METHOD 0 65535 SYMBOL_LINK "xAdiaCalDataB" 308 /end CHARACTERISTIC
/begin CHARACTERISTIC INJ1_CAL.usrConf2Deval "Transition from CONFIRMED to DEVALIDATED - Number of NO_FAULT" VALUE 0xFCCAE6 __UWORD_Z 0 NO_COMPU_METHOD 0 65535 SYMBOL_LINK "xAdiaCalDataB" 326 /end CHARACTERISTIC
/begin CHARACTERISTIC INJ1_CAL.usrDeb2Conf "Transition from DEBOUNCING to CONFIRMED - Number of Fault" VALUE 0xFCCAE8 __UWORD_Z 0 NO_COMPU_METHOD 0 65535 SYMBOL_LINK "xAdiaCalDataB" 328 /end CHARACTERISTIC
/begin CHARACTERISTIC INJ1_CAL.usrFilt2Conf " Transition from FILTERING to CONFIRM - Counter threshold" VALUE 0xFCCAEC __UWORD_Z 0 NO_COMPU_METHOD 0 65535 SYMBOL_LINK "xAdiaCalDataB" 332 /end CHARACTERISTIC
/begin CHARACTERISTIC INJ1_CAL.usrInConfOld "Init counter value in CONFIRMED_OLD status" VALUE 0xFCCAEE __UWORD_Z 0 NO_COMPU_METHOD 0 65535 SYMBOL_LINK "xAdiaCalDataB" 334 /end CHARACTERISTIC
/begin CHARACTERISTIC INJ1_CAL.usrStep "Counter increment value from DEBOUNCING to CONFIRMED status and init value in the FILTERING status" VALUE 0xFCCAEA __UBYTE_Z 0 NO_COMPU_METHOD 0 255 SYMBOL_LINK "xAdiaCalDataB" 330 /end CHARACTERISTIC
/begin CHARACTERISTIC INJ1_CAL.usrWucCntIni "Transition from DEVALIDATED to NO_ERROR - Number of warm-up cycles" VALUE 0xFCCAE4 __UBYTE_Z 0 NO_COMPU_METHOD 0 255 SYMBOL_LINK "xAdiaCalDataB" 324 /end CHARACTERISTIC
/begin CHARACTERISTIC INJ1_CAL.xFlg.AdiaConfWord "Adia Configuration Word" VALUE 0xFCCAE2 __UWORD_Z 0 NO_COMPU_METHOD 0 65535 SYMBOL_LINK "xAdiaCalDataB" 322 /end CHARACTERISTIC
/begin CHARACTERISTIC INJ2_CAL.usrConf2Deval "Transition from CONFIRMED to DEVALIDATED - Number of NO_FAULT" VALUE 0xFCCAF4 __UWORD_Z 0 NO_COMPU_METHOD 0 65535 SYMBOL_LINK "xAdiaCalDataB" 340 /end CHARACTERISTIC
/begin CHARACTERISTIC INJ2_CAL.usrDeb2Conf "Transition from DEBOUNCING to CONFIRMED - Number of Fault" VALUE 0xFCCAF6 __UWORD_Z 0 NO_COMPU_METHOD 0 65535 SYMBOL_LINK "xAdiaCalDataB" 342 /end CHARACTERISTIC
/begin CHARACTERISTIC INJ2_CAL.usrFilt2Conf " Transition from FILTERING to CONFIRM - Counter threshold" VALUE 0xFCCAFA __UWORD_Z 0 NO_COMPU_METHOD 0 65535 SYMBOL_LINK "xAdiaCalDataB" 346 /end CHARACTERISTIC
/begin CHARACTERISTIC INJ2_CAL.usrInConfOld "Init counter value in CONFIRMED_OLD status" VALUE 0xFCCAFC __UWORD_Z 0 NO_COMPU_METHOD 0 65535 SYMBOL_LINK "xAdiaCalDataB" 348 /end CHARACTERISTIC
/begin CHARACTERISTIC INJ2_CAL.usrStep "Counter increment value from DEBOUNCING to CONFIRMED status and init value in the FILTERING status" VALUE 0xFCCAF8 __UBYTE_Z 0 NO_COMPU_METHOD 0 255 SYMBOL_LINK "xAdiaCalDataB" 344 /end CHARACTERISTIC
/begin CHARACTERISTIC INJ2_CAL.usrWucCntIni "Transition from DEVALIDATED to NO_ERROR - Number of warm-up cycles" VALUE 0xFCCAF2 __UBYTE_Z 0 NO_COMPU_METHOD 0 255 SYMBOL_LINK "xAdiaCalDataB" 338 /end CHARACTERISTIC
/begin CHARACTERISTIC INJ2_CAL.xFlg.AdiaConfWord "Adia Configuration Word" VALUE 0xFCCAF0 __UWORD_Z 0 NO_COMPU_METHOD 0 65535 SYMBOL_LINK "xAdiaCalDataB" 336 /end CHARACTERISTIC
/begin CHARACTERISTIC INJ3_CAL.usrConf2Deval "Transition from CONFIRMED to DEVALIDATED - Number of NO_FAULT" VALUE 0xFCCB02 __UWORD_Z 0 NO_COMPU_METHOD 0 65535 SYMBOL_LINK "xAdiaCalDataB" 354 /end CHARACTERISTIC
/begin CHARACTERISTIC INJ3_CAL.usrDeb2Conf "Transition from DEBOUNCING to CONFIRMED - Number of Fault" VALUE 0xFCCB04 __UWORD_Z 0 NO_COMPU_METHOD 0 65535 SYMBOL_LINK "xAdiaCalDataB" 356 /end CHARACTERISTIC
/begin CHARACTERISTIC INJ3_CAL.usrFilt2Conf " Transition from FILTERING to CONFIRM - Counter threshold" VALUE 0xFCCB08 __UWORD_Z 0 NO_COMPU_METHOD 0 65535 SYMBOL_LINK "xAdiaCalDataB" 360 /end CHARACTERISTIC
/begin CHARACTERISTIC INJ3_CAL.usrInConfOld "Init counter value in CONFIRMED_OLD status" VALUE 0xFCCB0A __UWORD_Z 0 NO_COMPU_METHOD 0 65535 SYMBOL_LINK "xAdiaCalDataB" 362 /end CHARACTERISTIC
/begin CHARACTERISTIC INJ3_CAL.usrStep "Counter increment value from DEBOUNCING to CONFIRMED status and init value in the FILTERING status" VALUE 0xFCCB06 __UBYTE_Z 0 NO_COMPU_METHOD 0 255 SYMBOL_LINK "xAdiaCalDataB" 358 /end CHARACTERISTIC
/begin CHARACTERISTIC INJ3_CAL.usrWucCntIni "Transition from DEVALIDATED to NO_ERROR - Number of warm-up cycles" VALUE 0xFCCB00 __UBYTE_Z 0 NO_COMPU_METHOD 0 255 SYMBOL_LINK "xAdiaCalDataB" 352 /end CHARACTERISTIC
/begin CHARACTERISTIC INJ3_CAL.xFlg.AdiaConfWord "Adia Configuration Word" VALUE 0xFCCAFE __UWORD_Z 0 NO_COMPU_METHOD 0 65535 SYMBOL_LINK "xAdiaCalDataB" 350 /end CHARACTERISTIC
/begin CHARACTERISTIC INJ4_CAL.usrConf2Deval "Transition from CONFIRMED to DEVALIDATED - Number of NO_FAULT" VALUE 0xFCCB10 __UWORD_Z 0 NO_COMPU_METHOD 0 65535 SYMBOL_LINK "xAdiaCalDataB" 368 /end CHARACTERISTIC
/begin CHARACTERISTIC INJ4_CAL.usrDeb2Conf "Transition from DEBOUNCING to CONFIRMED - Number of Fault" VALUE 0xFCCB12 __UWORD_Z 0 NO_COMPU_METHOD 0 65535 SYMBOL_LINK "xAdiaCalDataB" 370 /end CHARACTERISTIC
/begin CHARACTERISTIC INJ4_CAL.usrFilt2Conf " Transition from FILTERING to CONFIRM - Counter threshold" VALUE 0xFCCB16 __UWORD_Z 0 NO_COMPU_METHOD 0 65535 SYMBOL_LINK "xAdiaCalDataB" 374 /end CHARACTERISTIC
/begin CHARACTERISTIC INJ4_CAL.usrInConfOld "Init counter value in CONFIRMED_OLD status" VALUE 0xFCCB18 __UWORD_Z 0 NO_COMPU_METHOD 0 65535 SYMBOL_LINK "xAdiaCalDataB" 376 /end CHARACTERISTIC
/begin CHARACTERISTIC INJ4_CAL.usrStep "Counter increment value from DEBOUNCING to CONFIRMED status and init value in the FILTERING status" VALUE 0xFCCB14 __UBYTE_Z 0 NO_COMPU_METHOD 0 255 SYMBOL_LINK "xAdiaCalDataB" 372 /end CHARACTERISTIC
/begin CHARACTERISTIC INJ4_CAL.usrWucCntIni "Transition from DEVALIDATED to NO_ERROR - Number of warm-up cycles" VALUE 0xFCCB0E __UBYTE_Z 0 NO_COMPU_METHOD 0 255 SYMBOL_LINK "xAdiaCalDataB" 366 /end CHARACTERISTIC
/begin CHARACTERISTIC INJ4_CAL.xFlg.AdiaConfWord "Adia Configuration Word" VALUE 0xFCCB0C __UWORD_Z 0 NO_COMPU_METHOD 0 65535 SYMBOL_LINK "xAdiaCalDataB" 364 /end CHARACTERISTIC
/begin CHARACTERISTIC INJ5_CAL.usrConf2Deval "Transition from CONFIRMED to DEVALIDATED - Number of NO_FAULT" VALUE 0xFCCB1E __UWORD_Z 0 NO_COMPU_METHOD 0 65535 SYMBOL_LINK "xAdiaCalDataB" 382 /end CHARACTERISTIC
/begin CHARACTERISTIC INJ5_CAL.usrDeb2Conf "Transition from DEBOUNCING to CONFIRMED - Number of Fault" VALUE 0xFCCB20 __UWORD_Z 0 NO_COMPU_METHOD 0 65535 SYMBOL_LINK "xAdiaCalDataB" 384 /end CHARACTERISTIC
/begin CHARACTERISTIC INJ5_CAL.usrFilt2Conf " Transition from FILTERING to CONFIRM - Counter threshold" VALUE 0xFCCB24 __UWORD_Z 0 NO_COMPU_METHOD 0 65535 SYMBOL_LINK "xAdiaCalDataB" 388 /end CHARACTERISTIC
/begin CHARACTERISTIC INJ5_CAL.usrInConfOld "Init counter value in CONFIRMED_OLD status" VALUE 0xFCCB26 __UWORD_Z 0 NO_COMPU_METHOD 0 65535 SYMBOL_LINK "xAdiaCalDataB" 390 /end CHARACTERISTIC
/begin CHARACTERISTIC INJ5_CAL.usrStep "Counter increment value from DEBOUNCING to CONFIRMED status and init value in the FILTERING status" VALUE 0xFCCB22 __UBYTE_Z 0 NO_COMPU_METHOD 0 255 SYMBOL_LINK "xAdiaCalDataB" 386 /end CHARACTERISTIC
/begin CHARACTERISTIC INJ5_CAL.usrWucCntIni "Transition from DEVALIDATED to NO_ERROR - Number of warm-up cycles" VALUE 0xFCCB1C __UBYTE_Z 0 NO_COMPU_METHOD 0 255 SYMBOL_LINK "xAdiaCalDataB" 380 /end CHARACTERISTIC
/begin CHARACTERISTIC INJ5_CAL.xFlg.AdiaConfWord "Adia Configuration Word" VALUE 0xFCCB1A __UWORD_Z 0 NO_COMPU_METHOD 0 65535 SYMBOL_LINK "xAdiaCalDataB" 378 /end CHARACTERISTIC
/begin CHARACTERISTIC INJ6_CAL.usrConf2Deval "Transition from CONFIRMED to DEVALIDATED - Number of NO_FAULT" VALUE 0xFCCB2C __UWORD_Z 0 NO_COMPU_METHOD 0 65535 SYMBOL_LINK "xAdiaCalDataB" 396 /end CHARACTERISTIC
/begin CHARACTERISTIC INJ6_CAL.usrDeb2Conf "Transition from DEBOUNCING to CONFIRMED - Number of Fault" VALUE 0xFCCB2E __UWORD_Z 0 NO_COMPU_METHOD 0 65535 SYMBOL_LINK "xAdiaCalDataB" 398 /end CHARACTERISTIC
/begin CHARACTERISTIC INJ6_CAL.usrFilt2Conf " Transition from FILTERING to CONFIRM - Counter threshold" VALUE 0xFCCB32 __UWORD_Z 0 NO_COMPU_METHOD 0 65535 SYMBOL_LINK "xAdiaCalDataB" 402 /end CHARACTERISTIC
/begin CHARACTERISTIC INJ6_CAL.usrInConfOld "Init counter value in CONFIRMED_OLD status" VALUE 0xFCCB34 __UWORD_Z 0 NO_COMPU_METHOD 0 65535 SYMBOL_LINK "xAdiaCalDataB" 404 /end CHARACTERISTIC
/begin CHARACTERISTIC INJ6_CAL.usrStep "Counter increment value from DEBOUNCING to CONFIRMED status and init value in the FILTERING status" VALUE 0xFCCB30 __UBYTE_Z 0 NO_COMPU_METHOD 0 255 SYMBOL_LINK "xAdiaCalDataB" 400 /end CHARACTERISTIC
/begin CHARACTERISTIC INJ6_CAL.usrWucCntIni "Transition from DEVALIDATED to NO_ERROR - Number of warm-up cycles" VALUE 0xFCCB2A __UBYTE_Z 0 NO_COMPU_METHOD 0 255 SYMBOL_LINK "xAdiaCalDataB" 394 /end CHARACTERISTIC
/begin CHARACTERISTIC INJ6_CAL.xFlg.AdiaConfWord "Adia Configuration Word" VALUE 0xFCCB28 __UWORD_Z 0 NO_COMPU_METHOD 0 65535 SYMBOL_LINK "xAdiaCalDataB" 392 /end CHARACTERISTIC
/begin CHARACTERISTIC INJ7_CAL.usrConf2Deval "Transition from CONFIRMED to DEVALIDATED - Number of NO_FAULT" VALUE 0xFCCB3A __UWORD_Z 0 NO_COMPU_METHOD 0 65535 SYMBOL_LINK "xAdiaCalDataB" 410 /end CHARACTERISTIC
/begin CHARACTERISTIC INJ7_CAL.usrDeb2Conf "Transition from DEBOUNCING to CONFIRMED - Number of Fault" VALUE 0xFCCB3C __UWORD_Z 0 NO_COMPU_METHOD 0 65535 SYMBOL_LINK "xAdiaCalDataB" 412 /end CHARACTERISTIC
/begin CHARACTERISTIC INJ7_CAL.usrFilt2Conf " Transition from FILTERING to CONFIRM - Counter threshold" VALUE 0xFCCB40 __UWORD_Z 0 NO_COMPU_METHOD 0 65535 SYMBOL_LINK "xAdiaCalDataB" 416 /end CHARACTERISTIC
/begin CHARACTERISTIC INJ7_CAL.usrInConfOld "Init counter value in CONFIRMED_OLD status" VALUE 0xFCCB42 __UWORD_Z 0 NO_COMPU_METHOD 0 65535 SYMBOL_LINK "xAdiaCalDataB" 418 /end CHARACTERISTIC
/begin CHARACTERISTIC INJ7_CAL.usrStep "Counter increment value from DEBOUNCING to CONFIRMED status and init value in the FILTERING status" VALUE 0xFCCB3E __UBYTE_Z 0 NO_COMPU_METHOD 0 255 SYMBOL_LINK "xAdiaCalDataB" 414 /end CHARACTERISTIC
/begin CHARACTERISTIC INJ7_CAL.usrWucCntIni "Transition from DEVALIDATED to NO_ERROR - Number of warm-up cycles" VALUE 0xFCCB38 __UBYTE_Z 0 NO_COMPU_METHOD 0 255 SYMBOL_LINK "xAdiaCalDataB" 408 /end CHARACTERISTIC
/begin CHARACTERISTIC INJ7_CAL.xFlg.AdiaConfWord "Adia Configuration Word" VALUE 0xFCCB36 __UWORD_Z 0 NO_COMPU_METHOD 0 65535 SYMBOL_LINK "xAdiaCalDataB" 406 /end CHARACTERISTIC
/begin CHARACTERISTIC STA_CAL.usrConf2Deval "Transition from CONFIRMED to DEVALIDATED - Number of NO_FAULT" VALUE 0xFCC9C0 __UWORD_Z 0 NO_COMPU_METHOD 0 65535 SYMBOL_LINK "xAdiaCalDataB" 32 /end CHARACTERISTIC
/begin CHARACTERISTIC STA_CAL.usrDeb2Conf "Transition from DEBOUNCING to CONFIRMED - Number of Fault" VALUE 0xFCC9C2 __UWORD_Z 0 NO_COMPU_METHOD 0 65535 SYMBOL_LINK "xAdiaCalDataB" 34 /end CHARACTERISTIC
/begin CHARACTERISTIC STA_CAL.usrFilt2Conf " Transition from FILTERING to CONFIRM - Counter threshold" VALUE 0xFCC9C6 __UWORD_Z 0 NO_COMPU_METHOD 0 65535 SYMBOL_LINK "xAdiaCalDataB" 38 /end CHARACTERISTIC
/begin CHARACTERISTIC STA_CAL.usrInConfOld "Init counter value in CONFIRMED_OLD status" VALUE 0xFCC9C8 __UWORD_Z 0 NO_COMPU_METHOD 0 65535 SYMBOL_LINK "xAdiaCalDataB" 40 /end CHARACTERISTIC
/begin CHARACTERISTIC STA_CAL.usrStep "Counter increment value from DEBOUNCING to CONFIRMED status and init value in the FILTERING status" VALUE 0xFCC9C4 __UBYTE_Z 0 NO_COMPU_METHOD 0 255 SYMBOL_LINK "xAdiaCalDataB" 36 /end CHARACTERISTIC
/begin CHARACTERISTIC STA_CAL.usrWucCntIni "Transition from DEVALIDATED to NO_ERROR - Number of warm-up cycles" VALUE 0xFCC9BE __UBYTE_Z 0 NO_COMPU_METHOD 0 255 SYMBOL_LINK "xAdiaCalDataB" 30 /end CHARACTERISTIC
/begin CHARACTERISTIC STA_CAL.xFlg.AdiaConfWord "Adia Configuration Word" VALUE 0xFCC9BC __UWORD_Z 0 NO_COMPU_METHOD 0 65535 SYMBOL_LINK "xAdiaCalDataB" 28 /end CHARACTERISTIC
/begin CHARACTERISTIC INJ8_CAL.usrConf2Deval "Transition from CONFIRMED to DEVALIDATED - Number of NO_FAULT" VALUE 0xFCCB48 __UWORD_Z 0 NO_COMPU_METHOD 0 65535 SYMBOL_LINK "xAdiaCalDataB" 424 /end CHARACTERISTIC
/begin CHARACTERISTIC INJ8_CAL.usrDeb2Conf "Transition from DEBOUNCING to CONFIRMED - Number of Fault" VALUE 0xFCCB4A __UWORD_Z 0 NO_COMPU_METHOD 0 65535 SYMBOL_LINK "xAdiaCalDataB" 426 /end CHARACTERISTIC
/begin CHARACTERISTIC INJ8_CAL.usrFilt2Conf " Transition from FILTERING to CONFIRM - Counter threshold" VALUE 0xFCCB4E __UWORD_Z 0 NO_COMPU_METHOD 0 65535 SYMBOL_LINK "xAdiaCalDataB" 430 /end CHARACTERISTIC
/begin CHARACTERISTIC INJ8_CAL.usrInConfOld "Init counter value in CONFIRMED_OLD status" VALUE 0xFCCB50 __UWORD_Z 0 NO_COMPU_METHOD 0 65535 SYMBOL_LINK "xAdiaCalDataB" 432 /end CHARACTERISTIC
/begin CHARACTERISTIC INJ8_CAL.usrStep "Counter increment value from DEBOUNCING to CONFIRMED status and init value in the FILTERING status" VALUE 0xFCCB4C __UBYTE_Z 0 NO_COMPU_METHOD 0 255 SYMBOL_LINK "xAdiaCalDataB" 428 /end CHARACTERISTIC
/begin CHARACTERISTIC INJ8_CAL.usrWucCntIni "Transition from DEVALIDATED to NO_ERROR - Number of warm-up cycles" VALUE 0xFCCB46 __UBYTE_Z 0 NO_COMPU_METHOD 0 255 SYMBOL_LINK "xAdiaCalDataB" 422 /end CHARACTERISTIC
/begin CHARACTERISTIC INJ8_CAL.xFlg.AdiaConfWord "Adia Configuration Word" VALUE 0xFCCB44 __UWORD_Z 0 NO_COMPU_METHOD 0 65535 SYMBOL_LINK "xAdiaCalDataB" 420 /end CHARACTERISTIC
/begin CHARACTERISTIC PWRCOL_CAL.usrConf2Deval "Transition from CONFIRMED to DEVALIDATED - Number of NO_FAULT" VALUE 0xFCCB56 __UWORD_Z 0 NO_COMPU_METHOD 0 65535 SYMBOL_LINK "xAdiaCalDataB" 438 /end CHARACTERISTIC
/begin CHARACTERISTIC PWRCOL_CAL.usrDeb2Conf "Transition from DEBOUNCING to CONFIRMED - Number of Fault" VALUE 0xFCCB58 __UWORD_Z 0 NO_COMPU_METHOD 0 65535 SYMBOL_LINK "xAdiaCalDataB" 440 /end CHARACTERISTIC
/begin CHARACTERISTIC PWRCOL_CAL.usrFilt2Conf " Transition from FILTERING to CONFIRM - Counter threshold" VALUE 0xFCCB5C __UWORD_Z 0 NO_COMPU_METHOD 0 65535 SYMBOL_LINK "xAdiaCalDataB" 444 /end CHARACTERISTIC
/begin CHARACTERISTIC PWRCOL_CAL.usrInConfOld "Init counter value in CONFIRMED_OLD status" VALUE 0xFCCB5E __UWORD_Z 0 NO_COMPU_METHOD 0 65535 SYMBOL_LINK "xAdiaCalDataB" 446 /end CHARACTERISTIC
/begin CHARACTERISTIC PWRCOL_CAL.usrStep "Counter increment value from DEBOUNCING to CONFIRMED status and init value in the FILTERING status" VALUE 0xFCCB5A __UBYTE_Z 0 NO_COMPU_METHOD 0 255 SYMBOL_LINK "xAdiaCalDataB" 442 /end CHARACTERISTIC
/begin CHARACTERISTIC PWRCOL_CAL.usrWucCntIni "Transition from DEVALIDATED to NO_ERROR - Number of warm-up cycles" VALUE 0xFCCB54 __UBYTE_Z 0 NO_COMPU_METHOD 0 255 SYMBOL_LINK "xAdiaCalDataB" 436 /end CHARACTERISTIC
/begin CHARACTERISTIC PWRCOL_CAL.xFlg.AdiaConfWord "Adia Configuration Word" VALUE 0xFCCB52 __UWORD_Z 0 NO_COMPU_METHOD 0 65535 SYMBOL_LINK "xAdiaCalDataB" 434 /end CHARACTERISTIC
/begin CHARACTERISTIC PWRCGND_CAL.usrConf2Deval "Transition from CONFIRMED to DEVALIDATED - Number of NO_FAULT" VALUE 0xFCCB64 __UWORD_Z 0 NO_COMPU_METHOD 0 65535 SYMBOL_LINK "xAdiaCalDataB" 452 /end CHARACTERISTIC
/begin CHARACTERISTIC PWRCGND_CAL.usrDeb2Conf "Transition from DEBOUNCING to CONFIRMED - Number of Fault" VALUE 0xFCCB66 __UWORD_Z 0 NO_COMPU_METHOD 0 65535 SYMBOL_LINK "xAdiaCalDataB" 454 /end CHARACTERISTIC
/begin CHARACTERISTIC PWRCGND_CAL.usrFilt2Conf " Transition from FILTERING to CONFIRM - Counter threshold" VALUE 0xFCCB6A __UWORD_Z 0 NO_COMPU_METHOD 0 65535 SYMBOL_LINK "xAdiaCalDataB" 458 /end CHARACTERISTIC
/begin CHARACTERISTIC PWRCGND_CAL.usrInConfOld "Init counter value in CONFIRMED_OLD status" VALUE 0xFCCB6C __UWORD_Z 0 NO_COMPU_METHOD 0 65535 SYMBOL_LINK "xAdiaCalDataB" 460 /end CHARACTERISTIC
/begin CHARACTERISTIC PWRCGND_CAL.usrStep "Counter increment value from DEBOUNCING to CONFIRMED status and init value in the FILTERING status" VALUE 0xFCCB68 __UBYTE_Z 0 NO_COMPU_METHOD 0 255 SYMBOL_LINK "xAdiaCalDataB" 456 /end CHARACTERISTIC
/begin CHARACTERISTIC PWRCGND_CAL.usrWucCntIni "Transition from DEVALIDATED to NO_ERROR - Number of warm-up cycles" VALUE 0xFCCB62 __UBYTE_Z 0 NO_COMPU_METHOD 0 255 SYMBOL_LINK "xAdiaCalDataB" 450 /end CHARACTERISTIC
/begin CHARACTERISTIC PWRCGND_CAL.xFlg.AdiaConfWord "Adia Configuration Word" VALUE 0xFCCB60 __UWORD_Z 0 NO_COMPU_METHOD 0 65535 SYMBOL_LINK "xAdiaCalDataB" 448 /end CHARACTERISTIC
/begin CHARACTERISTIC PWRCVB_CAL.usrConf2Deval "Transition from CONFIRMED to DEVALIDATED - Number of NO_FAULT" VALUE 0xFCCB72 __UWORD_Z 0 NO_COMPU_METHOD 0 65535 SYMBOL_LINK "xAdiaCalDataB" 466 /end CHARACTERISTIC
/begin CHARACTERISTIC PWRCVB_CAL.usrDeb2Conf "Transition from DEBOUNCING to CONFIRMED - Number of Fault" VALUE 0xFCCB74 __UWORD_Z 0 NO_COMPU_METHOD 0 65535 SYMBOL_LINK "xAdiaCalDataB" 468 /end CHARACTERISTIC
/begin CHARACTERISTIC PWRCVB_CAL.usrFilt2Conf " Transition from FILTERING to CONFIRM - Counter threshold" VALUE 0xFCCB78 __UWORD_Z 0 NO_COMPU_METHOD 0 65535 SYMBOL_LINK "xAdiaCalDataB" 472 /end CHARACTERISTIC
/begin CHARACTERISTIC PWRCVB_CAL.usrInConfOld "Init counter value in CONFIRMED_OLD status" VALUE 0xFCCB7A __UWORD_Z 0 NO_COMPU_METHOD 0 65535 SYMBOL_LINK "xAdiaCalDataB" 474 /end CHARACTERISTIC
/begin CHARACTERISTIC PWRCVB_CAL.usrStep "Counter increment value from DEBOUNCING to CONFIRMED status and init value in the FILTERING status" VALUE 0xFCCB76 __UBYTE_Z 0 NO_COMPU_METHOD 0 255 SYMBOL_LINK "xAdiaCalDataB" 470 /end CHARACTERISTIC
/begin CHARACTERISTIC PWRCVB_CAL.usrWucCntIni "Transition from DEVALIDATED to NO_ERROR - Number of warm-up cycles" VALUE 0xFCCB70 __UBYTE_Z 0 NO_COMPU_METHOD 0 255 SYMBOL_LINK "xAdiaCalDataB" 464 /end CHARACTERISTIC
/begin CHARACTERISTIC PWRCVB_CAL.xFlg.AdiaConfWord "Adia Configuration Word" VALUE 0xFCCB6E __UWORD_Z 0 NO_COMPU_METHOD 0 65535 SYMBOL_LINK "xAdiaCalDataB" 462 /end CHARACTERISTIC
/begin CHARACTERISTIC PWROC_CAL.usrConf2Deval "Transition from CONFIRMED to DEVALIDATED - Number of NO_FAULT" VALUE 0xFCCB80 __UWORD_Z 0 NO_COMPU_METHOD 0 65535 SYMBOL_LINK "xAdiaCalDataB" 480 /end CHARACTERISTIC
/begin CHARACTERISTIC PWROC_CAL.usrDeb2Conf "Transition from DEBOUNCING to CONFIRMED - Number of Fault" VALUE 0xFCCB82 __UWORD_Z 0 NO_COMPU_METHOD 0 65535 SYMBOL_LINK "xAdiaCalDataB" 482 /end CHARACTERISTIC
/begin CHARACTERISTIC PWROC_CAL.usrFilt2Conf " Transition from FILTERING to CONFIRM - Counter threshold" VALUE 0xFCCB86 __UWORD_Z 0 NO_COMPU_METHOD 0 65535 SYMBOL_LINK "xAdiaCalDataB" 486 /end CHARACTERISTIC
/begin CHARACTERISTIC PWROC_CAL.usrInConfOld "Init counter value in CONFIRMED_OLD status" VALUE 0xFCCB88 __UWORD_Z 0 NO_COMPU_METHOD 0 65535 SYMBOL_LINK "xAdiaCalDataB" 488 /end CHARACTERISTIC
/begin CHARACTERISTIC PWROC_CAL.usrStep "Counter increment value from DEBOUNCING to CONFIRMED status and init value in the FILTERING status" VALUE 0xFCCB84 __UBYTE_Z 0 NO_COMPU_METHOD 0 255 SYMBOL_LINK "xAdiaCalDataB" 484 /end CHARACTERISTIC
/begin CHARACTERISTIC PWROC_CAL.usrWucCntIni "Transition from DEVALIDATED to NO_ERROR - Number of warm-up cycles" VALUE 0xFCCB7E __UBYTE_Z 0 NO_COMPU_METHOD 0 255 SYMBOL_LINK "xAdiaCalDataB" 478 /end CHARACTERISTIC
/begin CHARACTERISTIC PWROC_CAL.xFlg.AdiaConfWord "Adia Configuration Word" VALUE 0xFCCB7C __UWORD_Z 0 NO_COMPU_METHOD 0 65535 SYMBOL_LINK "xAdiaCalDataB" 476 /end CHARACTERISTIC
/begin CHARACTERISTIC PWRCC_CAL.usrConf2Deval "Transition from CONFIRMED to DEVALIDATED - Number of NO_FAULT" VALUE 0xFCCB8E __UWORD_Z 0 NO_COMPU_METHOD 0 65535 SYMBOL_LINK "xAdiaCalDataB" 494 /end CHARACTERISTIC
/begin CHARACTERISTIC PWRCC_CAL.usrDeb2Conf "Transition from DEBOUNCING to CONFIRMED - Number of Fault" VALUE 0xFCCB90 __UWORD_Z 0 NO_COMPU_METHOD 0 65535 SYMBOL_LINK "xAdiaCalDataB" 496 /end CHARACTERISTIC
/begin CHARACTERISTIC PWRCC_CAL.usrFilt2Conf " Transition from FILTERING to CONFIRM - Counter threshold" VALUE 0xFCCB94 __UWORD_Z 0 NO_COMPU_METHOD 0 65535 SYMBOL_LINK "xAdiaCalDataB" 500 /end CHARACTERISTIC
/begin CHARACTERISTIC PWRCC_CAL.usrInConfOld "Init counter value in CONFIRMED_OLD status" VALUE 0xFCCB96 __UWORD_Z 0 NO_COMPU_METHOD 0 65535 SYMBOL_LINK "xAdiaCalDataB" 502 /end CHARACTERISTIC
/begin CHARACTERISTIC PWRCC_CAL.usrStep "Counter increment value from DEBOUNCING to CONFIRMED status and init value in the FILTERING status" VALUE 0xFCCB92 __UBYTE_Z 0 NO_COMPU_METHOD 0 255 SYMBOL_LINK "xAdiaCalDataB" 498 /end CHARACTERISTIC
/begin CHARACTERISTIC PWRCC_CAL.usrWucCntIni "Transition from DEVALIDATED to NO_ERROR - Number of warm-up cycles" VALUE 0xFCCB8C __UBYTE_Z 0 NO_COMPU_METHOD 0 255 SYMBOL_LINK "xAdiaCalDataB" 492 /end CHARACTERISTIC
/begin CHARACTERISTIC PWRCC_CAL.xFlg.AdiaConfWord "Adia Configuration Word" VALUE 0xFCCB8A __UWORD_Z 0 NO_COMPU_METHOD 0 65535 SYMBOL_LINK "xAdiaCalDataB" 490 /end CHARACTERISTIC
/begin CHARACTERISTIC SGM_CAL.usrConf2Deval "Transition from CONFIRMED to DEVALIDATED - Number of NO_FAULT" VALUE 0xFCCB9C __UWORD_Z 0 NO_COMPU_METHOD 0 65535 SYMBOL_LINK "xAdiaCalDataB" 508 /end CHARACTERISTIC
/begin CHARACTERISTIC SGM_CAL.usrDeb2Conf "Transition from DEBOUNCING to CONFIRMED - Number of Fault" VALUE 0xFCCB9E __UWORD_Z 0 NO_COMPU_METHOD 0 65535 SYMBOL_LINK "xAdiaCalDataB" 510 /end CHARACTERISTIC
/begin CHARACTERISTIC SGM_CAL.usrFilt2Conf " Transition from FILTERING to CONFIRM - Counter threshold" VALUE 0xFCCBA2 __UWORD_Z 0 NO_COMPU_METHOD 0 65535 SYMBOL_LINK "xAdiaCalDataB" 514 /end CHARACTERISTIC
/begin CHARACTERISTIC SGM_CAL.usrInConfOld "Init counter value in CONFIRMED_OLD status" VALUE 0xFCCBA4 __UWORD_Z 0 NO_COMPU_METHOD 0 65535 SYMBOL_LINK "xAdiaCalDataB" 516 /end CHARACTERISTIC
/begin CHARACTERISTIC SGM_CAL.usrStep "Counter increment value from DEBOUNCING to CONFIRMED status and init value in the FILTERING status" VALUE 0xFCCBA0 __UBYTE_Z 0 NO_COMPU_METHOD 0 255 SYMBOL_LINK "xAdiaCalDataB" 512 /end CHARACTERISTIC
/begin CHARACTERISTIC SGM_CAL.usrWucCntIni "Transition from DEVALIDATED to NO_ERROR - Number of warm-up cycles" VALUE 0xFCCB9A __UBYTE_Z 0 NO_COMPU_METHOD 0 255 SYMBOL_LINK "xAdiaCalDataB" 506 /end CHARACTERISTIC
/begin CHARACTERISTIC SGM_CAL.xFlg.AdiaConfWord "Adia Configuration Word" VALUE 0xFCCB98 __UWORD_Z 0 NO_COMPU_METHOD 0 65535 SYMBOL_LINK "xAdiaCalDataB" 504 /end CHARACTERISTIC
/begin CHARACTERISTIC EVRCOL_CAL.usrConf2Deval "Transition from CONFIRMED to DEVALIDATED - Number of NO_FAULT" VALUE 0xFCCBAA __UWORD_Z 0 NO_COMPU_METHOD 0 65535 SYMBOL_LINK "xAdiaCalDataB" 522 /end CHARACTERISTIC
/begin CHARACTERISTIC EVRCOL_CAL.usrDeb2Conf "Transition from DEBOUNCING to CONFIRMED - Number of Fault" VALUE 0xFCCBAC __UWORD_Z 0 NO_COMPU_METHOD 0 65535 SYMBOL_LINK "xAdiaCalDataB" 524 /end CHARACTERISTIC
/begin CHARACTERISTIC EVRCOL_CAL.usrFilt2Conf " Transition from FILTERING to CONFIRM - Counter threshold" VALUE 0xFCCBB0 __UWORD_Z 0 NO_COMPU_METHOD 0 65535 SYMBOL_LINK "xAdiaCalDataB" 528 /end CHARACTERISTIC
/begin CHARACTERISTIC EVRCOL_CAL.usrInConfOld "Init counter value in CONFIRMED_OLD status" VALUE 0xFCCBB2 __UWORD_Z 0 NO_COMPU_METHOD 0 65535 SYMBOL_LINK "xAdiaCalDataB" 530 /end CHARACTERISTIC
/begin CHARACTERISTIC EVRCOL_CAL.usrStep "Counter increment value from DEBOUNCING to CONFIRMED status and init value in the FILTERING status" VALUE 0xFCCBAE __UBYTE_Z 0 NO_COMPU_METHOD 0 255 SYMBOL_LINK "xAdiaCalDataB" 526 /end CHARACTERISTIC
/begin CHARACTERISTIC EVRCOL_CAL.usrWucCntIni "Transition from DEVALIDATED to NO_ERROR - Number of warm-up cycles" VALUE 0xFCCBA8 __UBYTE_Z 0 NO_COMPU_METHOD 0 255 SYMBOL_LINK "xAdiaCalDataB" 520 /end CHARACTERISTIC
/begin CHARACTERISTIC EVRCOL_CAL.xFlg.AdiaConfWord "Adia Configuration Word" VALUE 0xFCCBA6 __UWORD_Z 0 NO_COMPU_METHOD 0 65535 SYMBOL_LINK "xAdiaCalDataB" 518 /end CHARACTERISTIC
/begin CHARACTERISTIC EVRCGND_CAL.usrConf2Deval "Transition from CONFIRMED to DEVALIDATED - Number of NO_FAULT" VALUE 0xFCCBB8 __UWORD_Z 0 NO_COMPU_METHOD 0 65535 SYMBOL_LINK "xAdiaCalDataB" 536 /end CHARACTERISTIC
/begin CHARACTERISTIC EVRCGND_CAL.usrDeb2Conf "Transition from DEBOUNCING to CONFIRMED - Number of Fault" VALUE 0xFCCBBA __UWORD_Z 0 NO_COMPU_METHOD 0 65535 SYMBOL_LINK "xAdiaCalDataB" 538 /end CHARACTERISTIC
/begin CHARACTERISTIC EVRCGND_CAL.usrFilt2Conf " Transition from FILTERING to CONFIRM - Counter threshold" VALUE 0xFCCBBE __UWORD_Z 0 NO_COMPU_METHOD 0 65535 SYMBOL_LINK "xAdiaCalDataB" 542 /end CHARACTERISTIC
/begin CHARACTERISTIC EVRCGND_CAL.usrInConfOld "Init counter value in CONFIRMED_OLD status" VALUE 0xFCCBC0 __UWORD_Z 0 NO_COMPU_METHOD 0 65535 SYMBOL_LINK "xAdiaCalDataB" 544 /end CHARACTERISTIC
/begin CHARACTERISTIC EVRCGND_CAL.usrStep "Counter increment value from DEBOUNCING to CONFIRMED status and init value in the FILTERING status" VALUE 0xFCCBBC __UBYTE_Z 0 NO_COMPU_METHOD 0 255 SYMBOL_LINK "xAdiaCalDataB" 540 /end CHARACTERISTIC
/begin CHARACTERISTIC EVRCGND_CAL.usrWucCntIni "Transition from DEVALIDATED to NO_ERROR - Number of warm-up cycles" VALUE 0xFCCBB6 __UBYTE_Z 0 NO_COMPU_METHOD 0 255 SYMBOL_LINK "xAdiaCalDataB" 534 /end CHARACTERISTIC
/begin CHARACTERISTIC EVRCGND_CAL.xFlg.AdiaConfWord "Adia Configuration Word" VALUE 0xFCCBB4 __UWORD_Z 0 NO_COMPU_METHOD 0 65535 SYMBOL_LINK "xAdiaCalDataB" 532 /end CHARACTERISTIC
/begin CHARACTERISTIC EVRCVB_CAL.usrConf2Deval "Transition from CONFIRMED to DEVALIDATED - Number of NO_FAULT" VALUE 0xFCCBC6 __UWORD_Z 0 NO_COMPU_METHOD 0 65535 SYMBOL_LINK "xAdiaCalDataB" 550 /end CHARACTERISTIC
/begin CHARACTERISTIC EVRCVB_CAL.usrDeb2Conf "Transition from DEBOUNCING to CONFIRMED - Number of Fault" VALUE 0xFCCBC8 __UWORD_Z 0 NO_COMPU_METHOD 0 65535 SYMBOL_LINK "xAdiaCalDataB" 552 /end CHARACTERISTIC
/begin CHARACTERISTIC EVRCVB_CAL.usrFilt2Conf " Transition from FILTERING to CONFIRM - Counter threshold" VALUE 0xFCCBCC __UWORD_Z 0 NO_COMPU_METHOD 0 65535 SYMBOL_LINK "xAdiaCalDataB" 556 /end CHARACTERISTIC
/begin CHARACTERISTIC EVRCVB_CAL.usrInConfOld "Init counter value in CONFIRMED_OLD status" VALUE 0xFCCBCE __UWORD_Z 0 NO_COMPU_METHOD 0 65535 SYMBOL_LINK "xAdiaCalDataB" 558 /end CHARACTERISTIC
/begin CHARACTERISTIC EVRCVB_CAL.usrStep "Counter increment value from DEBOUNCING to CONFIRMED status and init value in the FILTERING status" VALUE 0xFCCBCA __UBYTE_Z 0 NO_COMPU_METHOD 0 255 SYMBOL_LINK "xAdiaCalDataB" 554 /end CHARACTERISTIC
/begin CHARACTERISTIC EVRCVB_CAL.usrWucCntIni "Transition from DEVALIDATED to NO_ERROR - Number of warm-up cycles" VALUE 0xFCCBC4 __UBYTE_Z 0 NO_COMPU_METHOD 0 255 SYMBOL_LINK "xAdiaCalDataB" 548 /end CHARACTERISTIC
/begin CHARACTERISTIC EVRCVB_CAL.xFlg.AdiaConfWord "Adia Configuration Word" VALUE 0xFCCBC2 __UWORD_Z 0 NO_COMPU_METHOD 0 65535 SYMBOL_LINK "xAdiaCalDataB" 546 /end CHARACTERISTIC
/begin CHARACTERISTIC SPO_CAL.usrConf2Deval "Transition from CONFIRMED to DEVALIDATED - Number of NO_FAULT" VALUE 0xFCC9CE __UWORD_Z 0 NO_COMPU_METHOD 0 65535 SYMBOL_LINK "xAdiaCalDataB" 46 /end CHARACTERISTIC
/begin CHARACTERISTIC SPO_CAL.usrDeb2Conf "Transition from DEBOUNCING to CONFIRMED - Number of Fault" VALUE 0xFCC9D0 __UWORD_Z 0 NO_COMPU_METHOD 0 65535 SYMBOL_LINK "xAdiaCalDataB" 48 /end CHARACTERISTIC
/begin CHARACTERISTIC SPO_CAL.usrFilt2Conf " Transition from FILTERING to CONFIRM - Counter threshold" VALUE 0xFCC9D4 __UWORD_Z 0 NO_COMPU_METHOD 0 65535 SYMBOL_LINK "xAdiaCalDataB" 52 /end CHARACTERISTIC
/begin CHARACTERISTIC SPO_CAL.usrInConfOld "Init counter value in CONFIRMED_OLD status" VALUE 0xFCC9D6 __UWORD_Z 0 NO_COMPU_METHOD 0 65535 SYMBOL_LINK "xAdiaCalDataB" 54 /end CHARACTERISTIC
/begin CHARACTERISTIC SPO_CAL.usrStep "Counter increment value from DEBOUNCING to CONFIRMED status and init value in the FILTERING status" VALUE 0xFCC9D2 __UBYTE_Z 0 NO_COMPU_METHOD 0 255 SYMBOL_LINK "xAdiaCalDataB" 50 /end CHARACTERISTIC
/begin CHARACTERISTIC SPO_CAL.usrWucCntIni "Transition from DEVALIDATED to NO_ERROR - Number of warm-up cycles" VALUE 0xFCC9CC __UBYTE_Z 0 NO_COMPU_METHOD 0 255 SYMBOL_LINK "xAdiaCalDataB" 44 /end CHARACTERISTIC
/begin CHARACTERISTIC SPO_CAL.xFlg.AdiaConfWord "Adia Configuration Word" VALUE 0xFCC9CA __UWORD_Z 0 NO_COMPU_METHOD 0 65535 SYMBOL_LINK "xAdiaCalDataB" 42 /end CHARACTERISTIC
/begin CHARACTERISTIC PRVCOL_CAL.usrConf2Deval "Transition from CONFIRMED to DEVALIDATED - Number of NO_FAULT" VALUE 0xFCCBD4 __UWORD_Z 0 NO_COMPU_METHOD 0 65535 SYMBOL_LINK "xAdiaCalDataB" 564 /end CHARACTERISTIC
/begin CHARACTERISTIC PRVCOL_CAL.usrDeb2Conf "Transition from DEBOUNCING to CONFIRMED - Number of Fault" VALUE 0xFCCBD6 __UWORD_Z 0 NO_COMPU_METHOD 0 65535 SYMBOL_LINK "xAdiaCalDataB" 566 /end CHARACTERISTIC
/begin CHARACTERISTIC PRVCOL_CAL.usrFilt2Conf " Transition from FILTERING to CONFIRM - Counter threshold" VALUE 0xFCCBDA __UWORD_Z 0 NO_COMPU_METHOD 0 65535 SYMBOL_LINK "xAdiaCalDataB" 570 /end CHARACTERISTIC
/begin CHARACTERISTIC PRVCOL_CAL.usrInConfOld "Init counter value in CONFIRMED_OLD status" VALUE 0xFCCBDC __UWORD_Z 0 NO_COMPU_METHOD 0 65535 SYMBOL_LINK "xAdiaCalDataB" 572 /end CHARACTERISTIC
/begin CHARACTERISTIC PRVCOL_CAL.usrStep "Counter increment value from DEBOUNCING to CONFIRMED status and init value in the FILTERING status" VALUE 0xFCCBD8 __UBYTE_Z 0 NO_COMPU_METHOD 0 255 SYMBOL_LINK "xAdiaCalDataB" 568 /end CHARACTERISTIC
/begin CHARACTERISTIC PRVCOL_CAL.usrWucCntIni "Transition from DEVALIDATED to NO_ERROR - Number of warm-up cycles" VALUE 0xFCCBD2 __UBYTE_Z 0 NO_COMPU_METHOD 0 255 SYMBOL_LINK "xAdiaCalDataB" 562 /end CHARACTERISTIC
/begin CHARACTERISTIC PRVCOL_CAL.xFlg.AdiaConfWord "Adia Configuration Word" VALUE 0xFCCBD0 __UWORD_Z 0 NO_COMPU_METHOD 0 65535 SYMBOL_LINK "xAdiaCalDataB" 560 /end CHARACTERISTIC
/begin CHARACTERISTIC PRVCGND_CAL.usrConf2Deval "Transition from CONFIRMED to DEVALIDATED - Number of NO_FAULT" VALUE 0xFCCBE2 __UWORD_Z 0 NO_COMPU_METHOD 0 65535 SYMBOL_LINK "xAdiaCalDataB" 578 /end CHARACTERISTIC
/begin CHARACTERISTIC PRVCGND_CAL.usrDeb2Conf "Transition from DEBOUNCING to CONFIRMED - Number of Fault" VALUE 0xFCCBE4 __UWORD_Z 0 NO_COMPU_METHOD 0 65535 SYMBOL_LINK "xAdiaCalDataB" 580 /end CHARACTERISTIC
/begin CHARACTERISTIC PRVCGND_CAL.usrFilt2Conf " Transition from FILTERING to CONFIRM - Counter threshold" VALUE 0xFCCBE8 __UWORD_Z 0 NO_COMPU_METHOD 0 65535 SYMBOL_LINK "xAdiaCalDataB" 584 /end CHARACTERISTIC
/begin CHARACTERISTIC PRVCGND_CAL.usrInConfOld "Init counter value in CONFIRMED_OLD status" VALUE 0xFCCBEA __UWORD_Z 0 NO_COMPU_METHOD 0 65535 SYMBOL_LINK "xAdiaCalDataB" 586 /end CHARACTERISTIC
/begin CHARACTERISTIC PRVCGND_CAL.usrStep "Counter increment value from DEBOUNCING to CONFIRMED status and init value in the FILTERING status" VALUE 0xFCCBE6 __UBYTE_Z 0 NO_COMPU_METHOD 0 255 SYMBOL_LINK "xAdiaCalDataB" 582 /end CHARACTERISTIC
/begin CHARACTERISTIC PRVCGND_CAL.usrWucCntIni "Transition from DEVALIDATED to NO_ERROR - Number of warm-up cycles" VALUE 0xFCCBE0 __UBYTE_Z 0 NO_COMPU_METHOD 0 255 SYMBOL_LINK "xAdiaCalDataB" 576 /end CHARACTERISTIC
/begin CHARACTERISTIC PRVCGND_CAL.xFlg.AdiaConfWord "Adia Configuration Word" VALUE 0xFCCBDE __UWORD_Z 0 NO_COMPU_METHOD 0 65535 SYMBOL_LINK "xAdiaCalDataB" 574 /end CHARACTERISTIC
/begin CHARACTERISTIC PRVCVB_CAL.usrConf2Deval "Transition from CONFIRMED to DEVALIDATED - Number of NO_FAULT" VALUE 0xFCCBF0 __UWORD_Z 0 NO_COMPU_METHOD 0 65535 SYMBOL_LINK "xAdiaCalDataB" 592 /end CHARACTERISTIC
/begin CHARACTERISTIC PRVCVB_CAL.usrDeb2Conf "Transition from DEBOUNCING to CONFIRMED - Number of Fault" VALUE 0xFCCBF2 __UWORD_Z 0 NO_COMPU_METHOD 0 65535 SYMBOL_LINK "xAdiaCalDataB" 594 /end CHARACTERISTIC
/begin CHARACTERISTIC PRVCVB_CAL.usrFilt2Conf " Transition from FILTERING to CONFIRM - Counter threshold" VALUE 0xFCCBF6 __UWORD_Z 0 NO_COMPU_METHOD 0 65535 SYMBOL_LINK "xAdiaCalDataB" 598 /end CHARACTERISTIC
/begin CHARACTERISTIC PRVCVB_CAL.usrInConfOld "Init counter value in CONFIRMED_OLD status" VALUE 0xFCCBF8 __UWORD_Z 0 NO_COMPU_METHOD 0 65535 SYMBOL_LINK "xAdiaCalDataB" 600 /end CHARACTERISTIC
/begin CHARACTERISTIC PRVCVB_CAL.usrStep "Counter increment value from DEBOUNCING to CONFIRMED status and init value in the FILTERING status" VALUE 0xFCCBF4 __UBYTE_Z 0 NO_COMPU_METHOD 0 255 SYMBOL_LINK "xAdiaCalDataB" 596 /end CHARACTERISTIC
/begin CHARACTERISTIC PRVCVB_CAL.usrWucCntIni "Transition from DEVALIDATED to NO_ERROR - Number of warm-up cycles" VALUE 0xFCCBEE __UBYTE_Z 0 NO_COMPU_METHOD 0 255 SYMBOL_LINK "xAdiaCalDataB" 590 /end CHARACTERISTIC
/begin CHARACTERISTIC PRVCVB_CAL.xFlg.AdiaConfWord "Adia Configuration Word" VALUE 0xFCCBEC __UWORD_Z 0 NO_COMPU_METHOD 0 65535 SYMBOL_LINK "xAdiaCalDataB" 588 /end CHARACTERISTIC
/begin CHARACTERISTIC LHR_CAL.usrConf2Deval "Transition from CONFIRMED to DEVALIDATED - Number of NO_FAULT" VALUE 0xFCCBFE __UWORD_Z 0 NO_COMPU_METHOD 0 65535 SYMBOL_LINK "xAdiaCalDataB" 606 /end CHARACTERISTIC
/begin CHARACTERISTIC LHR_CAL.usrDeb2Conf "Transition from DEBOUNCING to CONFIRMED - Number of Fault" VALUE 0xFCCC00 __UWORD_Z 0 NO_COMPU_METHOD 0 65535 SYMBOL_LINK "xAdiaCalDataB" 608 /end CHARACTERISTIC
/begin CHARACTERISTIC LHR_CAL.usrFilt2Conf " Transition from FILTERING to CONFIRM - Counter threshold" VALUE 0xFCCC04 __UWORD_Z 0 NO_COMPU_METHOD 0 65535 SYMBOL_LINK "xAdiaCalDataB" 612 /end CHARACTERISTIC
/begin CHARACTERISTIC LHR_CAL.usrInConfOld "Init counter value in CONFIRMED_OLD status" VALUE 0xFCCC06 __UWORD_Z 0 NO_COMPU_METHOD 0 65535 SYMBOL_LINK "xAdiaCalDataB" 614 /end CHARACTERISTIC
/begin CHARACTERISTIC LHR_CAL.usrStep "Counter increment value from DEBOUNCING to CONFIRMED status and init value in the FILTERING status" VALUE 0xFCCC02 __UBYTE_Z 0 NO_COMPU_METHOD 0 255 SYMBOL_LINK "xAdiaCalDataB" 610 /end CHARACTERISTIC
/begin CHARACTERISTIC LHR_CAL.usrWucCntIni "Transition from DEVALIDATED to NO_ERROR - Number of warm-up cycles" VALUE 0xFCCBFC __UBYTE_Z 0 NO_COMPU_METHOD 0 255 SYMBOL_LINK "xAdiaCalDataB" 604 /end CHARACTERISTIC
/begin CHARACTERISTIC LHR_CAL.xFlg.AdiaConfWord "Adia Configuration Word" VALUE 0xFCCBFA __UWORD_Z 0 NO_COMPU_METHOD 0 65535 SYMBOL_LINK "xAdiaCalDataB" 602 /end CHARACTERISTIC
/begin CHARACTERISTIC SPMP_CAL.usrConf2Deval "Transition from CONFIRMED to DEVALIDATED - Number of NO_FAULT" VALUE 0xFCCC0C __UWORD_Z 0 NO_COMPU_METHOD 0 65535 SYMBOL_LINK "xAdiaCalDataB" 620 /end CHARACTERISTIC
/begin CHARACTERISTIC SPMP_CAL.usrDeb2Conf "Transition from DEBOUNCING to CONFIRMED - Number of Fault" VALUE 0xFCCC0E __UWORD_Z 0 NO_COMPU_METHOD 0 65535 SYMBOL_LINK "xAdiaCalDataB" 622 /end CHARACTERISTIC
/begin CHARACTERISTIC SPMP_CAL.usrFilt2Conf " Transition from FILTERING to CONFIRM - Counter threshold" VALUE 0xFCCC12 __UWORD_Z 0 NO_COMPU_METHOD 0 65535 SYMBOL_LINK "xAdiaCalDataB" 626 /end CHARACTERISTIC
/begin CHARACTERISTIC SPMP_CAL.usrInConfOld "Init counter value in CONFIRMED_OLD status" VALUE 0xFCCC14 __UWORD_Z 0 NO_COMPU_METHOD 0 65535 SYMBOL_LINK "xAdiaCalDataB" 628 /end CHARACTERISTIC
/begin CHARACTERISTIC SPMP_CAL.usrStep "Counter increment value from DEBOUNCING to CONFIRMED status and init value in the FILTERING status" VALUE 0xFCCC10 __UBYTE_Z 0 NO_COMPU_METHOD 0 255 SYMBOL_LINK "xAdiaCalDataB" 624 /end CHARACTERISTIC
/begin CHARACTERISTIC SPMP_CAL.usrWucCntIni "Transition from DEVALIDATED to NO_ERROR - Number of warm-up cycles" VALUE 0xFCCC0A __UBYTE_Z 0 NO_COMPU_METHOD 0 255 SYMBOL_LINK "xAdiaCalDataB" 618 /end CHARACTERISTIC
/begin CHARACTERISTIC SPMP_CAL.xFlg.AdiaConfWord "Adia Configuration Word" VALUE 0xFCCC08 __UWORD_Z 0 NO_COMPU_METHOD 0 65535 SYMBOL_LINK "xAdiaCalDataB" 616 /end CHARACTERISTIC
/begin CHARACTERISTIC STC1_CAL.usrConf2Deval "Transition from CONFIRMED to DEVALIDATED - Number of NO_FAULT" VALUE 0xFCCC1A __UWORD_Z 0 NO_COMPU_METHOD 0 65535 SYMBOL_LINK "xAdiaCalDataB" 634 /end CHARACTERISTIC
/begin CHARACTERISTIC STC1_CAL.usrDeb2Conf "Transition from DEBOUNCING to CONFIRMED - Number of Fault" VALUE 0xFCCC1C __UWORD_Z 0 NO_COMPU_METHOD 0 65535 SYMBOL_LINK "xAdiaCalDataB" 636 /end CHARACTERISTIC
/begin CHARACTERISTIC STC1_CAL.usrFilt2Conf " Transition from FILTERING to CONFIRM - Counter threshold" VALUE 0xFCCC20 __UWORD_Z 0 NO_COMPU_METHOD 0 65535 SYMBOL_LINK "xAdiaCalDataB" 640 /end CHARACTERISTIC
/begin CHARACTERISTIC STC1_CAL.usrInConfOld "Init counter value in CONFIRMED_OLD status" VALUE 0xFCCC22 __UWORD_Z 0 NO_COMPU_METHOD 0 65535 SYMBOL_LINK "xAdiaCalDataB" 642 /end CHARACTERISTIC
/begin CHARACTERISTIC STC1_CAL.usrStep "Counter increment value from DEBOUNCING to CONFIRMED status and init value in the FILTERING status" VALUE 0xFCCC1E __UBYTE_Z 0 NO_COMPU_METHOD 0 255 SYMBOL_LINK "xAdiaCalDataB" 638 /end CHARACTERISTIC
/begin CHARACTERISTIC STC1_CAL.usrWucCntIni "Transition from DEVALIDATED to NO_ERROR - Number of warm-up cycles" VALUE 0xFCCC18 __UBYTE_Z 0 NO_COMPU_METHOD 0 255 SYMBOL_LINK "xAdiaCalDataB" 632 /end CHARACTERISTIC
/begin CHARACTERISTIC STC1_CAL.xFlg.AdiaConfWord "Adia Configuration Word" VALUE 0xFCCC16 __UWORD_Z 0 NO_COMPU_METHOD 0 65535 SYMBOL_LINK "xAdiaCalDataB" 630 /end CHARACTERISTIC
/begin CHARACTERISTIC STC2_CAL.usrConf2Deval "Transition from CONFIRMED to DEVALIDATED - Number of NO_FAULT" VALUE 0xFCCC28 __UWORD_Z 0 NO_COMPU_METHOD 0 65535 SYMBOL_LINK "xAdiaCalDataB" 648 /end CHARACTERISTIC
/begin CHARACTERISTIC STC2_CAL.usrDeb2Conf "Transition from DEBOUNCING to CONFIRMED - Number of Fault" VALUE 0xFCCC2A __UWORD_Z 0 NO_COMPU_METHOD 0 65535 SYMBOL_LINK "xAdiaCalDataB" 650 /end CHARACTERISTIC
/begin CHARACTERISTIC STC2_CAL.usrFilt2Conf " Transition from FILTERING to CONFIRM - Counter threshold" VALUE 0xFCCC2E __UWORD_Z 0 NO_COMPU_METHOD 0 65535 SYMBOL_LINK "xAdiaCalDataB" 654 /end CHARACTERISTIC
/begin CHARACTERISTIC STC2_CAL.usrInConfOld "Init counter value in CONFIRMED_OLD status" VALUE 0xFCCC30 __UWORD_Z 0 NO_COMPU_METHOD 0 65535 SYMBOL_LINK "xAdiaCalDataB" 656 /end CHARACTERISTIC
/begin CHARACTERISTIC STC2_CAL.usrStep "Counter increment value from DEBOUNCING to CONFIRMED status and init value in the FILTERING status" VALUE 0xFCCC2C __UBYTE_Z 0 NO_COMPU_METHOD 0 255 SYMBOL_LINK "xAdiaCalDataB" 652 /end CHARACTERISTIC
/begin CHARACTERISTIC STC2_CAL.usrWucCntIni "Transition from DEVALIDATED to NO_ERROR - Number of warm-up cycles" VALUE 0xFCCC26 __UBYTE_Z 0 NO_COMPU_METHOD 0 255 SYMBOL_LINK "xAdiaCalDataB" 646 /end CHARACTERISTIC
/begin CHARACTERISTIC STC2_CAL.xFlg.AdiaConfWord "Adia Configuration Word" VALUE 0xFCCC24 __UWORD_Z 0 NO_COMPU_METHOD 0 65535 SYMBOL_LINK "xAdiaCalDataB" 644 /end CHARACTERISTIC
/begin CHARACTERISTIC VS1_CAL.usrConf2Deval "Transition from CONFIRMED to DEVALIDATED - Number of NO_FAULT" VALUE 0xFCCC36 __UWORD_Z 0 NO_COMPU_METHOD 0 65535 SYMBOL_LINK "xAdiaCalDataB" 662 /end CHARACTERISTIC
/begin CHARACTERISTIC VS1_CAL.usrDeb2Conf "Transition from DEBOUNCING to CONFIRMED - Number of Fault" VALUE 0xFCCC38 __UWORD_Z 0 NO_COMPU_METHOD 0 65535 SYMBOL_LINK "xAdiaCalDataB" 664 /end CHARACTERISTIC
/begin CHARACTERISTIC VS1_CAL.usrFilt2Conf " Transition from FILTERING to CONFIRM - Counter threshold" VALUE 0xFCCC3C __UWORD_Z 0 NO_COMPU_METHOD 0 65535 SYMBOL_LINK "xAdiaCalDataB" 668 /end CHARACTERISTIC
/begin CHARACTERISTIC VS1_CAL.usrInConfOld "Init counter value in CONFIRMED_OLD status" VALUE 0xFCCC3E __UWORD_Z 0 NO_COMPU_METHOD 0 65535 SYMBOL_LINK "xAdiaCalDataB" 670 /end CHARACTERISTIC
/begin CHARACTERISTIC VS1_CAL.usrStep "Counter increment value from DEBOUNCING to CONFIRMED status and init value in the FILTERING status" VALUE 0xFCCC3A __UBYTE_Z 0 NO_COMPU_METHOD 0 255 SYMBOL_LINK "xAdiaCalDataB" 666 /end CHARACTERISTIC
/begin CHARACTERISTIC VS1_CAL.usrWucCntIni "Transition from DEVALIDATED to NO_ERROR - Number of warm-up cycles" VALUE 0xFCCC34 __UBYTE_Z 0 NO_COMPU_METHOD 0 255 SYMBOL_LINK "xAdiaCalDataB" 660 /end CHARACTERISTIC
/begin CHARACTERISTIC VS1_CAL.xFlg.AdiaConfWord "Adia Configuration Word" VALUE 0xFCCC32 __UWORD_Z 0 NO_COMPU_METHOD 0 65535 SYMBOL_LINK "xAdiaCalDataB" 658 /end CHARACTERISTIC
/begin CHARACTERISTIC VS2_CAL.usrConf2Deval "Transition from CONFIRMED to DEVALIDATED - Number of NO_FAULT" VALUE 0xFCCC44 __UWORD_Z 0 NO_COMPU_METHOD 0 65535 SYMBOL_LINK "xAdiaCalDataB" 676 /end CHARACTERISTIC
/begin CHARACTERISTIC VS2_CAL.usrDeb2Conf "Transition from DEBOUNCING to CONFIRMED - Number of Fault" VALUE 0xFCCC46 __UWORD_Z 0 NO_COMPU_METHOD 0 65535 SYMBOL_LINK "xAdiaCalDataB" 678 /end CHARACTERISTIC
/begin CHARACTERISTIC VS2_CAL.usrFilt2Conf " Transition from FILTERING to CONFIRM - Counter threshold" VALUE 0xFCCC4A __UWORD_Z 0 NO_COMPU_METHOD 0 65535 SYMBOL_LINK "xAdiaCalDataB" 682 /end CHARACTERISTIC
/begin CHARACTERISTIC VS2_CAL.usrInConfOld "Init counter value in CONFIRMED_OLD status" VALUE 0xFCCC4C __UWORD_Z 0 NO_COMPU_METHOD 0 65535 SYMBOL_LINK "xAdiaCalDataB" 684 /end CHARACTERISTIC
/begin CHARACTERISTIC VS2_CAL.usrStep "Counter increment value from DEBOUNCING to CONFIRMED status and init value in the FILTERING status" VALUE 0xFCCC48 __UBYTE_Z 0 NO_COMPU_METHOD 0 255 SYMBOL_LINK "xAdiaCalDataB" 680 /end CHARACTERISTIC
/begin CHARACTERISTIC VS2_CAL.usrWucCntIni "Transition from DEVALIDATED to NO_ERROR - Number of warm-up cycles" VALUE 0xFCCC42 __UBYTE_Z 0 NO_COMPU_METHOD 0 255 SYMBOL_LINK "xAdiaCalDataB" 674 /end CHARACTERISTIC
/begin CHARACTERISTIC VS2_CAL.xFlg.AdiaConfWord "Adia Configuration Word" VALUE 0xFCCC40 __UWORD_Z 0 NO_COMPU_METHOD 0 65535 SYMBOL_LINK "xAdiaCalDataB" 672 /end CHARACTERISTIC
/begin CHARACTERISTIC VS3_CAL.usrConf2Deval "Transition from CONFIRMED to DEVALIDATED - Number of NO_FAULT" VALUE 0xFCCC52 __UWORD_Z 0 NO_COMPU_METHOD 0 65535 SYMBOL_LINK "xAdiaCalDataB" 690 /end CHARACTERISTIC
/begin CHARACTERISTIC VS3_CAL.usrDeb2Conf "Transition from DEBOUNCING to CONFIRMED - Number of Fault" VALUE 0xFCCC54 __UWORD_Z 0 NO_COMPU_METHOD 0 65535 SYMBOL_LINK "xAdiaCalDataB" 692 /end CHARACTERISTIC
/begin CHARACTERISTIC VS3_CAL.usrFilt2Conf " Transition from FILTERING to CONFIRM - Counter threshold" VALUE 0xFCCC58 __UWORD_Z 0 NO_COMPU_METHOD 0 65535 SYMBOL_LINK "xAdiaCalDataB" 696 /end CHARACTERISTIC
/begin CHARACTERISTIC VS3_CAL.usrInConfOld "Init counter value in CONFIRMED_OLD status" VALUE 0xFCCC5A __UWORD_Z 0 NO_COMPU_METHOD 0 65535 SYMBOL_LINK "xAdiaCalDataB" 698 /end CHARACTERISTIC
/begin CHARACTERISTIC VS3_CAL.usrStep "Counter increment value from DEBOUNCING to CONFIRMED status and init value in the FILTERING status" VALUE 0xFCCC56 __UBYTE_Z 0 NO_COMPU_METHOD 0 255 SYMBOL_LINK "xAdiaCalDataB" 694 /end CHARACTERISTIC
/begin CHARACTERISTIC VS3_CAL.usrWucCntIni "Transition from DEVALIDATED to NO_ERROR - Number of warm-up cycles" VALUE 0xFCCC50 __UBYTE_Z 0 NO_COMPU_METHOD 0 255 SYMBOL_LINK "xAdiaCalDataB" 688 /end CHARACTERISTIC
/begin CHARACTERISTIC VS3_CAL.xFlg.AdiaConfWord "Adia Configuration Word" VALUE 0xFCCC4E __UWORD_Z 0 NO_COMPU_METHOD 0 65535 SYMBOL_LINK "xAdiaCalDataB" 686 /end CHARACTERISTIC
/begin CHARACTERISTIC SPT_CAL.usrConf2Deval "Transition from CONFIRMED to DEVALIDATED - Number of NO_FAULT" VALUE 0xFCC9DC __UWORD_Z 0 NO_COMPU_METHOD 0 65535 SYMBOL_LINK "xAdiaCalDataB" 60 /end CHARACTERISTIC
/begin CHARACTERISTIC SPT_CAL.usrDeb2Conf "Transition from DEBOUNCING to CONFIRMED - Number of Fault" VALUE 0xFCC9DE __UWORD_Z 0 NO_COMPU_METHOD 0 65535 SYMBOL_LINK "xAdiaCalDataB" 62 /end CHARACTERISTIC
/begin CHARACTERISTIC SPT_CAL.usrFilt2Conf " Transition from FILTERING to CONFIRM - Counter threshold" VALUE 0xFCC9E2 __UWORD_Z 0 NO_COMPU_METHOD 0 65535 SYMBOL_LINK "xAdiaCalDataB" 66 /end CHARACTERISTIC
/begin CHARACTERISTIC SPT_CAL.usrInConfOld "Init counter value in CONFIRMED_OLD status" VALUE 0xFCC9E4 __UWORD_Z 0 NO_COMPU_METHOD 0 65535 SYMBOL_LINK "xAdiaCalDataB" 68 /end CHARACTERISTIC
/begin CHARACTERISTIC SPT_CAL.usrStep "Counter increment value from DEBOUNCING to CONFIRMED status and init value in the FILTERING status" VALUE 0xFCC9E0 __UBYTE_Z 0 NO_COMPU_METHOD 0 255 SYMBOL_LINK "xAdiaCalDataB" 64 /end CHARACTERISTIC
/begin CHARACTERISTIC SPT_CAL.usrWucCntIni "Transition from DEVALIDATED to NO_ERROR - Number of warm-up cycles" VALUE 0xFCC9DA __UBYTE_Z 0 NO_COMPU_METHOD 0 255 SYMBOL_LINK "xAdiaCalDataB" 58 /end CHARACTERISTIC
/begin CHARACTERISTIC SPT_CAL.xFlg.AdiaConfWord "Adia Configuration Word" VALUE 0xFCC9D8 __UWORD_Z 0 NO_COMPU_METHOD 0 65535 SYMBOL_LINK "xAdiaCalDataB" 56 /end CHARACTERISTIC
/begin CHARACTERISTIC CLO1_CAL.usrConf2Deval "Transition from CONFIRMED to DEVALIDATED - Number of NO_FAULT" VALUE 0xFCCC60 __UWORD_Z 0 NO_COMPU_METHOD 0 65535 SYMBOL_LINK "xAdiaCalDataB" 704 /end CHARACTERISTIC
/begin CHARACTERISTIC CLO1_CAL.usrDeb2Conf "Transition from DEBOUNCING to CONFIRMED - Number of Fault" VALUE 0xFCCC62 __UWORD_Z 0 NO_COMPU_METHOD 0 65535 SYMBOL_LINK "xAdiaCalDataB" 706 /end CHARACTERISTIC
/begin CHARACTERISTIC CLO1_CAL.usrFilt2Conf " Transition from FILTERING to CONFIRM - Counter threshold" VALUE 0xFCCC66 __UWORD_Z 0 NO_COMPU_METHOD 0 65535 SYMBOL_LINK "xAdiaCalDataB" 710 /end CHARACTERISTIC
/begin CHARACTERISTIC CLO1_CAL.usrInConfOld "Init counter value in CONFIRMED_OLD status" VALUE 0xFCCC68 __UWORD_Z 0 NO_COMPU_METHOD 0 65535 SYMBOL_LINK "xAdiaCalDataB" 712 /end CHARACTERISTIC
/begin CHARACTERISTIC CLO1_CAL.usrStep "Counter increment value from DEBOUNCING to CONFIRMED status and init value in the FILTERING status" VALUE 0xFCCC64 __UBYTE_Z 0 NO_COMPU_METHOD 0 255 SYMBOL_LINK "xAdiaCalDataB" 708 /end CHARACTERISTIC
/begin CHARACTERISTIC CLO1_CAL.usrWucCntIni "Transition from DEVALIDATED to NO_ERROR - Number of warm-up cycles" VALUE 0xFCCC5E __UBYTE_Z 0 NO_COMPU_METHOD 0 255 SYMBOL_LINK "xAdiaCalDataB" 702 /end CHARACTERISTIC
/begin CHARACTERISTIC CLO1_CAL.xFlg.AdiaConfWord "Adia Configuration Word" VALUE 0xFCCC5C __UWORD_Z 0 NO_COMPU_METHOD 0 65535 SYMBOL_LINK "xAdiaCalDataB" 700 /end CHARACTERISTIC
/begin CHARACTERISTIC CLO2_CAL.usrConf2Deval "Transition from CONFIRMED to DEVALIDATED - Number of NO_FAULT" VALUE 0xFCCC6E __UWORD_Z 0 NO_COMPU_METHOD 0 65535 SYMBOL_LINK "xAdiaCalDataB" 718 /end CHARACTERISTIC
/begin CHARACTERISTIC CLO2_CAL.usrDeb2Conf "Transition from DEBOUNCING to CONFIRMED - Number of Fault" VALUE 0xFCCC70 __UWORD_Z 0 NO_COMPU_METHOD 0 65535 SYMBOL_LINK "xAdiaCalDataB" 720 /end CHARACTERISTIC
/begin CHARACTERISTIC CLO2_CAL.usrFilt2Conf " Transition from FILTERING to CONFIRM - Counter threshold" VALUE 0xFCCC74 __UWORD_Z 0 NO_COMPU_METHOD 0 65535 SYMBOL_LINK "xAdiaCalDataB" 724 /end CHARACTERISTIC
/begin CHARACTERISTIC CLO2_CAL.usrInConfOld "Init counter value in CONFIRMED_OLD status" VALUE 0xFCCC76 __UWORD_Z 0 NO_COMPU_METHOD 0 65535 SYMBOL_LINK "xAdiaCalDataB" 726 /end CHARACTERISTIC
/begin CHARACTERISTIC CLO2_CAL.usrStep "Counter increment value from DEBOUNCING to CONFIRMED status and init value in the FILTERING status" VALUE 0xFCCC72 __UBYTE_Z 0 NO_COMPU_METHOD 0 255 SYMBOL_LINK "xAdiaCalDataB" 722 /end CHARACTERISTIC
/begin CHARACTERISTIC CLO2_CAL.usrWucCntIni "Transition from DEVALIDATED to NO_ERROR - Number of warm-up cycles" VALUE 0xFCCC6C __UBYTE_Z 0 NO_COMPU_METHOD 0 255 SYMBOL_LINK "xAdiaCalDataB" 716 /end CHARACTERISTIC
/begin CHARACTERISTIC CLO2_CAL.xFlg.AdiaConfWord "Adia Configuration Word" VALUE 0xFCCC6A __UWORD_Z 0 NO_COMPU_METHOD 0 65535 SYMBOL_LINK "xAdiaCalDataB" 714 /end CHARACTERISTIC
/begin CHARACTERISTIC CLO3_CAL.usrConf2Deval "Transition from CONFIRMED to DEVALIDATED - Number of NO_FAULT" VALUE 0xFCCC7C __UWORD_Z 0 NO_COMPU_METHOD 0 65535 SYMBOL_LINK "xAdiaCalDataB" 732 /end CHARACTERISTIC
/begin CHARACTERISTIC CLO3_CAL.usrDeb2Conf "Transition from DEBOUNCING to CONFIRMED - Number of Fault" VALUE 0xFCCC7E __UWORD_Z 0 NO_COMPU_METHOD 0 65535 SYMBOL_LINK "xAdiaCalDataB" 734 /end CHARACTERISTIC
/begin CHARACTERISTIC CLO3_CAL.usrFilt2Conf " Transition from FILTERING to CONFIRM - Counter threshold" VALUE 0xFCCC82 __UWORD_Z 0 NO_COMPU_METHOD 0 65535 SYMBOL_LINK "xAdiaCalDataB" 738 /end CHARACTERISTIC
/begin CHARACTERISTIC CLO3_CAL.usrInConfOld "Init counter value in CONFIRMED_OLD status" VALUE 0xFCCC84 __UWORD_Z 0 NO_COMPU_METHOD 0 65535 SYMBOL_LINK "xAdiaCalDataB" 740 /end CHARACTERISTIC
/begin CHARACTERISTIC CLO3_CAL.usrStep "Counter increment value from DEBOUNCING to CONFIRMED status and init value in the FILTERING status" VALUE 0xFCCC80 __UBYTE_Z 0 NO_COMPU_METHOD 0 255 SYMBOL_LINK "xAdiaCalDataB" 736 /end CHARACTERISTIC
/begin CHARACTERISTIC CLO3_CAL.usrWucCntIni "Transition from DEVALIDATED to NO_ERROR - Number of warm-up cycles" VALUE 0xFCCC7A __UBYTE_Z 0 NO_COMPU_METHOD 0 255 SYMBOL_LINK "xAdiaCalDataB" 730 /end CHARACTERISTIC
/begin CHARACTERISTIC CLO3_CAL.xFlg.AdiaConfWord "Adia Configuration Word" VALUE 0xFCCC78 __UWORD_Z 0 NO_COMPU_METHOD 0 65535 SYMBOL_LINK "xAdiaCalDataB" 728 /end CHARACTERISTIC
/begin CHARACTERISTIC CLO4_CAL.usrConf2Deval "Transition from CONFIRMED to DEVALIDATED - Number of NO_FAULT" VALUE 0xFCCC8A __UWORD_Z 0 NO_COMPU_METHOD 0 65535 SYMBOL_LINK "xAdiaCalDataB" 746 /end CHARACTERISTIC
/begin CHARACTERISTIC CLO4_CAL.usrDeb2Conf "Transition from DEBOUNCING to CONFIRMED - Number of Fault" VALUE 0xFCCC8C __UWORD_Z 0 NO_COMPU_METHOD 0 65535 SYMBOL_LINK "xAdiaCalDataB" 748 /end CHARACTERISTIC
/begin CHARACTERISTIC CLO4_CAL.usrFilt2Conf " Transition from FILTERING to CONFIRM - Counter threshold" VALUE 0xFCCC90 __UWORD_Z 0 NO_COMPU_METHOD 0 65535 SYMBOL_LINK "xAdiaCalDataB" 752 /end CHARACTERISTIC
/begin CHARACTERISTIC CLO4_CAL.usrInConfOld "Init counter value in CONFIRMED_OLD status" VALUE 0xFCCC92 __UWORD_Z 0 NO_COMPU_METHOD 0 65535 SYMBOL_LINK "xAdiaCalDataB" 754 /end CHARACTERISTIC
/begin CHARACTERISTIC CLO4_CAL.usrStep "Counter increment value from DEBOUNCING to CONFIRMED status and init value in the FILTERING status" VALUE 0xFCCC8E __UBYTE_Z 0 NO_COMPU_METHOD 0 255 SYMBOL_LINK "xAdiaCalDataB" 750 /end CHARACTERISTIC
/begin CHARACTERISTIC CLO4_CAL.usrWucCntIni "Transition from DEVALIDATED to NO_ERROR - Number of warm-up cycles" VALUE 0xFCCC88 __UBYTE_Z 0 NO_COMPU_METHOD 0 255 SYMBOL_LINK "xAdiaCalDataB" 744 /end CHARACTERISTIC
/begin CHARACTERISTIC CLO4_CAL.xFlg.AdiaConfWord "Adia Configuration Word" VALUE 0xFCCC86 __UWORD_Z 0 NO_COMPU_METHOD 0 65535 SYMBOL_LINK "xAdiaCalDataB" 742 /end CHARACTERISTIC
/begin CHARACTERISTIC FAR02_CAL.usrConf2Deval "Transition from CONFIRMED to DEVALIDATED - Number of NO_FAULT" VALUE 0xFCCC98 __UWORD_Z 0 NO_COMPU_METHOD 0 65535 SYMBOL_LINK "xAdiaCalDataB" 760 /end CHARACTERISTIC
/begin CHARACTERISTIC FAR02_CAL.usrDeb2Conf "Transition from DEBOUNCING to CONFIRMED - Number of Fault" VALUE 0xFCCC9A __UWORD_Z 0 NO_COMPU_METHOD 0 65535 SYMBOL_LINK "xAdiaCalDataB" 762 /end CHARACTERISTIC
/begin CHARACTERISTIC FAR02_CAL.usrFilt2Conf " Transition from FILTERING to CONFIRM - Counter threshold" VALUE 0xFCCC9E __UWORD_Z 0 NO_COMPU_METHOD 0 65535 SYMBOL_LINK "xAdiaCalDataB" 766 /end CHARACTERISTIC
/begin CHARACTERISTIC FAR02_CAL.usrInConfOld "Init counter value in CONFIRMED_OLD status" VALUE 0xFCCCA0 __UWORD_Z 0 NO_COMPU_METHOD 0 65535 SYMBOL_LINK "xAdiaCalDataB" 768 /end CHARACTERISTIC
/begin CHARACTERISTIC FAR02_CAL.usrStep "Counter increment value from DEBOUNCING to CONFIRMED status and init value in the FILTERING status" VALUE 0xFCCC9C __UBYTE_Z 0 NO_COMPU_METHOD 0 255 SYMBOL_LINK "xAdiaCalDataB" 764 /end CHARACTERISTIC
/begin CHARACTERISTIC FAR02_CAL.usrWucCntIni "Transition from DEVALIDATED to NO_ERROR - Number of warm-up cycles" VALUE 0xFCCC96 __UBYTE_Z 0 NO_COMPU_METHOD 0 255 SYMBOL_LINK "xAdiaCalDataB" 758 /end CHARACTERISTIC
/begin CHARACTERISTIC FAR02_CAL.xFlg.AdiaConfWord "Adia Configuration Word" VALUE 0xFCCC94 __UWORD_Z 0 NO_COMPU_METHOD 0 65535 SYMBOL_LINK "xAdiaCalDataB" 756 /end CHARACTERISTIC
/begin CHARACTERISTIC FARCH_CAL.usrConf2Deval "Transition from CONFIRMED to DEVALIDATED - Number of NO_FAULT" VALUE 0xFCCCA6 __UWORD_Z 0 NO_COMPU_METHOD 0 65535 SYMBOL_LINK "xAdiaCalDataB" 774 /end CHARACTERISTIC
/begin CHARACTERISTIC FARCH_CAL.usrDeb2Conf "Transition from DEBOUNCING to CONFIRMED - Number of Fault" VALUE 0xFCCCA8 __UWORD_Z 0 NO_COMPU_METHOD 0 65535 SYMBOL_LINK "xAdiaCalDataB" 776 /end CHARACTERISTIC
/begin CHARACTERISTIC FARCH_CAL.usrFilt2Conf " Transition from FILTERING to CONFIRM - Counter threshold" VALUE 0xFCCCAC __UWORD_Z 0 NO_COMPU_METHOD 0 65535 SYMBOL_LINK "xAdiaCalDataB" 780 /end CHARACTERISTIC
/begin CHARACTERISTIC FARCH_CAL.usrInConfOld "Init counter value in CONFIRMED_OLD status" VALUE 0xFCCCAE __UWORD_Z 0 NO_COMPU_METHOD 0 65535 SYMBOL_LINK "xAdiaCalDataB" 782 /end CHARACTERISTIC
/begin CHARACTERISTIC FARCH_CAL.usrStep "Counter increment value from DEBOUNCING to CONFIRMED status and init value in the FILTERING status" VALUE 0xFCCCAA __UBYTE_Z 0 NO_COMPU_METHOD 0 255 SYMBOL_LINK "xAdiaCalDataB" 778 /end CHARACTERISTIC
/begin CHARACTERISTIC FARCH_CAL.usrWucCntIni "Transition from DEVALIDATED to NO_ERROR - Number of warm-up cycles" VALUE 0xFCCCA4 __UBYTE_Z 0 NO_COMPU_METHOD 0 255 SYMBOL_LINK "xAdiaCalDataB" 772 /end CHARACTERISTIC
/begin CHARACTERISTIC FARCH_CAL.xFlg.AdiaConfWord "Adia Configuration Word" VALUE 0xFCCCA2 __UWORD_Z 0 NO_COMPU_METHOD 0 65535 SYMBOL_LINK "xAdiaCalDataB" 770 /end CHARACTERISTIC
/begin CHARACTERISTIC THRCVB_CAL.usrConf2Deval "Transition from CONFIRMED to DEVALIDATED - Number of NO_FAULT" VALUE 0xFCCCB4 __UWORD_Z 0 NO_COMPU_METHOD 0 65535 SYMBOL_LINK "xAdiaCalDataB" 788 /end CHARACTERISTIC
/begin CHARACTERISTIC THRCVB_CAL.usrDeb2Conf "Transition from DEBOUNCING to CONFIRMED - Number of Fault" VALUE 0xFCCCB6 __UWORD_Z 0 NO_COMPU_METHOD 0 65535 SYMBOL_LINK "xAdiaCalDataB" 790 /end CHARACTERISTIC
/begin CHARACTERISTIC THRCVB_CAL.usrFilt2Conf " Transition from FILTERING to CONFIRM - Counter threshold" VALUE 0xFCCCBA __UWORD_Z 0 NO_COMPU_METHOD 0 65535 SYMBOL_LINK "xAdiaCalDataB" 794 /end CHARACTERISTIC
/begin CHARACTERISTIC THRCVB_CAL.usrInConfOld "Init counter value in CONFIRMED_OLD status" VALUE 0xFCCCBC __UWORD_Z 0 NO_COMPU_METHOD 0 65535 SYMBOL_LINK "xAdiaCalDataB" 796 /end CHARACTERISTIC
/begin CHARACTERISTIC THRCVB_CAL.usrStep "Counter increment value from DEBOUNCING to CONFIRMED status and init value in the FILTERING status" VALUE 0xFCCCB8 __UBYTE_Z 0 NO_COMPU_METHOD 0 255 SYMBOL_LINK "xAdiaCalDataB" 792 /end CHARACTERISTIC
/begin CHARACTERISTIC THRCVB_CAL.usrWucCntIni "Transition from DEVALIDATED to NO_ERROR - Number of warm-up cycles" VALUE 0xFCCCB2 __UBYTE_Z 0 NO_COMPU_METHOD 0 255 SYMBOL_LINK "xAdiaCalDataB" 786 /end CHARACTERISTIC
/begin CHARACTERISTIC THRCVB_CAL.xFlg.AdiaConfWord "Adia Configuration Word" VALUE 0xFCCCB0 __UWORD_Z 0 NO_COMPU_METHOD 0 65535 SYMBOL_LINK "xAdiaCalDataB" 784 /end CHARACTERISTIC
/begin CHARACTERISTIC THRCGND_CAL.usrConf2Deval "Transition from CONFIRMED to DEVALIDATED - Number of NO_FAULT" VALUE 0xFCCCC2 __UWORD_Z 0 NO_COMPU_METHOD 0 65535 SYMBOL_LINK "xAdiaCalDataB" 802 /end CHARACTERISTIC
/begin CHARACTERISTIC THRCGND_CAL.usrDeb2Conf "Transition from DEBOUNCING to CONFIRMED - Number of Fault" VALUE 0xFCCCC4 __UWORD_Z 0 NO_COMPU_METHOD 0 65535 SYMBOL_LINK "xAdiaCalDataB" 804 /end CHARACTERISTIC
/begin CHARACTERISTIC THRCGND_CAL.usrFilt2Conf " Transition from FILTERING to CONFIRM - Counter threshold" VALUE 0xFCCCC8 __UWORD_Z 0 NO_COMPU_METHOD 0 65535 SYMBOL_LINK "xAdiaCalDataB" 808 /end CHARACTERISTIC
/begin CHARACTERISTIC THRCGND_CAL.usrInConfOld "Init counter value in CONFIRMED_OLD status" VALUE 0xFCCCCA __UWORD_Z 0 NO_COMPU_METHOD 0 65535 SYMBOL_LINK "xAdiaCalDataB" 810 /end CHARACTERISTIC
/begin CHARACTERISTIC THRCGND_CAL.usrStep "Counter increment value from DEBOUNCING to CONFIRMED status and init value in the FILTERING status" VALUE 0xFCCCC6 __UBYTE_Z 0 NO_COMPU_METHOD 0 255 SYMBOL_LINK "xAdiaCalDataB" 806 /end CHARACTERISTIC
/begin CHARACTERISTIC THRCGND_CAL.usrWucCntIni "Transition from DEVALIDATED to NO_ERROR - Number of warm-up cycles" VALUE 0xFCCCC0 __UBYTE_Z 0 NO_COMPU_METHOD 0 255 SYMBOL_LINK "xAdiaCalDataB" 800 /end CHARACTERISTIC
/begin CHARACTERISTIC THRCGND_CAL.xFlg.AdiaConfWord "Adia Configuration Word" VALUE 0xFCCCBE __UWORD_Z 0 NO_COMPU_METHOD 0 65535 SYMBOL_LINK "xAdiaCalDataB" 798 /end CHARACTERISTIC
/begin CHARACTERISTIC AIR2H_CAL.usrConf2Deval "Transition from CONFIRMED to DEVALIDATED - Number of NO_FAULT" VALUE 0xFCCCD0 __UWORD_Z 0 NO_COMPU_METHOD 0 65535 SYMBOL_LINK "xAdiaCalDataB" 816 /end CHARACTERISTIC
/begin CHARACTERISTIC AIR2H_CAL.usrDeb2Conf "Transition from DEBOUNCING to CONFIRMED - Number of Fault" VALUE 0xFCCCD2 __UWORD_Z 0 NO_COMPU_METHOD 0 65535 SYMBOL_LINK "xAdiaCalDataB" 818 /end CHARACTERISTIC
/begin CHARACTERISTIC AIR2H_CAL.usrFilt2Conf " Transition from FILTERING to CONFIRM - Counter threshold" VALUE 0xFCCCD6 __UWORD_Z 0 NO_COMPU_METHOD 0 65535 SYMBOL_LINK "xAdiaCalDataB" 822 /end CHARACTERISTIC
/begin CHARACTERISTIC AIR2H_CAL.usrInConfOld "Init counter value in CONFIRMED_OLD status" VALUE 0xFCCCD8 __UWORD_Z 0 NO_COMPU_METHOD 0 65535 SYMBOL_LINK "xAdiaCalDataB" 824 /end CHARACTERISTIC
/begin CHARACTERISTIC AIR2H_CAL.usrStep "Counter increment value from DEBOUNCING to CONFIRMED status and init value in the FILTERING status" VALUE 0xFCCCD4 __UBYTE_Z 0 NO_COMPU_METHOD 0 255 SYMBOL_LINK "xAdiaCalDataB" 820 /end CHARACTERISTIC
/begin CHARACTERISTIC AIR2H_CAL.usrWucCntIni "Transition from DEVALIDATED to NO_ERROR - Number of warm-up cycles" VALUE 0xFCCCCE __UBYTE_Z 0 NO_COMPU_METHOD 0 255 SYMBOL_LINK "xAdiaCalDataB" 814 /end CHARACTERISTIC
/begin CHARACTERISTIC AIR2H_CAL.xFlg.AdiaConfWord "Adia Configuration Word" VALUE 0xFCCCCC __UWORD_Z 0 NO_COMPU_METHOD 0 65535 SYMBOL_LINK "xAdiaCalDataB" 812 /end CHARACTERISTIC
/begin CHARACTERISTIC AIR2L_CAL.usrConf2Deval "Transition from CONFIRMED to DEVALIDATED - Number of NO_FAULT" VALUE 0xFCCCDE __UWORD_Z 0 NO_COMPU_METHOD 0 65535 SYMBOL_LINK "xAdiaCalDataB" 830 /end CHARACTERISTIC
/begin CHARACTERISTIC AIR2L_CAL.usrDeb2Conf "Transition from DEBOUNCING to CONFIRMED - Number of Fault" VALUE 0xFCCCE0 __UWORD_Z 0 NO_COMPU_METHOD 0 65535 SYMBOL_LINK "xAdiaCalDataB" 832 /end CHARACTERISTIC
/begin CHARACTERISTIC AIR2L_CAL.usrFilt2Conf " Transition from FILTERING to CONFIRM - Counter threshold" VALUE 0xFCCCE4 __UWORD_Z 0 NO_COMPU_METHOD 0 65535 SYMBOL_LINK "xAdiaCalDataB" 836 /end CHARACTERISTIC
/begin CHARACTERISTIC AIR2L_CAL.usrInConfOld "Init counter value in CONFIRMED_OLD status" VALUE 0xFCCCE6 __UWORD_Z 0 NO_COMPU_METHOD 0 65535 SYMBOL_LINK "xAdiaCalDataB" 838 /end CHARACTERISTIC
/begin CHARACTERISTIC AIR2L_CAL.usrStep "Counter increment value from DEBOUNCING to CONFIRMED status and init value in the FILTERING status" VALUE 0xFCCCE2 __UBYTE_Z 0 NO_COMPU_METHOD 0 255 SYMBOL_LINK "xAdiaCalDataB" 834 /end CHARACTERISTIC
/begin CHARACTERISTIC AIR2L_CAL.usrWucCntIni "Transition from DEVALIDATED to NO_ERROR - Number of warm-up cycles" VALUE 0xFCCCDC __UBYTE_Z 0 NO_COMPU_METHOD 0 255 SYMBOL_LINK "xAdiaCalDataB" 828 /end CHARACTERISTIC
/begin CHARACTERISTIC AIR2L_CAL.xFlg.AdiaConfWord "Adia Configuration Word" VALUE 0xFCCCDA __UWORD_Z 0 NO_COMPU_METHOD 0 65535 SYMBOL_LINK "xAdiaCalDataB" 826 /end CHARACTERISTIC
/begin CHARACTERISTIC STM_CAL.usrConf2Deval "Transition from CONFIRMED to DEVALIDATED - Number of NO_FAULT" VALUE 0xFCC9EA __UWORD_Z 0 NO_COMPU_METHOD 0 65535 SYMBOL_LINK "xAdiaCalDataB" 74 /end CHARACTERISTIC
/begin CHARACTERISTIC STM_CAL.usrDeb2Conf "Transition from DEBOUNCING to CONFIRMED - Number of Fault" VALUE 0xFCC9EC __UWORD_Z 0 NO_COMPU_METHOD 0 65535 SYMBOL_LINK "xAdiaCalDataB" 76 /end CHARACTERISTIC
/begin CHARACTERISTIC STM_CAL.usrFilt2Conf " Transition from FILTERING to CONFIRM - Counter threshold" VALUE 0xFCC9F0 __UWORD_Z 0 NO_COMPU_METHOD 0 65535 SYMBOL_LINK "xAdiaCalDataB" 80 /end CHARACTERISTIC
/begin CHARACTERISTIC STM_CAL.usrInConfOld "Init counter value in CONFIRMED_OLD status" VALUE 0xFCC9F2 __UWORD_Z 0 NO_COMPU_METHOD 0 65535 SYMBOL_LINK "xAdiaCalDataB" 82 /end CHARACTERISTIC
/begin CHARACTERISTIC STM_CAL.usrStep "Counter increment value from DEBOUNCING to CONFIRMED status and init value in the FILTERING status" VALUE 0xFCC9EE __UBYTE_Z 0 NO_COMPU_METHOD 0 255 SYMBOL_LINK "xAdiaCalDataB" 78 /end CHARACTERISTIC
/begin CHARACTERISTIC STM_CAL.usrWucCntIni "Transition from DEVALIDATED to NO_ERROR - Number of warm-up cycles" VALUE 0xFCC9E8 __UBYTE_Z 0 NO_COMPU_METHOD 0 255 SYMBOL_LINK "xAdiaCalDataB" 72 /end CHARACTERISTIC
/begin CHARACTERISTIC STM_CAL.xFlg.AdiaConfWord "Adia Configuration Word" VALUE 0xFCC9E6 __UWORD_Z 0 NO_COMPU_METHOD 0 65535 SYMBOL_LINK "xAdiaCalDataB" 70 /end CHARACTERISTIC
/begin CHARACTERISTIC SAFPON_CAL.usrConf2Deval "Transition from CONFIRMED to DEVALIDATED - Number of NO_FAULT" VALUE 0xFCCCEC __UWORD_Z 0 NO_COMPU_METHOD 0 65535 SYMBOL_LINK "xAdiaCalDataB" 844 /end CHARACTERISTIC
/begin CHARACTERISTIC SAFPON_CAL.usrDeb2Conf "Transition from DEBOUNCING to CONFIRMED - Number of Fault" VALUE 0xFCCCEE __UWORD_Z 0 NO_COMPU_METHOD 0 65535 SYMBOL_LINK "xAdiaCalDataB" 846 /end CHARACTERISTIC
/begin CHARACTERISTIC SAFPON_CAL.usrFilt2Conf " Transition from FILTERING to CONFIRM - Counter threshold" VALUE 0xFCCCF2 __UWORD_Z 0 NO_COMPU_METHOD 0 65535 SYMBOL_LINK "xAdiaCalDataB" 850 /end CHARACTERISTIC
/begin CHARACTERISTIC SAFPON_CAL.usrInConfOld "Init counter value in CONFIRMED_OLD status" VALUE 0xFCCCF4 __UWORD_Z 0 NO_COMPU_METHOD 0 65535 SYMBOL_LINK "xAdiaCalDataB" 852 /end CHARACTERISTIC
/begin CHARACTERISTIC SAFPON_CAL.usrStep "Counter increment value from DEBOUNCING to CONFIRMED status and init value in the FILTERING status" VALUE 0xFCCCF0 __UBYTE_Z 0 NO_COMPU_METHOD 0 255 SYMBOL_LINK "xAdiaCalDataB" 848 /end CHARACTERISTIC
/begin CHARACTERISTIC SAFPON_CAL.usrWucCntIni "Transition from DEVALIDATED to NO_ERROR - Number of warm-up cycles" VALUE 0xFCCCEA __UBYTE_Z 0 NO_COMPU_METHOD 0 255 SYMBOL_LINK "xAdiaCalDataB" 842 /end CHARACTERISTIC
/begin CHARACTERISTIC SAFPON_CAL.xFlg.AdiaConfWord "Adia Configuration Word" VALUE 0xFCCCE8 __UWORD_Z 0 NO_COMPU_METHOD 0 65535 SYMBOL_LINK "xAdiaCalDataB" 840 /end CHARACTERISTIC
/begin CHARACTERISTIC SAFRTF_CAL.usrConf2Deval "Transition from CONFIRMED to DEVALIDATED - Number of NO_FAULT" VALUE 0xFCCCFA __UWORD_Z 0 NO_COMPU_METHOD 0 65535 SYMBOL_LINK "xAdiaCalDataB" 858 /end CHARACTERISTIC
/begin CHARACTERISTIC SAFRTF_CAL.usrDeb2Conf "Transition from DEBOUNCING to CONFIRMED - Number of Fault" VALUE 0xFCCCFC __UWORD_Z 0 NO_COMPU_METHOD 0 65535 SYMBOL_LINK "xAdiaCalDataB" 860 /end CHARACTERISTIC
/begin CHARACTERISTIC SAFRTF_CAL.usrFilt2Conf " Transition from FILTERING to CONFIRM - Counter threshold" VALUE 0xFCCD00 __UWORD_Z 0 NO_COMPU_METHOD 0 65535 SYMBOL_LINK "xAdiaCalDataB" 864 /end CHARACTERISTIC
/begin CHARACTERISTIC SAFRTF_CAL.usrInConfOld "Init counter value in CONFIRMED_OLD status" VALUE 0xFCCD02 __UWORD_Z 0 NO_COMPU_METHOD 0 65535 SYMBOL_LINK "xAdiaCalDataB" 866 /end CHARACTERISTIC
/begin CHARACTERISTIC SAFRTF_CAL.usrStep "Counter increment value from DEBOUNCING to CONFIRMED status and init value in the FILTERING status" VALUE 0xFCCCFE __UBYTE_Z 0 NO_COMPU_METHOD 0 255 SYMBOL_LINK "xAdiaCalDataB" 862 /end CHARACTERISTIC
/begin CHARACTERISTIC SAFRTF_CAL.usrWucCntIni "Transition from DEVALIDATED to NO_ERROR - Number of warm-up cycles" VALUE 0xFCCCF8 __UBYTE_Z 0 NO_COMPU_METHOD 0 255 SYMBOL_LINK "xAdiaCalDataB" 856 /end CHARACTERISTIC
/begin CHARACTERISTIC SAFRTF_CAL.xFlg.AdiaConfWord "Adia Configuration Word" VALUE 0xFCCCF6 __UWORD_Z 0 NO_COMPU_METHOD 0 65535 SYMBOL_LINK "xAdiaCalDataB" 854 /end CHARACTERISTIC
/begin CHARACTERISTIC LHR2_CAL.usrConf2Deval "Transition from CONFIRMED to DEVALIDATED - Number of NO_FAULT" VALUE 0xFCCD08 __UWORD_Z 0 NO_COMPU_METHOD 0 65535 SYMBOL_LINK "xAdiaCalDataB" 872 /end CHARACTERISTIC
/begin CHARACTERISTIC LHR2_CAL.usrDeb2Conf "Transition from DEBOUNCING to CONFIRMED - Number of Fault" VALUE 0xFCCD0A __UWORD_Z 0 NO_COMPU_METHOD 0 65535 SYMBOL_LINK "xAdiaCalDataB" 874 /end CHARACTERISTIC
/begin CHARACTERISTIC LHR2_CAL.usrFilt2Conf " Transition from FILTERING to CONFIRM - Counter threshold" VALUE 0xFCCD0E __UWORD_Z 0 NO_COMPU_METHOD 0 65535 SYMBOL_LINK "xAdiaCalDataB" 878 /end CHARACTERISTIC
/begin CHARACTERISTIC LHR2_CAL.usrInConfOld "Init counter value in CONFIRMED_OLD status" VALUE 0xFCCD10 __UWORD_Z 0 NO_COMPU_METHOD 0 65535 SYMBOL_LINK "xAdiaCalDataB" 880 /end CHARACTERISTIC
/begin CHARACTERISTIC LHR2_CAL.usrStep "Counter increment value from DEBOUNCING to CONFIRMED status and init value in the FILTERING status" VALUE 0xFCCD0C __UBYTE_Z 0 NO_COMPU_METHOD 0 255 SYMBOL_LINK "xAdiaCalDataB" 876 /end CHARACTERISTIC
/begin CHARACTERISTIC LHR2_CAL.usrWucCntIni "Transition from DEVALIDATED to NO_ERROR - Number of warm-up cycles" VALUE 0xFCCD06 __UBYTE_Z 0 NO_COMPU_METHOD 0 255 SYMBOL_LINK "xAdiaCalDataB" 870 /end CHARACTERISTIC
/begin CHARACTERISTIC LHR2_CAL.xFlg.AdiaConfWord "Adia Configuration Word" VALUE 0xFCCD04 __UWORD_Z 0 NO_COMPU_METHOD 0 65535 SYMBOL_LINK "xAdiaCalDataB" 868 /end CHARACTERISTIC
/begin CHARACTERISTIC FAN1_CAL.usrConf2Deval "Transition from CONFIRMED to DEVALIDATED - Number of NO_FAULT" VALUE 0xFCCD16 __UWORD_Z 0 NO_COMPU_METHOD 0 65535 SYMBOL_LINK "xAdiaCalDataB" 886 /end CHARACTERISTIC
/begin CHARACTERISTIC FAN1_CAL.usrDeb2Conf "Transition from DEBOUNCING to CONFIRMED - Number of Fault" VALUE 0xFCCD18 __UWORD_Z 0 NO_COMPU_METHOD 0 65535 SYMBOL_LINK "xAdiaCalDataB" 888 /end CHARACTERISTIC
/begin CHARACTERISTIC FAN1_CAL.usrFilt2Conf " Transition from FILTERING to CONFIRM - Counter threshold" VALUE 0xFCCD1C __UWORD_Z 0 NO_COMPU_METHOD 0 65535 SYMBOL_LINK "xAdiaCalDataB" 892 /end CHARACTERISTIC
/begin CHARACTERISTIC FAN1_CAL.usrInConfOld "Init counter value in CONFIRMED_OLD status" VALUE 0xFCCD1E __UWORD_Z 0 NO_COMPU_METHOD 0 65535 SYMBOL_LINK "xAdiaCalDataB" 894 /end CHARACTERISTIC
/begin CHARACTERISTIC FAN1_CAL.usrStep "Counter increment value from DEBOUNCING to CONFIRMED status and init value in the FILTERING status" VALUE 0xFCCD1A __UBYTE_Z 0 NO_COMPU_METHOD 0 255 SYMBOL_LINK "xAdiaCalDataB" 890 /end CHARACTERISTIC
/begin CHARACTERISTIC FAN1_CAL.usrWucCntIni "Transition from DEVALIDATED to NO_ERROR - Number of warm-up cycles" VALUE 0xFCCD14 __UBYTE_Z 0 NO_COMPU_METHOD 0 255 SYMBOL_LINK "xAdiaCalDataB" 884 /end CHARACTERISTIC
/begin CHARACTERISTIC FAN1_CAL.xFlg.AdiaConfWord "Adia Configuration Word" VALUE 0xFCCD12 __UWORD_Z 0 NO_COMPU_METHOD 0 65535 SYMBOL_LINK "xAdiaCalDataB" 882 /end CHARACTERISTIC
/begin CHARACTERISTIC FAN2_CAL.usrConf2Deval "Transition from CONFIRMED to DEVALIDATED - Number of NO_FAULT" VALUE 0xFCCD24 __UWORD_Z 0 NO_COMPU_METHOD 0 65535 SYMBOL_LINK "xAdiaCalDataB" 900 /end CHARACTERISTIC
/begin CHARACTERISTIC FAN2_CAL.usrDeb2Conf "Transition from DEBOUNCING to CONFIRMED - Number of Fault" VALUE 0xFCCD26 __UWORD_Z 0 NO_COMPU_METHOD 0 65535 SYMBOL_LINK "xAdiaCalDataB" 902 /end CHARACTERISTIC
/begin CHARACTERISTIC FAN2_CAL.usrFilt2Conf " Transition from FILTERING to CONFIRM - Counter threshold" VALUE 0xFCCD2A __UWORD_Z 0 NO_COMPU_METHOD 0 65535 SYMBOL_LINK "xAdiaCalDataB" 906 /end CHARACTERISTIC
/begin CHARACTERISTIC FAN2_CAL.usrInConfOld "Init counter value in CONFIRMED_OLD status" VALUE 0xFCCD2C __UWORD_Z 0 NO_COMPU_METHOD 0 65535 SYMBOL_LINK "xAdiaCalDataB" 908 /end CHARACTERISTIC
/begin CHARACTERISTIC FAN2_CAL.usrStep "Counter increment value from DEBOUNCING to CONFIRMED status and init value in the FILTERING status" VALUE 0xFCCD28 __UBYTE_Z 0 NO_COMPU_METHOD 0 255 SYMBOL_LINK "xAdiaCalDataB" 904 /end CHARACTERISTIC
/begin CHARACTERISTIC FAN2_CAL.usrWucCntIni "Transition from DEVALIDATED to NO_ERROR - Number of warm-up cycles" VALUE 0xFCCD22 __UBYTE_Z 0 NO_COMPU_METHOD 0 255 SYMBOL_LINK "xAdiaCalDataB" 898 /end CHARACTERISTIC
/begin CHARACTERISTIC FAN2_CAL.xFlg.AdiaConfWord "Adia Configuration Word" VALUE 0xFCCD20 __UWORD_Z 0 NO_COMPU_METHOD 0 65535 SYMBOL_LINK "xAdiaCalDataB" 896 /end CHARACTERISTIC
/begin CHARACTERISTIC TH2H_CAL.usrConf2Deval "Transition from CONFIRMED to DEVALIDATED - Number of NO_FAULT" VALUE 0xFCCD32 __UWORD_Z 0 NO_COMPU_METHOD 0 65535 SYMBOL_LINK "xAdiaCalDataB" 914 /end CHARACTERISTIC
/begin CHARACTERISTIC TH2H_CAL.usrDeb2Conf "Transition from DEBOUNCING to CONFIRMED - Number of Fault" VALUE 0xFCCD34 __UWORD_Z 0 NO_COMPU_METHOD 0 65535 SYMBOL_LINK "xAdiaCalDataB" 916 /end CHARACTERISTIC
/begin CHARACTERISTIC TH2H_CAL.usrFilt2Conf " Transition from FILTERING to CONFIRM - Counter threshold" VALUE 0xFCCD38 __UWORD_Z 0 NO_COMPU_METHOD 0 65535 SYMBOL_LINK "xAdiaCalDataB" 920 /end CHARACTERISTIC
/begin CHARACTERISTIC TH2H_CAL.usrInConfOld "Init counter value in CONFIRMED_OLD status" VALUE 0xFCCD3A __UWORD_Z 0 NO_COMPU_METHOD 0 65535 SYMBOL_LINK "xAdiaCalDataB" 922 /end CHARACTERISTIC
/begin CHARACTERISTIC TH2H_CAL.usrStep "Counter increment value from DEBOUNCING to CONFIRMED status and init value in the FILTERING status" VALUE 0xFCCD36 __UBYTE_Z 0 NO_COMPU_METHOD 0 255 SYMBOL_LINK "xAdiaCalDataB" 918 /end CHARACTERISTIC
/begin CHARACTERISTIC TH2H_CAL.usrWucCntIni "Transition from DEVALIDATED to NO_ERROR - Number of warm-up cycles" VALUE 0xFCCD30 __UBYTE_Z 0 NO_COMPU_METHOD 0 255 SYMBOL_LINK "xAdiaCalDataB" 912 /end CHARACTERISTIC
/begin CHARACTERISTIC TH2H_CAL.xFlg.AdiaConfWord "Adia Configuration Word" VALUE 0xFCCD2E __UWORD_Z 0 NO_COMPU_METHOD 0 65535 SYMBOL_LINK "xAdiaCalDataB" 910 /end CHARACTERISTIC
/begin CHARACTERISTIC PO2L_CAL.usrConf2Deval "Transition from CONFIRMED to DEVALIDATED - Number of NO_FAULT" VALUE 0xFCCD40 __UWORD_Z 0 NO_COMPU_METHOD 0 65535 SYMBOL_LINK "xAdiaCalDataB" 928 /end CHARACTERISTIC
/begin CHARACTERISTIC PO2L_CAL.usrDeb2Conf "Transition from DEBOUNCING to CONFIRMED - Number of Fault" VALUE 0xFCCD42 __UWORD_Z 0 NO_COMPU_METHOD 0 65535 SYMBOL_LINK "xAdiaCalDataB" 930 /end CHARACTERISTIC
/begin CHARACTERISTIC PO2L_CAL.usrFilt2Conf " Transition from FILTERING to CONFIRM - Counter threshold" VALUE 0xFCCD46 __UWORD_Z 0 NO_COMPU_METHOD 0 65535 SYMBOL_LINK "xAdiaCalDataB" 934 /end CHARACTERISTIC
/begin CHARACTERISTIC PO2L_CAL.usrInConfOld "Init counter value in CONFIRMED_OLD status" VALUE 0xFCCD48 __UWORD_Z 0 NO_COMPU_METHOD 0 65535 SYMBOL_LINK "xAdiaCalDataB" 936 /end CHARACTERISTIC
/begin CHARACTERISTIC PO2L_CAL.usrStep "Counter increment value from DEBOUNCING to CONFIRMED status and init value in the FILTERING status" VALUE 0xFCCD44 __UBYTE_Z 0 NO_COMPU_METHOD 0 255 SYMBOL_LINK "xAdiaCalDataB" 932 /end CHARACTERISTIC
/begin CHARACTERISTIC PO2L_CAL.usrWucCntIni "Transition from DEVALIDATED to NO_ERROR - Number of warm-up cycles" VALUE 0xFCCD3E __UBYTE_Z 0 NO_COMPU_METHOD 0 255 SYMBOL_LINK "xAdiaCalDataB" 926 /end CHARACTERISTIC
/begin CHARACTERISTIC PO2L_CAL.xFlg.AdiaConfWord "Adia Configuration Word" VALUE 0xFCCD3C __UWORD_Z 0 NO_COMPU_METHOD 0 65535 SYMBOL_LINK "xAdiaCalDataB" 924 /end CHARACTERISTIC
/begin CHARACTERISTIC THRST_CAL.usrConf2Deval "Transition from CONFIRMED to DEVALIDATED - Number of NO_FAULT" VALUE 0xFCCD4E __UWORD_Z 0 NO_COMPU_METHOD 0 65535 SYMBOL_LINK "xAdiaCalDataB" 942 /end CHARACTERISTIC
/begin CHARACTERISTIC THRST_CAL.usrDeb2Conf "Transition from DEBOUNCING to CONFIRMED - Number of Fault" VALUE 0xFCCD50 __UWORD_Z 0 NO_COMPU_METHOD 0 65535 SYMBOL_LINK "xAdiaCalDataB" 944 /end CHARACTERISTIC
/begin CHARACTERISTIC THRST_CAL.usrFilt2Conf " Transition from FILTERING to CONFIRM - Counter threshold" VALUE 0xFCCD54 __UWORD_Z 0 NO_COMPU_METHOD 0 65535 SYMBOL_LINK "xAdiaCalDataB" 948 /end CHARACTERISTIC
/begin CHARACTERISTIC THRST_CAL.usrInConfOld "Init counter value in CONFIRMED_OLD status" VALUE 0xFCCD56 __UWORD_Z 0 NO_COMPU_METHOD 0 65535 SYMBOL_LINK "xAdiaCalDataB" 950 /end CHARACTERISTIC
/begin CHARACTERISTIC THRST_CAL.usrStep "Counter increment value from DEBOUNCING to CONFIRMED status and init value in the FILTERING status" VALUE 0xFCCD52 __UBYTE_Z 0 NO_COMPU_METHOD 0 255 SYMBOL_LINK "xAdiaCalDataB" 946 /end CHARACTERISTIC
/begin CHARACTERISTIC THRST_CAL.usrWucCntIni "Transition from DEVALIDATED to NO_ERROR - Number of warm-up cycles" VALUE 0xFCCD4C __UBYTE_Z 0 NO_COMPU_METHOD 0 255 SYMBOL_LINK "xAdiaCalDataB" 940 /end CHARACTERISTIC
/begin CHARACTERISTIC THRST_CAL.xFlg.AdiaConfWord "Adia Configuration Word" VALUE 0xFCCD4A __UWORD_Z 0 NO_COMPU_METHOD 0 65535 SYMBOL_LINK "xAdiaCalDataB" 938 /end CHARACTERISTIC
/begin CHARACTERISTIC SPEED_CAL.usrConf2Deval "Transition from CONFIRMED to DEVALIDATED - Number of NO_FAULT" VALUE 0xFCCD5C __UWORD_Z 0 NO_COMPU_METHOD 0 65535 SYMBOL_LINK "xAdiaCalDataB" 956 /end CHARACTERISTIC
/begin CHARACTERISTIC SPEED_CAL.usrDeb2Conf "Transition from DEBOUNCING to CONFIRMED - Number of Fault" VALUE 0xFCCD5E __UWORD_Z 0 NO_COMPU_METHOD 0 65535 SYMBOL_LINK "xAdiaCalDataB" 958 /end CHARACTERISTIC
/begin CHARACTERISTIC SPEED_CAL.usrFilt2Conf " Transition from FILTERING to CONFIRM - Counter threshold" VALUE 0xFCCD62 __UWORD_Z 0 NO_COMPU_METHOD 0 65535 SYMBOL_LINK "xAdiaCalDataB" 962 /end CHARACTERISTIC
/begin CHARACTERISTIC SPEED_CAL.usrInConfOld "Init counter value in CONFIRMED_OLD status" VALUE 0xFCCD64 __UWORD_Z 0 NO_COMPU_METHOD 0 65535 SYMBOL_LINK "xAdiaCalDataB" 964 /end CHARACTERISTIC
/begin CHARACTERISTIC SPEED_CAL.usrStep "Counter increment value from DEBOUNCING to CONFIRMED status and init value in the FILTERING status" VALUE 0xFCCD60 __UBYTE_Z 0 NO_COMPU_METHOD 0 255 SYMBOL_LINK "xAdiaCalDataB" 960 /end CHARACTERISTIC
/begin CHARACTERISTIC SPEED_CAL.usrWucCntIni "Transition from DEVALIDATED to NO_ERROR - Number of warm-up cycles" VALUE 0xFCCD5A __UBYTE_Z 0 NO_COMPU_METHOD 0 255 SYMBOL_LINK "xAdiaCalDataB" 954 /end CHARACTERISTIC
/begin CHARACTERISTIC SPEED_CAL.xFlg.AdiaConfWord "Adia Configuration Word" VALUE 0xFCCD58 __UWORD_Z 0 NO_COMPU_METHOD 0 65535 SYMBOL_LINK "xAdiaCalDataB" 952 /end CHARACTERISTIC
/begin CHARACTERISTIC THRDR_CAL.usrConf2Deval "Transition from CONFIRMED to DEVALIDATED - Number of NO_FAULT" VALUE 0xFCCD6A __UWORD_Z 0 NO_COMPU_METHOD 0 65535 SYMBOL_LINK "xAdiaCalDataB" 970 /end CHARACTERISTIC
/begin CHARACTERISTIC THRDR_CAL.usrDeb2Conf "Transition from DEBOUNCING to CONFIRMED - Number of Fault" VALUE 0xFCCD6C __UWORD_Z 0 NO_COMPU_METHOD 0 65535 SYMBOL_LINK "xAdiaCalDataB" 972 /end CHARACTERISTIC
/begin CHARACTERISTIC THRDR_CAL.usrFilt2Conf " Transition from FILTERING to CONFIRM - Counter threshold" VALUE 0xFCCD70 __UWORD_Z 0 NO_COMPU_METHOD 0 65535 SYMBOL_LINK "xAdiaCalDataB" 976 /end CHARACTERISTIC
/begin CHARACTERISTIC THRDR_CAL.usrInConfOld "Init counter value in CONFIRMED_OLD status" VALUE 0xFCCD72 __UWORD_Z 0 NO_COMPU_METHOD 0 65535 SYMBOL_LINK "xAdiaCalDataB" 978 /end CHARACTERISTIC
/begin CHARACTERISTIC THRDR_CAL.usrStep "Counter increment value from DEBOUNCING to CONFIRMED status and init value in the FILTERING status" VALUE 0xFCCD6E __UBYTE_Z 0 NO_COMPU_METHOD 0 255 SYMBOL_LINK "xAdiaCalDataB" 974 /end CHARACTERISTIC
/begin CHARACTERISTIC THRDR_CAL.usrWucCntIni "Transition from DEVALIDATED to NO_ERROR - Number of warm-up cycles" VALUE 0xFCCD68 __UBYTE_Z 0 NO_COMPU_METHOD 0 255 SYMBOL_LINK "xAdiaCalDataB" 968 /end CHARACTERISTIC
/begin CHARACTERISTIC THRDR_CAL.xFlg.AdiaConfWord "Adia Configuration Word" VALUE 0xFCCD66 __UWORD_Z 0 NO_COMPU_METHOD 0 65535 SYMBOL_LINK "xAdiaCalDataB" 966 /end CHARACTERISTIC
/begin CHARACTERISTIC STC_CAL.usrConf2Deval "Transition from CONFIRMED to DEVALIDATED - Number of NO_FAULT" VALUE 0xFCC9F8 __UWORD_Z 0 NO_COMPU_METHOD 0 65535 SYMBOL_LINK "xAdiaCalDataB" 88 /end CHARACTERISTIC
/begin CHARACTERISTIC STC_CAL.usrDeb2Conf "Transition from DEBOUNCING to CONFIRMED - Number of Fault" VALUE 0xFCC9FA __UWORD_Z 0 NO_COMPU_METHOD 0 65535 SYMBOL_LINK "xAdiaCalDataB" 90 /end CHARACTERISTIC
/begin CHARACTERISTIC STC_CAL.usrFilt2Conf " Transition from FILTERING to CONFIRM - Counter threshold" VALUE 0xFCC9FE __UWORD_Z 0 NO_COMPU_METHOD 0 65535 SYMBOL_LINK "xAdiaCalDataB" 94 /end CHARACTERISTIC
/begin CHARACTERISTIC STC_CAL.usrInConfOld "Init counter value in CONFIRMED_OLD status" VALUE 0xFCCA00 __UWORD_Z 0 NO_COMPU_METHOD 0 65535 SYMBOL_LINK "xAdiaCalDataB" 96 /end CHARACTERISTIC
/begin CHARACTERISTIC STC_CAL.usrStep "Counter increment value from DEBOUNCING to CONFIRMED status and init value in the FILTERING status" VALUE 0xFCC9FC __UBYTE_Z 0 NO_COMPU_METHOD 0 255 SYMBOL_LINK "xAdiaCalDataB" 92 /end CHARACTERISTIC
/begin CHARACTERISTIC STC_CAL.usrWucCntIni "Transition from DEVALIDATED to NO_ERROR - Number of warm-up cycles" VALUE 0xFCC9F6 __UBYTE_Z 0 NO_COMPU_METHOD 0 255 SYMBOL_LINK "xAdiaCalDataB" 86 /end CHARACTERISTIC
/begin CHARACTERISTIC STC_CAL.xFlg.AdiaConfWord "Adia Configuration Word" VALUE 0xFCC9F4 __UWORD_Z 0 NO_COMPU_METHOD 0 65535 SYMBOL_LINK "xAdiaCalDataB" 84 /end CHARACTERISTIC
/begin CHARACTERISTIC STRCGNDOL_CAL.usrConf2Deval "Transition from CONFIRMED to DEVALIDATED - Number of NO_FAULT" VALUE 0xFCCD78 __UWORD_Z 0 NO_COMPU_METHOD 0 65535 SYMBOL_LINK "xAdiaCalDataB" 984 /end CHARACTERISTIC
/begin CHARACTERISTIC STRCGNDOL_CAL.usrDeb2Conf "Transition from DEBOUNCING to CONFIRMED - Number of Fault" VALUE 0xFCCD7A __UWORD_Z 0 NO_COMPU_METHOD 0 65535 SYMBOL_LINK "xAdiaCalDataB" 986 /end CHARACTERISTIC
/begin CHARACTERISTIC STRCGNDOL_CAL.usrFilt2Conf " Transition from FILTERING to CONFIRM - Counter threshold" VALUE 0xFCCD7E __UWORD_Z 0 NO_COMPU_METHOD 0 65535 SYMBOL_LINK "xAdiaCalDataB" 990 /end CHARACTERISTIC
/begin CHARACTERISTIC STRCGNDOL_CAL.usrInConfOld "Init counter value in CONFIRMED_OLD status" VALUE 0xFCCD80 __UWORD_Z 0 NO_COMPU_METHOD 0 65535 SYMBOL_LINK "xAdiaCalDataB" 992 /end CHARACTERISTIC
/begin CHARACTERISTIC STRCGNDOL_CAL.usrStep "Counter increment value from DEBOUNCING to CONFIRMED status and init value in the FILTERING status" VALUE 0xFCCD7C __UBYTE_Z 0 NO_COMPU_METHOD 0 255 SYMBOL_LINK "xAdiaCalDataB" 988 /end CHARACTERISTIC
/begin CHARACTERISTIC STRCGNDOL_CAL.usrWucCntIni "Transition from DEVALIDATED to NO_ERROR - Number of warm-up cycles" VALUE 0xFCCD76 __UBYTE_Z 0 NO_COMPU_METHOD 0 255 SYMBOL_LINK "xAdiaCalDataB" 982 /end CHARACTERISTIC
/begin CHARACTERISTIC STRCGNDOL_CAL.xFlg.AdiaConfWord "Adia Configuration Word" VALUE 0xFCCD74 __UWORD_Z 0 NO_COMPU_METHOD 0 65535 SYMBOL_LINK "xAdiaCalDataB" 980 /end CHARACTERISTIC
/begin CHARACTERISTIC STRCVB_CAL.usrConf2Deval "Transition from CONFIRMED to DEVALIDATED - Number of NO_FAULT" VALUE 0xFCCD86 __UWORD_Z 0 NO_COMPU_METHOD 0 65535 SYMBOL_LINK "xAdiaCalDataB" 998 /end CHARACTERISTIC
/begin CHARACTERISTIC STRCVB_CAL.usrDeb2Conf "Transition from DEBOUNCING to CONFIRMED - Number of Fault" VALUE 0xFCCD88 __UWORD_Z 0 NO_COMPU_METHOD 0 65535 SYMBOL_LINK "xAdiaCalDataB" 1000 /end CHARACTERISTIC
/begin CHARACTERISTIC STRCVB_CAL.usrFilt2Conf " Transition from FILTERING to CONFIRM - Counter threshold" VALUE 0xFCCD8C __UWORD_Z 0 NO_COMPU_METHOD 0 65535 SYMBOL_LINK "xAdiaCalDataB" 1004 /end CHARACTERISTIC
/begin CHARACTERISTIC STRCVB_CAL.usrInConfOld "Init counter value in CONFIRMED_OLD status" VALUE 0xFCCD8E __UWORD_Z 0 NO_COMPU_METHOD 0 65535 SYMBOL_LINK "xAdiaCalDataB" 1006 /end CHARACTERISTIC
/begin CHARACTERISTIC STRCVB_CAL.usrStep "Counter increment value from DEBOUNCING to CONFIRMED status and init value in the FILTERING status" VALUE 0xFCCD8A __UBYTE_Z 0 NO_COMPU_METHOD 0 255 SYMBOL_LINK "xAdiaCalDataB" 1002 /end CHARACTERISTIC
/begin CHARACTERISTIC STRCVB_CAL.usrWucCntIni "Transition from DEVALIDATED to NO_ERROR - Number of warm-up cycles" VALUE 0xFCCD84 __UBYTE_Z 0 NO_COMPU_METHOD 0 255 SYMBOL_LINK "xAdiaCalDataB" 996 /end CHARACTERISTIC
/begin CHARACTERISTIC STRCVB_CAL.xFlg.AdiaConfWord "Adia Configuration Word" VALUE 0xFCCD82 __UWORD_Z 0 NO_COMPU_METHOD 0 65535 SYMBOL_LINK "xAdiaCalDataB" 994 /end CHARACTERISTIC
/begin CHARACTERISTIC SPP01_CAL.usrConf2Deval "Transition from CONFIRMED to DEVALIDATED - Number of NO_FAULT" VALUE 0xFCCD94 __UWORD_Z 0 NO_COMPU_METHOD 0 65535 SYMBOL_LINK "xAdiaCalDataB" 1012 /end CHARACTERISTIC
/begin CHARACTERISTIC SPP01_CAL.usrDeb2Conf "Transition from DEBOUNCING to CONFIRMED - Number of Fault" VALUE 0xFCCD96 __UWORD_Z 0 NO_COMPU_METHOD 0 65535 SYMBOL_LINK "xAdiaCalDataB" 1014 /end CHARACTERISTIC
/begin CHARACTERISTIC SPP01_CAL.usrFilt2Conf " Transition from FILTERING to CONFIRM - Counter threshold" VALUE 0xFCCD9A __UWORD_Z 0 NO_COMPU_METHOD 0 65535 SYMBOL_LINK "xAdiaCalDataB" 1018 /end CHARACTERISTIC
/begin CHARACTERISTIC SPP01_CAL.usrInConfOld "Init counter value in CONFIRMED_OLD status" VALUE 0xFCCD9C __UWORD_Z 0 NO_COMPU_METHOD 0 65535 SYMBOL_LINK "xAdiaCalDataB" 1020 /end CHARACTERISTIC
/begin CHARACTERISTIC SPP01_CAL.usrStep "Counter increment value from DEBOUNCING to CONFIRMED status and init value in the FILTERING status" VALUE 0xFCCD98 __UBYTE_Z 0 NO_COMPU_METHOD 0 255 SYMBOL_LINK "xAdiaCalDataB" 1016 /end CHARACTERISTIC
/begin CHARACTERISTIC SPP01_CAL.usrWucCntIni "Transition from DEVALIDATED to NO_ERROR - Number of warm-up cycles" VALUE 0xFCCD92 __UBYTE_Z 0 NO_COMPU_METHOD 0 255 SYMBOL_LINK "xAdiaCalDataB" 1010 /end CHARACTERISTIC
/begin CHARACTERISTIC SPP01_CAL.xFlg.AdiaConfWord "Adia Configuration Word" VALUE 0xFCCD90 __UWORD_Z 0 NO_COMPU_METHOD 0 65535 SYMBOL_LINK "xAdiaCalDataB" 1008 /end CHARACTERISTIC
/begin CHARACTERISTIC SPP02_CAL.usrConf2Deval "Transition from CONFIRMED to DEVALIDATED - Number of NO_FAULT" VALUE 0xFCCDA2 __UWORD_Z 0 NO_COMPU_METHOD 0 65535 SYMBOL_LINK "xAdiaCalDataB" 1026 /end CHARACTERISTIC
/begin CHARACTERISTIC SPP02_CAL.usrDeb2Conf "Transition from DEBOUNCING to CONFIRMED - Number of Fault" VALUE 0xFCCDA4 __UWORD_Z 0 NO_COMPU_METHOD 0 65535 SYMBOL_LINK "xAdiaCalDataB" 1028 /end CHARACTERISTIC
/begin CHARACTERISTIC SPP02_CAL.usrFilt2Conf " Transition from FILTERING to CONFIRM - Counter threshold" VALUE 0xFCCDA8 __UWORD_Z 0 NO_COMPU_METHOD 0 65535 SYMBOL_LINK "xAdiaCalDataB" 1032 /end CHARACTERISTIC
/begin CHARACTERISTIC SPP02_CAL.usrInConfOld "Init counter value in CONFIRMED_OLD status" VALUE 0xFCCDAA __UWORD_Z 0 NO_COMPU_METHOD 0 65535 SYMBOL_LINK "xAdiaCalDataB" 1034 /end CHARACTERISTIC
/begin CHARACTERISTIC SPP02_CAL.usrStep "Counter increment value from DEBOUNCING to CONFIRMED status and init value in the FILTERING status" VALUE 0xFCCDA6 __UBYTE_Z 0 NO_COMPU_METHOD 0 255 SYMBOL_LINK "xAdiaCalDataB" 1030 /end CHARACTERISTIC
/begin CHARACTERISTIC SPP02_CAL.usrWucCntIni "Transition from DEVALIDATED to NO_ERROR - Number of warm-up cycles" VALUE 0xFCCDA0 __UBYTE_Z 0 NO_COMPU_METHOD 0 255 SYMBOL_LINK "xAdiaCalDataB" 1024 /end CHARACTERISTIC
/begin CHARACTERISTIC SPP02_CAL.xFlg.AdiaConfWord "Adia Configuration Word" VALUE 0xFCCD9E __UWORD_Z 0 NO_COMPU_METHOD 0 65535 SYMBOL_LINK "xAdiaCalDataB" 1022 /end CHARACTERISTIC
/begin CHARACTERISTIC SPPC2_CAL.usrConf2Deval "Transition from CONFIRMED to DEVALIDATED - Number of NO_FAULT" VALUE 0xFCCDB0 __UWORD_Z 0 NO_COMPU_METHOD 0 65535 SYMBOL_LINK "xAdiaCalDataB" 1040 /end CHARACTERISTIC
/begin CHARACTERISTIC SPPC2_CAL.usrDeb2Conf "Transition from DEBOUNCING to CONFIRMED - Number of Fault" VALUE 0xFCCDB2 __UWORD_Z 0 NO_COMPU_METHOD 0 65535 SYMBOL_LINK "xAdiaCalDataB" 1042 /end CHARACTERISTIC
/begin CHARACTERISTIC SPPC2_CAL.usrFilt2Conf " Transition from FILTERING to CONFIRM - Counter threshold" VALUE 0xFCCDB6 __UWORD_Z 0 NO_COMPU_METHOD 0 65535 SYMBOL_LINK "xAdiaCalDataB" 1046 /end CHARACTERISTIC
/begin CHARACTERISTIC SPPC2_CAL.usrInConfOld "Init counter value in CONFIRMED_OLD status" VALUE 0xFCCDB8 __UWORD_Z 0 NO_COMPU_METHOD 0 65535 SYMBOL_LINK "xAdiaCalDataB" 1048 /end CHARACTERISTIC
/begin CHARACTERISTIC SPPC2_CAL.usrStep "Counter increment value from DEBOUNCING to CONFIRMED status and init value in the FILTERING status" VALUE 0xFCCDB4 __UBYTE_Z 0 NO_COMPU_METHOD 0 255 SYMBOL_LINK "xAdiaCalDataB" 1044 /end CHARACTERISTIC
/begin CHARACTERISTIC SPPC2_CAL.usrWucCntIni "Transition from DEVALIDATED to NO_ERROR - Number of warm-up cycles" VALUE 0xFCCDAE __UBYTE_Z 0 NO_COMPU_METHOD 0 255 SYMBOL_LINK "xAdiaCalDataB" 1038 /end CHARACTERISTIC
/begin CHARACTERISTIC SPPC2_CAL.xFlg.AdiaConfWord "Adia Configuration Word" VALUE 0xFCCDAC __UWORD_Z 0 NO_COMPU_METHOD 0 65535 SYMBOL_LINK "xAdiaCalDataB" 1036 /end CHARACTERISTIC
/begin CHARACTERISTIC SPPC1_CAL.usrConf2Deval "Transition from CONFIRMED to DEVALIDATED - Number of NO_FAULT" VALUE 0xFCCDBE __UWORD_Z 0 NO_COMPU_METHOD 0 65535 SYMBOL_LINK "xAdiaCalDataB" 1054 /end CHARACTERISTIC
/begin CHARACTERISTIC SPPC1_CAL.usrDeb2Conf "Transition from DEBOUNCING to CONFIRMED - Number of Fault" VALUE 0xFCCDC0 __UWORD_Z 0 NO_COMPU_METHOD 0 65535 SYMBOL_LINK "xAdiaCalDataB" 1056 /end CHARACTERISTIC
/begin CHARACTERISTIC SPPC1_CAL.usrFilt2Conf " Transition from FILTERING to CONFIRM - Counter threshold" VALUE 0xFCCDC4 __UWORD_Z 0 NO_COMPU_METHOD 0 65535 SYMBOL_LINK "xAdiaCalDataB" 1060 /end CHARACTERISTIC
/begin CHARACTERISTIC SPPC1_CAL.usrInConfOld "Init counter value in CONFIRMED_OLD status" VALUE 0xFCCDC6 __UWORD_Z 0 NO_COMPU_METHOD 0 65535 SYMBOL_LINK "xAdiaCalDataB" 1062 /end CHARACTERISTIC
/begin CHARACTERISTIC SPPC1_CAL.usrStep "Counter increment value from DEBOUNCING to CONFIRMED status and init value in the FILTERING status" VALUE 0xFCCDC2 __UBYTE_Z 0 NO_COMPU_METHOD 0 255 SYMBOL_LINK "xAdiaCalDataB" 1058 /end CHARACTERISTIC
/begin CHARACTERISTIC SPPC1_CAL.usrWucCntIni "Transition from DEVALIDATED to NO_ERROR - Number of warm-up cycles" VALUE 0xFCCDBC __UBYTE_Z 0 NO_COMPU_METHOD 0 255 SYMBOL_LINK "xAdiaCalDataB" 1052 /end CHARACTERISTIC
/begin CHARACTERISTIC SPPC1_CAL.xFlg.AdiaConfWord "Adia Configuration Word" VALUE 0xFCCDBA __UWORD_Z 0 NO_COMPU_METHOD 0 65535 SYMBOL_LINK "xAdiaCalDataB" 1050 /end CHARACTERISTIC
/begin CHARACTERISTIC SPPCH_CAL.usrConf2Deval "Transition from CONFIRMED to DEVALIDATED - Number of NO_FAULT" VALUE 0xFCCDCC __UWORD_Z 0 NO_COMPU_METHOD 0 65535 SYMBOL_LINK "xAdiaCalDataB" 1068 /end CHARACTERISTIC
/begin CHARACTERISTIC SPPCH_CAL.usrDeb2Conf "Transition from DEBOUNCING to CONFIRMED - Number of Fault" VALUE 0xFCCDCE __UWORD_Z 0 NO_COMPU_METHOD 0 65535 SYMBOL_LINK "xAdiaCalDataB" 1070 /end CHARACTERISTIC
/begin CHARACTERISTIC SPPCH_CAL.usrFilt2Conf " Transition from FILTERING to CONFIRM - Counter threshold" VALUE 0xFCCDD2 __UWORD_Z 0 NO_COMPU_METHOD 0 65535 SYMBOL_LINK "xAdiaCalDataB" 1074 /end CHARACTERISTIC
/begin CHARACTERISTIC SPPCH_CAL.usrInConfOld "Init counter value in CONFIRMED_OLD status" VALUE 0xFCCDD4 __UWORD_Z 0 NO_COMPU_METHOD 0 65535 SYMBOL_LINK "xAdiaCalDataB" 1076 /end CHARACTERISTIC
/begin CHARACTERISTIC SPPCH_CAL.usrStep "Counter increment value from DEBOUNCING to CONFIRMED status and init value in the FILTERING status" VALUE 0xFCCDD0 __UBYTE_Z 0 NO_COMPU_METHOD 0 255 SYMBOL_LINK "xAdiaCalDataB" 1072 /end CHARACTERISTIC
/begin CHARACTERISTIC SPPCH_CAL.usrWucCntIni "Transition from DEVALIDATED to NO_ERROR - Number of warm-up cycles" VALUE 0xFCCDCA __UBYTE_Z 0 NO_COMPU_METHOD 0 255 SYMBOL_LINK "xAdiaCalDataB" 1066 /end CHARACTERISTIC
/begin CHARACTERISTIC SPPCH_CAL.xFlg.AdiaConfWord "Adia Configuration Word" VALUE 0xFCCDC8 __UWORD_Z 0 NO_COMPU_METHOD 0 65535 SYMBOL_LINK "xAdiaCalDataB" 1064 /end CHARACTERISTIC
/begin CHARACTERISTIC BRKCH_CAL.usrConf2Deval "Transition from CONFIRMED to DEVALIDATED - Number of NO_FAULT" VALUE 0xFCCDDA __UWORD_Z 0 NO_COMPU_METHOD 0 65535 SYMBOL_LINK "xAdiaCalDataB" 1082 /end CHARACTERISTIC
/begin CHARACTERISTIC BRKCH_CAL.usrDeb2Conf "Transition from DEBOUNCING to CONFIRMED - Number of Fault" VALUE 0xFCCDDC __UWORD_Z 0 NO_COMPU_METHOD 0 65535 SYMBOL_LINK "xAdiaCalDataB" 1084 /end CHARACTERISTIC
/begin CHARACTERISTIC BRKCH_CAL.usrFilt2Conf " Transition from FILTERING to CONFIRM - Counter threshold" VALUE 0xFCCDE0 __UWORD_Z 0 NO_COMPU_METHOD 0 65535 SYMBOL_LINK "xAdiaCalDataB" 1088 /end CHARACTERISTIC
/begin CHARACTERISTIC BRKCH_CAL.usrInConfOld "Init counter value in CONFIRMED_OLD status" VALUE 0xFCCDE2 __UWORD_Z 0 NO_COMPU_METHOD 0 65535 SYMBOL_LINK "xAdiaCalDataB" 1090 /end CHARACTERISTIC
/begin CHARACTERISTIC BRKCH_CAL.usrStep "Counter increment value from DEBOUNCING to CONFIRMED status and init value in the FILTERING status" VALUE 0xFCCDDE __UBYTE_Z 0 NO_COMPU_METHOD 0 255 SYMBOL_LINK "xAdiaCalDataB" 1086 /end CHARACTERISTIC
/begin CHARACTERISTIC BRKCH_CAL.usrWucCntIni "Transition from DEVALIDATED to NO_ERROR - Number of warm-up cycles" VALUE 0xFCCDD8 __UBYTE_Z 0 NO_COMPU_METHOD 0 255 SYMBOL_LINK "xAdiaCalDataB" 1080 /end CHARACTERISTIC
/begin CHARACTERISTIC BRKCH_CAL.xFlg.AdiaConfWord "Adia Configuration Word" VALUE 0xFCCDD6 __UWORD_Z 0 NO_COMPU_METHOD 0 65535 SYMBOL_LINK "xAdiaCalDataB" 1078 /end CHARACTERISTIC
/begin CHARACTERISTIC SUO_CAL.usrConf2Deval "Transition from CONFIRMED to DEVALIDATED - Number of NO_FAULT" VALUE 0xFCCDE8 __UWORD_Z 0 NO_COMPU_METHOD 0 65535 SYMBOL_LINK "xAdiaCalDataB" 1096 /end CHARACTERISTIC
/begin CHARACTERISTIC SUO_CAL.usrDeb2Conf "Transition from DEBOUNCING to CONFIRMED - Number of Fault" VALUE 0xFCCDEA __UWORD_Z 0 NO_COMPU_METHOD 0 65535 SYMBOL_LINK "xAdiaCalDataB" 1098 /end CHARACTERISTIC
/begin CHARACTERISTIC SUO_CAL.usrFilt2Conf " Transition from FILTERING to CONFIRM - Counter threshold" VALUE 0xFCCDEE __UWORD_Z 0 NO_COMPU_METHOD 0 65535 SYMBOL_LINK "xAdiaCalDataB" 1102 /end CHARACTERISTIC
/begin CHARACTERISTIC SUO_CAL.usrInConfOld "Init counter value in CONFIRMED_OLD status" VALUE 0xFCCDF0 __UWORD_Z 0 NO_COMPU_METHOD 0 65535 SYMBOL_LINK "xAdiaCalDataB" 1104 /end CHARACTERISTIC
/begin CHARACTERISTIC SUO_CAL.usrStep "Counter increment value from DEBOUNCING to CONFIRMED status and init value in the FILTERING status" VALUE 0xFCCDEC __UBYTE_Z 0 NO_COMPU_METHOD 0 255 SYMBOL_LINK "xAdiaCalDataB" 1100 /end CHARACTERISTIC
/begin CHARACTERISTIC SUO_CAL.usrWucCntIni "Transition from DEVALIDATED to NO_ERROR - Number of warm-up cycles" VALUE 0xFCCDE6 __UBYTE_Z 0 NO_COMPU_METHOD 0 255 SYMBOL_LINK "xAdiaCalDataB" 1094 /end CHARACTERISTIC
/begin CHARACTERISTIC SUO_CAL.xFlg.AdiaConfWord "Adia Configuration Word" VALUE 0xFCCDE4 __UWORD_Z 0 NO_COMPU_METHOD 0 65535 SYMBOL_LINK "xAdiaCalDataB" 1092 /end CHARACTERISTIC
/begin CHARACTERISTIC UDP_CAL.usrConf2Deval "Transition from CONFIRMED to DEVALIDATED - Number of NO_FAULT" VALUE 0xFCCDF6 __UWORD_Z 0 NO_COMPU_METHOD 0 65535 SYMBOL_LINK "xAdiaCalDataB" 1110 /end CHARACTERISTIC
/begin CHARACTERISTIC UDP_CAL.usrDeb2Conf "Transition from DEBOUNCING to CONFIRMED - Number of Fault" VALUE 0xFCCDF8 __UWORD_Z 0 NO_COMPU_METHOD 0 65535 SYMBOL_LINK "xAdiaCalDataB" 1112 /end CHARACTERISTIC
/begin CHARACTERISTIC UDP_CAL.usrFilt2Conf " Transition from FILTERING to CONFIRM - Counter threshold" VALUE 0xFCCDFC __UWORD_Z 0 NO_COMPU_METHOD 0 65535 SYMBOL_LINK "xAdiaCalDataB" 1116 /end CHARACTERISTIC
/begin CHARACTERISTIC UDP_CAL.usrInConfOld "Init counter value in CONFIRMED_OLD status" VALUE 0xFCCDFE __UWORD_Z 0 NO_COMPU_METHOD 0 65535 SYMBOL_LINK "xAdiaCalDataB" 1118 /end CHARACTERISTIC
/begin CHARACTERISTIC UDP_CAL.usrStep "Counter increment value from DEBOUNCING to CONFIRMED status and init value in the FILTERING status" VALUE 0xFCCDFA __UBYTE_Z 0 NO_COMPU_METHOD 0 255 SYMBOL_LINK "xAdiaCalDataB" 1114 /end CHARACTERISTIC
/begin CHARACTERISTIC UDP_CAL.usrWucCntIni "Transition from DEVALIDATED to NO_ERROR - Number of warm-up cycles" VALUE 0xFCCDF4 __UBYTE_Z 0 NO_COMPU_METHOD 0 255 SYMBOL_LINK "xAdiaCalDataB" 1108 /end CHARACTERISTIC
/begin CHARACTERISTIC UDP_CAL.xFlg.AdiaConfWord "Adia Configuration Word" VALUE 0xFCCDF2 __UWORD_Z 0 NO_COMPU_METHOD 0 65535 SYMBOL_LINK "xAdiaCalDataB" 1106 /end CHARACTERISTIC
/begin CHARACTERISTIC SPM_CAL.usrConf2Deval "Transition from CONFIRMED to DEVALIDATED - Number of NO_FAULT" VALUE 0xFCCA06 __UWORD_Z 0 NO_COMPU_METHOD 0 65535 SYMBOL_LINK "xAdiaCalDataB" 102 /end CHARACTERISTIC
/begin CHARACTERISTIC SPM_CAL.usrDeb2Conf "Transition from DEBOUNCING to CONFIRMED - Number of Fault" VALUE 0xFCCA08 __UWORD_Z 0 NO_COMPU_METHOD 0 65535 SYMBOL_LINK "xAdiaCalDataB" 104 /end CHARACTERISTIC
/begin CHARACTERISTIC SPM_CAL.usrFilt2Conf " Transition from FILTERING to CONFIRM - Counter threshold" VALUE 0xFCCA0C __UWORD_Z 0 NO_COMPU_METHOD 0 65535 SYMBOL_LINK "xAdiaCalDataB" 108 /end CHARACTERISTIC
/begin CHARACTERISTIC SPM_CAL.usrInConfOld "Init counter value in CONFIRMED_OLD status" VALUE 0xFCCA0E __UWORD_Z 0 NO_COMPU_METHOD 0 65535 SYMBOL_LINK "xAdiaCalDataB" 110 /end CHARACTERISTIC
/begin CHARACTERISTIC SPM_CAL.usrStep "Counter increment value from DEBOUNCING to CONFIRMED status and init value in the FILTERING status" VALUE 0xFCCA0A __UBYTE_Z 0 NO_COMPU_METHOD 0 255 SYMBOL_LINK "xAdiaCalDataB" 106 /end CHARACTERISTIC
/begin CHARACTERISTIC SPM_CAL.usrWucCntIni "Transition from DEVALIDATED to NO_ERROR - Number of warm-up cycles" VALUE 0xFCCA04 __UBYTE_Z 0 NO_COMPU_METHOD 0 255 SYMBOL_LINK "xAdiaCalDataB" 100 /end CHARACTERISTIC
/begin CHARACTERISTIC SPM_CAL.xFlg.AdiaConfWord "Adia Configuration Word" VALUE 0xFCCA02 __UWORD_Z 0 NO_COMPU_METHOD 0 65535 SYMBOL_LINK "xAdiaCalDataB" 98 /end CHARACTERISTIC
/begin CHARACTERISTIC UHR_CAL.usrConf2Deval "Transition from CONFIRMED to DEVALIDATED - Number of NO_FAULT" VALUE 0xFCCE04 __UWORD_Z 0 NO_COMPU_METHOD 0 65535 SYMBOL_LINK "xAdiaCalDataB" 1124 /end CHARACTERISTIC
/begin CHARACTERISTIC UHR_CAL.usrDeb2Conf "Transition from DEBOUNCING to CONFIRMED - Number of Fault" VALUE 0xFCCE06 __UWORD_Z 0 NO_COMPU_METHOD 0 65535 SYMBOL_LINK "xAdiaCalDataB" 1126 /end CHARACTERISTIC
/begin CHARACTERISTIC UHR_CAL.usrFilt2Conf " Transition from FILTERING to CONFIRM - Counter threshold" VALUE 0xFCCE0A __UWORD_Z 0 NO_COMPU_METHOD 0 65535 SYMBOL_LINK "xAdiaCalDataB" 1130 /end CHARACTERISTIC
/begin CHARACTERISTIC UHR_CAL.usrInConfOld "Init counter value in CONFIRMED_OLD status" VALUE 0xFCCE0C __UWORD_Z 0 NO_COMPU_METHOD 0 65535 SYMBOL_LINK "xAdiaCalDataB" 1132 /end CHARACTERISTIC
/begin CHARACTERISTIC UHR_CAL.usrStep "Counter increment value from DEBOUNCING to CONFIRMED status and init value in the FILTERING status" VALUE 0xFCCE08 __UBYTE_Z 0 NO_COMPU_METHOD 0 255 SYMBOL_LINK "xAdiaCalDataB" 1128 /end CHARACTERISTIC
/begin CHARACTERISTIC UHR_CAL.usrWucCntIni "Transition from DEVALIDATED to NO_ERROR - Number of warm-up cycles" VALUE 0xFCCE02 __UBYTE_Z 0 NO_COMPU_METHOD 0 255 SYMBOL_LINK "xAdiaCalDataB" 1122 /end CHARACTERISTIC
/begin CHARACTERISTIC UHR_CAL.xFlg.AdiaConfWord "Adia Configuration Word" VALUE 0xFCCE00 __UWORD_Z 0 NO_COMPU_METHOD 0 65535 SYMBOL_LINK "xAdiaCalDataB" 1120 /end CHARACTERISTIC
/begin CHARACTERISTIC SK1_CAL.usrConf2Deval "Transition from CONFIRMED to DEVALIDATED - Number of NO_FAULT" VALUE 0xFCCE12 __UWORD_Z 0 NO_COMPU_METHOD 0 65535 SYMBOL_LINK "xAdiaCalDataB" 1138 /end CHARACTERISTIC
/begin CHARACTERISTIC SK1_CAL.usrDeb2Conf "Transition from DEBOUNCING to CONFIRMED - Number of Fault" VALUE 0xFCCE14 __UWORD_Z 0 NO_COMPU_METHOD 0 65535 SYMBOL_LINK "xAdiaCalDataB" 1140 /end CHARACTERISTIC
/begin CHARACTERISTIC SK1_CAL.usrFilt2Conf " Transition from FILTERING to CONFIRM - Counter threshold" VALUE 0xFCCE18 __UWORD_Z 0 NO_COMPU_METHOD 0 65535 SYMBOL_LINK "xAdiaCalDataB" 1144 /end CHARACTERISTIC
/begin CHARACTERISTIC SK1_CAL.usrInConfOld "Init counter value in CONFIRMED_OLD status" VALUE 0xFCCE1A __UWORD_Z 0 NO_COMPU_METHOD 0 65535 SYMBOL_LINK "xAdiaCalDataB" 1146 /end CHARACTERISTIC
/begin CHARACTERISTIC SK1_CAL.usrStep "Counter increment value from DEBOUNCING to CONFIRMED status and init value in the FILTERING status" VALUE 0xFCCE16 __UBYTE_Z 0 NO_COMPU_METHOD 0 255 SYMBOL_LINK "xAdiaCalDataB" 1142 /end CHARACTERISTIC
/begin CHARACTERISTIC SK1_CAL.usrWucCntIni "Transition from DEVALIDATED to NO_ERROR - Number of warm-up cycles" VALUE 0xFCCE10 __UBYTE_Z 0 NO_COMPU_METHOD 0 255 SYMBOL_LINK "xAdiaCalDataB" 1136 /end CHARACTERISTIC
/begin CHARACTERISTIC SK1_CAL.xFlg.AdiaConfWord "Adia Configuration Word" VALUE 0xFCCE0E __UWORD_Z 0 NO_COMPU_METHOD 0 65535 SYMBOL_LINK "xAdiaCalDataB" 1134 /end CHARACTERISTIC
/begin CHARACTERISTIC SK2_CAL.usrConf2Deval "Transition from CONFIRMED to DEVALIDATED - Number of NO_FAULT" VALUE 0xFCCE20 __UWORD_Z 0 NO_COMPU_METHOD 0 65535 SYMBOL_LINK "xAdiaCalDataB" 1152 /end CHARACTERISTIC
/begin CHARACTERISTIC SK2_CAL.usrDeb2Conf "Transition from DEBOUNCING to CONFIRMED - Number of Fault" VALUE 0xFCCE22 __UWORD_Z 0 NO_COMPU_METHOD 0 65535 SYMBOL_LINK "xAdiaCalDataB" 1154 /end CHARACTERISTIC
/begin CHARACTERISTIC SK2_CAL.usrFilt2Conf " Transition from FILTERING to CONFIRM - Counter threshold" VALUE 0xFCCE26 __UWORD_Z 0 NO_COMPU_METHOD 0 65535 SYMBOL_LINK "xAdiaCalDataB" 1158 /end CHARACTERISTIC
/begin CHARACTERISTIC SK2_CAL.usrInConfOld "Init counter value in CONFIRMED_OLD status" VALUE 0xFCCE28 __UWORD_Z 0 NO_COMPU_METHOD 0 65535 SYMBOL_LINK "xAdiaCalDataB" 1160 /end CHARACTERISTIC
/begin CHARACTERISTIC SK2_CAL.usrStep "Counter increment value from DEBOUNCING to CONFIRMED status and init value in the FILTERING status" VALUE 0xFCCE24 __UBYTE_Z 0 NO_COMPU_METHOD 0 255 SYMBOL_LINK "xAdiaCalDataB" 1156 /end CHARACTERISTIC
/begin CHARACTERISTIC SK2_CAL.usrWucCntIni "Transition from DEVALIDATED to NO_ERROR - Number of warm-up cycles" VALUE 0xFCCE1E __UBYTE_Z 0 NO_COMPU_METHOD 0 255 SYMBOL_LINK "xAdiaCalDataB" 1150 /end CHARACTERISTIC
/begin CHARACTERISTIC SK2_CAL.xFlg.AdiaConfWord "Adia Configuration Word" VALUE 0xFCCE1C __UWORD_Z 0 NO_COMPU_METHOD 0 65535 SYMBOL_LINK "xAdiaCalDataB" 1148 /end CHARACTERISTIC
/begin CHARACTERISTIC SK3_CAL.usrConf2Deval "Transition from CONFIRMED to DEVALIDATED - Number of NO_FAULT" VALUE 0xFCCE2E __UWORD_Z 0 NO_COMPU_METHOD 0 65535 SYMBOL_LINK "xAdiaCalDataB" 1166 /end CHARACTERISTIC
/begin CHARACTERISTIC SK3_CAL.usrDeb2Conf "Transition from DEBOUNCING to CONFIRMED - Number of Fault" VALUE 0xFCCE30 __UWORD_Z 0 NO_COMPU_METHOD 0 65535 SYMBOL_LINK "xAdiaCalDataB" 1168 /end CHARACTERISTIC
/begin CHARACTERISTIC SK3_CAL.usrFilt2Conf " Transition from FILTERING to CONFIRM - Counter threshold" VALUE 0xFCCE34 __UWORD_Z 0 NO_COMPU_METHOD 0 65535 SYMBOL_LINK "xAdiaCalDataB" 1172 /end CHARACTERISTIC
/begin CHARACTERISTIC SK3_CAL.usrInConfOld "Init counter value in CONFIRMED_OLD status" VALUE 0xFCCE36 __UWORD_Z 0 NO_COMPU_METHOD 0 65535 SYMBOL_LINK "xAdiaCalDataB" 1174 /end CHARACTERISTIC
/begin CHARACTERISTIC SK3_CAL.usrStep "Counter increment value from DEBOUNCING to CONFIRMED status and init value in the FILTERING status" VALUE 0xFCCE32 __UBYTE_Z 0 NO_COMPU_METHOD 0 255 SYMBOL_LINK "xAdiaCalDataB" 1170 /end CHARACTERISTIC
/begin CHARACTERISTIC SK3_CAL.usrWucCntIni "Transition from DEVALIDATED to NO_ERROR - Number of warm-up cycles" VALUE 0xFCCE2C __UBYTE_Z 0 NO_COMPU_METHOD 0 255 SYMBOL_LINK "xAdiaCalDataB" 1164 /end CHARACTERISTIC
/begin CHARACTERISTIC SK3_CAL.xFlg.AdiaConfWord "Adia Configuration Word" VALUE 0xFCCE2A __UWORD_Z 0 NO_COMPU_METHOD 0 65535 SYMBOL_LINK "xAdiaCalDataB" 1162 /end CHARACTERISTIC
/begin CHARACTERISTIC SK4_CAL.usrConf2Deval "Transition from CONFIRMED to DEVALIDATED - Number of NO_FAULT" VALUE 0xFCCE3C __UWORD_Z 0 NO_COMPU_METHOD 0 65535 SYMBOL_LINK "xAdiaCalDataB" 1180 /end CHARACTERISTIC
/begin CHARACTERISTIC SK4_CAL.usrDeb2Conf "Transition from DEBOUNCING to CONFIRMED - Number of Fault" VALUE 0xFCCE3E __UWORD_Z 0 NO_COMPU_METHOD 0 65535 SYMBOL_LINK "xAdiaCalDataB" 1182 /end CHARACTERISTIC
/begin CHARACTERISTIC SK4_CAL.usrFilt2Conf " Transition from FILTERING to CONFIRM - Counter threshold" VALUE 0xFCCE42 __UWORD_Z 0 NO_COMPU_METHOD 0 65535 SYMBOL_LINK "xAdiaCalDataB" 1186 /end CHARACTERISTIC
/begin CHARACTERISTIC SK4_CAL.usrInConfOld "Init counter value in CONFIRMED_OLD status" VALUE 0xFCCE44 __UWORD_Z 0 NO_COMPU_METHOD 0 65535 SYMBOL_LINK "xAdiaCalDataB" 1188 /end CHARACTERISTIC
/begin CHARACTERISTIC SK4_CAL.usrStep "Counter increment value from DEBOUNCING to CONFIRMED status and init value in the FILTERING status" VALUE 0xFCCE40 __UBYTE_Z 0 NO_COMPU_METHOD 0 255 SYMBOL_LINK "xAdiaCalDataB" 1184 /end CHARACTERISTIC
/begin CHARACTERISTIC SK4_CAL.usrWucCntIni "Transition from DEVALIDATED to NO_ERROR - Number of warm-up cycles" VALUE 0xFCCE3A __UBYTE_Z 0 NO_COMPU_METHOD 0 255 SYMBOL_LINK "xAdiaCalDataB" 1178 /end CHARACTERISTIC
/begin CHARACTERISTIC SK4_CAL.xFlg.AdiaConfWord "Adia Configuration Word" VALUE 0xFCCE38 __UWORD_Z 0 NO_COMPU_METHOD 0 65535 SYMBOL_LINK "xAdiaCalDataB" 1176 /end CHARACTERISTIC
/begin CHARACTERISTIC SK5_CAL.usrConf2Deval "Transition from CONFIRMED to DEVALIDATED - Number of NO_FAULT" VALUE 0xFCCE4A __UWORD_Z 0 NO_COMPU_METHOD 0 65535 SYMBOL_LINK "xAdiaCalDataB" 1194 /end CHARACTERISTIC
/begin CHARACTERISTIC SK5_CAL.usrDeb2Conf "Transition from DEBOUNCING to CONFIRMED - Number of Fault" VALUE 0xFCCE4C __UWORD_Z 0 NO_COMPU_METHOD 0 65535 SYMBOL_LINK "xAdiaCalDataB" 1196 /end CHARACTERISTIC
/begin CHARACTERISTIC SK5_CAL.usrFilt2Conf " Transition from FILTERING to CONFIRM - Counter threshold" VALUE 0xFCCE50 __UWORD_Z 0 NO_COMPU_METHOD 0 65535 SYMBOL_LINK "xAdiaCalDataB" 1200 /end CHARACTERISTIC
/begin CHARACTERISTIC SK5_CAL.usrInConfOld "Init counter value in CONFIRMED_OLD status" VALUE 0xFCCE52 __UWORD_Z 0 NO_COMPU_METHOD 0 65535 SYMBOL_LINK "xAdiaCalDataB" 1202 /end CHARACTERISTIC
/begin CHARACTERISTIC SK5_CAL.usrStep "Counter increment value from DEBOUNCING to CONFIRMED status and init value in the FILTERING status" VALUE 0xFCCE4E __UBYTE_Z 0 NO_COMPU_METHOD 0 255 SYMBOL_LINK "xAdiaCalDataB" 1198 /end CHARACTERISTIC
/begin CHARACTERISTIC SK5_CAL.usrWucCntIni "Transition from DEVALIDATED to NO_ERROR - Number of warm-up cycles" VALUE 0xFCCE48 __UBYTE_Z 0 NO_COMPU_METHOD 0 255 SYMBOL_LINK "xAdiaCalDataB" 1192 /end CHARACTERISTIC
/begin CHARACTERISTIC SK5_CAL.xFlg.AdiaConfWord "Adia Configuration Word" VALUE 0xFCCE46 __UWORD_Z 0 NO_COMPU_METHOD 0 65535 SYMBOL_LINK "xAdiaCalDataB" 1190 /end CHARACTERISTIC
/begin CHARACTERISTIC SK6_CAL.usrConf2Deval "Transition from CONFIRMED to DEVALIDATED - Number of NO_FAULT" VALUE 0xFCCE58 __UWORD_Z 0 NO_COMPU_METHOD 0 65535 SYMBOL_LINK "xAdiaCalDataB" 1208 /end CHARACTERISTIC
/begin CHARACTERISTIC SK6_CAL.usrDeb2Conf "Transition from DEBOUNCING to CONFIRMED - Number of Fault" VALUE 0xFCCE5A __UWORD_Z 0 NO_COMPU_METHOD 0 65535 SYMBOL_LINK "xAdiaCalDataB" 1210 /end CHARACTERISTIC
/begin CHARACTERISTIC SK6_CAL.usrFilt2Conf " Transition from FILTERING to CONFIRM - Counter threshold" VALUE 0xFCCE5E __UWORD_Z 0 NO_COMPU_METHOD 0 65535 SYMBOL_LINK "xAdiaCalDataB" 1214 /end CHARACTERISTIC
/begin CHARACTERISTIC SK6_CAL.usrInConfOld "Init counter value in CONFIRMED_OLD status" VALUE 0xFCCE60 __UWORD_Z 0 NO_COMPU_METHOD 0 65535 SYMBOL_LINK "xAdiaCalDataB" 1216 /end CHARACTERISTIC
/begin CHARACTERISTIC SK6_CAL.usrStep "Counter increment value from DEBOUNCING to CONFIRMED status and init value in the FILTERING status" VALUE 0xFCCE5C __UBYTE_Z 0 NO_COMPU_METHOD 0 255 SYMBOL_LINK "xAdiaCalDataB" 1212 /end CHARACTERISTIC
/begin CHARACTERISTIC SK6_CAL.usrWucCntIni "Transition from DEVALIDATED to NO_ERROR - Number of warm-up cycles" VALUE 0xFCCE56 __UBYTE_Z 0 NO_COMPU_METHOD 0 255 SYMBOL_LINK "xAdiaCalDataB" 1206 /end CHARACTERISTIC
/begin CHARACTERISTIC SK6_CAL.xFlg.AdiaConfWord "Adia Configuration Word" VALUE 0xFCCE54 __UWORD_Z 0 NO_COMPU_METHOD 0 65535 SYMBOL_LINK "xAdiaCalDataB" 1204 /end CHARACTERISTIC
/begin CHARACTERISTIC SK7_CAL.usrConf2Deval "Transition from CONFIRMED to DEVALIDATED - Number of NO_FAULT" VALUE 0xFCCE66 __UWORD_Z 0 NO_COMPU_METHOD 0 65535 SYMBOL_LINK "xAdiaCalDataB" 1222 /end CHARACTERISTIC
/begin CHARACTERISTIC SK7_CAL.usrDeb2Conf "Transition from DEBOUNCING to CONFIRMED - Number of Fault" VALUE 0xFCCE68 __UWORD_Z 0 NO_COMPU_METHOD 0 65535 SYMBOL_LINK "xAdiaCalDataB" 1224 /end CHARACTERISTIC
/begin CHARACTERISTIC SK7_CAL.usrFilt2Conf " Transition from FILTERING to CONFIRM - Counter threshold" VALUE 0xFCCE6C __UWORD_Z 0 NO_COMPU_METHOD 0 65535 SYMBOL_LINK "xAdiaCalDataB" 1228 /end CHARACTERISTIC
/begin CHARACTERISTIC SK7_CAL.usrInConfOld "Init counter value in CONFIRMED_OLD status" VALUE 0xFCCE6E __UWORD_Z 0 NO_COMPU_METHOD 0 65535 SYMBOL_LINK "xAdiaCalDataB" 1230 /end CHARACTERISTIC
/begin CHARACTERISTIC SK7_CAL.usrStep "Counter increment value from DEBOUNCING to CONFIRMED status and init value in the FILTERING status" VALUE 0xFCCE6A __UBYTE_Z 0 NO_COMPU_METHOD 0 255 SYMBOL_LINK "xAdiaCalDataB" 1226 /end CHARACTERISTIC
/begin CHARACTERISTIC SK7_CAL.usrWucCntIni "Transition from DEVALIDATED to NO_ERROR - Number of warm-up cycles" VALUE 0xFCCE64 __UBYTE_Z 0 NO_COMPU_METHOD 0 255 SYMBOL_LINK "xAdiaCalDataB" 1220 /end CHARACTERISTIC
/begin CHARACTERISTIC SK7_CAL.xFlg.AdiaConfWord "Adia Configuration Word" VALUE 0xFCCE62 __UWORD_Z 0 NO_COMPU_METHOD 0 65535 SYMBOL_LINK "xAdiaCalDataB" 1218 /end CHARACTERISTIC
/begin CHARACTERISTIC SK8_CAL.usrConf2Deval "Transition from CONFIRMED to DEVALIDATED - Number of NO_FAULT" VALUE 0xFCCE74 __UWORD_Z 0 NO_COMPU_METHOD 0 65535 SYMBOL_LINK "xAdiaCalDataB" 1236 /end CHARACTERISTIC
/begin CHARACTERISTIC SK8_CAL.usrDeb2Conf "Transition from DEBOUNCING to CONFIRMED - Number of Fault" VALUE 0xFCCE76 __UWORD_Z 0 NO_COMPU_METHOD 0 65535 SYMBOL_LINK "xAdiaCalDataB" 1238 /end CHARACTERISTIC
/begin CHARACTERISTIC SK8_CAL.usrFilt2Conf " Transition from FILTERING to CONFIRM - Counter threshold" VALUE 0xFCCE7A __UWORD_Z 0 NO_COMPU_METHOD 0 65535 SYMBOL_LINK "xAdiaCalDataB" 1242 /end CHARACTERISTIC
/begin CHARACTERISTIC SK8_CAL.usrInConfOld "Init counter value in CONFIRMED_OLD status" VALUE 0xFCCE7C __UWORD_Z 0 NO_COMPU_METHOD 0 65535 SYMBOL_LINK "xAdiaCalDataB" 1244 /end CHARACTERISTIC
/begin CHARACTERISTIC SK8_CAL.usrStep "Counter increment value from DEBOUNCING to CONFIRMED status and init value in the FILTERING status" VALUE 0xFCCE78 __UBYTE_Z 0 NO_COMPU_METHOD 0 255 SYMBOL_LINK "xAdiaCalDataB" 1240 /end CHARACTERISTIC
/begin CHARACTERISTIC SK8_CAL.usrWucCntIni "Transition from DEVALIDATED to NO_ERROR - Number of warm-up cycles" VALUE 0xFCCE72 __UBYTE_Z 0 NO_COMPU_METHOD 0 255 SYMBOL_LINK "xAdiaCalDataB" 1234 /end CHARACTERISTIC
/begin CHARACTERISTIC SK8_CAL.xFlg.AdiaConfWord "Adia Configuration Word" VALUE 0xFCCE70 __UWORD_Z 0 NO_COMPU_METHOD 0 65535 SYMBOL_LINK "xAdiaCalDataB" 1232 /end CHARACTERISTIC
/begin CHARACTERISTIC WRNL_CAL.usrConf2Deval "Transition from CONFIRMED to DEVALIDATED - Number of NO_FAULT" VALUE 0xFCCE82 __UWORD_Z 0 NO_COMPU_METHOD 0 65535 SYMBOL_LINK "xAdiaCalDataB" 1250 /end CHARACTERISTIC
/begin CHARACTERISTIC WRNL_CAL.usrDeb2Conf "Transition from DEBOUNCING to CONFIRMED - Number of Fault" VALUE 0xFCCE84 __UWORD_Z 0 NO_COMPU_METHOD 0 65535 SYMBOL_LINK "xAdiaCalDataB" 1252 /end CHARACTERISTIC
/begin CHARACTERISTIC WRNL_CAL.usrFilt2Conf " Transition from FILTERING to CONFIRM - Counter threshold" VALUE 0xFCCE88 __UWORD_Z 0 NO_COMPU_METHOD 0 65535 SYMBOL_LINK "xAdiaCalDataB" 1256 /end CHARACTERISTIC
/begin CHARACTERISTIC WRNL_CAL.usrInConfOld "Init counter value in CONFIRMED_OLD status" VALUE 0xFCCE8A __UWORD_Z 0 NO_COMPU_METHOD 0 65535 SYMBOL_LINK "xAdiaCalDataB" 1258 /end CHARACTERISTIC
/begin CHARACTERISTIC WRNL_CAL.usrStep "Counter increment value from DEBOUNCING to CONFIRMED status and init value in the FILTERING status" VALUE 0xFCCE86 __UBYTE_Z 0 NO_COMPU_METHOD 0 255 SYMBOL_LINK "xAdiaCalDataB" 1254 /end CHARACTERISTIC
/begin CHARACTERISTIC WRNL_CAL.usrWucCntIni "Transition from DEVALIDATED to NO_ERROR - Number of warm-up cycles" VALUE 0xFCCE80 __UBYTE_Z 0 NO_COMPU_METHOD 0 255 SYMBOL_LINK "xAdiaCalDataB" 1248 /end CHARACTERISTIC
/begin CHARACTERISTIC WRNL_CAL.xFlg.AdiaConfWord "Adia Configuration Word" VALUE 0xFCCE7E __UWORD_Z 0 NO_COMPU_METHOD 0 65535 SYMBOL_LINK "xAdiaCalDataB" 1246 /end CHARACTERISTIC
/begin CHARACTERISTIC SPB_CAL.usrConf2Deval "Transition from CONFIRMED to DEVALIDATED - Number of NO_FAULT" VALUE 0xFCCA14 __UWORD_Z 0 NO_COMPU_METHOD 0 65535 SYMBOL_LINK "xAdiaCalDataB" 116 /end CHARACTERISTIC
/begin CHARACTERISTIC SPB_CAL.usrDeb2Conf "Transition from DEBOUNCING to CONFIRMED - Number of Fault" VALUE 0xFCCA16 __UWORD_Z 0 NO_COMPU_METHOD 0 65535 SYMBOL_LINK "xAdiaCalDataB" 118 /end CHARACTERISTIC
/begin CHARACTERISTIC SPB_CAL.usrFilt2Conf " Transition from FILTERING to CONFIRM - Counter threshold" VALUE 0xFCCA1A __UWORD_Z 0 NO_COMPU_METHOD 0 65535 SYMBOL_LINK "xAdiaCalDataB" 122 /end CHARACTERISTIC
/begin CHARACTERISTIC SPB_CAL.usrInConfOld "Init counter value in CONFIRMED_OLD status" VALUE 0xFCCA1C __UWORD_Z 0 NO_COMPU_METHOD 0 65535 SYMBOL_LINK "xAdiaCalDataB" 124 /end CHARACTERISTIC
/begin CHARACTERISTIC SPB_CAL.usrStep "Counter increment value from DEBOUNCING to CONFIRMED status and init value in the FILTERING status" VALUE 0xFCCA18 __UBYTE_Z 0 NO_COMPU_METHOD 0 255 SYMBOL_LINK "xAdiaCalDataB" 120 /end CHARACTERISTIC
/begin CHARACTERISTIC SPB_CAL.usrWucCntIni "Transition from DEVALIDATED to NO_ERROR - Number of warm-up cycles" VALUE 0xFCCA12 __UBYTE_Z 0 NO_COMPU_METHOD 0 255 SYMBOL_LINK "xAdiaCalDataB" 114 /end CHARACTERISTIC
/begin CHARACTERISTIC SPB_CAL.xFlg.AdiaConfWord "Adia Configuration Word" VALUE 0xFCCA10 __UWORD_Z 0 NO_COMPU_METHOD 0 65535 SYMBOL_LINK "xAdiaCalDataB" 112 /end CHARACTERISTIC
/begin CHARACTERISTIC REDL_CAL.usrConf2Deval "Transition from CONFIRMED to DEVALIDATED - Number of NO_FAULT" VALUE 0xFCCE90 __UWORD_Z 0 NO_COMPU_METHOD 0 65535 SYMBOL_LINK "xAdiaCalDataB" 1264 /end CHARACTERISTIC
/begin CHARACTERISTIC REDL_CAL.usrDeb2Conf "Transition from DEBOUNCING to CONFIRMED - Number of Fault" VALUE 0xFCCE92 __UWORD_Z 0 NO_COMPU_METHOD 0 65535 SYMBOL_LINK "xAdiaCalDataB" 1266 /end CHARACTERISTIC
/begin CHARACTERISTIC REDL_CAL.usrFilt2Conf " Transition from FILTERING to CONFIRM - Counter threshold" VALUE 0xFCCE96 __UWORD_Z 0 NO_COMPU_METHOD 0 65535 SYMBOL_LINK "xAdiaCalDataB" 1270 /end CHARACTERISTIC
/begin CHARACTERISTIC REDL_CAL.usrInConfOld "Init counter value in CONFIRMED_OLD status" VALUE 0xFCCE98 __UWORD_Z 0 NO_COMPU_METHOD 0 65535 SYMBOL_LINK "xAdiaCalDataB" 1272 /end CHARACTERISTIC
/begin CHARACTERISTIC REDL_CAL.usrStep "Counter increment value from DEBOUNCING to CONFIRMED status and init value in the FILTERING status" VALUE 0xFCCE94 __UBYTE_Z 0 NO_COMPU_METHOD 0 255 SYMBOL_LINK "xAdiaCalDataB" 1268 /end CHARACTERISTIC
/begin CHARACTERISTIC REDL_CAL.usrWucCntIni "Transition from DEVALIDATED to NO_ERROR - Number of warm-up cycles" VALUE 0xFCCE8E __UBYTE_Z 0 NO_COMPU_METHOD 0 255 SYMBOL_LINK "xAdiaCalDataB" 1262 /end CHARACTERISTIC
/begin CHARACTERISTIC REDL_CAL.xFlg.AdiaConfWord "Adia Configuration Word" VALUE 0xFCCE8C __UWORD_Z 0 NO_COMPU_METHOD 0 65535 SYMBOL_LINK "xAdiaCalDataB" 1260 /end CHARACTERISTIC
/begin CHARACTERISTIC MIL_CAL.usrConf2Deval "Transition from CONFIRMED to DEVALIDATED - Number of NO_FAULT" VALUE 0xFCCE9E __UWORD_Z 0 NO_COMPU_METHOD 0 65535 SYMBOL_LINK "xAdiaCalDataB" 1278 /end CHARACTERISTIC
/begin CHARACTERISTIC MIL_CAL.usrDeb2Conf "Transition from DEBOUNCING to CONFIRMED - Number of Fault" VALUE 0xFCCEA0 __UWORD_Z 0 NO_COMPU_METHOD 0 65535 SYMBOL_LINK "xAdiaCalDataB" 1280 /end CHARACTERISTIC
/begin CHARACTERISTIC MIL_CAL.usrFilt2Conf " Transition from FILTERING to CONFIRM - Counter threshold" VALUE 0xFCCEA4 __UWORD_Z 0 NO_COMPU_METHOD 0 65535 SYMBOL_LINK "xAdiaCalDataB" 1284 /end CHARACTERISTIC
/begin CHARACTERISTIC MIL_CAL.usrInConfOld "Init counter value in CONFIRMED_OLD status" VALUE 0xFCCEA6 __UWORD_Z 0 NO_COMPU_METHOD 0 65535 SYMBOL_LINK "xAdiaCalDataB" 1286 /end CHARACTERISTIC
/begin CHARACTERISTIC MIL_CAL.usrStep "Counter increment value from DEBOUNCING to CONFIRMED status and init value in the FILTERING status" VALUE 0xFCCEA2 __UBYTE_Z 0 NO_COMPU_METHOD 0 255 SYMBOL_LINK "xAdiaCalDataB" 1282 /end CHARACTERISTIC
/begin CHARACTERISTIC MIL_CAL.usrWucCntIni "Transition from DEVALIDATED to NO_ERROR - Number of warm-up cycles" VALUE 0xFCCE9C __UBYTE_Z 0 NO_COMPU_METHOD 0 255 SYMBOL_LINK "xAdiaCalDataB" 1276 /end CHARACTERISTIC
/begin CHARACTERISTIC MIL_CAL.xFlg.AdiaConfWord "Adia Configuration Word" VALUE 0xFCCE9A __UWORD_Z 0 NO_COMPU_METHOD 0 65535 SYMBOL_LINK "xAdiaCalDataB" 1274 /end CHARACTERISTIC
/begin CHARACTERISTIC STE_CAL.usrConf2Deval "Transition from CONFIRMED to DEVALIDATED - Number of NO_FAULT" VALUE 0xFCCEAC __UWORD_Z 0 NO_COMPU_METHOD 0 65535 SYMBOL_LINK "xAdiaCalDataB" 1292 /end CHARACTERISTIC
/begin CHARACTERISTIC STE_CAL.usrDeb2Conf "Transition from DEBOUNCING to CONFIRMED - Number of Fault" VALUE 0xFCCEAE __UWORD_Z 0 NO_COMPU_METHOD 0 65535 SYMBOL_LINK "xAdiaCalDataB" 1294 /end CHARACTERISTIC
/begin CHARACTERISTIC STE_CAL.usrFilt2Conf " Transition from FILTERING to CONFIRM - Counter threshold" VALUE 0xFCCEB2 __UWORD_Z 0 NO_COMPU_METHOD 0 65535 SYMBOL_LINK "xAdiaCalDataB" 1298 /end CHARACTERISTIC
/begin CHARACTERISTIC STE_CAL.usrInConfOld "Init counter value in CONFIRMED_OLD status" VALUE 0xFCCEB4 __UWORD_Z 0 NO_COMPU_METHOD 0 65535 SYMBOL_LINK "xAdiaCalDataB" 1300 /end CHARACTERISTIC
/begin CHARACTERISTIC STE_CAL.usrStep "Counter increment value from DEBOUNCING to CONFIRMED status and init value in the FILTERING status" VALUE 0xFCCEB0 __UBYTE_Z 0 NO_COMPU_METHOD 0 255 SYMBOL_LINK "xAdiaCalDataB" 1296 /end CHARACTERISTIC
/begin CHARACTERISTIC STE_CAL.usrWucCntIni "Transition from DEVALIDATED to NO_ERROR - Number of warm-up cycles" VALUE 0xFCCEAA __UBYTE_Z 0 NO_COMPU_METHOD 0 255 SYMBOL_LINK "xAdiaCalDataB" 1290 /end CHARACTERISTIC
/begin CHARACTERISTIC STE_CAL.xFlg.AdiaConfWord "Adia Configuration Word" VALUE 0xFCCEA8 __UWORD_Z 0 NO_COMPU_METHOD 0 65535 SYMBOL_LINK "xAdiaCalDataB" 1288 /end CHARACTERISTIC
/begin CHARACTERISTIC TE2H_CAL.usrConf2Deval "Transition from CONFIRMED to DEVALIDATED - Number of NO_FAULT" VALUE 0xFCCEBA __UWORD_Z 0 NO_COMPU_METHOD 0 65535 SYMBOL_LINK "xAdiaCalDataB" 1306 /end CHARACTERISTIC
/begin CHARACTERISTIC TE2H_CAL.usrDeb2Conf "Transition from DEBOUNCING to CONFIRMED - Number of Fault" VALUE 0xFCCEBC __UWORD_Z 0 NO_COMPU_METHOD 0 65535 SYMBOL_LINK "xAdiaCalDataB" 1308 /end CHARACTERISTIC
/begin CHARACTERISTIC TE2H_CAL.usrFilt2Conf " Transition from FILTERING to CONFIRM - Counter threshold" VALUE 0xFCCEC0 __UWORD_Z 0 NO_COMPU_METHOD 0 65535 SYMBOL_LINK "xAdiaCalDataB" 1312 /end CHARACTERISTIC
/begin CHARACTERISTIC TE2H_CAL.usrInConfOld "Init counter value in CONFIRMED_OLD status" VALUE 0xFCCEC2 __UWORD_Z 0 NO_COMPU_METHOD 0 65535 SYMBOL_LINK "xAdiaCalDataB" 1314 /end CHARACTERISTIC
/begin CHARACTERISTIC TE2H_CAL.usrStep "Counter increment value from DEBOUNCING to CONFIRMED status and init value in the FILTERING status" VALUE 0xFCCEBE __UBYTE_Z 0 NO_COMPU_METHOD 0 255 SYMBOL_LINK "xAdiaCalDataB" 1310 /end CHARACTERISTIC
/begin CHARACTERISTIC TE2H_CAL.usrWucCntIni "Transition from DEVALIDATED to NO_ERROR - Number of warm-up cycles" VALUE 0xFCCEB8 __UBYTE_Z 0 NO_COMPU_METHOD 0 255 SYMBOL_LINK "xAdiaCalDataB" 1304 /end CHARACTERISTIC
/begin CHARACTERISTIC TE2H_CAL.xFlg.AdiaConfWord "Adia Configuration Word" VALUE 0xFCCEB6 __UWORD_Z 0 NO_COMPU_METHOD 0 65535 SYMBOL_LINK "xAdiaCalDataB" 1302 /end CHARACTERISTIC
/begin CHARACTERISTIC STX_CAL.usrConf2Deval "Transition from CONFIRMED to DEVALIDATED - Number of NO_FAULT" VALUE 0xFCCEC8 __UWORD_Z 0 NO_COMPU_METHOD 0 65535 SYMBOL_LINK "xAdiaCalDataB" 1320 /end CHARACTERISTIC
/begin CHARACTERISTIC STX_CAL.usrDeb2Conf "Transition from DEBOUNCING to CONFIRMED - Number of Fault" VALUE 0xFCCECA __UWORD_Z 0 NO_COMPU_METHOD 0 65535 SYMBOL_LINK "xAdiaCalDataB" 1322 /end CHARACTERISTIC
/begin CHARACTERISTIC STX_CAL.usrFilt2Conf " Transition from FILTERING to CONFIRM - Counter threshold" VALUE 0xFCCECE __UWORD_Z 0 NO_COMPU_METHOD 0 65535 SYMBOL_LINK "xAdiaCalDataB" 1326 /end CHARACTERISTIC
/begin CHARACTERISTIC STX_CAL.usrInConfOld "Init counter value in CONFIRMED_OLD status" VALUE 0xFCCED0 __UWORD_Z 0 NO_COMPU_METHOD 0 65535 SYMBOL_LINK "xAdiaCalDataB" 1328 /end CHARACTERISTIC
/begin CHARACTERISTIC STX_CAL.usrStep "Counter increment value from DEBOUNCING to CONFIRMED status and init value in the FILTERING status" VALUE 0xFCCECC __UBYTE_Z 0 NO_COMPU_METHOD 0 255 SYMBOL_LINK "xAdiaCalDataB" 1324 /end CHARACTERISTIC
/begin CHARACTERISTIC STX_CAL.usrWucCntIni "Transition from DEVALIDATED to NO_ERROR - Number of warm-up cycles" VALUE 0xFCCEC6 __UBYTE_Z 0 NO_COMPU_METHOD 0 255 SYMBOL_LINK "xAdiaCalDataB" 1318 /end CHARACTERISTIC
/begin CHARACTERISTIC STX_CAL.xFlg.AdiaConfWord "Adia Configuration Word" VALUE 0xFCCEC4 __UWORD_Z 0 NO_COMPU_METHOD 0 65535 SYMBOL_LINK "xAdiaCalDataB" 1316 /end CHARACTERISTIC
/begin CHARACTERISTIC MD1_CAL.usrConf2Deval "Transition from CONFIRMED to DEVALIDATED - Number of NO_FAULT" VALUE 0xFCCED6 __UWORD_Z 0 NO_COMPU_METHOD 0 65535 SYMBOL_LINK "xAdiaCalDataB" 1334 /end CHARACTERISTIC
/begin CHARACTERISTIC MD1_CAL.usrDeb2Conf "Transition from DEBOUNCING to CONFIRMED - Number of Fault" VALUE 0xFCCED8 __UWORD_Z 0 NO_COMPU_METHOD 0 65535 SYMBOL_LINK "xAdiaCalDataB" 1336 /end CHARACTERISTIC
/begin CHARACTERISTIC MD1_CAL.usrFilt2Conf " Transition from FILTERING to CONFIRM - Counter threshold" VALUE 0xFCCEDC __UWORD_Z 0 NO_COMPU_METHOD 0 65535 SYMBOL_LINK "xAdiaCalDataB" 1340 /end CHARACTERISTIC
/begin CHARACTERISTIC MD1_CAL.usrInConfOld "Init counter value in CONFIRMED_OLD status" VALUE 0xFCCEDE __UWORD_Z 0 NO_COMPU_METHOD 0 65535 SYMBOL_LINK "xAdiaCalDataB" 1342 /end CHARACTERISTIC
/begin CHARACTERISTIC MD1_CAL.usrStep "Counter increment value from DEBOUNCING to CONFIRMED status and init value in the FILTERING status" VALUE 0xFCCEDA __UBYTE_Z 0 NO_COMPU_METHOD 0 255 SYMBOL_LINK "xAdiaCalDataB" 1338 /end CHARACTERISTIC
/begin CHARACTERISTIC MD1_CAL.usrWucCntIni "Transition from DEVALIDATED to NO_ERROR - Number of warm-up cycles" VALUE 0xFCCED4 __UBYTE_Z 0 NO_COMPU_METHOD 0 255 SYMBOL_LINK "xAdiaCalDataB" 1332 /end CHARACTERISTIC
/begin CHARACTERISTIC MD1_CAL.xFlg.AdiaConfWord "Adia Configuration Word" VALUE 0xFCCED2 __UWORD_Z 0 NO_COMPU_METHOD 0 65535 SYMBOL_LINK "xAdiaCalDataB" 1330 /end CHARACTERISTIC
/begin CHARACTERISTIC MD2_CAL.usrConf2Deval "Transition from CONFIRMED to DEVALIDATED - Number of NO_FAULT" VALUE 0xFCCEE4 __UWORD_Z 0 NO_COMPU_METHOD 0 65535 SYMBOL_LINK "xAdiaCalDataB" 1348 /end CHARACTERISTIC
/begin CHARACTERISTIC MD2_CAL.usrDeb2Conf "Transition from DEBOUNCING to CONFIRMED - Number of Fault" VALUE 0xFCCEE6 __UWORD_Z 0 NO_COMPU_METHOD 0 65535 SYMBOL_LINK "xAdiaCalDataB" 1350 /end CHARACTERISTIC
/begin CHARACTERISTIC MD2_CAL.usrFilt2Conf " Transition from FILTERING to CONFIRM - Counter threshold" VALUE 0xFCCEEA __UWORD_Z 0 NO_COMPU_METHOD 0 65535 SYMBOL_LINK "xAdiaCalDataB" 1354 /end CHARACTERISTIC
/begin CHARACTERISTIC MD2_CAL.usrInConfOld "Init counter value in CONFIRMED_OLD status" VALUE 0xFCCEEC __UWORD_Z 0 NO_COMPU_METHOD 0 65535 SYMBOL_LINK "xAdiaCalDataB" 1356 /end CHARACTERISTIC
/begin CHARACTERISTIC MD2_CAL.usrStep "Counter increment value from DEBOUNCING to CONFIRMED status and init value in the FILTERING status" VALUE 0xFCCEE8 __UBYTE_Z 0 NO_COMPU_METHOD 0 255 SYMBOL_LINK "xAdiaCalDataB" 1352 /end CHARACTERISTIC
/begin CHARACTERISTIC MD2_CAL.usrWucCntIni "Transition from DEVALIDATED to NO_ERROR - Number of warm-up cycles" VALUE 0xFCCEE2 __UBYTE_Z 0 NO_COMPU_METHOD 0 255 SYMBOL_LINK "xAdiaCalDataB" 1346 /end CHARACTERISTIC
/begin CHARACTERISTIC MD2_CAL.xFlg.AdiaConfWord "Adia Configuration Word" VALUE 0xFCCEE0 __UWORD_Z 0 NO_COMPU_METHOD 0 65535 SYMBOL_LINK "xAdiaCalDataB" 1344 /end CHARACTERISTIC
/begin CHARACTERISTIC MD3_CAL.usrConf2Deval "Transition from CONFIRMED to DEVALIDATED - Number of NO_FAULT" VALUE 0xFCCEF2 __UWORD_Z 0 NO_COMPU_METHOD 0 65535 SYMBOL_LINK "xAdiaCalDataB" 1362 /end CHARACTERISTIC
/begin CHARACTERISTIC MD3_CAL.usrDeb2Conf "Transition from DEBOUNCING to CONFIRMED - Number of Fault" VALUE 0xFCCEF4 __UWORD_Z 0 NO_COMPU_METHOD 0 65535 SYMBOL_LINK "xAdiaCalDataB" 1364 /end CHARACTERISTIC
/begin CHARACTERISTIC MD3_CAL.usrFilt2Conf " Transition from FILTERING to CONFIRM - Counter threshold" VALUE 0xFCCEF8 __UWORD_Z 0 NO_COMPU_METHOD 0 65535 SYMBOL_LINK "xAdiaCalDataB" 1368 /end CHARACTERISTIC
/begin CHARACTERISTIC MD3_CAL.usrInConfOld "Init counter value in CONFIRMED_OLD status" VALUE 0xFCCEFA __UWORD_Z 0 NO_COMPU_METHOD 0 65535 SYMBOL_LINK "xAdiaCalDataB" 1370 /end CHARACTERISTIC
/begin CHARACTERISTIC MD3_CAL.usrStep "Counter increment value from DEBOUNCING to CONFIRMED status and init value in the FILTERING status" VALUE 0xFCCEF6 __UBYTE_Z 0 NO_COMPU_METHOD 0 255 SYMBOL_LINK "xAdiaCalDataB" 1366 /end CHARACTERISTIC
/begin CHARACTERISTIC MD3_CAL.usrWucCntIni "Transition from DEVALIDATED to NO_ERROR - Number of warm-up cycles" VALUE 0xFCCEF0 __UBYTE_Z 0 NO_COMPU_METHOD 0 255 SYMBOL_LINK "xAdiaCalDataB" 1360 /end CHARACTERISTIC
/begin CHARACTERISTIC MD3_CAL.xFlg.AdiaConfWord "Adia Configuration Word" VALUE 0xFCCEEE __UWORD_Z 0 NO_COMPU_METHOD 0 65535 SYMBOL_LINK "xAdiaCalDataB" 1358 /end CHARACTERISTIC
/begin CHARACTERISTIC MD4_CAL.usrConf2Deval "Transition from CONFIRMED to DEVALIDATED - Number of NO_FAULT" VALUE 0xFCCF00 __UWORD_Z 0 NO_COMPU_METHOD 0 65535 SYMBOL_LINK "xAdiaCalDataB" 1376 /end CHARACTERISTIC
/begin CHARACTERISTIC MD4_CAL.usrDeb2Conf "Transition from DEBOUNCING to CONFIRMED - Number of Fault" VALUE 0xFCCF02 __UWORD_Z 0 NO_COMPU_METHOD 0 65535 SYMBOL_LINK "xAdiaCalDataB" 1378 /end CHARACTERISTIC
/begin CHARACTERISTIC MD4_CAL.usrFilt2Conf " Transition from FILTERING to CONFIRM - Counter threshold" VALUE 0xFCCF06 __UWORD_Z 0 NO_COMPU_METHOD 0 65535 SYMBOL_LINK "xAdiaCalDataB" 1382 /end CHARACTERISTIC
/begin CHARACTERISTIC MD4_CAL.usrInConfOld "Init counter value in CONFIRMED_OLD status" VALUE 0xFCCF08 __UWORD_Z 0 NO_COMPU_METHOD 0 65535 SYMBOL_LINK "xAdiaCalDataB" 1384 /end CHARACTERISTIC
/begin CHARACTERISTIC MD4_CAL.usrStep "Counter increment value from DEBOUNCING to CONFIRMED status and init value in the FILTERING status" VALUE 0xFCCF04 __UBYTE_Z 0 NO_COMPU_METHOD 0 255 SYMBOL_LINK "xAdiaCalDataB" 1380 /end CHARACTERISTIC
/begin CHARACTERISTIC MD4_CAL.usrWucCntIni "Transition from DEVALIDATED to NO_ERROR - Number of warm-up cycles" VALUE 0xFCCEFE __UBYTE_Z 0 NO_COMPU_METHOD 0 255 SYMBOL_LINK "xAdiaCalDataB" 1374 /end CHARACTERISTIC
/begin CHARACTERISTIC MD4_CAL.xFlg.AdiaConfWord "Adia Configuration Word" VALUE 0xFCCEFC __UWORD_Z 0 NO_COMPU_METHOD 0 65535 SYMBOL_LINK "xAdiaCalDataB" 1372 /end CHARACTERISTIC
/begin CHARACTERISTIC MD5_CAL.usrConf2Deval "Transition from CONFIRMED to DEVALIDATED - Number of NO_FAULT" VALUE 0xFCCF0E __UWORD_Z 0 NO_COMPU_METHOD 0 65535 SYMBOL_LINK "xAdiaCalDataB" 1390 /end CHARACTERISTIC
/begin CHARACTERISTIC MD5_CAL.usrDeb2Conf "Transition from DEBOUNCING to CONFIRMED - Number of Fault" VALUE 0xFCCF10 __UWORD_Z 0 NO_COMPU_METHOD 0 65535 SYMBOL_LINK "xAdiaCalDataB" 1392 /end CHARACTERISTIC
/begin CHARACTERISTIC MD5_CAL.usrFilt2Conf " Transition from FILTERING to CONFIRM - Counter threshold" VALUE 0xFCCF14 __UWORD_Z 0 NO_COMPU_METHOD 0 65535 SYMBOL_LINK "xAdiaCalDataB" 1396 /end CHARACTERISTIC
/begin CHARACTERISTIC MD5_CAL.usrInConfOld "Init counter value in CONFIRMED_OLD status" VALUE 0xFCCF16 __UWORD_Z 0 NO_COMPU_METHOD 0 65535 SYMBOL_LINK "xAdiaCalDataB" 1398 /end CHARACTERISTIC
/begin CHARACTERISTIC MD5_CAL.usrStep "Counter increment value from DEBOUNCING to CONFIRMED status and init value in the FILTERING status" VALUE 0xFCCF12 __UBYTE_Z 0 NO_COMPU_METHOD 0 255 SYMBOL_LINK "xAdiaCalDataB" 1394 /end CHARACTERISTIC
/begin CHARACTERISTIC MD5_CAL.usrWucCntIni "Transition from DEVALIDATED to NO_ERROR - Number of warm-up cycles" VALUE 0xFCCF0C __UBYTE_Z 0 NO_COMPU_METHOD 0 255 SYMBOL_LINK "xAdiaCalDataB" 1388 /end CHARACTERISTIC
/begin CHARACTERISTIC MD5_CAL.xFlg.AdiaConfWord "Adia Configuration Word" VALUE 0xFCCF0A __UWORD_Z 0 NO_COMPU_METHOD 0 65535 SYMBOL_LINK "xAdiaCalDataB" 1386 /end CHARACTERISTIC
/begin CHARACTERISTIC SPS_CAL.usrConf2Deval "Transition from CONFIRMED to DEVALIDATED - Number of NO_FAULT" VALUE 0xFCCA22 __UWORD_Z 0 NO_COMPU_METHOD 0 65535 SYMBOL_LINK "xAdiaCalDataB" 130 /end CHARACTERISTIC
/begin CHARACTERISTIC SPS_CAL.usrDeb2Conf "Transition from DEBOUNCING to CONFIRMED - Number of Fault" VALUE 0xFCCA24 __UWORD_Z 0 NO_COMPU_METHOD 0 65535 SYMBOL_LINK "xAdiaCalDataB" 132 /end CHARACTERISTIC
/begin CHARACTERISTIC SPS_CAL.usrFilt2Conf " Transition from FILTERING to CONFIRM - Counter threshold" VALUE 0xFCCA28 __UWORD_Z 0 NO_COMPU_METHOD 0 65535 SYMBOL_LINK "xAdiaCalDataB" 136 /end CHARACTERISTIC
/begin CHARACTERISTIC SPS_CAL.usrInConfOld "Init counter value in CONFIRMED_OLD status" VALUE 0xFCCA2A __UWORD_Z 0 NO_COMPU_METHOD 0 65535 SYMBOL_LINK "xAdiaCalDataB" 138 /end CHARACTERISTIC
/begin CHARACTERISTIC SPS_CAL.usrStep "Counter increment value from DEBOUNCING to CONFIRMED status and init value in the FILTERING status" VALUE 0xFCCA26 __UBYTE_Z 0 NO_COMPU_METHOD 0 255 SYMBOL_LINK "xAdiaCalDataB" 134 /end CHARACTERISTIC
/begin CHARACTERISTIC SPS_CAL.usrWucCntIni "Transition from DEVALIDATED to NO_ERROR - Number of warm-up cycles" VALUE 0xFCCA20 __UBYTE_Z 0 NO_COMPU_METHOD 0 255 SYMBOL_LINK "xAdiaCalDataB" 128 /end CHARACTERISTIC
/begin CHARACTERISTIC SPS_CAL.xFlg.AdiaConfWord "Adia Configuration Word" VALUE 0xFCCA1E __UWORD_Z 0 NO_COMPU_METHOD 0 65535 SYMBOL_LINK "xAdiaCalDataB" 126 /end CHARACTERISTIC
/begin CHARACTERISTIC STC3_CAL.usrWucCntIni "Transition from DEVALIDATED to NO_ERROR - Number of warm-up cycles" VALUE 0xFCD012 __UBYTE_Z 0 NO_COMPU_METHOD 0 255 SYMBOL_LINK "xAdiaCalDataC" 2 /end CHARACTERISTIC
/begin CHARACTERISTIC STC3_CAL.xFlg.AdiaConfWord "Adia Configuration Word" VALUE 0xFCD010 __UWORD_Z 0 NO_COMPU_METHOD 0 65535 SYMBOL_LINK "xAdiaCalDataC" 0 /end CHARACTERISTIC
/begin CHARACTERISTIC MFLV_CAL.usrWucCntIni "Transition from DEVALIDATED to NO_ERROR - Number of warm-up cycles" VALUE 0xFCD03A __UBYTE_Z 0 NO_COMPU_METHOD 0 255 SYMBOL_LINK "xAdiaCalDataC" 42 /end CHARACTERISTIC
/begin CHARACTERISTIC MFLV_CAL.xFlg.AdiaConfWord "Adia Configuration Word" VALUE 0xFCD038 __UWORD_Z 0 NO_COMPU_METHOD 0 65535 SYMBOL_LINK "xAdiaCalDataC" 40 /end CHARACTERISTIC
/begin CHARACTERISTIC CTSP_CAL.usrWucCntIni "Transition from DEVALIDATED to NO_ERROR - Number of warm-up cycles" VALUE 0xFCD03E __UBYTE_Z 0 NO_COMPU_METHOD 0 255 SYMBOL_LINK "xAdiaCalDataC" 46 /end CHARACTERISTIC
/begin CHARACTERISTIC CTSP_CAL.xFlg.AdiaConfWord "Adia Configuration Word" VALUE 0xFCD03C __UWORD_Z 0 NO_COMPU_METHOD 0 65535 SYMBOL_LINK "xAdiaCalDataC" 44 /end CHARACTERISTIC
/begin CHARACTERISTIC CTST_CAL.usrWucCntIni "Transition from DEVALIDATED to NO_ERROR - Number of warm-up cycles" VALUE 0xFCD042 __UBYTE_Z 0 NO_COMPU_METHOD 0 255 SYMBOL_LINK "xAdiaCalDataC" 50 /end CHARACTERISTIC
/begin CHARACTERISTIC CTST_CAL.xFlg.AdiaConfWord "Adia Configuration Word" VALUE 0xFCD040 __UWORD_Z 0 NO_COMPU_METHOD 0 65535 SYMBOL_LINK "xAdiaCalDataC" 48 /end CHARACTERISTIC
/begin CHARACTERISTIC VSS_CAL.usrWucCntIni "Transition from DEVALIDATED to NO_ERROR - Number of warm-up cycles" VALUE 0xFCD046 __UBYTE_Z 0 NO_COMPU_METHOD 0 255 SYMBOL_LINK "xAdiaCalDataC" 54 /end CHARACTERISTIC
/begin CHARACTERISTIC VSS_CAL.xFlg.AdiaConfWord "Adia Configuration Word" VALUE 0xFCD044 __UWORD_Z 0 NO_COMPU_METHOD 0 65535 SYMBOL_LINK "xAdiaCalDataC" 52 /end CHARACTERISTIC
/begin CHARACTERISTIC SAFRTI_CAL.usrWucCntIni "Transition from DEVALIDATED to NO_ERROR - Number of warm-up cycles" VALUE 0xFCD04A __UBYTE_Z 0 NO_COMPU_METHOD 0 255 SYMBOL_LINK "xAdiaCalDataC" 58 /end CHARACTERISTIC
/begin CHARACTERISTIC SAFRTI_CAL.xFlg.AdiaConfWord "Adia Configuration Word" VALUE 0xFCD048 __UWORD_Z 0 NO_COMPU_METHOD 0 65535 SYMBOL_LINK "xAdiaCalDataC" 56 /end CHARACTERISTIC
/begin CHARACTERISTIC SLO_CAL.usrWucCntIni "Transition from DEVALIDATED to NO_ERROR - Number of warm-up cycles" VALUE 0xFCD016 __UBYTE_Z 0 NO_COMPU_METHOD 0 255 SYMBOL_LINK "xAdiaCalDataC" 6 /end CHARACTERISTIC
/begin CHARACTERISTIC SLO_CAL.xFlg.AdiaConfWord "Adia Configuration Word" VALUE 0xFCD014 __UWORD_Z 0 NO_COMPU_METHOD 0 65535 SYMBOL_LINK "xAdiaCalDataC" 4 /end CHARACTERISTIC
/begin CHARACTERISTIC LRN01_CAL.usrWucCntIni "Transition from DEVALIDATED to NO_ERROR - Number of warm-up cycles" VALUE 0xFCD01A __UBYTE_Z 0 NO_COMPU_METHOD 0 255 SYMBOL_LINK "xAdiaCalDataC" 10 /end CHARACTERISTIC
/begin CHARACTERISTIC LRN01_CAL.xFlg.AdiaConfWord "Adia Configuration Word" VALUE 0xFCD018 __UWORD_Z 0 NO_COMPU_METHOD 0 65535 SYMBOL_LINK "xAdiaCalDataC" 8 /end CHARACTERISTIC
/begin CHARACTERISTIC LRN02_CAL.usrWucCntIni "Transition from DEVALIDATED to NO_ERROR - Number of warm-up cycles" VALUE 0xFCD01E __UBYTE_Z 0 NO_COMPU_METHOD 0 255 SYMBOL_LINK "xAdiaCalDataC" 14 /end CHARACTERISTIC
/begin CHARACTERISTIC LRN02_CAL.xFlg.AdiaConfWord "Adia Configuration Word" VALUE 0xFCD01C __UWORD_Z 0 NO_COMPU_METHOD 0 65535 SYMBOL_LINK "xAdiaCalDataC" 12 /end CHARACTERISTIC
/begin CHARACTERISTIC LRN03_CAL.usrWucCntIni "Transition from DEVALIDATED to NO_ERROR - Number of warm-up cycles" VALUE 0xFCD022 __UBYTE_Z 0 NO_COMPU_METHOD 0 255 SYMBOL_LINK "xAdiaCalDataC" 18 /end CHARACTERISTIC
/begin CHARACTERISTIC LRN03_CAL.xFlg.AdiaConfWord "Adia Configuration Word" VALUE 0xFCD020 __UWORD_Z 0 NO_COMPU_METHOD 0 65535 SYMBOL_LINK "xAdiaCalDataC" 16 /end CHARACTERISTIC
/begin CHARACTERISTIC SFM_CAL.usrWucCntIni "Transition from DEVALIDATED to NO_ERROR - Number of warm-up cycles" VALUE 0xFCD026 __UBYTE_Z 0 NO_COMPU_METHOD 0 255 SYMBOL_LINK "xAdiaCalDataC" 22 /end CHARACTERISTIC
/begin CHARACTERISTIC SFM_CAL.xFlg.AdiaConfWord "Adia Configuration Word" VALUE 0xFCD024 __UWORD_Z 0 NO_COMPU_METHOD 0 65535 SYMBOL_LINK "xAdiaCalDataC" 20 /end CHARACTERISTIC
/begin CHARACTERISTIC SFR_CAL.usrWucCntIni "Transition from DEVALIDATED to NO_ERROR - Number of warm-up cycles" VALUE 0xFCD02A __UBYTE_Z 0 NO_COMPU_METHOD 0 255 SYMBOL_LINK "xAdiaCalDataC" 26 /end CHARACTERISTIC
/begin CHARACTERISTIC SFR_CAL.xFlg.AdiaConfWord "Adia Configuration Word" VALUE 0xFCD028 __UWORD_Z 0 NO_COMPU_METHOD 0 65535 SYMBOL_LINK "xAdiaCalDataC" 24 /end CHARACTERISTIC
/begin CHARACTERISTIC ADAT_CAL.usrWucCntIni "Transition from DEVALIDATED to NO_ERROR - Number of warm-up cycles" VALUE 0xFCD02E __UBYTE_Z 0 NO_COMPU_METHOD 0 255 SYMBOL_LINK "xAdiaCalDataC" 30 /end CHARACTERISTIC
/begin CHARACTERISTIC ADAT_CAL.xFlg.AdiaConfWord "Adia Configuration Word" VALUE 0xFCD02C __UWORD_Z 0 NO_COMPU_METHOD 0 65535 SYMBOL_LINK "xAdiaCalDataC" 28 /end CHARACTERISTIC
/begin CHARACTERISTIC ADAT2_CAL.usrWucCntIni "Transition from DEVALIDATED to NO_ERROR - Number of warm-up cycles" VALUE 0xFCD032 __UBYTE_Z 0 NO_COMPU_METHOD 0 255 SYMBOL_LINK "xAdiaCalDataC" 34 /end CHARACTERISTIC
/begin CHARACTERISTIC ADAT2_CAL.xFlg.AdiaConfWord "Adia Configuration Word" VALUE 0xFCD030 __UWORD_Z 0 NO_COMPU_METHOD 0 65535 SYMBOL_LINK "xAdiaCalDataC" 32 /end CHARACTERISTIC
/begin CHARACTERISTIC FAR12_CAL.usrWucCntIni "Transition from DEVALIDATED to NO_ERROR - Number of warm-up cycles" VALUE 0xFCD036 __UBYTE_Z 0 NO_COMPU_METHOD 0 255 SYMBOL_LINK "xAdiaCalDataC" 38 /end CHARACTERISTIC
/begin CHARACTERISTIC FAR12_CAL.xFlg.AdiaConfWord "Adia Configuration Word" VALUE 0xFCD034 __UWORD_Z 0 NO_COMPU_METHOD 0 65535 SYMBOL_LINK "xAdiaCalDataC" 36 /end CHARACTERISTIC
/begin CHARACTERISTIC STOH_CAL.xFlg.AdiaConfWord "Adia Configuration Word" VALUE 0xFCD04C __UWORD_Z 0 NO_COMPU_METHOD 0 65535 SYMBOL_LINK "xAdiaCalDataD" 0 /end CHARACTERISTIC
/begin CHARACTERISTIC xAdiaCalDataEobd.bConfOldOrDevalid "Boolean value to identify if KeySval must turn the adia automa to CONFIRMED_OLD or to DEVALIDATED state at PowerOn" VALUE 0xFCD00D __UBYTE_Z 0 bConfOldOrDevalid.Conversion 0 1 SYMBOL_LINK "xAdiaCalDataEobd" 7 /end CHARACTERISTIC
/begin CHARACTERISTIC xAdiaCalDataEobd.u8DrivingCycleThres "Driving Cycle time Threshold" VALUE 0xFCD00E __UBYTE_Z 0 u8DrivingCycleThres.Conversion 0 255 SYMBOL_LINK "xAdiaCalDataEobd" 8 /end CHARACTERISTIC
/begin CHARACTERISTIC xAdiaCalDataEobd.u8Th2WucDelta "Water temperature delta to start a warm-up cycle " VALUE 0xFCD007 __UBYTE_Z 0 u8Th2WucDelta.Conversion -40 120 SYMBOL_LINK "xAdiaCalDataEobd" 1 /end CHARACTERISTIC
/begin CHARACTERISTIC xAdiaCalDataEobd.u8Th2WucThr "Water temperature threshold to identify a warm-up cycle" VALUE 0xFCD006 __UBYTE_Z 0 u8Th2WucThr.Conversion -40 130 SYMBOL_LINK "xAdiaCalDataEobd" 0 /end CHARACTERISTIC
/begin CHARACTERISTIC xAdiaCalDataEobd.usrClientCode "Code to identify the constructor (FIAT, OPEL, YUCHAI) " ASCII 0xFCD008 __UBYTE_Z 0 NO_COMPU_METHOD 0 255 BYTE_ORDER MSB_LAST NUMBER 5 SYMBOL_LINK "xAdiaCalDataEobd" 2 /end CHARACTERISTIC
/begin MEASUREMENT STH_EE.eCodErr "Machine B fault type" UBYTE eCodErr.Conversion 0 0 0 255 ECU_ADDRESS 0x4000BDDA SYMBOL_LINK "xAdiaEeDataB" 1 /end MEASUREMENT
/begin MEASUREMENT STH_EE.eErrSt "Machine B error state" UBYTE eErrSt.Conversion 0 0 0 255 ECU_ADDRESS 0x4000BDD9 SYMBOL_LINK "xAdiaEeDataB" 0 /end MEASUREMENT
/begin MEASUREMENT STH_EE.usrEventCnt "Machine B Warm-up cycles counter" UBYTE NO_COMPU_METHOD 0 0 0 255 ECU_ADDRESS 0x4000BDDB SYMBOL_LINK "xAdiaEeDataB" 2 /end MEASUREMENT
/begin MEASUREMENT STH_EE.usrInstFaultCnt "Instantaneous fault counter" UBYTE NO_COMPU_METHOD 0 0 0 255 ECU_ADDRESS 0x4000BDDC SYMBOL_LINK "xAdiaEeDataB" 3 /end MEASUREMENT
/begin MEASUREMENT STH_EE.usrWucCnt "Machine B Warm-up cycles counter" UBYTE NO_COMPU_METHOD 0 0 0 255 ECU_ADDRESS 0x4000BDDD SYMBOL_LINK "xAdiaEeDataB" 4 /end MEASUREMENT
/begin MEASUREMENT MD6_EE.eCodErr "Machine B fault type" UBYTE eCodErr.Conversion 0 0 0 255 ECU_ADDRESS 0x4000BFCE SYMBOL_LINK "xAdiaEeDataB" 501 /end MEASUREMENT
/begin MEASUREMENT MD6_EE.eErrSt "Machine B error state" UBYTE eErrSt.Conversion 0 0 0 255 ECU_ADDRESS 0x4000BFCD SYMBOL_LINK "xAdiaEeDataB" 500 /end MEASUREMENT
/begin MEASUREMENT MD6_EE.usrEventCnt "Machine B Warm-up cycles counter" UBYTE NO_COMPU_METHOD 0 0 0 255 ECU_ADDRESS 0x4000BFCF SYMBOL_LINK "xAdiaEeDataB" 502 /end MEASUREMENT
/begin MEASUREMENT MD6_EE.usrInstFaultCnt "Instantaneous fault counter" UBYTE NO_COMPU_METHOD 0 0 0 255 ECU_ADDRESS 0x4000BFD0 SYMBOL_LINK "xAdiaEeDataB" 503 /end MEASUREMENT
/begin MEASUREMENT MD6_EE.usrWucCnt "Machine B Warm-up cycles counter" UBYTE NO_COMPU_METHOD 0 0 0 255 ECU_ADDRESS 0x4000BFD1 SYMBOL_LINK "xAdiaEeDataB" 504 /end MEASUREMENT
/begin MEASUREMENT MD7_EE.eCodErr "Machine B fault type" UBYTE eCodErr.Conversion 0 0 0 255 ECU_ADDRESS 0x4000BFD3 SYMBOL_LINK "xAdiaEeDataB" 506 /end MEASUREMENT
/begin MEASUREMENT MD7_EE.eErrSt "Machine B error state" UBYTE eErrSt.Conversion 0 0 0 255 ECU_ADDRESS 0x4000BFD2 SYMBOL_LINK "xAdiaEeDataB" 505 /end MEASUREMENT
/begin MEASUREMENT MD7_EE.usrEventCnt "Machine B Warm-up cycles counter" UBYTE NO_COMPU_METHOD 0 0 0 255 ECU_ADDRESS 0x4000BFD4 SYMBOL_LINK "xAdiaEeDataB" 507 /end MEASUREMENT
/begin MEASUREMENT MD7_EE.usrInstFaultCnt "Instantaneous fault counter" UBYTE NO_COMPU_METHOD 0 0 0 255 ECU_ADDRESS 0x4000BFD5 SYMBOL_LINK "xAdiaEeDataB" 508 /end MEASUREMENT
/begin MEASUREMENT MD7_EE.usrWucCnt "Machine B Warm-up cycles counter" UBYTE NO_COMPU_METHOD 0 0 0 255 ECU_ADDRESS 0x4000BFD6 SYMBOL_LINK "xAdiaEeDataB" 509 /end MEASUREMENT
/begin MEASUREMENT MD8_EE.eCodErr "Machine B fault type" UBYTE eCodErr.Conversion 0 0 0 255 ECU_ADDRESS 0x4000BFD8 SYMBOL_LINK "xAdiaEeDataB" 511 /end MEASUREMENT
/begin MEASUREMENT MD8_EE.eErrSt "Machine B error state" UBYTE eErrSt.Conversion 0 0 0 255 ECU_ADDRESS 0x4000BFD7 SYMBOL_LINK "xAdiaEeDataB" 510 /end MEASUREMENT
/begin MEASUREMENT MD8_EE.usrEventCnt "Machine B Warm-up cycles counter" UBYTE NO_COMPU_METHOD 0 0 0 255 ECU_ADDRESS 0x4000BFD9 SYMBOL_LINK "xAdiaEeDataB" 512 /end MEASUREMENT
/begin MEASUREMENT MD8_EE.usrInstFaultCnt "Instantaneous fault counter" UBYTE NO_COMPU_METHOD 0 0 0 255 ECU_ADDRESS 0x4000BFDA SYMBOL_LINK "xAdiaEeDataB" 513 /end MEASUREMENT
/begin MEASUREMENT MD8_EE.usrWucCnt "Machine B Warm-up cycles counter" UBYTE NO_COMPU_METHOD 0 0 0 255 ECU_ADDRESS 0x4000BFDB SYMBOL_LINK "xAdiaEeDataB" 514 /end MEASUREMENT
/begin MEASUREMENT MDR_EE.eCodErr "Machine B fault type" UBYTE eCodErr.Conversion 0 0 0 255 ECU_ADDRESS 0x4000BFDD SYMBOL_LINK "xAdiaEeDataB" 516 /end MEASUREMENT
/begin MEASUREMENT MDR_EE.eErrSt "Machine B error state" UBYTE eErrSt.Conversion 0 0 0 255 ECU_ADDRESS 0x4000BFDC SYMBOL_LINK "xAdiaEeDataB" 515 /end MEASUREMENT
/begin MEASUREMENT MDR_EE.usrEventCnt "Machine B Warm-up cycles counter" UBYTE NO_COMPU_METHOD 0 0 0 255 ECU_ADDRESS 0x4000BFDE SYMBOL_LINK "xAdiaEeDataB" 517 /end MEASUREMENT
/begin MEASUREMENT MDR_EE.usrInstFaultCnt "Instantaneous fault counter" UBYTE NO_COMPU_METHOD 0 0 0 255 ECU_ADDRESS 0x4000BFDF SYMBOL_LINK "xAdiaEeDataB" 518 /end MEASUREMENT
/begin MEASUREMENT MDR_EE.usrWucCnt "Machine B Warm-up cycles counter" UBYTE NO_COMPU_METHOD 0 0 0 255 ECU_ADDRESS 0x4000BFE0 SYMBOL_LINK "xAdiaEeDataB" 519 /end MEASUREMENT
/begin MEASUREMENT SPM2H_EE.eCodErr "Machine B fault type" UBYTE eCodErr.Conversion 0 0 0 255 ECU_ADDRESS 0x4000BFE2 SYMBOL_LINK "xAdiaEeDataB" 521 /end MEASUREMENT
/begin MEASUREMENT SPM2H_EE.eErrSt "Machine B error state" UBYTE eErrSt.Conversion 0 0 0 255 ECU_ADDRESS 0x4000BFE1 SYMBOL_LINK "xAdiaEeDataB" 520 /end MEASUREMENT
/begin MEASUREMENT SPM2H_EE.usrEventCnt "Machine B Warm-up cycles counter" UBYTE NO_COMPU_METHOD 0 0 0 255 ECU_ADDRESS 0x4000BFE3 SYMBOL_LINK "xAdiaEeDataB" 522 /end MEASUREMENT
/begin MEASUREMENT SPM2H_EE.usrInstFaultCnt "Instantaneous fault counter" UBYTE NO_COMPU_METHOD 0 0 0 255 ECU_ADDRESS 0x4000BFE4 SYMBOL_LINK "xAdiaEeDataB" 523 /end MEASUREMENT
/begin MEASUREMENT SPM2H_EE.usrWucCnt "Machine B Warm-up cycles counter" UBYTE NO_COMPU_METHOD 0 0 0 255 ECU_ADDRESS 0x4000BFE5 SYMBOL_LINK "xAdiaEeDataB" 524 /end MEASUREMENT
/begin MEASUREMENT KSP1_EE.eCodErr "Machine B fault type" UBYTE eCodErr.Conversion 0 0 0 255 ECU_ADDRESS 0x4000BFE7 SYMBOL_LINK "xAdiaEeDataB" 526 /end MEASUREMENT
/begin MEASUREMENT KSP1_EE.eErrSt "Machine B error state" UBYTE eErrSt.Conversion 0 0 0 255 ECU_ADDRESS 0x4000BFE6 SYMBOL_LINK "xAdiaEeDataB" 525 /end MEASUREMENT
/begin MEASUREMENT KSP1_EE.usrEventCnt "Machine B Warm-up cycles counter" UBYTE NO_COMPU_METHOD 0 0 0 255 ECU_ADDRESS 0x4000BFE8 SYMBOL_LINK "xAdiaEeDataB" 527 /end MEASUREMENT
/begin MEASUREMENT KSP1_EE.usrInstFaultCnt "Instantaneous fault counter" UBYTE NO_COMPU_METHOD 0 0 0 255 ECU_ADDRESS 0x4000BFE9 SYMBOL_LINK "xAdiaEeDataB" 528 /end MEASUREMENT
/begin MEASUREMENT KSP1_EE.usrWucCnt "Machine B Warm-up cycles counter" UBYTE NO_COMPU_METHOD 0 0 0 255 ECU_ADDRESS 0x4000BFEA SYMBOL_LINK "xAdiaEeDataB" 529 /end MEASUREMENT
/begin MEASUREMENT KSP2_EE.eCodErr "Machine B fault type" UBYTE eCodErr.Conversion 0 0 0 255 ECU_ADDRESS 0x4000BFEC SYMBOL_LINK "xAdiaEeDataB" 531 /end MEASUREMENT
/begin MEASUREMENT KSP2_EE.eErrSt "Machine B error state" UBYTE eErrSt.Conversion 0 0 0 255 ECU_ADDRESS 0x4000BFEB SYMBOL_LINK "xAdiaEeDataB" 530 /end MEASUREMENT
/begin MEASUREMENT KSP2_EE.usrEventCnt "Machine B Warm-up cycles counter" UBYTE NO_COMPU_METHOD 0 0 0 255 ECU_ADDRESS 0x4000BFED SYMBOL_LINK "xAdiaEeDataB" 532 /end MEASUREMENT
/begin MEASUREMENT KSP2_EE.usrInstFaultCnt "Instantaneous fault counter" UBYTE NO_COMPU_METHOD 0 0 0 255 ECU_ADDRESS 0x4000BFEE SYMBOL_LINK "xAdiaEeDataB" 533 /end MEASUREMENT
/begin MEASUREMENT KSP2_EE.usrWucCnt "Machine B Warm-up cycles counter" UBYTE NO_COMPU_METHOD 0 0 0 255 ECU_ADDRESS 0x4000BFEF SYMBOL_LINK "xAdiaEeDataB" 534 /end MEASUREMENT
/begin MEASUREMENT EGRP_EE.eCodErr "Machine B fault type" UBYTE eCodErr.Conversion 0 0 0 255 ECU_ADDRESS 0x4000BFF1 SYMBOL_LINK "xAdiaEeDataB" 536 /end MEASUREMENT
/begin MEASUREMENT EGRP_EE.eErrSt "Machine B error state" UBYTE eErrSt.Conversion 0 0 0 255 ECU_ADDRESS 0x4000BFF0 SYMBOL_LINK "xAdiaEeDataB" 535 /end MEASUREMENT
/begin MEASUREMENT EGRP_EE.usrEventCnt "Machine B Warm-up cycles counter" UBYTE NO_COMPU_METHOD 0 0 0 255 ECU_ADDRESS 0x4000BFF2 SYMBOL_LINK "xAdiaEeDataB" 537 /end MEASUREMENT
/begin MEASUREMENT EGRP_EE.usrInstFaultCnt "Instantaneous fault counter" UBYTE NO_COMPU_METHOD 0 0 0 255 ECU_ADDRESS 0x4000BFF3 SYMBOL_LINK "xAdiaEeDataB" 538 /end MEASUREMENT
/begin MEASUREMENT EGRP_EE.usrWucCnt "Machine B Warm-up cycles counter" UBYTE NO_COMPU_METHOD 0 0 0 255 ECU_ADDRESS 0x4000BFF4 SYMBOL_LINK "xAdiaEeDataB" 539 /end MEASUREMENT
/begin MEASUREMENT EGRV_EE.eCodErr "Machine B fault type" UBYTE eCodErr.Conversion 0 0 0 255 ECU_ADDRESS 0x4000BFF6 SYMBOL_LINK "xAdiaEeDataB" 541 /end MEASUREMENT
/begin MEASUREMENT EGRV_EE.eErrSt "Machine B error state" UBYTE eErrSt.Conversion 0 0 0 255 ECU_ADDRESS 0x4000BFF5 SYMBOL_LINK "xAdiaEeDataB" 540 /end MEASUREMENT
/begin MEASUREMENT EGRV_EE.usrEventCnt "Machine B Warm-up cycles counter" UBYTE NO_COMPU_METHOD 0 0 0 255 ECU_ADDRESS 0x4000BFF7 SYMBOL_LINK "xAdiaEeDataB" 542 /end MEASUREMENT
/begin MEASUREMENT EGRV_EE.usrInstFaultCnt "Instantaneous fault counter" UBYTE NO_COMPU_METHOD 0 0 0 255 ECU_ADDRESS 0x4000BFF8 SYMBOL_LINK "xAdiaEeDataB" 543 /end MEASUREMENT
/begin MEASUREMENT EGRV_EE.usrWucCnt "Machine B Warm-up cycles counter" UBYTE NO_COMPU_METHOD 0 0 0 255 ECU_ADDRESS 0x4000BFF9 SYMBOL_LINK "xAdiaEeDataB" 544 /end MEASUREMENT
/begin MEASUREMENT EGRC_EE.eCodErr "Machine B fault type" UBYTE eCodErr.Conversion 0 0 0 255 ECU_ADDRESS 0x4000BFFB SYMBOL_LINK "xAdiaEeDataB" 546 /end MEASUREMENT
/begin MEASUREMENT EGRC_EE.eErrSt "Machine B error state" UBYTE eErrSt.Conversion 0 0 0 255 ECU_ADDRESS 0x4000BFFA SYMBOL_LINK "xAdiaEeDataB" 545 /end MEASUREMENT
/begin MEASUREMENT EGRC_EE.usrEventCnt "Machine B Warm-up cycles counter" UBYTE NO_COMPU_METHOD 0 0 0 255 ECU_ADDRESS 0x4000BFFC SYMBOL_LINK "xAdiaEeDataB" 547 /end MEASUREMENT
/begin MEASUREMENT EGRC_EE.usrInstFaultCnt "Instantaneous fault counter" UBYTE NO_COMPU_METHOD 0 0 0 255 ECU_ADDRESS 0x4000BFFD SYMBOL_LINK "xAdiaEeDataB" 548 /end MEASUREMENT
/begin MEASUREMENT EGRC_EE.usrWucCnt "Machine B Warm-up cycles counter" UBYTE NO_COMPU_METHOD 0 0 0 255 ECU_ADDRESS 0x4000BFFE SYMBOL_LINK "xAdiaEeDataB" 549 /end MEASUREMENT
/begin MEASUREMENT FAR01_EE.eCodErr "Machine B fault type" UBYTE eCodErr.Conversion 0 0 0 255 ECU_ADDRESS 0x4000BE0C SYMBOL_LINK "xAdiaEeDataB" 51 /end MEASUREMENT
/begin MEASUREMENT FAR01_EE.eErrSt "Machine B error state" UBYTE eErrSt.Conversion 0 0 0 255 ECU_ADDRESS 0x4000BE0B SYMBOL_LINK "xAdiaEeDataB" 50 /end MEASUREMENT
/begin MEASUREMENT FAR01_EE.usrEventCnt "Machine B Warm-up cycles counter" UBYTE NO_COMPU_METHOD 0 0 0 255 ECU_ADDRESS 0x4000BE0D SYMBOL_LINK "xAdiaEeDataB" 52 /end MEASUREMENT
/begin MEASUREMENT FAR01_EE.usrInstFaultCnt "Instantaneous fault counter" UBYTE NO_COMPU_METHOD 0 0 0 255 ECU_ADDRESS 0x4000BE0E SYMBOL_LINK "xAdiaEeDataB" 53 /end MEASUREMENT
/begin MEASUREMENT FAR01_EE.usrWucCnt "Machine B Warm-up cycles counter" UBYTE NO_COMPU_METHOD 0 0 0 255 ECU_ADDRESS 0x4000BE0F SYMBOL_LINK "xAdiaEeDataB" 54 /end MEASUREMENT
/begin MEASUREMENT ENGBRK_EE.eCodErr "Machine B fault type" UBYTE eCodErr.Conversion 0 0 0 255 ECU_ADDRESS 0x4000C000 SYMBOL_LINK "xAdiaEeDataB" 551 /end MEASUREMENT
/begin MEASUREMENT ENGBRK_EE.eErrSt "Machine B error state" UBYTE eErrSt.Conversion 0 0 0 255 ECU_ADDRESS 0x4000BFFF SYMBOL_LINK "xAdiaEeDataB" 550 /end MEASUREMENT
/begin MEASUREMENT ENGBRK_EE.usrEventCnt "Machine B Warm-up cycles counter" UBYTE NO_COMPU_METHOD 0 0 0 255 ECU_ADDRESS 0x4000C001 SYMBOL_LINK "xAdiaEeDataB" 552 /end MEASUREMENT
/begin MEASUREMENT ENGBRK_EE.usrInstFaultCnt "Instantaneous fault counter" UBYTE NO_COMPU_METHOD 0 0 0 255 ECU_ADDRESS 0x4000C002 SYMBOL_LINK "xAdiaEeDataB" 553 /end MEASUREMENT
/begin MEASUREMENT ENGBRK_EE.usrWucCnt "Machine B Warm-up cycles counter" UBYTE NO_COMPU_METHOD 0 0 0 255 ECU_ADDRESS 0x4000C003 SYMBOL_LINK "xAdiaEeDataB" 554 /end MEASUREMENT
/begin MEASUREMENT DFLF_EE.eCodErr "Machine B fault type" UBYTE eCodErr.Conversion 0 0 0 255 ECU_ADDRESS 0x4000C005 SYMBOL_LINK "xAdiaEeDataB" 556 /end MEASUREMENT
/begin MEASUREMENT DFLF_EE.eErrSt "Machine B error state" UBYTE eErrSt.Conversion 0 0 0 255 ECU_ADDRESS 0x4000C004 SYMBOL_LINK "xAdiaEeDataB" 555 /end MEASUREMENT
/begin MEASUREMENT DFLF_EE.usrEventCnt "Machine B Warm-up cycles counter" UBYTE NO_COMPU_METHOD 0 0 0 255 ECU_ADDRESS 0x4000C006 SYMBOL_LINK "xAdiaEeDataB" 557 /end MEASUREMENT
/begin COMPU_METHOD TE_HBEgrValveCtrl4ms_CM_ufix16_En10_adm "Q = V*1024.000000" RAT_FUNC "%12.10" "adm" COEFFS 0 1024 0 0 0 1 /end COMPU_METHOD
/begin COMPU_METHOD TE_HBEgrValveCtrl4ms_CM_ufix16_En3__ "Q = V*8.000000" RAT_FUNC "%7.3" "%" COEFFS 0 8 0 0 0 1 /end COMPU_METHOD
/begin COMPU_METHOD TE_HBEgrValveCtrl4ms_CM_uint16_rpm "Q = V" RAT_FUNC "%5.0" "rpm" COEFFS 0 1 0 0 0 1 /end COMPU_METHOD
/begin COMPU_METHOD bConfOldOrDevalid.Conversion "" TAB_VERB "%.0" "" COMPU_TAB_REF bConfOldOrDevalid.Conversion /end COMPU_METHOD
/begin COMPU_METHOD bsENG_HOURS_Tx_Enable.Conversion "" LINEAR "%.3" "adm" COEFFS_LINEAR 1 0 /end COMPU_METHOD
/begin COMPU_METHOD bsENG_TEMP_Tx_Enable.Conversion "" LINEAR "%.3" "adm" COEFFS_LINEAR 1 0 /end COMPU_METHOD
/begin COMPU_METHOD bsERC1_ER_Tx_Enable.Conversion "" LINEAR "%.3" "adm" COEFFS_LINEAR 1 0 /end COMPU_METHOD
/begin COMPU_METHOD bsET2_Tx_Enable.Conversion "" LINEAR "%.3" "adm" COEFFS_LINEAR 1 0 /end COMPU_METHOD
/begin COMPU_METHOD bsEVRel.Conversion "" LINEAR "%.3" "adm" COEFFS_LINEAR 1 0 /end COMPU_METHOD
/begin COMPU_METHOD bsEgrCmdEnable.Conversion "" LINEAR "%.3" "adm" COEFFS_LINEAR 1 0 /end COMPU_METHOD
/begin COMPU_METHOD bsEgrDir.Conversion "" LINEAR "%.3" "adm" COEFFS_LINEAR 1 0 /end COMPU_METHOD
/begin COMPU_METHOD bsEgrDuty.Conversion "" LINEAR "%.3" "%" COEFFS_LINEAR 0.125 0 /end COMPU_METHOD
/begin COMPU_METHOD bsEgrFreq.Conversion "" LINEAR "%.3" "Hz" COEFFS_LINEAR 10 0 /end COMPU_METHOD
/begin COMPU_METHOD bsEngBrkDuty.Conversion "" LINEAR "%.3" "%" COEFFS_LINEAR 0.0625 0 /end COMPU_METHOD
/begin COMPU_METHOD bsEngBrkFreq.Conversion "" LINEAR "%.3" "Hz" COEFFS_LINEAR 10 0 /end COMPU_METHOD
/begin COMPU_METHOD bsEngMode_GOBD.Conversion "" LINEAR "%.3" "%" COEFFS_LINEAR 1 0 /end COMPU_METHOD
/begin COMPU_METHOD bsEngState_GOBD.Conversion "" LINEAR "%.3" "%" COEFFS_LINEAR 1 0 /end COMPU_METHOD
/begin COMPU_METHOD bsEngineType.Conversion "" LINEAR "%.3" "adm" COEFFS_LINEAR 1 0 /end COMPU_METHOD
/begin COMPU_METHOD bsEnvParDay_GOBD.Conversion "" LINEAR "%.3" "day" COEFFS_LINEAR 0.25 0 /end COMPU_METHOD
/begin COMPU_METHOD bsEnvParHours_GOBD.Conversion "" LINEAR "%.3" "hour" COEFFS_LINEAR 1 0 /end COMPU_METHOD
/begin COMPU_METHOD bsEnvParMinutes_GOBD.Conversion "" LINEAR "%.3" "min" COEFFS_LINEAR 1 0 /end COMPU_METHOD
/begin COMPU_METHOD bsEnvParMonth_GOBD.Conversion "" LINEAR "%.3" "month" COEFFS_LINEAR 1 0 /end COMPU_METHOD
/begin COMPU_METHOD bsEnvParSeconds_GOBD.Conversion "" LINEAR "%.3" "sec" COEFFS_LINEAR 0.25 0 /end COMPU_METHOD
/begin COMPU_METHOD bsEnvParYear_GOBD.Conversion "" LINEAR "%.3" "year" COEFFS_LINEAR 1 1985 /end COMPU_METHOD
/begin COMPU_METHOD bsFFAbsLoad.Conversion "" LINEAR "%.3" "%" COEFFS_LINEAR 0.392 0 /end COMPU_METHOD
/begin COMPU_METHOD bsFFAdvance.Conversion "" LINEAR "%.3" "degree" COEFFS_LINEAR 0.5 -64 /end COMPU_METHOD
/begin COMPU_METHOD bsFFBoostCtrlSt.Conversion "" LINEAR "%.3" "adm" COEFFS_LINEAR 1 0 /end COMPU_METHOD
/begin COMPU_METHOD bsFFCLoad.Conversion "" LINEAR "%.3" "%" COEFFS_LINEAR 0.392 0 /end COMPU_METHOD
/begin COMPU_METHOD bsFFCmdEqRatio.Conversion "" LINEAR "%.3" "adm" COEFFS_LINEAR 3.05E-05 0 /end COMPU_METHOD
/begin COMPU_METHOD bsFFDrvPedPerc.Conversion "" LINEAR "%.3" "%" COEFFS_LINEAR 0.392156862745 0 /end COMPU_METHOD
/begin COMPU_METHOD bsFFEngTrqMode_DM4.Conversion "" LINEAR "%.3" "adm" COEFFS_LINEAR 1 0 /end COMPU_METHOD
/begin COMPU_METHOD bsFFFInj.Conversion "" LINEAR "%.3" "degree" COEFFS_LINEAR 0.0078125 -210 /end COMPU_METHOD
/begin COMPU_METHOD bsFFFlsySt.Conversion "" LINEAR "%.3" "adm" COEFFS_LINEAR 1 0 /end COMPU_METHOD
/begin COMPU_METHOD bsFFFuelLev.Conversion "" LINEAR "%.3" "%" COEFFS_LINEAR 0.392156862745 0 /end COMPU_METHOD
/begin COMPU_METHOD bsFFLoad_DM4.Conversion "" LINEAR "%.3" "%" COEFFS_LINEAR 1 0 /end COMPU_METHOD
/begin COMPU_METHOD bsFFLongFlTrim.Conversion "" LINEAR "%.3" "%" COEFFS_LINEAR 0.78125 -100 /end COMPU_METHOD
/begin COMPU_METHOD bsFFMap.Conversion "" LINEAR "%.3" "kPa" COEFFS_LINEAR 1 0 /end COMPU_METHOD
/begin COMPU_METHOD bsFFP6RefEngCmu.Conversion "" LINEAR "%.3" "N*m" COEFFS_LINEAR 1 0 /end COMPU_METHOD
/begin COMPU_METHOD bsFFPAtm.Conversion "" LINEAR "%.3" "kPa" COEFFS_LINEAR 1 0 /end COMPU_METHOD
/begin COMPU_METHOD bsFFPBoost.Conversion "" LINEAR "%.3" "kPa" COEFFS_LINEAR 0.0312504768444 0 /end COMPU_METHOD
/begin COMPU_METHOD bsFFPBoostSup.Conversion "" LINEAR "%.3" "adm" COEFFS_LINEAR 1 0 /end COMPU_METHOD
/begin COMPU_METHOD bsFFPBoost_DM4.Conversion "" LINEAR "%.3" "kPa" COEFFS_LINEAR 2 0 /end COMPU_METHOD
/begin COMPU_METHOD bsFFPRail.Conversion "" LINEAR "%.3" "kPa" COEFFS_LINEAR 10 0 /end COMPU_METHOD
/begin COMPU_METHOD bsFFPdlPerfReq.Conversion "" LINEAR "%.3" "%" COEFFS_LINEAR 1 -125 /end COMPU_METHOD
/begin COMPU_METHOD bsFFPercCmuIstAbs.Conversion "" LINEAR "%.3" "%" COEFFS_LINEAR 1 -125 /end COMPU_METHOD
/begin COMPU_METHOD bsFFPercWGDirect.Conversion "" LINEAR "%.3" "%" COEFFS_LINEAR 0.392156862745 0 /end COMPU_METHOD
/begin COMPU_METHOD bsFFPtoStatusA.Conversion "" LINEAR "%.3" "adm" COEFFS_LINEAR 1 0 /end COMPU_METHOD
/begin COMPU_METHOD bsFFPtoStatusB.Conversion "" LINEAR "%.3" "adm" COEFFS_LINEAR 1 0 /end COMPU_METHOD
/begin COMPU_METHOD bsFFRifPress.Conversion "" LINEAR "%.3" "kPa" COEFFS_LINEAR 0.0312504768444 0 /end COMPU_METHOD
/begin COMPU_METHOD bsFFRpm.Conversion "" LINEAR "%.3" "rpm" COEFFS_LINEAR 0.25 0 /end COMPU_METHOD
/begin COMPU_METHOD bsFFRpm_DM4.Conversion "" LINEAR "%.3" "rpm" COEFFS_LINEAR 0.125 0 /end COMPU_METHOD
/begin COMPU_METHOD eCodErr.Conversion "" TAB_VERB "%.0" "" COMPU_TAB_REF eCodErr.Conversion /end COMPU_METHOD
/begin COMPU_METHOD eErrSt.Conversion "" TAB_VERB "%.0" "" COMPU_TAB_REF eErrSt.Conversion /end COMPU_METHOD
/begin COMPU_METHOD u8DrivingCycleThres.Conversion "" LINEAR "%.3" "adm" COEFFS_LINEAR 1 0 /end COMPU_METHOD
/begin COMPU_METHOD u8Th2WucDelta.Conversion "" LINEAR "%.3" "degC" COEFFS_LINEAR 1 -40 /end COMPU_METHOD
/begin COMPU_METHOD u8Th2WucThr.Conversion "" LINEAR "%.3" "degC" COEFFS_LINEAR 1 -40 /end COMPU_METHOD
/begin COMPU_VTAB bConfOldOrDevalid.Conversion "" TAB_VERB 2 0 "CONFIREMED_OLD" 1 "DEVALIDATED" /end COMPU_VTAB
/begin COMPU_VTAB eCodErr.Conversion "" TAB_VERB 90 0 "NO_FAULT" 1 "SIGNAL_TOO_LOW" 2 "SIGNAL_TOO_BIG" 3 "SC_TO_BATTERY" 4 "SC_TO_GND" 5 "SIGNAL_NOT_PLAUSIBLE" 6 "OC_OR_SC_TO_BATTERY" 7 "OC_OR_SC_TO_GND" 8 "OC" 9 "NO_SIGNAL" 10 "SIGNAL_DELAYED" 11 "TRASMISSION_IMPOSSIBLE" 12 "COMPONENT_DAMAGED" 13 "CONDITION_NOT_CORRECT_" 14 "MECHANICAL_PROBLEM" 15 "GENERIC_FAULT" 16 "DERIVATIVE_TOO_HIGH" 17 "DERIVATIVE_TOO_LOW" 18 "CONTROL_ERROR" 19 "ALIM_KO" 20 "ADC_KO" 21 "CAN_OFF" 22 "AIRQCONTROL_ERROR" 23 "FBCONTROL_ERROR" 24 "RPCONTROL_ERROR" 25 "SAFETY_KO" 26 "SC_HS_LS" 27 "SC_TO_GND_HS" 28 "TPU_ERROR" 29 "OC_OR_SC_TO_GND_LS" 30 "SC_TO_BAT_LS" 31 "OVERTEMPERATURE" 32 "SC_TO_GND_LS" 33 "SC_TO_BAT_HS" 34 "CLOSED" 35 "OPEN" 36 "LOAD_DUMP" 37 "STUCK_OPEN" 38 "STUCK_CLOSED" 39 "UNKNOWN_STATE" 40 "UNDERVOLTAGE" 41 "STUCK_ON" 42 "STUCK_OFF" 43 "ON" 44 "OFF" 45 "THR_INCOHERENCE" 46 "PDL_INCOHERENCE" 47 "POT_2_FAULT" 48 "QAIR_UNDER_ESTIM" 49 "QAIR_OVER_ESTIM" 50 "RSCOPEN_ERROR" 51 "RSCWAIT_ERROR" 52 "RSCCLOSE_ERROR" 53 "OSCCLOSE_ERROR" 54 "OSCOPEN_ERROR" 55 "DTC_ERROR" 56 "NLP_ERROR" 57 "UMA_ERROR" 58 "TEMP_PREWARNING" 59 "TEMP_WARNING" 60 "THR_LRN_ERROR" 61 "COMM_ERROR" 62 "MMP_ERROR" 63 "SMP_ERROR" 64 "EOBD_ERROR" 65 "ENERGY_ERROR" 66 "GAIN_ERROR" 67 "KO2_HPRAIL_ERROR" 68 "KO2_LPRAIL_ERROR" 69 "OFFS_ERROR" 70 "SWT_INCOHERENCE" 71 "MFLV_INCOHERENCE" 72 "SET_PLUS_FAULT" 73 "SET_MINUS_FAULT" 74 "OFF_FAULT" 75 "SET_FAULT" 76 "RESUME_FAULT" 77 "HOLD_FAULT" 78 "STOP_CABIN_TILT_FAULT" 79 "START_CABIN_TILT_FAULT" 80 "STUCK_CLOSED_OR_OPEN_LOAD" 81 "OVERCURR" 82 "CAM_NTEETH_INCOHERENCE" 83 "CAM_POS_INCOHERENCE" 84 "SERIAL_ERROR" 85 "CHIP_FAULT" 86 "SC_PHASES" 87 "STACK_ERROR" 87 "NUMBER_OF_FAULT" 88 "ANY_FAULT" /end COMPU_VTAB
/begin COMPU_VTAB eErrSt.Conversion "" TAB_VERB 9 0 "NO_ERROR" 1 "FILTERING" 2 "VALIDATING" 4 "CONFIRMED" 8 "CONFIRMED_OLD" 16 "DEBOUNCING" 32 "DEVALIDATED" 64 "REFILTERING" 128 "REVALIDATING" /end COMPU_VTAB
/begin RECORD_LAYOUT Lookup2D_UWORD FNC_VALUES 1 UWORD COLUMN_DIR DIRECT /end RECORD_LAYOUT
/begin RECORD_LAYOUT Lookup2D_X_UWORD AXIS_PTS_X 1 UWORD INDEX_INCR DIRECT /end RECORD_LAYOUT
/begin RECORD_LAYOUT __UBYTE_Z FNC_VALUES 1 UBYTE ROW_DIR DIRECT /end RECORD_LAYOUT
/begin RECORD_LAYOUT __UWORD_Z FNC_VALUES 1 UWORD ROW_DIR DIRECT /end RECORD_LAYOUT
/end MODULE
/end PROJECT
