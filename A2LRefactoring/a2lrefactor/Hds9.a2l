ASAP2_VERSION 1 70
/begin PROJECT XCPonCANFD "Generated for ETAS and Vector "
/begin MODULE XCPonCANFD "Generated for ETAS and Vector "
/begin MOD_COMMON "XCPonCANFD" BYTE_ORDER MSB_FIRST ALIGNMENT_BYTE 1 ALIGNMENT_WORD 2 ALIGNMENT_LONG 4 ALIGNMENT_FLOAT32_IEEE 4 ALIGNMENT_FLOAT64_IEEE 8 ALIGNMENT_INT64 8 /end MOD_COMMON
/begin AXIS_PTS okETASPCIC_1G "[Y_BKP] Rendimento Volumetrico" 0xFCAA16 NO_INPUT_QUANTITY Lookup2D_X_UWORD 0 MisfireDetectionTDC_CM_ufix16_En10_adm 12 0 3 /end AXIS_PTS
/begin AXIS_PTS okETASPCIC_CEC "[Y_BKP] Rendimento Volumetrico" 0xFCA9FE NO_INPUT_QUANTITY Lookup2D_X_UWORD 0 MisfireDetectionTDC_CM_ufix16_En10_adm 12 0 3 /end AXIS_PTS
/begin AXIS_PTS okETASPTWAMISG "[Y_BKP] Rendimento Volumetrico" 0xFCA9F2 NO_INPUT_QUANTITY Lookup2D_X_UWORD 0 MisfireDetectionTDC_CM_ufix16_En10_adm 6 0 3 /end AXIS_PTS
/begin AXIS_PTS okETASP_ENGPOINT_ENMISF "[Y_BKP] Table for disabling misfire detection in accord to engine working point" 0xFCA9E2 NO_INPUT_QUANTITY Lookup2D_X_UWORD 0 MisfireDetectionTDC_CM_ufix16_En10_adm 8 0 3 /end AXIS_PTS
/begin AXIS_PTS okMEAN_ETASP "[Y_BKP] Mean Value of Etasp during Misfire counting analisys" 0xFCA9D2 NO_INPUT_QUANTITY Lookup2D_X_UWORD 0 FaultChkMDxTDC_CM_ufix16_En10_adm 8 0 3 /end AXIS_PTS
/begin AXIS_PTS okMEAN_RPM "[X_BKP] Mean Value of RPM during Misfire counting analisys" 0xFCA9C2 NO_INPUT_QUANTITY Lookup2D_X_UWORD 0 FaultChkMDxTDC_CM_uint16_adm 8 0 10000 /end AXIS_PTS
/begin AXIS_PTS okRPMCIC_1G "[X_BKP] Velocitá di rotazione motore" 0xFCA9A2 NO_INPUT_QUANTITY Lookup2D_X_UWORD 0 MisfireDetectionTDC_CM_uint16_rpm 16 0 10000 /end AXIS_PTS
/begin AXIS_PTS okRPMCIC_CEC "[X_BKP] Velocitá di rotazione motore" 0xFCA982 NO_INPUT_QUANTITY Lookup2D_X_UWORD 0 MisfireDetectionTDC_CM_uint16_rpm 16 0 10000 /end AXIS_PTS
/begin AXIS_PTS okRPM_AIRFLOW_ENMISF "[X_BKP] Table for disabling misfire detection in case of low air mass flow rate" 0xFCA972 NO_INPUT_QUANTITY Lookup2D_X_UWORD 0 MisfireDetectionTDC_CM_uint16_rpm 8 0 10000 /end AXIS_PTS
/begin AXIS_PTS okRPM_ENGPOINT_ENMISF "[X_BKP] Table for disabling misfire detection in accord to engine working point" 0xFCA962 NO_INPUT_QUANTITY Lookup2D_X_UWORD 0 MisfireDetectionTDC_CM_uint16_rpm 8 0 10000 /end AXIS_PTS
/begin AXIS_PTS okTAIR_AIRFLOW_ENMISF "[Y_BKP] Table for disabling misfire detection in case of low air mass flow rate" 0xFCA952 NO_INPUT_QUANTITY Lookup2D_X_UWORD 0 MisfireDetectionTDC_CM_ufix16_Bn40_degC 8 -40 130 /end AXIS_PTS
/begin AXIS_PTS okTB_ETS_CAT "[XBK] Tabella Stima temperatura catalizzatore" 0xFC4960 NO_INPUT_QUANTITY Lookup2D_X_UWORD 0 Cata100ms_Symbol_CM_ufix16_En10_adm 8 0 3 /end AXIS_PTS
/begin AXIS_PTS okTB_RPM_CAT "[YBK] Tabella Stima temperatura catalizzatore" 0xFC4950 NO_INPUT_QUANTITY Lookup2D_X_UWORD 0 Cata100ms_Symbol_CM_uint16_rpm 8 0 10000 /end AXIS_PTS
/begin AXIS_PTS okTH2OTWAMISG "[X_BKP] Temperatura acqua motore" 0xFCA940 NO_INPUT_QUANTITY Lookup2D_X_UWORD 0 MisfireDetectionTDC_CM_ufix16_Bn40_degC 9 -40 140 /end AXIS_PTS
/begin AXIS_PTS okVBK_TMAP_NOM "[XBK] Tabella per calcolo pressione nominale in funzione della temperatura" 0xFC5A18 NO_INPUT_QUANTITY Lookup1D_X_UWORD 0 Test_RipCarica_TDC_Symbol_CM_ufix16_Bn40_degC 9 -40 140 /end AXIS_PTS
/begin AXIS_PTS okVLTR2_MAP "[XBK] Tabella per il calcolo della soglia di transizione sonda lambda post catalizzatore" 0xFC4AEE NO_INPUT_QUANTITY Lookup2D_X_UWORD 0 CataTDC_Symbol_CM_uint16_mbar 12 150 2500 /end AXIS_PTS
/begin AXIS_PTS okVLTR2_RPM "[YBK] Tabella per il calcolo della soglia di transizione sonda lambda post catalizzatore" 0xFC4AD6 NO_INPUT_QUANTITY Lookup2D_X_UWORD 0 CataTDC_Symbol_CM_uint16_rpm 12 0 10000 /end AXIS_PTS
/begin AXIS_PTS okZONE_GIRI "[YBK] Tabella indice soglia per abilitazione diagnosi catalizzatore" 0xFC4946 NO_INPUT_QUANTITY Lookup2D_X_UWORD 0 Cata100ms_Symbol_CM_uint16_adm 5 0 4 /end AXIS_PTS
/begin AXIS_PTS okZONE_GIRI_1 "[YBK] Mappa delle soglie di frequenza diagnosi sonda lambda monte" 0xFC4A4C NO_INPUT_QUANTITY Lookup2D_X_UWORD 0 VarMgmDLAM100ms_Symbol_CM_uint16_adm 5 0 4 /end AXIS_PTS
/begin AXIS_PTS okZONE_GIRI_2 "[YBK] Tabelle soglie di dissemetria inferiore (Diagnosi Sonda Lambda Monte)" 0xFC4A42 NO_INPUT_QUANTITY Lookup2D_X_UWORD 0 VarMgmDLAM100ms_Symbol_CM_uint16_adm 5 0 4 /end AXIS_PTS
/begin AXIS_PTS okZONE_GIRI_3 "[YBK] Tabelle soglie di dissemetria inferiore (Diagnosi Sonda Lambda Monte)" 0xFC4A38 NO_INPUT_QUANTITY Lookup2D_X_UWORD 0 VarMgmDLAM100ms_Symbol_CM_uint16_adm 5 0 4 /end AXIS_PTS
/begin AXIS_PTS okZONE_QAC_PMS "[XBK] Tabella indice soglia per abilitazione diagnosi catalizzatore" 0xFC493A NO_INPUT_QUANTITY Lookup2D_X_UWORD 0 Cata100ms_Symbol_CM_uint16_adm 6 0 5 /end AXIS_PTS
/begin AXIS_PTS okZONE_QAC_PMS_1 "[XBK] Mappa delle soglie di frequenza diagnosi sonda lambda monte" 0xFC4A2C NO_INPUT_QUANTITY Lookup2D_X_UWORD 0 VarMgmDLAM100ms_Symbol_CM_uint16_adm 6 0 5 /end AXIS_PTS
/begin AXIS_PTS okZONE_QAC_PMS_2 "[XBK] Tabelle soglie di dissemetria inferiore (Diagnosi Sonda Lambda Monte)" 0xFC4A20 NO_INPUT_QUANTITY Lookup2D_X_UWORD 0 VarMgmDLAM100ms_Symbol_CM_uint16_adm 6 0 5 /end AXIS_PTS
/begin AXIS_PTS okZONE_QAC_PMS_3 "[XBK] Tabelle soglie di dissemetria inferiore (Diagnosi Sonda Lambda Monte)" 0xFC4A14 NO_INPUT_QUANTITY Lookup2D_X_UWORD 0 VarMgmDLAM100ms_Symbol_CM_uint16_adm 6 0 5 /end AXIS_PTS
/begin MEASUREMENT osDLamFreqThTemp "Soglia di frequenza temporanea (Diagnosi Sonda Lambda Monte)" UWORD Dcat_Diagnosis100ms_CM_ufix16_Sp01_hz 0 0 0 655.35 ECU_ADDRESS 0x40002650 /end MEASUREMENT
/begin MEASUREMENT osDLamOfSum "Somma delle tensioni massime e minime della sonda lambda monte per la valutazione dell offset (Diagnosi Sonda Lambda Monte)" ULONG Dcat_Diagnosis100ms_CM_uint32_mV 0 0 0 1000000000 ECU_ADDRESS 0x40002684 /end MEASUREMENT
/begin MEASUREMENT osDLamOfSumEval "Flag di aggiornamento della somma delle tensioni massima e minima della sonda lambda monte (Diagnosi Sonda Lambda Monte)" UBYTE Dcat_Diagnosis100ms_CM_boolean_adm 0 0 0 1 ECU_ADDRESS 0x40002633 /end MEASUREMENT
/begin MEASUREMENT osDLamPre "Tensione sonda lambda monte (Diagnosi Sonda Lambda Monte)" UWORD Dcat_Diagnosis100ms_CM_uint16_mV 0 0 0 1000 ECU_ADDRESS 0x4000266E /end MEASUREMENT
/begin MEASUREMENT osDLamPreOld "Tensione sonda lambda monte al campione precedente (Diagnosi Sonda Lambda Monte)" UWORD Dcat_Diagnosis100ms_CM_uint16_mV 0 0 0 1000 ECU_ADDRESS 0x4000266C /end MEASUREMENT
/begin MEASUREMENT osDLamSFMState "Stato di avanzamento della diagnosi sonda lambda (nel driving cycle corrente)" UBYTE Dcat_Diagnosis100ms_CM_uint8_adm 0 0 1 4 ECU_ADDRESS 0x4000263D /end MEASUREMENT
/begin MEASUREMENT osDLamSInd "Soglia Indice risultato dalla diagnosi EOBD sonda lambda monte" UWORD Dcat_Diagnosis100ms_CM_ufix16_Sp01__ 0 0 0 100 ECU_ADDRESS 0x40002652 /end MEASUREMENT
/begin MEASUREMENT osDLamStoreParAmb "Flag di chiamata per la registrazione dei parametri ambientali temporanei da parte della diagnosi sonda lambda monte" UBYTE Dcat_Diagnosis100ms_CM_boolean_adm 0 0 0 1 ECU_ADDRESS 0x40002626 /end MEASUREMENT
/begin MEASUREMENT osDLamThEval "Flag di aggiornamento delle soglie temporanee della diagnosi sonda lambda monte" UBYTE Dcat_Diagnosis100ms_CM_boolean_adm 0 0 0 1 ECU_ADDRESS 0x40002634 /end MEASUREMENT
/begin MEASUREMENT osDLamThValid "Flag di validazione delle soglie temporanee della diagnosi sonda lambda monte" UBYTE Dcat_Diagnosis100ms_CM_boolean_adm 0 0 0 1 ECU_ADDRESS 0x40002631 /end MEASUREMENT
/begin MEASUREMENT osDLamTotDiag "Contatore di diagnosi eseguite (Diagnosi Sonda Lambda Monte)" UBYTE Dcat_Diagnosis100ms_CM_uint8_adm 0 0 0 255 ECU_ADDRESS 0x4000263E /end MEASUREMENT
/begin MEASUREMENT osDLamTranCalc "Contatore di transizioni sonda lambda monte registrate durante la fase di calcolo (Diagnosi Sonda Lambda Monte)" UWORD Dcat_Diagnosis100ms_CM_uint16_adm 0 0 0 65535 ECU_ADDRESS 0x40002666 /end MEASUREMENT
/begin MEASUREMENT osDLamTranNum "Numero di transizioni sonda lambda monte al momento della sicronizzazione (Diagnosi Sonda Lambda Monte)" ULONG VarMgmDLAM100ms_Symbol_CM_uint32_adm 0 0 0 1000000000 ECU_ADDRESS 0x400028C4 /end MEASUREMENT
/begin MEASUREMENT osDLamVAve "Tensione media della sonda lambda monte (Diagnosi Sonda Lambda Monte)" UWORD Dcat_Diagnosis100ms_CM_uint16_mV 0 0 0 1000 ECU_ADDRESS 0x40002674 /end MEASUREMENT
/begin MEASUREMENT osDLamZoneCnt "Contatore di numero si zone qac-giri visitate durante la diagnosi (Diagnosi Sonda Lambda Monte)" UBYTE Dcat_Diagnosis100ms_CM_uint8_adm 0 0 0 30 ECU_ADDRESS 0x4000263F /end MEASUREMENT
/begin CHARACTERISTIC osDURATA_TDC_SELECT "Selector to choose the duration of the TDC: 0 - Computation from bsRPM; 1 - bsDurataTDC" VALUE 0xFCA938 Scalar_FLOAT32_IEEE 0 MisfireDetectionTDC_CM_single_adm -1 1 /end CHARACTERISTIC
/begin MEASUREMENT osDefFS100ms "Variabile di stato del tipo di fault riscontrato, sezione 100ms (Diagnosi Fuel System)" UBYTE Fuels_CtrlMgmt100ms_CM_uint8_adm 0 0 0 255 ECU_ADDRESS 0x40002E3D /end MEASUREMENT
/begin MEASUREMENT osDefFSKo2 "Variabile di stato del tipo di fault riscontrato attraverso il test di saturazione del controllo titolo, sezione TDC (Diagnosi Fuel System)" UBYTE Fuels_CtrlMgmtTDC_CM_uint8_adm 0 0 0 255 ECU_ADDRESS 0x40002E78 /end MEASUREMENT
/begin MEASUREMENT osDefFsRCar "Init:[0]; Variabile di stato del tipo di fault riscontrato attraverso il test di ripartizione carica, sezione TDC (Diagnosi Fuel System)" UBYTE Test_RipCarica_TDC_Symbol_CM_uint8_adm 0 0 0 255 ECU_ADDRESS 0x40002F1C /end MEASUREMENT
/begin MEASUREMENT osDefFsgTDC "Variabile di stato del tipo di fault riscontrato, sezione TDC (Diagnosi Fuel System)" UBYTE Fuels_CtrlMgmtTDC_CM_uint8_adm 0 0 0 255 ECU_ADDRESS 0x40002E77 /end MEASUREMENT
/begin MEASUREMENT osDerateDiag29 "Derate apertura controllo turbo per recovery 29" UBYTE FFSymUpdater100ms_CM_boolean_adm 0 0 0 1 ECU_ADDRESS 0x40002915 /end MEASUREMENT
/begin MEASUREMENT osDerdnTh "[OUT] Tabelle soglie di dissemetria inferiore (Diagnosi Sonda Lambda Monte)" SWORD VarMgmDLAM100ms_Symbol_CM_int16__ 0 0 -32768 32767 ECU_ADDRESS 0x400028C2 /end MEASUREMENT
/begin MEASUREMENT osDerupTh "[OUT] Tabelle soglie di dissemetria inferiore (Diagnosi Sonda Lambda Monte)" SWORD VarMgmDLAM100ms_Symbol_CM_int16__ 0 0 -32768 32767 ECU_ADDRESS 0x400028C0 /end MEASUREMENT
/begin MEASUREMENT osDiagAbort "lag di Diagnosis Abort (Diagnosi Sonda Lambda Monte)" UBYTE Dcat_Diagnosis100ms_CM_boolean_adm 0 0 0 1 ECU_ADDRESS 0x40002637 /end MEASUREMENT
/begin MEASUREMENT osDmn_KO2 "Variazione massima in modulo degli ultimi due valori min-max di KO2" UWORD Dcat_Diagnosis100ms_CM_ufix16_En15_adm 0 0 0 0.5 ECU_ADDRESS 0x400028D4 /end MEASUREMENT
/begin MEASUREMENT osDurataTDC "Computed duration of the TDC" FLOAT32_IEEE MisfireDetectionTDC_CM_single_us 0 0 -3.4E+38 3.4E+38 ECU_ADDRESS 0x40003DBC /end MEASUREMENT
/begin MEASUREMENT osEnClosedLoop "Abilitazione del Closed Loop turbo" UBYTE FFSymUpdater100ms_CM_boolean_adm 0 0 0 1 ECU_ADDRESS 0x40002914 /end MEASUREMENT
/begin MEASUREMENT osEnDcMv "Flag di stato che indica che sono soddisfatte le condizioni per la diagnosi monte-valle" UBYTE DCmvInterface100ms_Symbol_CM_boolean_bool 0 0 0 1 ECU_ADDRESS 0x4000281B /end MEASUREMENT
/begin MEASUREMENT osEnableMisfDet "Misfire detection enable flag" UBYTE MisfireDetectionTDC_CM_boolean_adm 0 0 0 1 ECU_ADDRESS 0x40003DB8 /end MEASUREMENT
/begin MEASUREMENT osEnableMisfDetCond "Conditions to ebnabling the misfire detection strategy (bitword)." UWORD MisfireDetectionTDC_CM_uint16_adm 0 0 0 511 ECU_ADDRESS 0x40003DB6 /end MEASUREMENT
/begin MEASUREMENT osEngPointEnMisf "[OUT] Table for disabling misfire detection in accord to engine working point" UBYTE MisfireDetectionTDC_CM_uint8_adm 0 0 0 1 ECU_ADDRESS 0x40003DB4 /end MEASUREMENT
/begin MEASUREMENT osExitCalc "lag di Exit Calc (Diagnosi Sonda Lambda Monte)" UBYTE Dcat_Diagnosis100ms_CM_boolean_adm 0 0 0 1 ECU_ADDRESS 0x40002638 /end MEASUREMENT
/begin CHARACTERISTIC osFASCRPMG "Number of  RPM band for flywheel correction" VALUE 0xFCA934 Scalar_UBYTE 0 FlywheelCorrTDC_CM_uint8_adm 1 8 /end CHARACTERISTIC
/begin MEASUREMENT osFAdaCyc "lag di soglia di calcoli autoadattativi in zona ciclo superata (Diagnosi Fuel System)" UBYTE Fuels_CtrlMgmt100ms_CM_boolean_adm 0 0 0 1 ECU_ADDRESS 0x40002E36 /end MEASUREMENT
/begin MEASUREMENT osFAdaIdl "lag di soglia di calcoli autoadattativi in zona idle superata (Diagnosi Fuel System)" UBYTE Fuels_CtrlMgmt100ms_CM_boolean_adm 0 0 0 1 ECU_ADDRESS 0x40002E37 /end MEASUREMENT
/begin MEASUREMENT osFFFInj "Representative fuel injection timing, beginning of first main injection ( -osFFTinj -qsFInj ) [deg] " FLOAT32_IEEE FFSymUpdater100ms_CM_single_deg 0 0 -210 301.99 ECU_ADDRESS 0x40002910 /end MEASUREMENT
/begin MEASUREMENT osFFTInj "Representative fuel injection timing [in deg]" FLOAT32_IEEE FFSymUpdater100ms_CM_single_deg 0 0 0 720 ECU_ADDRESS 0x4000290C /end MEASUREMENT
/begin CHARACTERISTIC osFL_RIP_EN "Flag di abilitazione generale diagnosi ripartizione (Diagnosi Fuel System)" VALUE 0xFC59F7 Scalar_BOOLEAN 0 Test_RipCarica_TDC_Symbol_CM_boolean_adm 0 1 /end CHARACTERISTIC
/begin MEASUREMENT osFWCState "State of the flywheel correction automa: 0= INIT; 1 = MEDOC_CALC_CORRECTION; 2 = MEDOC_CORRECTION." UBYTE FlywheelCorrTDC_CM_uint8_adm 0 0 0 7 ECU_ADDRESS 0x40003AC6 /end MEASUREMENT
/begin MEASUREMENT osFascCorrG "Number of the current RPM band for flywheel correction" UBYTE FlywheelCorrTDC_CM_uint8_adm 0 0 0 7 ECU_ADDRESS 0x40003AC5 /end MEASUREMENT
/begin MEASUREMENT osFlEnAd "lag di abilitazione diagnosi autoadattativa (Diagnosi Fuel System)" UBYTE Fuels_CtrlMgmt100ms_CM_boolean_adm 0 0 0 1 ECU_ADDRESS 0x40002E3A /end MEASUREMENT
/begin MEASUREMENT osFlEnAdVect "Vettore delle condizioni del flag osFlEnAd abilitazione della diagnosi autoadattativita" UBYTE Abilitazione_DFSLY_100ms_Symbol_CM_uint8_adm 0 0 0 255 ECU_ADDRESS 0x40002E42 /end MEASUREMENT
/begin MEASUREMENT osFlowAirEnMisf "[OUT] Table for disabling misfire detection in case of low air mass flow rate" UWORD MisfireDetectionTDC_CM_ufix16_En3_mg_cc 0 0 0 8191 ECU_ADDRESS 0x40003DB2 /end MEASUREMENT
/begin MEASUREMENT osFlsySt "Fuel System Status" UBYTE DiagSym100ms_CM_uint8_adm 0 0 0 31 ECU_ADDRESS 0x40002E7C /end MEASUREMENT
/begin CHARACTERISTIC osGIRI_CAT_MN "Soglia minima di giri per la disattivazione della diagnosi catalizzatore" VALUE 0xFC4836 Scalar_UWORD 0 Cata100ms_Symbol_CM_uint16_rpm 0 10000 /end CHARACTERISTIC
/begin CHARACTERISTIC osGIRI_CAT_MX "Soglia massima di giri per la disattivazione della diagnosi catalizzatore" VALUE 0xFC4834 Scalar_UWORD 0 Cata100ms_Symbol_CM_uint16_rpm 0 10000 /end CHARACTERISTIC
/begin CHARACTERISTIC osG_ADAT_EN "Abilitazione alla diagnosi sui guadagni autoadattativi (Diagnosi Fuel System)" VALUE 0xFC59D4 Scalar_BOOLEAN 0 Gain_Adat_Test_100ms_Symbol_CM_boolean_adm 0 1 /end CHARACTERISTIC
/begin MEASUREMENT osGainCyc "uadagno autoadattativo filtrato in zona ciclo (Diagnosi Fuel System)" UWORD Fuels_CtrlMgmt100ms_CM_ufix16_Sp004__ 0 0 0 125 ECU_ADDRESS 0x40002E3E /end MEASUREMENT
/begin MEASUREMENT osGainIdl "uadagno autoadattativo filtrato in zona idle (Diagnosi Fuel System)" UWORD Fuels_CtrlMgmt100ms_CM_ufix16_Sp1__ 0 0 0 125 ECU_ADDRESS 0x40002E40 /end MEASUREMENT
/begin CHARACTERISTIC osH_LAM "Periodo di valutazione in PMS per lambda saturata" VALUE 0xFC59EE Scalar_UWORD 0 Test_KO2_TDC_Symbol_CM_uint16_adm 0 65000 /end CHARACTERISTIC
/begin CHARACTERISTIC osIGNITION_RPM_THR "Soglia di giri per conteggio avviamenti motore" VALUE 0xFC55A0 Scalar_UWORD 0 EngineRun100ms_Symbol_CM_uint16_rpm 0 10000 /end CHARACTERISTIC
/begin CHARACTERISTIC osIGNITION_TIME_THR "Soglia temporale per conteggio avviamenti" VALUE 0xFC559E Scalar_UBYTE 0 EngineRun100ms_Symbol_CM_ufix8_S100_ms 0 25500 /end CHARACTERISTIC
/begin CHARACTERISTIC osIIRD2G0 "Coefficiente 0 al denominatore del filtro del secondo ordine" VALUE 0xFC4866 Scalar_SWORD 0 Cata100ms_Symbol_CM_sfix16_En14_adm -2 1 /end CHARACTERISTIC
/begin CHARACTERISTIC osIIRD2G1 "Coefficiente 1 al denominatore del filtro del secondo ordine" VALUE 0xFC4864 Scalar_SWORD 0 Cata100ms_Symbol_CM_sfix16_En14_adm -2 1 /end CHARACTERISTIC
/begin CHARACTERISTIC osIIRN2G0 "Coefficiente 0 al numeratore del filtro del secondo ordine" VALUE 0xFC4862 Scalar_SWORD 0 Cata100ms_Symbol_CM_sfix16_En14_adm -2 1 /end CHARACTERISTIC
/begin CHARACTERISTIC osIIRN2G1 "Coefficiente 1 al numeratore del filtro del secondo ordine" VALUE 0xFC4860 Scalar_SWORD 0 Cata100ms_Symbol_CM_sfix16_En14_adm -2 1 /end CHARACTERISTIC
/begin CHARACTERISTIC osIIRN2G2 "Coefficiente 2 al numeratore del filtro del secondo ordine" VALUE 0xFC485E Scalar_SWORD 0 Cata100ms_Symbol_CM_sfix16_En14_adm -2 1 /end CHARACTERISTIC
/begin MEASUREMENT osIdleCond "Flag condizione idle per la Diagnosi Fuel System" UBYTE Test_RipCarica_TDC_Symbol_CM_boolean_adm 0 0 0 1 ECU_ADDRESS 0x40002F1B /end MEASUREMENT
/begin CHARACTERISTIC osK1MDCNC_WIN_LENGTH "Angular window length for the misfire k1mdcnc computation" VALUE 0xFCA932 Scalar_UWORD 0 AngWinAcqTDC_CM_ufix16_S6_degree 0 180 /end CHARACTERISTIC
/begin CHARACTERISTIC osK1MDCNC_WIN_START "Advance with respect to TDC for the starting angle of the misfire k1mdcnc computation" VALUE 0xFCA930 Scalar_SWORD 0 AngWinAcqTDC_CM_sfix16_S6_degree -90 90 /end CHARACTERISTIC
/begin MEASUREMENT osK1MdcNcWinLength "Saturated angular window length for the misfire k1mdcnc computation" UWORD AngWinAcqTDC_CM_ufix16_S6_degree 0 0 0 180 ECU_ADDRESS 0x40003806 /end MEASUREMENT
/begin MEASUREMENT osK1MdcNcWinStart "Saturated advance with respect to TDC for the starting angle of the misfire k1mdcnc computation" SWORD AngWinAcqTDC_CM_sfix16_S6_degree 0 0 -90 90 ECU_ADDRESS 0x40003804 /end MEASUREMENT
/begin MEASUREMENT osK1MdcNcg "Selected angular window duration, without flywheel correction, for misfire detection" ULONG MisfdTDC_CM_ufix32_Sp2_us 0 0 0 858993459 ECU_ADDRESS 0x400037E8 /end MEASUREMENT
/begin MEASUREMENT osK1MedocG "MEDOC Angular window duration for misfire detection" ULONG MisfdTDC_CM_ufix32_Sp2_us 0 0 0 117963 ECU_ADDRESS 0x400037E4 /end MEASUREMENT
/begin CHARACTERISTIC osKFCATCOG "Coefficiente di filtraggio temperatura di cutoff" VALUE 0xFC4832 Scalar_UWORD 0 Cata100ms_Symbol_CM_ufix16_En15_adm 0 1 /end CHARACTERISTIC
/begin CHARACTERISTIC osKFCATSTG "Coefficiente di filtraggio temperatura stabilizzata" VALUE 0xFC4830 Scalar_UWORD 0 Cata100ms_Symbol_CM_ufix16_En15_adm 0 1 /end CHARACTERISTIC
/begin CHARACTERISTIC osKMSGLMDCG "Gain to compute the lower threshold for cyclicity inexes filtering " VALUE 0xFCA92C Scalar_FLOAT32_IEEE 0 MisfireDetectionTDC_CM_single_adm -1 1 /end CHARACTERISTIC
/begin MEASUREMENT osKO22F "KO22 filtrato per diagnosi monte-valle" SWORD DCmvInterface100ms_Symbol_CM_sfix16_Sp01__ 0 0 -25 25 ECU_ADDRESS 0x40002820 /end MEASUREMENT
/begin CHARACTERISTIC osKO2_MAX "Soglia superiore per considerare KO2 in battuta" VALUE 0xFC59EC Scalar_UWORD 0 Test_KO2_TDC_Symbol_CM_ufix16_En15_adm 0.75 1.25 /end CHARACTERISTIC
/begin CHARACTERISTIC osKO2_MIN "Soglia inferiore per considerare KO2 in battuta" VALUE 0xFC59EA Scalar_UWORD 0 Test_KO2_TDC_Symbol_CM_ufix16_En15_adm 0.75 1.25 /end CHARACTERISTIC
/begin CHARACTERISTIC osKO2_PMS_OFF "Soglia di PMS per disabilitare la diagnosi ripartizione (Diagnosi Fuel System)" VALUE 0xFC59F6 Scalar_UBYTE 0 Test_RipCarica_TDC_Symbol_CM_uint8_adm 0 255 /end CHARACTERISTIC
/begin CHARACTERISTIC osKO2_PMS_ON "Soglia di PMS per abilitare nuovamente la diagnosi ripartizione (Diagnosi Fuel System)" VALUE 0xFC59F5 Scalar_UBYTE 0 Test_RipCarica_TDC_Symbol_CM_uint8_adm 0 255 /end CHARACTERISTIC
/begin MEASUREMENT osKO2_max "Valore massimo del KO2 nel caso titolo ricco" UWORD CataTDC_Symbol_CM_ufix16_En15_adm 0 0 0.75 1.25 ECU_ADDRESS 0x40002904 /end MEASUREMENT
/begin MEASUREMENT osKO2_min "Valore minimo del KO2 nel caso titolo magro" UWORD CataTDC_Symbol_CM_ufix16_En15_adm 0 0 0.75 1.25 ECU_ADDRESS 0x40002902 /end MEASUREMENT
/begin CHARACTERISTIC osKPSGLMDCG "Gain to compute the upper threshold for cyclicity inexes filtering" VALUE 0xFCA928 Scalar_FLOAT32_IEEE 0 MisfireDetectionTDC_CM_single_adm -1 1 /end CHARACTERISTIC
/begin CHARACTERISTIC osKSTATCATG "Coefficiente di filtraggio quantita aria aspirata oraria diviso 3600 (riscalamento da ore a secondi della Qah)" VALUE 0xFC482E Scalar_UWORD 0 Cata100ms_Symbol_CM_ufix16_En15_degC_kg 0 1 /end CHARACTERISTIC
/begin CHARACTERISTIC osK_LPF_KO22 "Costante di Tempo del Filtro su KO22 per diagnosi monte-valle" VALUE 0xFC49B2 Scalar_UWORD 0 DCmvInterface100ms_Symbol_CM_ufix16_En8_adm 0 1 /end CHARACTERISTIC
/begin MEASUREMENT osKo2SatDone "lag di segnalazione di diagnosi saturazione K_O2 completata (Diagnosi Fuel System)" UBYTE Fuels_CtrlMgmtTDC_CM_boolean_adm 0 0 0 1 ECU_ADDRESS 0x40002E68 /end MEASUREMENT
/begin MEASUREMENT osKo2SatLoLim "Flag di saturazione inferiore del KO2" UBYTE Test_KO2_TDC_Symbol_CM_boolean_adm 0 0 0 1 ECU_ADDRESS 0x40002ED8 /end MEASUREMENT
/begin MEASUREMENT osKo2SatUpLim "Flag di saturazione superiore del KO2" UBYTE Test_KO2_TDC_Symbol_CM_boolean_adm 0 0 0 1 ECU_ADDRESS 0x40002ED7 /end MEASUREMENT
/begin CHARACTERISTIC osLAMP_FCOND "Flag per la scelta di utilizzo nella diagnosi catalizzatore della tensione lambda monte filtrata (1) o non filtrata (0)" VALUE 0xFC4803 Scalar_BOOLEAN 0 Cata100ms_Symbol_CM_boolean_adm 0 1 /end CHARACTERISTIC
/begin CHARACTERISTIC osMAX_DELTATHR_ENMISF "Upper Throttle position variation in a complete engine cycle for cyclicity inexes computation " VALUE 0xFCA926 Scalar_UWORD 0 MisfireDetectionTDC_CM_ufix16_En3_degree 0 90 /end CHARACTERISTIC
/begin CHARACTERISTIC osMAX_RPM_ENMISF "Upper RPM threshold for cyclicity inexes computation " VALUE 0xFCA924 Scalar_UWORD 0 MisfireDetectionTDC_CM_uint16_rpm 0 10000 /end CHARACTERISTIC
/begin CHARACTERISTIC osMAX_TH2O_ENMISF "Upper TH2o threshold for cyclicity inexes computation " VALUE 0xFCA922 Scalar_UWORD 0 MisfireDetectionTDC_CM_ufix16_Bn40_degC -40 140 /end CHARACTERISTIC
/begin CHARACTERISTIC osMIN_RPM_ENMISF "Lower RPM threshold for cyclicity inexes computation " VALUE 0xFCA920 Scalar_UWORD 0 MisfireDetectionTDC_CM_uint16_rpm 0 10000 /end CHARACTERISTIC
/begin CHARACTERISTIC osMIN_TH2O_ENMISF "Lower TH2o threshold for cyclicity inexes computation " VALUE 0xFCA91E Scalar_UWORD 0 MisfireDetectionTDC_CM_ufix16_Bn40_degC -40 140 /end CHARACTERISTIC
/begin MEASUREMENT osMeanEtasp1000 "Mean Value of etasp during Misfire 1000 rpm counting analisys" UWORD MisfdTDC_CM_ufix16_En10_adm 0 0 0 3 ECU_ADDRESS 0x400037C6 /end MEASUREMENT
/begin MEASUREMENT osMeanEtasp200 "Mean Value of etasp during Misfire 200 rpm counting analisys" UWORD MisfdTDC_CM_ufix16_En10_adm 0 0 0 3 ECU_ADDRESS 0x400037C8 /end MEASUREMENT
/begin MEASUREMENT osMeanRPM1000 "Mean Value of RPM during Misfire 1000 rpm counting analisys" UWORD MisfdTDC_CM_uint16_rpm 0 0 0 10000 ECU_ADDRESS 0x400037DC /end MEASUREMENT
/begin MEASUREMENT osMeanRPM200 "Mean Value of RPM during Misfire 200 rpm counting analisys" UWORD MisfdTDC_CM_uint16_rpm 0 0 0 10000 ECU_ADDRESS 0x400037E0 /end MEASUREMENT
/begin MEASUREMENT osMedPRail "Vaolre medio di pressione rail nel periodo di valutazione del KO2" UWORD Test_KO2_TDC_Symbol_CM_uint16_mbar 0 0 0 13793 ECU_ADDRESS 0x40002EE4 /end MEASUREMENT
/begin MEASUREMENT osMedPRailHigh "Valor medio PRAIL sopra soglia" UBYTE Test_KO2_TDC_Symbol_CM_boolean_adm 0 0 0 1 ECU_ADDRESS 0x40002ED6 /end MEASUREMENT
/begin MEASUREMENT osMedPRailInRange "Valor medio PRAIL nel range ammesso in calibrazione" UBYTE Test_KO2_TDC_Symbol_CM_boolean_adm 0 0 0 1 ECU_ADDRESS 0x40002ED5 /end MEASUREMENT
/begin MEASUREMENT osMedPRailLow "Valor medio PRAIL sotto soglia" UBYTE Test_KO2_TDC_Symbol_CM_boolean_adm 0 0 0 1 ECU_ADDRESS 0x40002ED4 /end MEASUREMENT
/begin MEASUREMENT osMedocOkG "Flag di correzione ruota fonica effettuata" UBYTE MisfdTDC_CM_boolean_adm 0 0 0 1 ECU_ADDRESS 0x400037AF /end MEASUREMENT
/begin MEASUREMENT osMisfCylCnt1000 "Number of Misfire detected on each cylinder during last 1000 rpm" UWORD MisfdTDC_CM_uint16_adm 0 0 0 500 ECU_ADDRESS 0x400037CC MATRIX_DIM 8 /end MEASUREMENT
/begin MEASUREMENT osMisfCylCnt200 "Number of Misfire detected on each cylinder during last 200 rpm" UBYTE MisfdTDC_CM_uint8_adm 0 0 0 100 ECU_ADDRESS 0x400037BC MATRIX_DIM 8 /end MEASUREMENT
/begin MEASUREMENT osMisfDetEn "Misfire Detection Enabled" UBYTE MisfdTDC_CM_boolean_adm 0 0 0 1 ECU_ADDRESS 0x400037AC /end MEASUREMENT
/begin MEASUREMENT osMisfRndCnt1000 "Total number of Misfire detected through CIC1 during last 1000 rpm" UWORD MisfdTDC_CM_uint16_adm 0 0 0 4000 ECU_ADDRESS 0x400037CA /end MEASUREMENT
/begin MEASUREMENT osMisfRndCnt200 "Total number of Misfire detected through CIC1 during last 200 rpm" UWORD MisfdTDC_CM_uint16_adm 0 0 0 800 ECU_ADDRESS 0x400037DE /end MEASUREMENT
/begin CHARACTERISTIC osNCICCOFFG "Maximum number of Cut-Off cycles for flywheel correction updating" VALUE 0xFCA91C Scalar_UBYTE 0 FlywheelCorrTDC_CM_uint8_adm 1 5 /end CHARACTERISTIC
/begin MEASUREMENT osNConfNrg "Contatore di numero di fault diagnosi ripartizione (Diagnosi Fuel System)" UBYTE Test_RipCarica_TDC_Symbol_CM_uint8_adm 0 0 0 255 ECU_ADDRESS 0x40002F1A /end MEASUREMENT
/begin MEASUREMENT osNCutOffG "Number of executed Cut-Off for flywheel correction updating" UBYTE FlywheelCorrTDC_CM_uint8_adm 0 0 0 255 ECU_ADDRESS 0x40003AC4 /end MEASUREMENT
/begin MEASUREMENT osNDedLamH "Contatore di PMS per il valore massimo di K_O2" UWORD Test_KO2_TDC_Symbol_CM_uint16_tdc 0 0 0 65535 ECU_ADDRESS 0x40002EE2 /end MEASUREMENT
/begin MEASUREMENT osNDedLamL "Contatore di PMS per il valore minimo di K_O2" UWORD Test_KO2_TDC_Symbol_CM_uint16_tdc 0 0 0 65535 ECU_ADDRESS 0x40002EE0 /end MEASUREMENT
/begin MEASUREMENT osNDiagNrg "Contatore di numero diagnosi ripartizione carica eseguite (Diagnosi Fuel System)" UBYTE Test_RipCarica_TDC_Symbol_CM_uint8_adm 0 0 0 255 ECU_ADDRESS 0x40002F19 /end MEASUREMENT
/begin MEASUREMENT osNFreqDFs "Contatore di PMS per il calcolo della frequenza sonda lambda (Diagnosi Fuel System)" UWORD Test_RipCarica_TDC_Symbol_CM_uint16_adm 0 0 0 65535 ECU_ADDRESS 0x40002F24 /end MEASUREMENT
/begin MEASUREMENT osNLamb "Contatore di PMS in A/F anello chiuso" UWORD Test_KO2_TDC_Symbol_CM_uint16_tdc 0 0 0 65535 ECU_ADDRESS 0x40002EDE /end MEASUREMENT
/begin CHARACTERISTIC osNMONTG "Numero transizioni sonda lambda pre-cat per abilitare diagnosi catalizzatore" VALUE 0xFC4802 Scalar_UBYTE 0 Cata100ms_Symbol_CM_uint8_adm 0 255 /end CHARACTERISTIC
/begin CHARACTERISTIC osNRG_MAX "Soglia sulla sommatoria delle variazioni sonda lambda (Diagnosi Fuel System)" VALUE 0xFC5A06 Scalar_UWORD 0 Test_RipCarica_TDC_Symbol_CM_ufix16_Sp001_V 0 65.535 /end CHARACTERISTIC
/begin CHARACTERISTIC osNVALG "Numero transizioni sonda lambda post-cat per abilitare diagnosi catalizzatore" VALUE 0xFC4801 Scalar_UBYTE 0 Cata100ms_Symbol_CM_uint8_adm 0 255 /end CHARACTERISTIC
/begin CHARACTERISTIC osN_ADA_CYL "Soglia di calcoli autoadattativi in zona ciclo (Diagnosi Fuel System)" VALUE 0xFC59C7 Scalar_UBYTE 0 CalcGain_Adat_100ms_Symbol_CM_uint8_adm 0 255 /end CHARACTERISTIC
/begin CHARACTERISTIC osN_ADA_IDL "Soglia di calcoli autoadattativi in zona idle (Diagnosi Fuel System)" VALUE 0xFC59C6 Scalar_UBYTE 0 CalcGain_Adat_100ms_Symbol_CM_uint8_adm 0 255 /end CHARACTERISTIC
/begin CHARACTERISTIC osN_CONF_NRG "Soglia di fault della diagnosi ripartizione carica (Diagnosi Fuel System)" VALUE 0xFC59F4 Scalar_UBYTE 0 Test_RipCarica_TDC_Symbol_CM_uint8_adm 0 255 /end CHARACTERISTIC
/begin MEASUREMENT osNbDgnCat "ontatore numero di diagnosi catalizzatore effettuate" UWORD Dcat_Diagnosis100ms_CM_uint16_adm 0 0 0 65535 ECU_ADDRESS 0x40002672 /end MEASUREMENT
/begin MEASUREMENT osNbZoneCat "Contatore del numero delle zone motore (giri-qac) in cui è stata eseguita la diagnosi catalizzatore" UBYTE Cata100ms_Symbol_CM_uint8_adm 0 0 0 255 ECU_ADDRESS 0x40002785 /end MEASUREMENT
/begin MEASUREMENT osNextTdcIdx "Next TDC index for misfire" UBYTE MisfdTDC_CM_uint8_adm 0 0 0 7 ECU_ADDRESS 0x400037C4 /end MEASUREMENT
/begin MEASUREMENT osNrgLam "Somma delle variazioni sonda lambda in valore assoluto (Diagnosi Fuel System)" ULONG Test_RipCarica_TDC_Symbol_CM_ufix32_Sp001_V 0 0 0 1000000 ECU_ADDRESS 0x40002F2C /end MEASUREMENT
/begin MEASUREMENT osNrgLamDone "lag di segnalazione di diagnosi ripartizione carica completata" UBYTE Fuels_CtrlMgmtTDC_CM_boolean_adm 0 0 0 1 ECU_ADDRESS 0x40002E67 /end MEASUREMENT
/begin MEASUREMENT osO2Freq "Frequenza di oscillazione della sonda lambda monte (dalla diagnosi EOBD lambda monte)" UWORD Dcat_Diagnosis100ms_CM_ufix16_Sp01_hz 0 0 0 100 ECU_ADDRESS 0x4000265E /end MEASUREMENT
/begin MEASUREMENT osO2FreqThr "Soglia sulla frequenza di oscillazione della sonda lambda monte (dalla diagnosi EOBD lambda monte)" UWORD Dcat_Diagnosis100ms_CM_ufix16_Sp01_hz 0 0 0 100 ECU_ADDRESS 0x4000264E /end MEASUREMENT
/begin CHARACTERISTIC osOFSVLEAN "Offset di tensione sonda lambda valle per la transizione a magro" VALUE 0xFC4AD0 Scalar_UWORD 0 CataTDC_Symbol_CM_uint16_mV 0 1000 /end CHARACTERISTIC
/begin CHARACTERISTIC osOFSVRICH "Offset di tensione sonda lambda valle per la transizione a ricco" VALUE 0xFC4ACE Scalar_UWORD 0 CataTDC_Symbol_CM_uint16_mV 0 1000 /end CHARACTERISTIC
/begin MEASUREMENT osPMSCutEx "Numero assoluto del TDC in uscita da cut-off" ULONG Test_KO2_TDC_Symbol_CM_uint32_tdc 0 0 0 4294967000 ECU_ADDRESS 0x40002EEC /end MEASUREMENT
/begin CHARACTERISTIC osPMS_CO_EX "Periodo dopo il cutoff exit per abilitazione della strategia" VALUE 0xFC59E8 Scalar_UWORD 0 Test_KO2_TDC_Symbol_CM_uint16_tdc 0 65535 /end CHARACTERISTIC
/begin CHARACTERISTIC osPMS_NRG "Periodo di calcolo in PMS della diagnosi ripartizione carica (Diagnosi Fuel System)" VALUE 0xFC5A04 Scalar_UWORD 0 Test_RipCarica_TDC_Symbol_CM_uint16_adm 0 65535 /end CHARACTERISTIC
/begin MEASUREMENT osPmsIdlCnt "Contatore di PMS in idle (Diagnosi Fuel System)" UWORD Test_RipCarica_TDC_Symbol_CM_uint16_adm 0 0 0 65535 ECU_ADDRESS 0x40002F22 /end MEASUREMENT
/begin MEASUREMENT osResetNrg "Reset della somma delle variazioni sonda lambda in valore assoluto (Diagnosi Fuel System)" UBYTE Test_RipCarica_TDC_Symbol_CM_boolean_adm 0 0 0 1 ECU_ADDRESS 0x40002F18 /end MEASUREMENT
/begin MEASUREMENT osRet_Calc_Init_Old "Flag di inizializzazione calcoli per la diagnosi catalizzatore" UBYTE Cata100ms_Symbol_CM_boolean_adm 0 0 0 1 ECU_ADDRESS 0x40002784 /end MEASUREMENT
/begin CHARACTERISTIC osSAT_LEAN "Soglia di fault DTC 0130 \"Sonda guasta magra\" per la segnalazione del guasto" VALUE 0xFC59DF Scalar_UBYTE 0 Test_KO2_TDC_Symbol_CM_uint8_adm 0 255 /end CHARACTERISTIC
/begin CHARACTERISTIC osSAT_RICH "Soglia di fault DTC 0130 \"Sonda guasta ricca\" per la segnalazione del guasto" VALUE 0xFC59DE Scalar_UBYTE 0 Test_KO2_TDC_Symbol_CM_uint8_adm 0 255 /end CHARACTERISTIC
/begin CHARACTERISTIC osSGLHVITG "Soglia superiore di velocita veicolo per la diagnosi catalizzatore" VALUE 0xFC482C Scalar_UWORD 0 Cata100ms_Symbol_CM_uint16_km_h 0 250 /end CHARACTERISTIC
/begin CHARACTERISTIC osSGLLVITG "Soglia inferiore di velocita veicolo per la diagnosi catalizzatore" VALUE 0xFC482A Scalar_UWORD 0 Cata100ms_Symbol_CM_uint16_km_h 0 250 /end CHARACTERISTIC
/begin CHARACTERISTIC osSGL_INF_MED_PRAIL "Soglia inferiore di pressione rail media per valutazione tipo di fault K_O2 saturato" VALUE 0xFC59E6 Scalar_UWORD 0 Test_KO2_TDC_Symbol_CM_uint16_mbar 0 13793 /end CHARACTERISTIC
/begin CHARACTERISTIC osSGL_SUP_MED_PRAIL "Soglia superiore di pressione rail madia per valutazione tipo di fault K_O2 saturato" VALUE 0xFC59E4 Scalar_UWORD 0 Test_KO2_TDC_Symbol_CM_uint16_mbar 0 13793 /end CHARACTERISTIC
/begin CHARACTERISTIC osSIMSTCUTG "Tempo di stabilizzazione Cutoff" VALUE 0xFC4828 Scalar_UWORD 0 Cata100ms_Symbol_CM_ufix16_Sp1_s 0 6553.5 /end CHARACTERISTIC
/begin MEASUREMENT osSTEstCatG "Variabile di stato della Stima temperatura catalizzatore" UBYTE Cata100ms_Symbol_CM_uint8_adm 0 0 0 5 ECU_ADDRESS 0x40002783 /end MEASUREMENT
/begin CHARACTERISTIC osSTH2ODISG "Lower Th2o threshold for flywheel correction computation" VALUE 0xFCA91A Scalar_UWORD 0 FlywheelCorrTDC_CM_ufix16_Bn40_deg -40 140 /end CHARACTERISTIC
/begin CHARACTERISTIC osSVBATT "Soglia di carica batteria per abilitazione diagnosi ripartizione (Diagnosi Fuel System)" VALUE 0xFC5A02 Scalar_UWORD 0 Test_RipCarica_TDC_Symbol_CM_ufix16_S50_mV 12000 36000 /end CHARACTERISTIC
/begin CHARACTERISTIC osSWTSENSTKAT "Switch tra temperatura catalizzatore letta da sensore (1) o da modello (0)" VALUE 0xFC4800 Scalar_BOOLEAN 0 Cata100ms_Symbol_CM_boolean_adm 0 1 /end CHARACTERISTIC
/begin CHARACTERISTIC osS_ADA_CYCH "Soglia massima guadagno autoadattativo zona ciclo (Diagnosi Fuel System)" VALUE 0xFC59D8 Scalar_UWORD 0 Gain_Adat_Test_100ms_Symbol_CM_ufix16_Sp004__ 75 125 /end CHARACTERISTIC
/begin CHARACTERISTIC osS_ADA_CYCL "Soglia minima guadagno autoadattativo zona ciclo" VALUE 0xFC59D6 Scalar_UWORD 0 Gain_Adat_Test_100ms_Symbol_CM_ufix16_Sp004__ 75 125 /end CHARACTERISTIC
/begin CHARACTERISTIC osS_ADA_IDLH "Soglia superiore guadagno autoadattativo (Diagnosi Fuel System)" VALUE 0xFC59DC Scalar_SWORD 0 Gain_Adat_Test_100ms_Symbol_CM_sfix16_Sp004__ -125 125 /end CHARACTERISTIC
/begin CHARACTERISTIC osS_ADA_IDLL "Soglia inferiore guadagno autoadattativo (Diagnosi Fuel System)" VALUE 0xFC59DA Scalar_SWORD 0 Gain_Adat_Test_100ms_Symbol_CM_sfix16_Sp004__ -125 125 /end CHARACTERISTIC
/begin CHARACTERISTIC osS_H_LAM "Soglia di PMS per valutazione K_O2 saturato alto" VALUE 0xFC59E2 Scalar_UWORD 0 Test_KO2_TDC_Symbol_CM_uint16_adm 0 65000 /end CHARACTERISTIC
/begin CHARACTERISTIC osS_L_LAM "Soglia di PMS per valutazione K_O2 saturato basso" VALUE 0xFC59E0 Scalar_UWORD 0 Test_KO2_TDC_Symbol_CM_uint16_adm 0 65000 /end CHARACTERISTIC
/begin MEASUREMENT osSgl_1G "soglia per rilevazione misfire tramite indice ciclicita intera" SLONG MisfdTDC_CM_int32_adm 0 0 -500000000 500000000 ECU_ADDRESS 0x400037FC /end MEASUREMENT
/begin MEASUREMENT osSgl_Cec "soglia per rilevazione misfire tramite indice ciclicita Cylinder Engine Cycle (720°/NumCyl)" SLONG MisfdTDC_CM_int32_adm 0 0 -500000000 500000000 ECU_ADDRESS 0x400037F4 /end MEASUREMENT
/begin MEASUREMENT osStartSyncSegment "lag di Start Sync Segment (Diagnosi Sonda Lambda Monte)" UBYTE Dcat_Diagnosis100ms_CM_boolean_adm 0 0 0 1 ECU_ADDRESS 0x4000263B /end MEASUREMENT
/begin MEASUREMENT osSumPRail "Integrale della pressione nel rail sul periodo di valutazione del K_O2 saturato" ULONG Test_KO2_TDC_Symbol_CM_uint32_mbar 0 0 0 4294967000 ECU_ADDRESS 0x40002EE8 /end MEASUREMENT
/begin MEASUREMENT osSyncSegment "lag di abilitazione Sync Segment (Diagnosi Sonda Lambda Monte)" UBYTE Dcat_Diagnosis100ms_CM_boolean_adm 0 0 0 1 ECU_ADDRESS 0x4000263A /end MEASUREMENT
/begin CHARACTERISTIC osT1MAXG "Tempo massimo per il calcolo indice stabilizzato" VALUE 0xFC4826 Scalar_UWORD 0 Cata100ms_Symbol_CM_ufix16_Sp1_s 0 6553.5 /end CHARACTERISTIC
/begin CHARACTERISTIC osT1MING "Tempo minimo per il calcolo indice stabilizzato" VALUE 0xFC4824 Scalar_UWORD 0 Cata100ms_Symbol_CM_ufix16_Sp1_s 0 6553.5 /end CHARACTERISTIC
/begin CHARACTERISTIC osTCATCUTG "Temperatura di Cutoff del catalizzatore" VALUE 0xFC4822 Scalar_UWORD 0 Cata100ms_Symbol_CM_ufix16_Bn40_degC -40 1200 /end CHARACTERISTIC
/begin CHARACTERISTIC osTCATHREG "Soglia temperatura catalizzatore" VALUE 0xFC4820 Scalar_UWORD 0 Cata100ms_Symbol_CM_ufix16_Bn40_degC -40 1200 /end CHARACTERISTIC
/begin MEASUREMENT osTCatEsTrG "Soglia di temperatura stimata catalizzatore" UWORD Cata100ms_Symbol_CM_ufix16_Bn40_degC 0 0 -40 1000 ECU_ADDRESS 0x4000278C /end MEASUREMENT
/begin MEASUREMENT osTCatEstG "Temperatura stimata catalizzatore" UWORD Dcat_Diagnosis100ms_CM_ufix16_Bn40_degC 0 0 -40 1000 ECU_ADDRESS 0x40002660 /end MEASUREMENT
/begin CHARACTERISTIC osTECHTCATG "Periodo di campionamento del filtraggio Cutoff " VALUE 0xFC481E Scalar_UWORD 0 Cata100ms_Symbol_CM_ufix16_Sp1_s 0 6553.5 /end CHARACTERISTIC
/begin CHARACTERISTIC osTHDKO2STG "Soglia variazione min/max del K_O2 per il funzionamento stabilizzato" VALUE 0xFC481C Scalar_UWORD 0 Cata100ms_Symbol_CM_ufix16_En15_adm 0 0.5 /end CHARACTERISTIC
/begin CHARACTERISTIC osTHRE1CORG "Number of TDC until the first checkpoint of flywheel correction computation" VALUE 0xFCA918 Scalar_UWORD 0 FlywheelCorrTDC_CM_uint16_adm 0 65535 /end CHARACTERISTIC
/begin CHARACTERISTIC osTHRE2CORG "Number of TDC between the second and the third checkpoint of flywheel correction computation" VALUE 0xFCA916 Scalar_UWORD 0 FlywheelCorrTDC_CM_uint16_adm 0 65535 /end CHARACTERISTIC
/begin CHARACTERISTIC osTHRPMMAXG "Maximum RPM threshold for flywheel correction" VALUE 0xFCA914 Scalar_UWORD 0 FlywheelCorrTDC_CM_uint16_rpm 0 10000 /end CHARACTERISTIC
/begin CHARACTERISTIC osTHRPMMEDG "Medium RPM threshold for flywheel correction" VALUE 0xFCA912 Scalar_UWORD 0 FlywheelCorrTDC_CM_uint16_rpm 0 10000 /end CHARACTERISTIC
/begin CHARACTERISTIC osTHRPMMING "Minimum RPM threshold for flywheel correction" VALUE 0xFCA910 Scalar_UWORD 0 FlywheelCorrTDC_CM_uint16_rpm 0 10000 /end CHARACTERISTIC
/begin CHARACTERISTIC osTH_DMAP "Soglia del valore assoluto della differenza della pressione nominale e della pressione collettore per abilitazione diagnosi ripartizione carica (Diagnosi Fuel System)" VALUE 0xFC5A00 Scalar_UWORD 0 Test_RipCarica_TDC_Symbol_CM_uint16_mbar 0 2000 /end CHARACTERISTIC
/begin CHARACTERISTIC osTH_MAP_AD_CYCH "Soglia superiore pressione collettore per zona ciclo (Diagnosi Fuel System)" VALUE 0xFC59BC Scalar_UWORD 0 CalcADCYC_ADIDL_100ms_Symbol_CM_uint16_mbar 150 2500 /end CHARACTERISTIC
/begin CHARACTERISTIC osTH_MAP_AD_CYCL "Soglia inferiore pressione collettore per zona ciclo (Diagnosi Fuel System)" VALUE 0xFC59BA Scalar_UWORD 0 CalcADCYC_ADIDL_100ms_Symbol_CM_uint16_mbar 150 2500 /end CHARACTERISTIC
/begin CHARACTERISTIC osTH_MAP_AD_IDL "Soglia pressione collettore per zona idle (Diagnosi Fuel System)" VALUE 0xFC59B8 Scalar_UWORD 0 CalcADCYC_ADIDL_100ms_Symbol_CM_uint16_mbar 150 2500 /end CHARACTERISTIC
/begin CHARACTERISTIC osTH_PMS_IDL "Soglia di TDC in idle abilitazione della diagnosi ripartizione (Diagnosi Fuel System)" VALUE 0xFC59FE Scalar_UWORD 0 Test_RipCarica_TDC_Symbol_CM_uint16_tdc 0 65535 /end CHARACTERISTIC
/begin CHARACTERISTIC osTH_RPM_AD_CYCH "Soglia superiore di giri zona ciclo (Diagnosi Fuel System)" VALUE 0xFC59B6 Scalar_UWORD 0 CalcADCYC_ADIDL_100ms_Symbol_CM_uint16_rpm 0 10000 /end CHARACTERISTIC
/begin CHARACTERISTIC osTH_RPM_AD_CYCL "Soglia inferiore di giri zona ciclo (Diagnosi Fuel System)" VALUE 0xFC59B4 Scalar_UWORD 0 CalcADCYC_ADIDL_100ms_Symbol_CM_uint16_rpm 0 10000 /end CHARACTERISTIC
/begin CHARACTERISTIC osTH_RPM_AD_IDL "Soglia di giri zona idle (Diagnosi Fuel System)" VALUE 0xFC59B2 Scalar_UWORD 0 CalcADCYC_ADIDL_100ms_Symbol_CM_uint16_rpm 0 10000 /end CHARACTERISTIC
/begin CHARACTERISTIC osTH_RPM_IDL "Soglia di giri obiettivo al minimo (Diagnosi Fuel System)" VALUE 0xFC59FC Scalar_UWORD 0 Test_RipCarica_TDC_Symbol_CM_uint16_rpm 0 10000 /end CHARACTERISTIC
/begin CHARACTERISTIC osTON_DFI_MIN_DCMV "Soglia del contatore per abilitare il calcolo della diagnosi monte-valle" VALUE 0xFC49B0 Scalar_UWORD 0 DCmvInterface100ms_Symbol_CM_ufix16_Sp1_s 0 1000 /end CHARACTERISTIC
/begin CHARACTERISTIC osT_WAIT_IDL "PMS di attesa in idle per abilitazione della diagnosi ripartizione carica (Diagnosi Fuel System)" VALUE 0xFC59FA Scalar_UWORD 0 Test_RipCarica_TDC_Symbol_CM_uint16_pms 0 65535 /end CHARACTERISTIC
/begin MEASUREMENT osTabtcat "[OUT] Tabella Stima temperatura catalizzatore" UWORD Cata100ms_Symbol_CM_ufix16_Bn40_degC 0 0 -40 1200 ECU_ADDRESS 0x4000278A /end MEASUREMENT
/begin MEASUREMENT osTbMapNom "[OUT] Tabella per calcolo pressione nominale in funzione della temperatura" UWORD Test_RipCarica_TDC_Symbol_CM_uint16_mbar 0 0 150 2000 ECU_ADDRESS 0x40002F20 /end MEASUREMENT
/begin MEASUREMENT osThrCylMisf1000 "[OUT] Maximum number of misfire event  on single cylinder allowed in last 1000 rpm" UWORD FaultChkMDxTDC_CM_uint16_adm 0 0 0 500 ECU_ADDRESS 0x4000384C /end MEASUREMENT
/begin MEASUREMENT osThrCylMisf200 "[OUT] Maximum number of misfire event on single cylinder allowed in last 200 rpm" UBYTE FaultChkMDxTDC_CM_uint8_adm 0 0 0 100 ECU_ADDRESS 0x4000384A /end MEASUREMENT
/begin MEASUREMENT osThrRndMisf1000 "[OUT] Maximum number of overall misfire event allowed in last 1000 rpm" UWORD FaultChkMDxTDC_CM_uint16_adm 0 0 0 4000 ECU_ADDRESS 0x40003848 /end MEASUREMENT
/begin MEASUREMENT osThrRndMisf200 "[OUT] Maximum number of overall misfire event allowed in last 200 rpm" UWORD FaultChkMDxTDC_CM_uint16_adm 0 0 0 800 ECU_ADDRESS 0x40003846 /end MEASUREMENT
/begin MEASUREMENT osTranCalcEval "Flag di aggiornamento del contatore delle transizioni registrate durante la fase di calcolo (Diagnosi Sonda Lambda Monte)" UBYTE Dcat_Diagnosis100ms_CM_boolean_adm 0 0 0 1 ECU_ADDRESS 0x40002632 /end MEASUREMENT
/begin MEASUREMENT osTripCalc "Flag di abilitazione all aggiornamento del valore dell indice di efficienza catalizzatore" UBYTE Cata100ms_Symbol_CM_boolean_adm 0 0 0 1 ECU_ADDRESS 0x40002782 /end MEASUREMENT
/begin MEASUREMENT osTthcic_1g "[OUT] Table for threshold computation related to cyclicity CIC1" SWORD MisfireDetectionTDC_CM_int16_adm 0 0 -820 820 ECU_ADDRESS 0x40003DB0 /end MEASUREMENT
/begin MEASUREMENT osTthcic_Cec "[OUT] Table for threshold computation related to cyclicity CICHEC" SWORD MisfireDetectionTDC_CM_int16_adm 0 0 -820 820 ECU_ADDRESS 0x40003DAE /end MEASUREMENT
/begin MEASUREMENT osTwamisg "[OUT] Gain for threshold misfire detection" UWORD MisfireDetectionTDC_CM_ufix16_En9_adm 0 0 0 3 ECU_ADDRESS 0x40003DAC /end MEASUREMENT
/begin MEASUREMENT osUpdMisfCnt1000 "Flag for updating values of Misfire counters during last 1000 rpm" UBYTE MisfdTDC_CM_boolean_adm 0 0 0 1 ECU_ADDRESS 0x400037AD /end MEASUREMENT
/begin MEASUREMENT osUpdMisfCnt200 "Flag for updating values of Misfire counters during last 200 rpm" UBYTE MisfdTDC_CM_boolean_adm 0 0 0 1 ECU_ADDRESS 0x400037AE /end MEASUREMENT
/begin CHARACTERISTIC osVBATT_SEL "Select if store in GOBD freeze frame the value coming from direct battery voltage sensor (zsVBatt) or after saturation (zsVBattSat)" VALUE 0xFC4C26 Scalar_BOOLEAN 0 FFSymUpdater100ms_CM_boolean_adm 0 1 /end CHARACTERISTIC
/begin CHARACTERISTIC osVLAM2FMNG "Soglia inferiore di tensione sonda lambda valle per la diagnosi catalizzatore" VALUE 0xFC481A Scalar_UWORD 0 Cata100ms_Symbol_CM_uint16_mV 0 1000 /end CHARACTERISTIC
/begin CHARACTERISTIC osVLAM2FMXG "Soglia superiore di tensione sonda lambda valle per la diagnosi catalizzatore" VALUE 0xFC4818 Scalar_UWORD 0 Cata100ms_Symbol_CM_uint16_mV 0 1000 /end CHARACTERISTIC
/begin CHARACTERISTIC osVLAM_MX_MN_STP "Step di incremento\\decremento per il calcolo del minimo\\massimo della tensione sonda lambda monte (Diagnosi Sonda Lambda Monte)" VALUE 0xFC49CA Scalar_UWORD 0 VarMgmDLAM100ms_Symbol_CM_uint16_mV 0 1000 /end CHARACTERISTIC
/begin MEASUREMENT osVLamMax "Tensione lambda monte massima (Diagnosi Sonda Lambda Monte)" UWORD Dcat_Diagnosis100ms_CM_uint16_mV 0 0 0 1000 ECU_ADDRESS 0x40002664 /end MEASUREMENT
/begin MEASUREMENT osVLamMaxTmp "Init:[600]; Tensione lambda monte massima (Diagnosi Sonda Lambda Monte)" UWORD VarMgmDLAM100ms_Symbol_CM_uint16_mV 0 0 0 1000 ECU_ADDRESS 0x400028BC /end MEASUREMENT
/begin MEASUREMENT osVLamMin "Tensione lambda monte minima (Diagnosi Sonda Lambda Monte)" UWORD Dcat_Diagnosis100ms_CM_uint16_mV 0 0 0 1000 ECU_ADDRESS 0x40002662 /end MEASUREMENT
/begin MEASUREMENT osVLamMinTmp "Init:[600]; Tensione lambda monte minima (Diagnosi Sonda Lambda Monte)" UWORD VarMgmDLAM100ms_Symbol_CM_uint16_mV 0 0 0 1000 ECU_ADDRESS 0x400028BA /end MEASUREMENT
/begin MEASUREMENT osVLamMxMnSt "Init:[0]; Stato automa calcolo massimi e minimi della sonda lambda monte" UBYTE VarMgmDLAM100ms_Symbol_CM_uint8_adm 0 0 0 2 ECU_ADDRESS 0x400028B8 /end MEASUREMENT
/begin CHARACTERISTIC osVSPD_THRH "Soglia superiore di velocità veicolo per abilitazione della diagnosi sonda lambda monte" VALUE 0xFC47EC Scalar_UWORD 0 AbilitazioneDLAM100ms_Symbol_CM_uint16_km_h 0 250 /end CHARACTERISTIC
/begin CHARACTERISTIC osVSPD_THRL "Soglia inferiore di velocità veicolo per abilitazione della diagnosi sonda lambda monte" VALUE 0xFC47EA Scalar_UWORD 0 AbilitazioneDLAM100ms_Symbol_CM_uint16_km_h 0 250 /end CHARACTERISTIC
/begin MEASUREMENT osVltr2 "[OUT] Tabella per il calcolo della soglia di transizione sonda lambda post catalizzatore" UWORD CataTDC_Symbol_CM_uint16_mV 0 0 0 1000 ECU_ADDRESS 0x40002900 /end MEASUREMENT
/begin CHARACTERISTIC osZONE_GIRI0 "Soglia di zona giri 0" VALUE 0xFC4816 Scalar_UWORD 0 Cata100ms_Symbol_CM_uint16_rpm 0 10000 /end CHARACTERISTIC
/begin CHARACTERISTIC osZONE_GIRI1 "Soglia di zona giri 1" VALUE 0xFC4814 Scalar_UWORD 0 Cata100ms_Symbol_CM_uint16_rpm 0 10000 /end CHARACTERISTIC
/begin CHARACTERISTIC osZONE_GIRI2 "Soglia di zona giri 2" VALUE 0xFC4812 Scalar_UWORD 0 Cata100ms_Symbol_CM_uint16_rpm 0 10000 /end CHARACTERISTIC
/begin CHARACTERISTIC osZONE_GIRI3 "Soglia di zona giri 3" VALUE 0xFC4810 Scalar_UWORD 0 Cata100ms_Symbol_CM_uint16_rpm 0 10000 /end CHARACTERISTIC
/begin CHARACTERISTIC osZONE_QAC0 "Soglia di zona Qac 0" VALUE 0xFC480E Scalar_UWORD 0 Cata100ms_Symbol_CM_ufix16_En3_mg_cc 0 5000 /end CHARACTERISTIC
/begin CHARACTERISTIC osZONE_QAC1 "Soglia di zona Qac 1" VALUE 0xFC480C Scalar_UWORD 0 Cata100ms_Symbol_CM_ufix16_En3_mg_cc 0 5000 /end CHARACTERISTIC
/begin CHARACTERISTIC osZONE_QAC2 "Soglia di zona Qac 2" VALUE 0xFC480A Scalar_UWORD 0 Cata100ms_Symbol_CM_ufix16_En3_mg_cc 0 5000 /end CHARACTERISTIC
/begin CHARACTERISTIC osZONE_QAC3 "Soglia di zona Qac 3" VALUE 0xFC4808 Scalar_UWORD 0 Cata100ms_Symbol_CM_ufix16_En3_mg_cc 0 5000 /end CHARACTERISTIC
/begin CHARACTERISTIC osZONE_QAC4 "Soglia di zona Qac 4" VALUE 0xFC4806 Scalar_UWORD 0 Cata100ms_Symbol_CM_ufix16_En3_mg_cc 0 5000 /end CHARACTERISTIC
/begin MEASUREMENT osZoneByteFlag0 "Byte di flag di diagnosi eseguita, riferito al osZoneGiri 0" UBYTE Cata100ms_Symbol_CM_uint8_adm 0 0 0 63 ECU_ADDRESS 0x40002781 /end MEASUREMENT
/begin MEASUREMENT osZoneByteFlag1 "Byte di flag di diagnosi eseguita, riferito al osZoneGiri 1" UBYTE Cata100ms_Symbol_CM_uint8_adm 0 0 0 63 ECU_ADDRESS 0x40002780 /end MEASUREMENT
/begin MEASUREMENT osZoneByteFlag2 "Byte di flag di diagnosi eseguita, riferito al osZoneGiri 2" UBYTE Cata100ms_Symbol_CM_uint8_adm 0 0 0 63 ECU_ADDRESS 0x4000277F /end MEASUREMENT
/begin MEASUREMENT osZoneByteFlag3 "Byte di flag di diagnosi eseguita, riferito al osZoneGiri 3" UBYTE Cata100ms_Symbol_CM_uint8_adm 0 0 0 63 ECU_ADDRESS 0x4000277E /end MEASUREMENT
/begin MEASUREMENT osZoneByteFlag4 "Byte di flag di diagnosi eseguita, riferito al osZoneGiri 4" UBYTE Cata100ms_Symbol_CM_uint8_adm 0 0 0 63 ECU_ADDRESS 0x4000277D /end MEASUREMENT
/begin MEASUREMENT osZoneCnt00 "Numero di diagnosi eseguite nella zona motore Qac-Giri 00 (Diagnosi Sonda Lambda Monte)" UBYTE ExitCalcDLAM100ms_Symbol_CM_uint8_adm 0 0 0 255 ECU_ADDRESS 0x4000287F /end MEASUREMENT
/begin MEASUREMENT osZoneCnt01 "Numero di diagnosi eseguite nella zona motore Qac-Giri 01 (Diagnosi Sonda Lambda Monte)" UBYTE ExitCalcDLAM100ms_Symbol_CM_uint8_adm 0 0 0 255 ECU_ADDRESS 0x4000287E /end MEASUREMENT
/begin MEASUREMENT osZoneCnt02 "Numero di diagnosi eseguite nella zona motore Qac-Giri 02 (Diagnosi Sonda Lambda Monte)" UBYTE ExitCalcDLAM100ms_Symbol_CM_uint8_adm 0 0 0 255 ECU_ADDRESS 0x4000287D /end MEASUREMENT
/begin MEASUREMENT osZoneCnt03 "Numero di diagnosi eseguite nella zona motore Qac-Giri 03 (Diagnosi Sonda Lambda Monte)" UBYTE ExitCalcDLAM100ms_Symbol_CM_uint8_adm 0 0 0 255 ECU_ADDRESS 0x4000287C /end MEASUREMENT
/begin MEASUREMENT osZoneCnt04 "Numero di diagnosi eseguite nella zona motore Qac-Giri 04 (Diagnosi Sonda Lambda Monte)" UBYTE ExitCalcDLAM100ms_Symbol_CM_uint8_adm 0 0 0 255 ECU_ADDRESS 0x4000287B /end MEASUREMENT
/begin MEASUREMENT osZoneCnt10 "Numero di diagnosi eseguite nella zona motore Qac-Giri 10 (Diagnosi Sonda Lambda Monte)" UBYTE ExitCalcDLAM100ms_Symbol_CM_uint8_adm 0 0 0 255 ECU_ADDRESS 0x4000287A /end MEASUREMENT
/begin MEASUREMENT osZoneCnt11 "Numero di diagnosi eseguite nella zona motore Qac-Giri 11 (Diagnosi Sonda Lambda Monte)" UBYTE ExitCalcDLAM100ms_Symbol_CM_uint8_adm 0 0 0 255 ECU_ADDRESS 0x40002879 /end MEASUREMENT
/begin MEASUREMENT osZoneCnt12 "Numero di diagnosi eseguite nella zona motore Qac-Giri 12 (Diagnosi Sonda Lambda Monte)" UBYTE ExitCalcDLAM100ms_Symbol_CM_uint8_adm 0 0 0 255 ECU_ADDRESS 0x40002878 /end MEASUREMENT
/begin MEASUREMENT osZoneCnt13 "Numero di diagnosi eseguite nella zona motore Qac-Giri 13 (Diagnosi Sonda Lambda Monte)" UBYTE ExitCalcDLAM100ms_Symbol_CM_uint8_adm 0 0 0 255 ECU_ADDRESS 0x40002877 /end MEASUREMENT
/begin MEASUREMENT osZoneCnt14 "Numero di diagnosi eseguite nella zona motore Qac-Giri 14 (Diagnosi Sonda Lambda Monte)" UBYTE ExitCalcDLAM100ms_Symbol_CM_uint8_adm 0 0 0 255 ECU_ADDRESS 0x40002876 /end MEASUREMENT
/begin MEASUREMENT osZoneCnt20 "Numero di diagnosi eseguite nella zona motore Qac-Giri 20 (Diagnosi Sonda Lambda Monte)" UBYTE ExitCalcDLAM100ms_Symbol_CM_uint8_adm 0 0 0 255 ECU_ADDRESS 0x40002875 /end MEASUREMENT
/begin MEASUREMENT osZoneCnt21 "Numero di diagnosi eseguite nella zona motore Qac-Giri 21 (Diagnosi Sonda Lambda Monte)" UBYTE ExitCalcDLAM100ms_Symbol_CM_uint8_adm 0 0 0 255 ECU_ADDRESS 0x40002874 /end MEASUREMENT
/begin MEASUREMENT osZoneCnt22 "Numero di diagnosi eseguite nella zona motore Qac-Giri 22 (Diagnosi Sonda Lambda Monte)" UBYTE ExitCalcDLAM100ms_Symbol_CM_uint8_adm 0 0 0 255 ECU_ADDRESS 0x40002873 /end MEASUREMENT
/begin MEASUREMENT osZoneCnt23 "Numero di diagnosi eseguite nella zona motore Qac-Giri 23 (Diagnosi Sonda Lambda Monte)" UBYTE ExitCalcDLAM100ms_Symbol_CM_uint8_adm 0 0 0 255 ECU_ADDRESS 0x40002872 /end MEASUREMENT
/begin MEASUREMENT osZoneCnt24 "Numero di diagnosi eseguite nella zona motore Qac-Giri 24 (Diagnosi Sonda Lambda Monte)" UBYTE ExitCalcDLAM100ms_Symbol_CM_uint8_adm 0 0 0 255 ECU_ADDRESS 0x40002871 /end MEASUREMENT
/begin MEASUREMENT osZoneCnt30 "Numero di diagnosi eseguite nella zona motore Qac-Giri 30 (Diagnosi Sonda Lambda Monte)" UBYTE ExitCalcDLAM100ms_Symbol_CM_uint8_adm 0 0 0 255 ECU_ADDRESS 0x40002870 /end MEASUREMENT
/begin MEASUREMENT osZoneCnt31 "Numero di diagnosi eseguite nella zona motore Qac-Giri 31 (Diagnosi Sonda Lambda Monte)" UBYTE ExitCalcDLAM100ms_Symbol_CM_uint8_adm 0 0 0 255 ECU_ADDRESS 0x4000286F /end MEASUREMENT
/begin MEASUREMENT osZoneCnt32 "Numero di diagnosi eseguite nella zona motore Qac-Giri 32 (Diagnosi Sonda Lambda Monte)" UBYTE ExitCalcDLAM100ms_Symbol_CM_uint8_adm 0 0 0 255 ECU_ADDRESS 0x4000286E /end MEASUREMENT
/begin MEASUREMENT osZoneCnt33 "Numero di diagnosi eseguite nella zona motore Qac-Giri 33 (Diagnosi Sonda Lambda Monte)" UBYTE ExitCalcDLAM100ms_Symbol_CM_uint8_adm 0 0 0 255 ECU_ADDRESS 0x4000286D /end MEASUREMENT
/begin MEASUREMENT osZoneCnt34 "Numero di diagnosi eseguite nella zona motore Qac-Giri 34 (Diagnosi Sonda Lambda Monte)" UBYTE ExitCalcDLAM100ms_Symbol_CM_uint8_adm 0 0 0 255 ECU_ADDRESS 0x4000286C /end MEASUREMENT
/begin MEASUREMENT osZoneCnt40 "Numero di diagnosi eseguite nella zona motore Qac-Giri 40 (Diagnosi Sonda Lambda Monte)" UBYTE ExitCalcDLAM100ms_Symbol_CM_uint8_adm 0 0 0 255 ECU_ADDRESS 0x4000286B /end MEASUREMENT
/begin MEASUREMENT osZoneCnt41 "Numero di diagnosi eseguite nella zona motore Qac-Giri 41 (Diagnosi Sonda Lambda Monte)" UBYTE ExitCalcDLAM100ms_Symbol_CM_uint8_adm 0 0 0 255 ECU_ADDRESS 0x4000286A /end MEASUREMENT
/begin MEASUREMENT osZoneCnt42 "Numero di diagnosi eseguite nella zona motore Qac-Giri 42 (Diagnosi Sonda Lambda Monte)" UBYTE ExitCalcDLAM100ms_Symbol_CM_uint8_adm 0 0 0 255 ECU_ADDRESS 0x40002869 /end MEASUREMENT
/begin MEASUREMENT osZoneCnt43 "Numero di diagnosi eseguite nella zona motore Qac-Giri 43 (Diagnosi Sonda Lambda Monte)" UBYTE ExitCalcDLAM100ms_Symbol_CM_uint8_adm 0 0 0 255 ECU_ADDRESS 0x40002868 /end MEASUREMENT
/begin MEASUREMENT osZoneCnt44 "Numero di diagnosi eseguite nella zona motore Qac-Giri 44 (Diagnosi Sonda Lambda Monte)" UBYTE ExitCalcDLAM100ms_Symbol_CM_uint8_adm 0 0 0 255 ECU_ADDRESS 0x40002867 /end MEASUREMENT
/begin MEASUREMENT osZoneCnt50 "Numero di diagnosi eseguite nella zona motore Qac-Giri 50 (Diagnosi Sonda Lambda Monte)" UBYTE ExitCalcDLAM100ms_Symbol_CM_uint8_adm 0 0 0 255 ECU_ADDRESS 0x40002866 /end MEASUREMENT
/begin MEASUREMENT osZoneCnt51 "Numero di diagnosi eseguite nella zona motore Qac-Giri 51 (Diagnosi Sonda Lambda Monte)" UBYTE ExitCalcDLAM100ms_Symbol_CM_uint8_adm 0 0 0 255 ECU_ADDRESS 0x40002865 /end MEASUREMENT
/begin MEASUREMENT osZoneCnt52 "Numero di diagnosi eseguite nella zona motore Qac-Giri 52 (Diagnosi Sonda Lambda Monte)" UBYTE ExitCalcDLAM100ms_Symbol_CM_uint8_adm 0 0 0 255 ECU_ADDRESS 0x40002864 /end MEASUREMENT
/begin MEASUREMENT osZoneCnt53 "Numero di diagnosi eseguite nella zona motore Qac-Giri 53 (Diagnosi Sonda Lambda Monte)" UBYTE ExitCalcDLAM100ms_Symbol_CM_uint8_adm 0 0 0 255 ECU_ADDRESS 0x40002863 /end MEASUREMENT
/begin MEASUREMENT osZoneCnt54 "Numero di diagnosi eseguite nella zona motore Qac-Giri 54 (Diagnosi Sonda Lambda Monte)" UBYTE ExitCalcDLAM100ms_Symbol_CM_uint8_adm 0 0 0 255 ECU_ADDRESS 0x40002862 /end MEASUREMENT
/begin MEASUREMENT osZoneFlag "Flag indicante diagnosi catalizzatore eseguita per la prima volta nella zona giri-qac corrente" UBYTE Cata100ms_Symbol_CM_boolean_adm 0 0 0 1 ECU_ADDRESS 0x4000277C /end MEASUREMENT
/begin MEASUREMENT osZoneGiri "Numero identificativo della zona giri" UBYTE Dcat_Diagnosis100ms_CM_uint8_adm 0 0 0 4 ECU_ADDRESS 0x40002643 /end MEASUREMENT
/begin MEASUREMENT osZoneQac "Numero identificativo della zona qac" UBYTE Dcat_Diagnosis100ms_CM_uint8_adm 0 0 0 5 ECU_ADDRESS 0x40002642 /end MEASUREMENT
/begin CHARACTERISTIC otAIRFLOW_ENMISF "Table for disabling misfire detection in case of low air mass flow rate" MAP 0xFCA890 Lookup2D_UWORD 0 MisfireDetectionTDC_CM_ufix16_En3_mg_cc 0 8191
 /begin AXIS_DESCR COM_AXIS NO_INPUT_QUANTITY MisfireDetectionTDC_CM_ufix16_Bn40_degC 8 -40 130 AXIS_PTS_REF okTAIR_AIRFLOW_ENMISF /end AXIS_DESCR
 /begin AXIS_DESCR COM_AXIS NO_INPUT_QUANTITY MisfireDetectionTDC_CM_uint16_rpm 8 0 10000 AXIS_PTS_REF okRPM_AIRFLOW_ENMISF /end AXIS_DESCR
/end CHARACTERISTIC
/begin CHARACTERISTIC otAUTOCATAG "Tabella indice soglia per abilitazione diagnosi catalizzatore" MAP 0xFC48F2 Lookup2DSF_UWORD 0 Cata100ms_Symbol_CM_ufix16_En7__ 0 100
 /begin AXIS_DESCR COM_AXIS NO_INPUT_QUANTITY Cata100ms_Symbol_CM_uint16_adm 5 0 4 AXIS_PTS_REF okZONE_GIRI /end AXIS_DESCR
 /begin AXIS_DESCR COM_AXIS NO_INPUT_QUANTITY Cata100ms_Symbol_CM_uint16_adm 6 0 5 AXIS_PTS_REF okZONE_QAC_PMS /end AXIS_DESCR
/end CHARACTERISTIC
/begin CHARACTERISTIC otAUTOSOND "Mappa delle soglie di frequenza diagnosi sonda lambda monte" MAP 0xFC49D8 Lookup2DSF_UWORD 0 VarMgmDLAM100ms_Symbol_CM_ufix16_Sp01_hz 0 655.35
 /begin AXIS_DESCR COM_AXIS NO_INPUT_QUANTITY VarMgmDLAM100ms_Symbol_CM_uint16_adm 5 0 4 AXIS_PTS_REF okZONE_GIRI_1 /end AXIS_DESCR
 /begin AXIS_DESCR COM_AXIS NO_INPUT_QUANTITY VarMgmDLAM100ms_Symbol_CM_uint16_adm 6 0 5 AXIS_PTS_REF okZONE_QAC_PMS_1 /end AXIS_DESCR
/end CHARACTERISTIC
/begin CHARACTERISTIC otDERDN_TH "Tabelle soglie di dissemetria inferiore (Diagnosi Sonda Lambda Monte)" MAP 0xFC4A92 Lookup2DSF_WORD 0 VarMgmDLAM100ms_Symbol_CM_int16__ -32768 32767
 /begin AXIS_DESCR COM_AXIS NO_INPUT_QUANTITY VarMgmDLAM100ms_Symbol_CM_uint16_adm 5 0 4 AXIS_PTS_REF okZONE_GIRI_3 /end AXIS_DESCR
 /begin AXIS_DESCR COM_AXIS NO_INPUT_QUANTITY VarMgmDLAM100ms_Symbol_CM_uint16_adm 6 0 5 AXIS_PTS_REF okZONE_QAC_PMS_3 /end AXIS_DESCR
/end CHARACTERISTIC
/begin CHARACTERISTIC otDERUP_TH "Tabelle soglie di dissemetria inferiore (Diagnosi Sonda Lambda Monte)" MAP 0xFC4A56 Lookup2DSF_WORD 0 VarMgmDLAM100ms_Symbol_CM_int16__ -32768 32767
 /begin AXIS_DESCR COM_AXIS NO_INPUT_QUANTITY VarMgmDLAM100ms_Symbol_CM_uint16_adm 5 0 4 AXIS_PTS_REF okZONE_GIRI_2 /end AXIS_DESCR
 /begin AXIS_DESCR COM_AXIS NO_INPUT_QUANTITY VarMgmDLAM100ms_Symbol_CM_uint16_adm 6 0 5 AXIS_PTS_REF okZONE_QAC_PMS_2 /end AXIS_DESCR
/end CHARACTERISTIC
/begin CHARACTERISTIC otENGPOINT_ENMISF "Table for disabling misfire detection in accord to engine working point" MAP 0xFCA850 Lookup2D_UBYTE 0 MisfireDetectionTDC_CM_uint8_adm 0 1
 /begin AXIS_DESCR COM_AXIS NO_INPUT_QUANTITY MisfireDetectionTDC_CM_ufix16_En10_adm 8 0 3 AXIS_PTS_REF okETASP_ENGPOINT_ENMISF /end AXIS_DESCR
 /begin AXIS_DESCR COM_AXIS NO_INPUT_QUANTITY MisfireDetectionTDC_CM_uint16_rpm 8 0 10000 AXIS_PTS_REF okRPM_ENGPOINT_ENMISF /end AXIS_DESCR
/end CHARACTERISTIC
/begin CHARACTERISTIC otTAB_T_CAT "Tabella Stima temperatura catalizzatore" MAP 0xFC4872 Lookup2DSF_UWORD 0 Cata100ms_Symbol_CM_ufix16_Bn40_degC -40 1200
 /begin AXIS_DESCR COM_AXIS NO_INPUT_QUANTITY Cata100ms_Symbol_CM_uint16_rpm 8 0 10000 AXIS_PTS_REF okTB_RPM_CAT /end AXIS_DESCR
 /begin AXIS_DESCR COM_AXIS NO_INPUT_QUANTITY Cata100ms_Symbol_CM_ufix16_En10_adm 8 0 3 AXIS_PTS_REF okTB_ETS_CAT /end AXIS_DESCR
/end CHARACTERISTIC
/begin CHARACTERISTIC otTHR_CYL_MISF1000 "Maximum number of misfire event on single cylinder allowed in last 1000 rpm" MAP 0xFCA7D0 Lookup2D_UWORD 0 FaultChkMDxTDC_CM_uint16_adm 0 500
 /begin AXIS_DESCR COM_AXIS NO_INPUT_QUANTITY FaultChkMDxTDC_CM_ufix16_En10_adm 8 0 3 AXIS_PTS_REF okMEAN_ETASP /end AXIS_DESCR
 /begin AXIS_DESCR COM_AXIS NO_INPUT_QUANTITY FaultChkMDxTDC_CM_uint16_adm 8 0 10000 AXIS_PTS_REF okMEAN_RPM /end AXIS_DESCR
/end CHARACTERISTIC
/begin CHARACTERISTIC otTHR_CYL_MISF200 "Maximum number of misfire event on single cylinder allowed in last 200 rpm" MAP 0xFCA790 Lookup2D_UBYTE 0 FaultChkMDxTDC_CM_uint8_adm 0 100
 /begin AXIS_DESCR COM_AXIS NO_INPUT_QUANTITY FaultChkMDxTDC_CM_ufix16_En10_adm 8 0 3 AXIS_PTS_REF okMEAN_ETASP /end AXIS_DESCR
 /begin AXIS_DESCR COM_AXIS NO_INPUT_QUANTITY FaultChkMDxTDC_CM_uint16_adm 8 0 10000 AXIS_PTS_REF okMEAN_RPM /end AXIS_DESCR
/end CHARACTERISTIC
/begin CHARACTERISTIC otTHR_RND_MISF1000 "Maximum number of overall misfire event allowed in last 1000 rpm" MAP 0xFCA710 Lookup2D_UWORD 0 FaultChkMDxTDC_CM_uint16_adm 0 4000
 /begin AXIS_DESCR COM_AXIS NO_INPUT_QUANTITY FaultChkMDxTDC_CM_ufix16_En10_adm 8 0 3 AXIS_PTS_REF okMEAN_ETASP /end AXIS_DESCR
 /begin AXIS_DESCR COM_AXIS NO_INPUT_QUANTITY FaultChkMDxTDC_CM_uint16_adm 8 0 10000 AXIS_PTS_REF okMEAN_RPM /end AXIS_DESCR
/end CHARACTERISTIC
/begin CHARACTERISTIC otTHR_RND_MISF200 "Maximum number of overall misfire event allowed in last 200 rpm" MAP 0xFCA690 Lookup2D_UWORD 0 FaultChkMDxTDC_CM_uint16_adm 0 800
 /begin AXIS_DESCR COM_AXIS NO_INPUT_QUANTITY FaultChkMDxTDC_CM_ufix16_En10_adm 8 0 3 AXIS_PTS_REF okMEAN_ETASP /end AXIS_DESCR
 /begin AXIS_DESCR COM_AXIS NO_INPUT_QUANTITY FaultChkMDxTDC_CM_uint16_adm 8 0 10000 AXIS_PTS_REF okMEAN_RPM /end AXIS_DESCR
/end CHARACTERISTIC
/begin CHARACTERISTIC otTTHCIC_1G "Table for threshold computation related to cyclicity CIC1" MAP 0xFCA510 Lookup2D_WORD 0 MisfireDetectionTDC_CM_int16_adm -820 820
 /begin AXIS_DESCR COM_AXIS NO_INPUT_QUANTITY MisfireDetectionTDC_CM_ufix16_En10_adm 12 0 3 AXIS_PTS_REF okETASPCIC_1G /end AXIS_DESCR
 /begin AXIS_DESCR COM_AXIS NO_INPUT_QUANTITY MisfireDetectionTDC_CM_uint16_rpm 16 0 10000 AXIS_PTS_REF okRPMCIC_1G /end AXIS_DESCR
/end CHARACTERISTIC
/begin CHARACTERISTIC otTTHCIC_CEC "Table for threshold computation related to cyclicity CICHEC" MAP 0xFCA390 Lookup2D_WORD 0 MisfireDetectionTDC_CM_int16_adm -820 820
 /begin AXIS_DESCR COM_AXIS NO_INPUT_QUANTITY MisfireDetectionTDC_CM_ufix16_En10_adm 12 0 3 AXIS_PTS_REF okETASPCIC_CEC /end AXIS_DESCR
 /begin AXIS_DESCR COM_AXIS NO_INPUT_QUANTITY MisfireDetectionTDC_CM_uint16_rpm 16 0 10000 AXIS_PTS_REF okRPMCIC_CEC /end AXIS_DESCR
/end CHARACTERISTIC
/begin CHARACTERISTIC otTWAMISG "Gain for threshold misfire detection" MAP 0xFCA324 Lookup2D_UWORD 0 MisfireDetectionTDC_CM_ufix16_En9_adm 0 3
 /begin AXIS_DESCR COM_AXIS NO_INPUT_QUANTITY MisfireDetectionTDC_CM_ufix16_En10_adm 6 0 3 AXIS_PTS_REF okETASPTWAMISG /end AXIS_DESCR
 /begin AXIS_DESCR COM_AXIS NO_INPUT_QUANTITY MisfireDetectionTDC_CM_ufix16_Bn40_degC 9 -40 140 AXIS_PTS_REF okTH2OTWAMISG /end AXIS_DESCR
/end CHARACTERISTIC
/begin CHARACTERISTIC otVLTR2 "Tabella per il calcolo della soglia di transizione sonda lambda post catalizzatore" MAP 0xFC4B06 Lookup2DSF_UWORD 0 CataTDC_Symbol_CM_uint16_mV 0 1000
 /begin AXIS_DESCR COM_AXIS NO_INPUT_QUANTITY CataTDC_Symbol_CM_uint16_rpm 12 0 10000 AXIS_PTS_REF okVLTR2_RPM /end AXIS_DESCR
 /begin AXIS_DESCR COM_AXIS NO_INPUT_QUANTITY CataTDC_Symbol_CM_uint16_mbar 12 150 2500 AXIS_PTS_REF okVLTR2_MAP /end AXIS_DESCR
/end CHARACTERISTIC
/begin CHARACTERISTIC ovTB_MAP_NOM "Tabella per calcolo pressione nominale in funzione della temperatura" CURVE 0xFC5A2A Lookup1D_UWORD 0 Test_RipCarica_TDC_Symbol_CM_uint16_mbar 150 2000
 /begin AXIS_DESCR COM_AXIS NO_INPUT_QUANTITY Test_RipCarica_TDC_Symbol_CM_ufix16_Bn40_degC 9 -40 140 AXIS_PTS_REF okVBK_TMAP_NOM /end AXIS_DESCR
/end CHARACTERISTIC
/begin MEASUREMENT psLoadDiagEn "Enable of loads diagnosis after the power relay control block (1 = enabled)" UBYTE Pwrl4ms_CM_boolean_adm 0 0 0 1 ECU_ADDRESS 0x40003FD4 /end MEASUREMENT
/begin MEASUREMENT psLoadEn "Loads command enable after the power relay control block (1 = enabled)" UBYTE Pwrl4ms_CM_boolean_adm 0 0 0 1 ECU_ADDRESS 0x40003FD3 /end MEASUREMENT
/begin CHARACTERISTIC psPWR_DELAY "Power relay closing time" VALUE 0xFCAF52 Scalar_UWORD 0 RecoveryPWR4ms_Symbol_CM_ufix16_E2_ms 0 10000 /end CHARACTERISTIC
/begin MEASUREMENT psPWRel "Power relay command from the control" UBYTE Pwrl4ms_CM_boolean_adm 0 0 0 1 ECU_ADDRESS 0x40003FD5 /end MEASUREMENT
/begin MEASUREMENT psResetTLE09 "Request of resetting TLE6209 (idle bypass driver)" UBYTE Pwrl4ms_CM_boolean_adm 0 0 0 1 ECU_ADDRESS 0x40003FD2 /end MEASUREMENT
/begin CHARACTERISTIC qfAFSTECHIO_Enable "[FIX] Fix for A/F stechiometric value" VALUE 0xFC7FE8 Scalar_UBYTE 0 InjTDC_CM_FixEnableT 171 218 /end CHARACTERISTIC
/begin CHARACTERISTIC qfAFSTECHIO_Value "[FIX] Fix for A/F stechiometric value" VALUE 0xFC7FE6 Scalar_UWORD 0 InjTDC_CM_ufix16_En10_adm 5 30 /end CHARACTERISTIC
/begin CHARACTERISTIC qfAUTOLEAN_SWITCH_Enable "[FIX] Fix for qsAutoLeanSwitch" VALUE 0xFC7FE4 Scalar_UBYTE 0 InjTDC_CM_FixEnableT 171 218 /end CHARACTERISTIC
/begin CHARACTERISTIC qfAUTOLEAN_SWITCH_Value "[FIX] Fix for qsAutoLeanSwitch" VALUE 0xFC7FE3 Scalar_BOOLEAN 0 InjTDC_CM_boolean_adm 0 1 /end CHARACTERISTIC
/begin CHARACTERISTIC qfCOFF_LAM_CORRON_Enable "[FIX] Fix for Lambda CutOff Correction on" VALUE 0xFC7FE2 Scalar_UBYTE 0 InjTDC_CM_FixEnableT 171 218 /end CHARACTERISTIC
/begin CHARACTERISTIC qfCOFF_LAM_CORRON_Value "[FIX] Fix for Lambda CutOff Correction on" VALUE 0xFC7FE1 Scalar_BOOLEAN 0 InjTDC_CM_boolean_adm 0 1 /end CHARACTERISTIC
/begin CHARACTERISTIC qfCRANK_CORR_Enable "[FIX] Fix for Crank" VALUE 0xFC7FE0 Scalar_UBYTE 0 InjTDC_CM_FixEnableT 171 218 /end CHARACTERISTIC
/begin CHARACTERISTIC qfCRANK_CORR_Value "[FIX] Fix for Crank" VALUE 0xFC7FDE Scalar_UWORD 0 InjTDC_CM_ufix16_En10_adm 0 1.599609375 /end CHARACTERISTIC
/begin CHARACTERISTIC qfCUT_OFF_CORR_Enable "[FIX] Fix for Lambda Correction exiting from CutOff" VALUE 0xFC7FDC Scalar_UBYTE 0 InjTDC_CM_FixEnableT 171 218 /end CHARACTERISTIC
/begin CHARACTERISTIC qfCUT_OFF_CORR_Value "[FIX] Fix for Lambda Correction exiting from CutOff" VALUE 0xFC7FDA Scalar_UWORD 0 InjTDC_CM_ufix16_En10_adm 0 1.599609375 /end CHARACTERISTIC
/begin CHARACTERISTIC qfDELAY_IN_Enable "[FIX] Delay time in number of TDC to change from stoich to lean lambase table" VALUE 0xFC7FD8 Scalar_UBYTE 0 InjTDC_CM_FixEnableT 171 218 /end CHARACTERISTIC
/begin CHARACTERISTIC qfDELAY_IN_Value "[FIX] Delay time in number of TDC to change from stoich to lean lambase table" VALUE 0xFC7FD6 Scalar_UWORD 0 InjTDC_CM_uint16_TDC 0 65000 /end CHARACTERISTIC
/begin CHARACTERISTIC qfDELAY_OUT_Enable "[FIX] Delay time in number of TDC to change from stoich to lean lambase table" VALUE 0xFC7FD4 Scalar_UBYTE 0 InjTDC_CM_FixEnableT 171 218 /end CHARACTERISTIC
/begin CHARACTERISTIC qfDELAY_OUT_Value "[FIX] Delay time in number of TDC to change from stoich to lean lambase table" VALUE 0xFC7FD2 Scalar_UWORD 0 InjTDC_CM_uint16_TDC 0 65000 /end CHARACTERISTIC
/begin CHARACTERISTIC qfEND_CUTOFF_ENT_Enable "[FIX] Fix for qsEndCutOffEntry" VALUE 0xFC7FD1 Scalar_UBYTE 0 InjTDC_CM_FixEnableT 171 218 /end CHARACTERISTIC
/begin CHARACTERISTIC qfEND_CUTOFF_ENT_Value "[FIX] Fix for qsEndCutOffEntry" VALUE 0xFC7FD0 Scalar_BOOLEAN 0 InjTDC_CM_boolean_adm 0 1 /end CHARACTERISTIC
/begin CHARACTERISTIC qfEND_CUTOFF_Enable "[FIX] Fix for qsEndCutOff" VALUE 0xFC7FCF Scalar_UBYTE 0 InjTDC_CM_FixEnableT 171 218 /end CHARACTERISTIC
/begin CHARACTERISTIC qfEND_CUTOFF_Value "[FIX] Fix for qsEndCutOff" VALUE 0xFC7FCE Scalar_BOOLEAN 0 InjTDC_CM_boolean_adm 0 1 /end CHARACTERISTIC
/begin CHARACTERISTIC qfEND_PHASE2_Enable "[FIX] Fix for variable qsEndPhase2" VALUE 0xFC7FCD Scalar_UBYTE 0 InjTDC_CM_FixEnableT 171 218 /end CHARACTERISTIC
/begin CHARACTERISTIC qfEND_PHASE2_Value "[FIX] Fix for variable qsEndPhase2" VALUE 0xFC7FCC Scalar_BOOLEAN 0 InjTDC_CM_boolean_adm 0 1 /end CHARACTERISTIC
/begin CHARACTERISTIC qfEND_PHASE3_Enable "[FIX] Fix for variable qsEndPhase3" VALUE 0xFC7FCB Scalar_UBYTE 0 InjTDC_CM_FixEnableT 171 218 /end CHARACTERISTIC
/begin CHARACTERISTIC qfEND_PHASE3_Value "[FIX] Fix for variable qsEndPhase3" VALUE 0xFC7FCA Scalar_BOOLEAN 0 InjTDC_CM_boolean_adm 0 1 /end CHARACTERISTIC
/begin CHARACTERISTIC qfFINJ_Enable "[FIX] Fix for Injection Timing" VALUE 0xFC7FC9 Scalar_UBYTE 0 InjTDC_CM_FixEnableT 171 218 /end CHARACTERISTIC
/begin CHARACTERISTIC qfFINJ_PHASE3_4_Enable "[FIX] Injection Timing  Crank Phase 3 and Normal Mode" VALUE 0xFC7FC8 Scalar_UBYTE 0 InjTDC_CM_FixEnableT 171 218 /end CHARACTERISTIC
/begin CHARACTERISTIC qfFINJ_PHASE3_4_Value "[FIX] Injection Timing  Crank Phase 3 and Normal Mode" VALUE 0xFC7FC6 Scalar_UWORD 0 InjTDC_CM_ufix16_En4_degree 0 360 /end CHARACTERISTIC
/begin CHARACTERISTIC qfFINJ_Value "[FIX] Fix for Injection Timing" VALUE 0xFC7FC4 Scalar_UWORD 0 InjTDC_CM_ufix16_En4_degree 0 720 /end CHARACTERISTIC
/begin CHARACTERISTIC qfGAIN_CRK_Enable "[FIX] Crank Lambda Correction Evolution" VALUE 0xFC7FC2 Scalar_UBYTE 0 InjTDC_CM_FixEnableT 171 218 /end CHARACTERISTIC
/begin CHARACTERISTIC qfGAIN_CRK_Value "[FIX] Crank Lambda Correction Evolution" VALUE 0xFC7FC0 Scalar_UWORD 0 InjTDC_CM_ufix16_En10_adm 0 1.599609375 /end CHARACTERISTIC
/begin CHARACTERISTIC qfHOLD_CURRENT_Enable "[FIX ENABLE] Injector Hold current target" VALUE 0xFC825E Scalar_UBYTE 0 InjectorParms4ms_CM_FixEnableT 171 218 /end CHARACTERISTIC
/begin CHARACTERISTIC qfHOLD_CURRENT_Value "[FIX VALUE] Injector Hold current target" VALUE 0xFC825C Scalar_UWORD 0 InjectorParms4ms_CM_uint16_mA 200 8200 /end CHARACTERISTIC
/begin CHARACTERISTIC qfINJGAIN "[FIX] Injector Gain" VALUE 0xFC8026 Scalar_UWORD 0 InjectorTDC_Symbol_CM_ufix16_En1_us_mg 0 6000 /end CHARACTERISTIC
/begin CHARACTERISTIC qfINJGAIN_EnFix "[FIX] Injector Gain" VALUE 0xFC8024 Scalar_UWORD 0 InjectorTDC_Symbol_CM_FixEnableT 171 218 /end CHARACTERISTIC
/begin CHARACTERISTIC qfINJ_O_DPRE "[FIX] Injector Offset - Pressure Drop Correction" VALUE 0xFC8022 Scalar_UWORD 0 InjectorTDC_Symbol_CM_ufix16_E4_us 0 60000 /end CHARACTERISTIC
/begin CHARACTERISTIC qfINJ_O_DPRE_EnFix "[FIX] Injector Offset - Pressure Drop Correction" VALUE 0xFC8020 Scalar_UWORD 0 InjectorTDC_Symbol_CM_FixEnableT 171 218 /end CHARACTERISTIC
/begin CHARACTERISTIC qfINJ_O_VBPW "[FIX] Injector Offset - Battery Voltage Correction" VALUE 0xFC801E Scalar_UWORD 0 InjectorTDC_Symbol_CM_ufix16_E4_us 0 60000 /end CHARACTERISTIC
/begin CHARACTERISTIC qfINJ_O_VBPW_EnFix "[FIX] Injector Offset - Battery Voltage Correction" VALUE 0xFC801C Scalar_UWORD 0 InjectorTDC_Symbol_CM_FixEnableT 171 218 /end CHARACTERISTIC
/begin CHARACTERISTIC qfINJ_TEMP_Enable "[FIX ENABLE] su temperatura iniettore calcolata" VALUE 0xFC825A Scalar_UBYTE 0 InjectorParms4ms_CM_FixEnableT 171 218 /end CHARACTERISTIC
/begin CHARACTERISTIC qfINJ_TEMP_Value "[FIX VALUE] Valore di bypass su temperatura iniettore calcolata" VALUE 0xFC8258 Scalar_UWORD 0 InjectorParms4ms_CM_ufix16_Bn40_degC -40 140 /end CHARACTERISTIC
/begin CHARACTERISTIC qfINTEGRAL_OVER_Enable "[FIX] Fix for integral over value (0 if you want not use this branch of strategy)" VALUE 0xFC7FBE Scalar_UBYTE 0 InjTDC_CM_FixEnableT 171 218 /end CHARACTERISTIC
/begin CHARACTERISTIC qfINTEGRAL_OVER_Value "[FIX] Fix for integral over value (0 if you want not use this branch of strategy)" VALUE 0xFC7FBD Scalar_BOOLEAN 0 InjTDC_CM_boolean_adm 0 1 /end CHARACTERISTIC
/begin CHARACTERISTIC qfLAMBASE_DELAYED_Enable "[FIX] Fix for Lambda Base delayed value" VALUE 0xFC7FBC Scalar_UBYTE 0 InjTDC_CM_FixEnableT 171 218 /end CHARACTERISTIC
/begin CHARACTERISTIC qfLAMBASE_DELAYED_Value "[FIX] Fix for Lambda Base delayed value" VALUE 0xFC7FBA Scalar_UWORD 0 InjTDC_CM_ufix16_En10_adm 0.015625 1.599609375 /end CHARACTERISTIC
/begin CHARACTERISTIC qfLAMBASE_Enable "[FIX] Basic Lambda" VALUE 0xFC7FB9 Scalar_UBYTE 0 InjTDC_CM_FixEnableT 171 218 /end CHARACTERISTIC
/begin CHARACTERISTIC qfLAMBASE_FILT_Enable "[FIX] Fix for Lambda Base filtered value" VALUE 0xFC7FB8 Scalar_UBYTE 0 InjTDC_CM_FixEnableT 171 218 /end CHARACTERISTIC
/begin CHARACTERISTIC qfLAMBASE_FILT_Value "[FIX] Fix for Lambda Base filtered value" VALUE 0xFC7FB6 Scalar_UWORD 0 InjTDC_CM_ufix16_En10_adm 0.015625 1.599609375 /end CHARACTERISTIC
/begin CHARACTERISTIC qfLAMBASE_LEAN_Enable "[FIX] Basic Lambda for Lean Application" VALUE 0xFC7FB4 Scalar_UBYTE 0 InjTDC_CM_FixEnableT 171 218 /end CHARACTERISTIC
/begin CHARACTERISTIC qfLAMBASE_LEAN_Value "[FIX] Basic Lambda for Lean Application" VALUE 0xFC7FB2 Scalar_UWORD 0 InjTDC_CM_ufix16_En10_adm 0.400390625 1.599609375 /end CHARACTERISTIC
/begin CHARACTERISTIC qfLAMBASE_Value "[FIX] Basic Lambda" VALUE 0xFC7FB0 Scalar_UWORD 0 InjTDC_CM_ufix16_En10_adm 0.400390625 1.599609375 /end CHARACTERISTIC
/begin CHARACTERISTIC qfLAM_OBT_FIN_Enable "[FIX] Fix for qsLamObtFin" VALUE 0xFC7FAE Scalar_UBYTE 0 InjTDC_CM_FixEnableT 171 218 /end CHARACTERISTIC
/begin CHARACTERISTIC qfLAM_OBT_FIN_Value "[FIX] Fix for qsLamObtFin" VALUE 0xFC7FAC Scalar_UWORD 0 InjTDC_CM_ufix16_En10_adm 0.015625 1.599609375 /end CHARACTERISTIC
/begin CHARACTERISTIC qfLAM_TAIR_CORR_Enable "[FIX] Air Temperature Lambda Correction" VALUE 0xFC7FAA Scalar_UBYTE 0 InjTDC_CM_FixEnableT 171 218 /end CHARACTERISTIC
/begin CHARACTERISTIC qfLAM_TAIR_CORR_Value "[FIX] Air Temperature Lambda Correction" VALUE 0xFC7FA8 Scalar_UWORD 0 InjTDC_CM_ufix16_En10_adm 0 1 /end CHARACTERISTIC
/begin CHARACTERISTIC qfLAM_WUP_H2O_Enable "[FIX] Warm Up TH2O Lambda Correction" VALUE 0xFC7FA6 Scalar_UBYTE 0 InjTDC_CM_FixEnableT 171 218 /end CHARACTERISTIC
/begin CHARACTERISTIC qfLAM_WUP_H2O_Value "[FIX] Warm Up TH2O Lambda Correction" VALUE 0xFC7FA4 Scalar_UWORD 0 InjTDC_CM_ufix16_En10_adm 0 1.599609375 /end CHARACTERISTIC
/begin CHARACTERISTIC qfLAM_WUP_OIL_Enable "[FIX] Warm Up  TOil Lambda Correction" VALUE 0xFC7FA2 Scalar_UBYTE 0 InjTDC_CM_FixEnableT 171 218 /end CHARACTERISTIC
/begin CHARACTERISTIC qfLAM_WUP_OIL_Value "[FIX] Warm Up  TOil Lambda Correction" VALUE 0xFC7FA0 Scalar_UWORD 0 InjTDC_CM_ufix16_En10_adm 0 1.599609375 /end CHARACTERISTIC
/begin CHARACTERISTIC qfMIN_INJ_TFLAG "[FIX] Fix for qsMinInjTimeFlag" VALUE 0xFC801A Scalar_UWORD 0 InjectorTDC_Symbol_CM_boolean_adm 0 1 /end CHARACTERISTIC
/begin CHARACTERISTIC qfMIN_INJ_TFLAG_EnFix "[FIX] Fix for qsMinInjTimeFlag" VALUE 0xFC8018 Scalar_UWORD 0 InjectorTDC_Symbol_CM_FixEnableT 171 218 /end CHARACTERISTIC
/begin CHARACTERISTIC qfPEAK_CURRENT_Enable "[FIX ENABLE] Injector Peak current target" VALUE 0xFC8256 Scalar_UBYTE 0 InjectorParms4ms_CM_FixEnableT 171 218 /end CHARACTERISTIC
/begin CHARACTERISTIC qfPEAK_CURRENT_Value "[FIX VALUE] Injector Peak current target" VALUE 0xFC8254 Scalar_UWORD 0 InjectorParms4ms_CM_uint16_mA 1000 8200 /end CHARACTERISTIC
/begin CHARACTERISTIC qfQAIR_REQ_LEAN_IN_Enable "[FIX] Air quantity requested to set on the lean mode in function of rpm" VALUE 0xFC7F9E Scalar_UBYTE 0 InjTDC_CM_FixEnableT 171 218 /end CHARACTERISTIC
/begin CHARACTERISTIC qfQAIR_REQ_LEAN_IN_Value "[FIX] Air quantity requested to set on the lean mode in function of rpm" VALUE 0xFC7F9C Scalar_UWORD 0 InjTDC_CM_ufix16_En4_kg_h 0 3200 /end CHARACTERISTIC
/begin CHARACTERISTIC qfQAIR_REQ_LEAN_OUT_Enable "[FIX] Air quantity requested to set off the lean mode in function of rpm" VALUE 0xFC7F9A Scalar_UBYTE 0 InjTDC_CM_FixEnableT 171 218 /end CHARACTERISTIC
/begin CHARACTERISTIC qfQAIR_REQ_LEAN_OUT_Value "[FIX] Air quantity requested to set off the lean mode in function of rpm" VALUE 0xFC7F98 Scalar_UWORD 0 InjTDC_CM_ufix16_En4_kg_h 0 3200 /end CHARACTERISTIC
/begin CHARACTERISTIC qfQINJ_ADAPT_Enable "[FIX] Fix for Fuel Quantity from Adaptation" VALUE 0xFC7F96 Scalar_UBYTE 0 InjTDC_CM_FixEnableT 171 218 /end CHARACTERISTIC
/begin CHARACTERISTIC qfQINJ_ADAPT_Value "[FIX] Fix for Fuel Quantity from Adaptation" VALUE 0xFC7F94 Scalar_UWORD 0 InjTDC_CM_ufix16_En7_mg_cc 0 500 /end CHARACTERISTIC
/begin CHARACTERISTIC qfQINJ_Enable "[FIX] Fix for variable Qinj" VALUE 0xFC7F92 Scalar_UBYTE 0 InjTDC_CM_FixEnableT 171 218 /end CHARACTERISTIC
/begin CHARACTERISTIC qfQINJ_Value "[FIX] Fix for variable Qinj" VALUE 0xFC7F90 Scalar_UWORD 0 InjTDC_CM_ufix16_En7_mg_cc 0 500 /end CHARACTERISTIC
/begin CHARACTERISTIC qfSHUT_DOWN "[FIX] Fix for csShutDown" VALUE 0xFC8016 Scalar_UWORD 0 InjectorTDC_Symbol_CM_boolean_adm 0 1 /end CHARACTERISTIC
/begin CHARACTERISTIC qfSHUT_DOWN_EnFix "[FIX] Fix for csShutDown" VALUE 0xFC8014 Scalar_UWORD 0 InjectorTDC_Symbol_CM_FixEnableT 171 218 /end CHARACTERISTIC
/begin CHARACTERISTIC qfTINJ "[FIX] Fix for Tinj" VALUE 0xFC8012 Scalar_UWORD 0 InjectorTDC_Symbol_CM_ufix16_E4_us 0 65520 /end CHARACTERISTIC
/begin CHARACTERISTIC qfTINJ_EnFix "[FIX] Fix for Tinj" VALUE 0xFC8010 Scalar_UWORD 0 InjectorTDC_Symbol_CM_FixEnableT 171 218 /end CHARACTERISTIC
/begin CHARACTERISTIC qfT_PEAK_Enable "[FIX ENABLE] for Peak phase duration" VALUE 0xFC8252 Scalar_UBYTE 0 InjectorParms4ms_CM_FixEnableT 171 218 /end CHARACTERISTIC
/begin CHARACTERISTIC qfT_PEAK_Value "[FIX VALUE] Peak phase duration" VALUE 0xFC8250 Scalar_UWORD 0 InjectorParms4ms_CM_uint16_us 200 8200 /end CHARACTERISTIC
/begin CHARACTERISTIC qfWARMUP_CORR_Enable "[FIX] Fix for Warm Up" VALUE 0xFC7F8E Scalar_UBYTE 0 InjTDC_CM_FixEnableT 171 218 /end CHARACTERISTIC
/begin CHARACTERISTIC qfWARMUP_CORR_Value "[FIX] Fix for Warm Up" VALUE 0xFC7F8C Scalar_UWORD 0 InjTDC_CM_ufix16_En10_adm 0 1.599609375 /end CHARACTERISTIC
/begin CHARACTERISTIC qfWUP_LAM_CORRON_Enable "[FIX] Fix for qsWupLamCorrOn" VALUE 0xFC7F8B Scalar_UBYTE 0 InjTDC_CM_FixEnableT 171 218 /end CHARACTERISTIC
/begin CHARACTERISTIC qfWUP_LAM_CORRON_Value "[FIX] Fix for qsWupLamCorrOn" VALUE 0xFC7F8A Scalar_BOOLEAN 0 InjTDC_CM_boolean_adm 0 1 /end CHARACTERISTIC
/begin AXIS_PTS qkETASP_1 "[YBK] Warm Up  TOil Lambda Correction" 0xFC7F7A NO_INPUT_QUANTITY Lookup2D_X_UWORD 0 InjTDC_CM_ufix16_En10_adm 8 0 3 /end AXIS_PTS
/begin AXIS_PTS qkETASP_2 "[YBK] Basic Lambda" 0xFC7F5A NO_INPUT_QUANTITY Lookup2D_X_UWORD 0 InjTDC_CM_ufix16_En10_adm 16 0 3 /end AXIS_PTS
/begin AXIS_PTS qkETASP_3 "[YBK] Injection Timing  Crank Phase 3 and Normal Mode" 0xFC7F42 NO_INPUT_QUANTITY Lookup2D_X_UWORD 0 InjTDC_CM_ufix16_En10_adm 12 0 3 /end AXIS_PTS
/begin AXIS_PTS qkETASP_4 "[YBK] Warm Up TH2O Lambda Correction" 0xFC7F32 NO_INPUT_QUANTITY Lookup2D_X_UWORD 0 InjTDC_CM_ufix16_En10_adm 8 0 3 /end AXIS_PTS
/begin AXIS_PTS qkETASP_5 "[YBK] Basic Lambda for Lean Application" 0xFC7F12 NO_INPUT_QUANTITY Lookup2D_X_UWORD 0 InjTDC_CM_ufix16_En10_adm 16 0 3 /end AXIS_PTS
/begin AXIS_PTS qkPRAIL_1 "[XBK] Injector Gain" 0xFC8118 NO_INPUT_QUANTITY Lookup2D_X_UWORD 0 InjectorTDC_Symbol_CM_uint16_mbar 8 0 13793 /end AXIS_PTS
/begin AXIS_PTS qkPRAIL_2 "[XBK] Injector Offset - Pressure Drop Correction" 0xFC8108 NO_INPUT_QUANTITY Lookup1D_X_UWORD 0 InjectorTDC_Symbol_CM_uint16_mbar 8 0 13793 /end AXIS_PTS
/begin AXIS_PTS qkQAIR_IN "[YBK] Delay time in number of TDC to change from stoich to lean lambase table" 0xFC7EF2 NO_INPUT_QUANTITY Lookup2D_X_UWORD 0 InjTDC_CM_ufix16_En4_kg_h 16 0 3200 /end AXIS_PTS
/begin AXIS_PTS qkQAIR_OUT "[YBK] Delay time in number of TDC to change from stoich to lean lambase table" 0xFC7ED2 NO_INPUT_QUANTITY Lookup2D_X_UWORD 0 InjTDC_CM_ufix16_En4_kg_h 16 0 3200 /end AXIS_PTS
/begin AXIS_PTS qkRPM_1 "[XBK] Basic Lambda" 0xFC7EB2 NO_INPUT_QUANTITY Lookup2D_X_UWORD 0 InjTDC_CM_uint16_rpm 16 0 10000 /end AXIS_PTS
/begin AXIS_PTS qkRPM_2 "[XBK] Injection Timing  Crank Phase 3 and Normal Mode" 0xFC7E92 NO_INPUT_QUANTITY Lookup2D_X_UWORD 0 InjTDC_CM_uint16_rpm 16 0 10000 /end AXIS_PTS
/begin AXIS_PTS qkRPM_3 "[XBK] Basic Lambda for Lean Application" 0xFC7E72 NO_INPUT_QUANTITY Lookup2D_X_UWORD 0 InjTDC_CM_uint16_rpm 16 0 10000 /end AXIS_PTS
/begin AXIS_PTS qkRPM_IN "[XBK] Delay time in number of TDC to change from stoich to lean lambase table" 0xFC7E52 NO_INPUT_QUANTITY Lookup2D_X_UWORD 0 InjTDC_CM_uint16_rpm 16 0 10000 /end AXIS_PTS
/begin AXIS_PTS qkRPM_L_IN "[XBK] Air quantity requested to set on the lean mode in function of rpm" 0xFC7E32 NO_INPUT_QUANTITY Lookup1D_X_UWORD 0 InjTDC_CM_uint16_rpm 16 0 10000 /end AXIS_PTS
/begin AXIS_PTS qkRPM_L_OUT "[XBK] Air quantity requested to set off the lean mode in function of rpm" 0xFC7E12 NO_INPUT_QUANTITY Lookup1D_X_UWORD 0 InjTDC_CM_uint16_rpm 16 0 10000 /end AXIS_PTS
/begin AXIS_PTS qkRPM_OUT "[XBK] Delay time in number of TDC to change from stoich to lean lambase table" 0xFC7DF2 NO_INPUT_QUANTITY Lookup2D_X_UWORD 0 InjTDC_CM_uint16_rpm 16 0 10000 /end AXIS_PTS
/begin AXIS_PTS qkTAIR_1 "[XBK] Air Temperature Lambda Correction" 0xFC7DD2 NO_INPUT_QUANTITY Lookup1D_X_UWORD 0 InjTDC_CM_ufix16_Bn40_degC 16 -40 130 /end AXIS_PTS
/begin AXIS_PTS qkTEMP_INJ1 "[BRK Y] Breakpoint  per tabella tempo di picco." 0xFC8248 NO_INPUT_QUANTITY Lookup2D_X_UWORD 0 InjectorParms4ms_CM_ufix16_Bn40_degC 4 -40 140 /end AXIS_PTS
/begin AXIS_PTS qkTEMP_INJ2 "[BRK Y] Breakpoint per tabella duty cycle fase bypass iniettori" 0xFC8240 NO_INPUT_QUANTITY Lookup2D_X_UWORD 0 InjectorParms4ms_CM_ufix16_Bn40_degC 4 -40 140 /end AXIS_PTS
/begin AXIS_PTS qkTEMP_INJ3 "[BRK Y] Breakpoint per tabella duty cycle fase hold iniettori" 0xFC8238 NO_INPUT_QUANTITY Lookup2D_X_UWORD 0 InjectorParms4ms_CM_ufix16_Bn40_degC 4 -40 140 /end AXIS_PTS
/begin AXIS_PTS qkTH2O_3 "[XBK] Crank Lambda Correction Evolution" 0xFC7DB2 NO_INPUT_QUANTITY Lookup1D_X_UWORD 0 InjTDC_CM_ufix16_Bn40_degC 16 -40 140 /end AXIS_PTS
/begin AXIS_PTS qkTH2O_9 "[XBK] Warm Up TH2O Lambda Correction" 0xFC7DA2 NO_INPUT_QUANTITY Lookup2D_X_UWORD 0 InjTDC_CM_ufix16_Bn40_degC 8 -40 140 /end AXIS_PTS
/begin AXIS_PTS qkTOIL "[XBK] Warm Up  TOil Lambda Correction" 0xFC7D92 NO_INPUT_QUANTITY Lookup2D_X_UWORD 0 InjTDC_CM_ufix16_Bn40_degC 8 -40 130 /end AXIS_PTS
/begin AXIS_PTS qkTRAIL_2 "[YBK] Injector Gain" 0xFC80F8 NO_INPUT_QUANTITY Lookup2D_X_UWORD 0 InjectorTDC_Symbol_CM_ufix16_Bn40_degC 8 -40 150 /end AXIS_PTS
/begin AXIS_PTS qkVBPW "[XBK] Injector Offset - Battery Voltage Correction" 0xFC80D8 NO_INPUT_QUANTITY Lookup1D_X_UWORD 0 InjectorTDC_Symbol_CM_ufix16_S50_mV 16 12000 36000 /end AXIS_PTS
/begin AXIS_PTS qkVBPW_1 "[BRK X] Breakpoint VBPW per tabella tempo di picco." 0xFC8228 NO_INPUT_QUANTITY Lookup2D_X_UWORD 0 InjectorParms4ms_CM_ufix16_S50_mVolt 8 8000 42000 /end AXIS_PTS
/begin AXIS_PTS qkVBPW_2 "[BRK X] Breakpoint VBPW per tabella corrente di picco." 0xFC8218 NO_INPUT_QUANTITY Lookup2D_X_UWORD 0 InjectorParms4ms_CM_ufix16_S50_mVolt 8 8000 42000 /end AXIS_PTS
/begin AXIS_PTS qkVBPW_3 "[BRK X] Breakpoint VBPW per tabella corrente di hold" 0xFC8208 NO_INPUT_QUANTITY Lookup2D_X_UWORD 0 InjectorParms4ms_CM_ufix16_S50_mVolt 8 8000 42000 /end AXIS_PTS
/begin CHARACTERISTIC qsAFSTECHIO_INIT "A/F stechiometric init value" VALUE 0xFC7D90 Scalar_UWORD 0 InjTDC_CM_ufix16_En10_adm 5 30 /end CHARACTERISTIC
/begin CHARACTERISTIC qsAFSTECHIO_MAX "A/F stechiometric maximum value" VALUE 0xFC7D8E Scalar_UWORD 0 InjTDC_CM_ufix16_En10_adm 5 30 /end CHARACTERISTIC
/begin CHARACTERISTIC qsAFSTECHIO_MIN "A/F stechiometric minimum value" VALUE 0xFC7D8C Scalar_UWORD 0 InjTDC_CM_ufix16_En10_adm 5 30 /end CHARACTERISTIC
/begin MEASUREMENT qsAFStechio "A/F stoichiometric value" UWORD Airq_CtrlMgmtTDC_CM_ufix16_En10_adm 0 0 5 30 ECU_ADDRESS 0x40003180 /end MEASUREMENT
/begin MEASUREMENT qsAFStechioInit "Valore di inizializzazione di A/F stechiometrico" UWORD AutoTDC_CM_ufix16_En10_adm 0 0 5 30 ECU_ADDRESS 0x4000317A /end MEASUREMENT
/begin MEASUREMENT qsAFStechioWr "Test Point sulla variabile qsAFStechioWr" UWORD InjTDC_CM_ufix16_En10_adm 0 0 5 30 ECU_ADDRESS 0x4000325A /end MEASUREMENT
/begin MEASUREMENT qsAutoLeanSwitch "Test Point sulla variabile qsAutoLeanSwitch (variabile di attivazione tabelle lean)" UBYTE InjTDC_CM_boolean_adm 0 0 0 1 ECU_ADDRESS 0x40003258 /end MEASUREMENT
/begin CHARACTERISTIC qsCOLD_DESTICKING_EN "Cold desticking procedure enable" VALUE 0xFC8206 Scalar_BOOLEAN 0 InjectorParms4ms_CM_boolean_adm 0 1 /end CHARACTERISTIC
/begin CHARACTERISTIC qsCOLD_FASTDEC_TIME "Fast decay transition (from peak to hold phase) time calibration during cold desticking procedure." VALUE 0xFC8204 Scalar_UWORD 0 InjectorParms4ms_CM_uint16_us 0 2000 /end CHARACTERISTIC
/begin CHARACTERISTIC qsCOLD_HOLD_CURR "Hold Current for cold injector desticking procedure" VALUE 0xFC8202 Scalar_UWORD 0 InjectorParms4ms_CM_uint16_mA 200 8200 /end CHARACTERISTIC
/begin CHARACTERISTIC qsCOLD_PEAK_CURR "Peak Current for cold injector desticking procedure" VALUE 0xFC8200 Scalar_UWORD 0 InjectorParms4ms_CM_uint16_mA 1000 8200 /end CHARACTERISTIC
/begin CHARACTERISTIC qsCOLD_PEAK_TIME "Peak phase duration for cold desticking procedure" VALUE 0xFC81FE Scalar_UWORD 0 InjectorParms4ms_CM_uint16_us 200 8200 /end CHARACTERISTIC
/begin CHARACTERISTIC qsCOLD_TINJ "Cold Injector Opening Time" VALUE 0xFC81FC Scalar_UWORD 0 InjectorParms4ms_CM_ufix16_E4_us 0 80000 /end CHARACTERISTIC
/begin MEASUREMENT qsCOLamCorrErr "Smooth sulla correzione lambda in uscita da CutOff" SWORD InjTDC_CM_sfix16_En10_adm 0 0 -1 0.599609375 ECU_ADDRESS 0x40003256 /end MEASUREMENT
/begin CHARACTERISTIC qsCO_EXIT_LAM_CORR "Correzione lambda in uscita da CutOff" VALUE 0xFC7D8A Scalar_UWORD 0 InjTDC_CM_ufix16_En10_adm 0 1.599609375 /end CHARACTERISTIC
/begin CHARACTERISTIC qsCUTOFF_SMOOTH_EN "Abilitazione alla gestione carburante in ingresso-uscita CutOff " VALUE 0xFC7D88 Scalar_BOOLEAN 0 InjTDC_CM_boolean_adm 0 1 /end CHARACTERISTIC
/begin MEASUREMENT qsCoffLamCorrOn "CutOff lambda correction on" UBYTE InjtTDC_CM_boolean_adm 0 0 0 1 ECU_ADDRESS 0x4000316A /end MEASUREMENT
/begin MEASUREMENT qsColdDestickingCnd "Enable condition for cold injector desticking procedure" UBYTE InjectorParms4ms_CM_boolean_adm 0 0 0 1 ECU_ADDRESS 0x400032E4 /end MEASUREMENT
/begin MEASUREMENT qsColdInjEnd "Cold Injector procedure ended" UBYTE Injt_SetParameters4ms_CM_boolean_adm 0 0 0 1 ECU_ADDRESS 0x400032AC /end MEASUREMENT
/begin MEASUREMENT qsColdInjRunning "Cold Injector procedure running" UBYTE Injt_SetParameters4ms_CM_boolean_adm 0 0 0 1 ECU_ADDRESS 0x400032AD /end MEASUREMENT
/begin MEASUREMENT qsCorCutofOutFar "Test Point sulla variabile qsCorCutofOutFar" UWORD InjTDC_CM_ufix16_En7__ 0 0 70 100 ECU_ADDRESS 0x40003254 /end MEASUREMENT
/begin MEASUREMENT qsCorCutofOutRpm "Test Point sulla variabile qsCorCutofOutRpm" UWORD InjTDC_CM_ufix16_En7__ 0 0 70 100 ECU_ADDRESS 0x40003252 /end MEASUREMENT
/begin MEASUREMENT qsCorrCutOffIn "Test Point sulla variabile qsCorrCutOffIn" UWORD InjTDC_CM_ufix16_En7__ 0 0 0 100 ECU_ADDRESS 0x40003250 /end MEASUREMENT
/begin MEASUREMENT qsCrk3LamCorrErr "Smooth sulla correzione lambda in cranking fase 3" SWORD InjTDC_CM_sfix16_En10_adm 0 0 -1.599609375 1.599609375 ECU_ADDRESS 0x4000324E /end MEASUREMENT
/begin MEASUREMENT qsCrkLamCorr "Crank lambda correction" UWORD InjtTDC_CM_ufix16_En10_adm 0 0 0 1.599609375 ECU_ADDRESS 0x40003182 /end MEASUREMENT
/begin MEASUREMENT qsCrkLamCorrPh3 "Test Point sulla variabile qsCrkLamCorrPh3" UWORD InjTDC_CM_ufix16_En10_adm 0 0 0 1.599609375 ECU_ADDRESS 0x4000324C /end MEASUREMENT
/begin MEASUREMENT qsCrkLamCorrTmp "Test Point sulla variabile qsCrkLamCorrTmp" UWORD InjTDC_CM_ufix16_En10_adm 0 0 0 1.599609375 ECU_ADDRESS 0x4000324A /end MEASUREMENT
/begin MEASUREMENT qsCutOffState3 "Test Point sulla variabile qsCutOffState3" UBYTE InjTDC_CM_boolean_adm 0 0 0 1 ECU_ADDRESS 0x40003249 /end MEASUREMENT
/begin MEASUREMENT qsCutOffState4 "Test Point sulla variabile qsCutOffState4" UBYTE InjTDC_CM_boolean_adm 0 0 0 1 ECU_ADDRESS 0x40003248 /end MEASUREMENT
/begin CHARACTERISTIC qsDELTA_START "Delta time delay between cold desticking injectors start commands." VALUE 0xFC81FA Scalar_UWORD 0 InjectorParms4ms_CM_ufix16_Sp004_s 0.008 262.14 /end CHARACTERISTIC
/begin MEASUREMENT qsDelayIn "[OUT] Delay time in number of TDC to change from stoich to lean lambase table" UWORD InjTDC_CM_uint16_TDC 0 0 0 65000 ECU_ADDRESS 0x40003246 /end MEASUREMENT
/begin MEASUREMENT qsDelayOut "[OUT] Delay time in number of TDC to change from stoich to lean lambase table" UWORD InjTDC_CM_uint16_TDC 0 0 0 65000 ECU_ADDRESS 0x40003244 /end MEASUREMENT
/begin MEASUREMENT qsDeltaPRail "Delta pressure during Cold injection desticking procedure (start/end)" SWORD Injt_SetParameters4ms_CM_int16_mbar 0 0 -13793 13793 ECU_ADDRESS 0x400032AE /end MEASUREMENT
/begin MEASUREMENT qsEnAdatAF "Test Point sulla variabile qsEnAdatAF" UBYTE InjTDC_CM_boolean_adm 0 0 0 1 ECU_ADDRESS 0x40003242 /end MEASUREMENT
/begin MEASUREMENT qsEndCutOff "Flag di fine cut-off" UBYTE EgmdTDC_CM_boolean_adm 0 0 0 1 ECU_ADDRESS 0x4000316C /end MEASUREMENT
/begin MEASUREMENT qsEndCutOffEntry "Flag di abilitazione ingresso in cut-off" UBYTE EgmdTDC_CM_boolean_adm 0 0 0 1 ECU_ADDRESS 0x4000316D /end MEASUREMENT
/begin MEASUREMENT qsEndCutOffFar "Test Point sulla variabile qsEndCutOffFar" UBYTE InjTDC_CM_boolean_adm 0 0 0 1 ECU_ADDRESS 0x40003241 /end MEASUREMENT
/begin MEASUREMENT qsEndCutOffRpm "Test Point sulla variabile qsEndCutOffRpm" UBYTE InjTDC_CM_boolean_adm 0 0 0 1 ECU_ADDRESS 0x40003240 /end MEASUREMENT
/begin MEASUREMENT qsEndPhase2 "Flag of End Crank Phase 2" UBYTE EgmdTDC_CM_boolean_adm 0 0 0 1 ECU_ADDRESS 0x4000316F /end MEASUREMENT
/begin MEASUREMENT qsEndPhase3 "Flag of End Crank Phase 3" UBYTE EgmdTDC_CM_boolean_adm 0 0 0 1 ECU_ADDRESS 0x4000316E /end MEASUREMENT
/begin MEASUREMENT qsErrSmoothCnt "Contatore per lo smoothing correzione lambda in uscita CutOff" UWORD InjTDC_CM_ufix16_En10_adm 0 0 0 1 ECU_ADDRESS 0x4000323E /end MEASUREMENT
/begin MEASUREMENT qsErrSmthCrk3Cnt "Contatore per lo smoothing correzione lambda in crancking fase 3" UWORD InjTDC_CM_ufix16_En10_adm 0 0 0 1 ECU_ADDRESS 0x4000323C /end MEASUREMENT
/begin CHARACTERISTIC qsFAST_DECAY_TIME "Fast decay transition (from peak to hold phase) time calibration." VALUE 0xFC81F8 Scalar_UWORD 0 InjectorParms4ms_CM_uint16_us 0 2000 /end CHARACTERISTIC
/begin CHARACTERISTIC qsFINJ_PHASE2 "Injection Timing Crank Phase 2" VALUE 0xFC7D86 Scalar_UWORD 0 InjTDC_CM_ufix16_En4_degree 0 720 /end CHARACTERISTIC
/begin MEASUREMENT qsFInj "Injection Phase" UWORD DiagSym100ms_CM_ufix16_En4_degree 0 0 0 720 ECU_ADDRESS 0x40003178 /end MEASUREMENT
/begin MEASUREMENT qsFinjPhase34 "[OUT] Injection Timing  Crank Phase 3 and Normal Mode" UWORD InjTDC_CM_ufix16_En4_degree 0 0 0 360 ECU_ADDRESS 0x4000323A /end MEASUREMENT
/begin MEASUREMENT qsFuelPostCutOff "Test Point sulla variabile qsFuelPostCutOff" UWORD InjTDC_CM_ufix16_En7_mg_cc 0 0 0 500 ECU_ADDRESS 0x40003238 /end MEASUREMENT
/begin MEASUREMENT qsFuelPreCutOff "Test Point sulla variabile qsFuelPreCutOff" UWORD InjTDC_CM_ufix16_En7_mg_cc 0 0 0 500 ECU_ADDRESS 0x40003236 /end MEASUREMENT
/begin CHARACTERISTIC qsGAIN_CRK_MAX "Maximum Crank Lambda Correction " VALUE 0xFC7D84 Scalar_UWORD 0 InjTDC_CM_ufix16_En10_adm 0 0.998046875 /end CHARACTERISTIC
/begin MEASUREMENT qsGainCrk "[OUT] Crank Lambda Correction Evolution" UWORD InjTDC_CM_ufix16_En10_adm 0 0 0 1.599609375 ECU_ADDRESS 0x40003234 /end MEASUREMENT
/begin MEASUREMENT qsHoldCurrent "Injector Hold current target before saturation" UWORD InjectorParms4ms_CM_uint16_mA 0 0 200 8200 ECU_ADDRESS 0x400032E2 /end MEASUREMENT
/begin MEASUREMENT qsInjCylx "Cylinder X start injection command" UBYTE InjectorParms4ms_CM_uint8_adm 0 0 0 7 ECU_ADDRESS 0x400032E0 /end MEASUREMENT
/begin MEASUREMENT qsInjODpre "[OUT] Injector Offset - Pressure Drop Correction" UWORD InjectorTDC_Symbol_CM_ufix16_E4_us 0 0 0 60000 ECU_ADDRESS 0x4000318E /end MEASUREMENT
/begin MEASUREMENT qsInjOVbpw "[OUT] Injector Offset - Battery Voltage Correction" UWORD InjectorTDC_Symbol_CM_ufix16_E4_us 0 0 0 60000 ECU_ADDRESS 0x4000318C /end MEASUREMENT
/begin MEASUREMENT qsInjTemperature "Test point su temperatura iniettore calcolata" UWORD InjectorParms4ms_CM_ufix16_Bn40_degC 0 0 -40 140 ECU_ADDRESS 0x400032DE /end MEASUREMENT
/begin MEASUREMENT qsInjgain "[OUT] Injector Gain" UWORD InjectorTDC_Symbol_CM_ufix16_En1_us_mg 0 0 0 6000 ECU_ADDRESS 0x4000318A /end MEASUREMENT
/begin CHARACTERISTIC qsK_TAIR "Costante per temperatura aria" VALUE 0xFC81F6 Scalar_UWORD 0 InjectorParms4ms_CM_ufix16_En7_adm 0 1 /end CHARACTERISTIC
/begin CHARACTERISTIC qsK_TH2O "Costatante per temperatura acqua" VALUE 0xFC81F4 Scalar_UWORD 0 InjectorParms4ms_CM_ufix16_En7_adm 0 1 /end CHARACTERISTIC
/begin CHARACTERISTIC qsK_TRAIL "Costante per temperatura rail" VALUE 0xFC81F2 Scalar_UWORD 0 InjectorParms4ms_CM_ufix16_En7_adm 0 1 /end CHARACTERISTIC
/begin CHARACTERISTIC qsLAMBASE_DELAY_L2R "Number of TDC to wait before to apply lambda base value as target when a transition from Rich Target to Lean one occurs" VALUE 0xFC7D82 Scalar_UWORD 0 InjTDC_CM_uint16_adm 0 50000 /end CHARACTERISTIC
/begin CHARACTERISTIC qsLAMBASE_DELAY_R2L "Number of TDC to wait before to apply lambda base value as target when a transition from Lean Target to Rich one occurs" VALUE 0xFC7D80 Scalar_UWORD 0 InjTDC_CM_uint16_adm 0 50000 /end CHARACTERISTIC
/begin CHARACTERISTIC qsLAMBASE_DELTA_L2R "Threshold to use the delay block when a transition from Lean Target to Rich one occurs" VALUE 0xFC7D7E Scalar_UWORD 0 InjTDC_CM_ufix16_En10_adm 0 1.599609375 /end CHARACTERISTIC
/begin CHARACTERISTIC qsLAMBASE_DELTA_R2L "Threshold to use the delay block when a transition from Rich Target to Lean one occurs" VALUE 0xFC7D7C Scalar_UWORD 0 InjTDC_CM_ufix16_En10_adm 0 1.599609375 /end CHARACTERISTIC
/begin CHARACTERISTIC qsLAMBASE_STEP_L2R "Value of step increment to add to lambda target to get the desired value when a transition from Lean Target to Rich one occurs" VALUE 0xFC7D7A Scalar_UWORD 0 InjTDC_CM_ufix16_En10_adm 0 1 /end CHARACTERISTIC
/begin CHARACTERISTIC qsLAMBASE_STEP_R2L "Value of step decrement to remove from lambda target to get the desired value when a transition from Rich Target to Lean one occurs" VALUE 0xFC7D78 Scalar_UWORD 0 InjTDC_CM_ufix16_En10_adm 0 1 /end CHARACTERISTIC
/begin MEASUREMENT qsLamBase "[OUT] Basic Lambda" UWORD InjTDC_CM_ufix16_En10_adm 0 0 0.400390625 1.599609375 ECU_ADDRESS 0x40003232 /end MEASUREMENT
/begin MEASUREMENT qsLamBaseDelayed "Test Point sulla variabile qsLamBase dopo ritardatore" UWORD InjTDC_CM_ufix16_En10_adm 0 0 0.015625 1.599609375 ECU_ADDRESS 0x40003230 /end MEASUREMENT
/begin MEASUREMENT qsLamBaseFilt "Test Point sulla variabile qsLamBase dopo filtraggio" UWORD InjTDC_CM_ufix16_En10_adm 0 0 0.015625 1.599609375 ECU_ADDRESS 0x4000322E /end MEASUREMENT
/begin MEASUREMENT qsLamBaseFiltRes "ambda res to be applied" UWORD Dcat_Diagnosis100ms_CM_ufix16_En10_adm 0 0 0.015625 1.599609375 ECU_ADDRESS 0x4000317C /end MEASUREMENT
/begin MEASUREMENT qsLamBaseLean "[OUT] Basic Lambda for Lean Application" UWORD InjTDC_CM_ufix16_En10_adm 0 0 0.400390625 1.599609375 ECU_ADDRESS 0x4000322C /end MEASUREMENT
/begin MEASUREMENT qsLamObt "Test Point sulla variabile qsLamObt" UWORD InjTDC_CM_ufix16_En10_adm 0 0 0.015625 1.599609375 ECU_ADDRESS 0x4000322A /end MEASUREMENT
/begin MEASUREMENT qsLamObtFin "inal Lambda Obt used in AsuF as Lambda target to apply" UWORD Airq_CtrlMgmtTDC_CM_ufix16_En10_adm 0 0 0.015625 1.599609375 ECU_ADDRESS 0x4000317E /end MEASUREMENT
/begin MEASUREMENT qsLamTairCorr "[OUT] Air Temperature Lambda Correction" UWORD InjTDC_CM_ufix16_En10_adm 0 0 0 1 ECU_ADDRESS 0x40003228 /end MEASUREMENT
/begin MEASUREMENT qsLamWupH2o "[OUT] Warm Up TH2O Lambda Correction" UWORD InjTDC_CM_ufix16_En10_adm 0 0 0 1.599609375 ECU_ADDRESS 0x40003226 /end MEASUREMENT
/begin MEASUREMENT qsLamWupOil "[OUT] Warm Up  TOil Lambda Correction" UWORD InjTDC_CM_ufix16_En10_adm 0 0 0 1.599609375 ECU_ADDRESS 0x40003224 /end MEASUREMENT
/begin CHARACTERISTIC qsMININJTIME "Minimum Injection Time" VALUE 0xFC800E Scalar_UWORD 0 InjectorTDC_Symbol_CM_ufix16_E4_us 0 3008 /end CHARACTERISTIC
/begin MEASUREMENT qsMinInjTimeFlag "Flag of minimum injection time" UBYTE InjtTDC_CM_boolean_adm 0 0 0 1 ECU_ADDRESS 0x40003168 /end MEASUREMENT
/begin CHARACTERISTIC qsNTDC_PHASE2 "Number of TDC for Lambda Corr in Crank Phase2" VALUE 0xFC7D76 Scalar_UWORD 0 InjTDC_CM_uint16_TDC 0 65535 /end CHARACTERISTIC
/begin CHARACTERISTIC qsN_INIET_CYL "Numero iniettori per cilindro  (1 - applicazione NEF; 2 - applicazione F2G)" VALUE 0xFC800C Scalar_UWORD 0 InjectorTDC_Symbol_CM_uint16_adm 1 2 /end CHARACTERISTIC
/begin CHARACTERISTIC qsOFF_CUTOF_FAR "Offset dello Step di correzione del Qinj per uscita da cut-off per farfalla" VALUE 0xFC7D74 Scalar_UWORD 0 InjTDC_CM_ufix16_En7__ 70 100 /end CHARACTERISTIC
/begin CHARACTERISTIC qsOFF_CUTOF_RPM "Offset dello Step di correzione del Qinj per uscita da cut-off per giri" VALUE 0xFC7D72 Scalar_UWORD 0 InjTDC_CM_ufix16_En7__ 70 100 /end CHARACTERISTIC
/begin CHARACTERISTIC qsOFF_IN_CUTOFF "Offset dello Step di correzione del Qinj per ingresso in cut-off" VALUE 0xFC7D70 Scalar_UWORD 0 InjTDC_CM_ufix16_En7__ 25 100 /end CHARACTERISTIC
/begin MEASUREMENT qsPeakCurrent "Injector Peak current target" UWORD InjectorParms4ms_CM_uint16_mA 0 0 1000 8200 ECU_ADDRESS 0x400032DC /end MEASUREMENT
/begin CHARACTERISTIC qsQAIR_ACCUM_H_THR "High sat limitfor integral accumulator (kg/h)" VALUE 0xFC7D6C Scalar_ULONG 0 InjTDC_CM_ufix32_En4_Bn130000000_kg_h -130000000 130000000 /end CHARACTERISTIC
/begin CHARACTERISTIC qsQAIR_ACCUM_INIT "Initial condition for integral accumulator (kg/h)" VALUE 0xFC7D68 Scalar_ULONG 0 InjTDC_CM_ufix32_En4_Bn130000000_kg_h -130000000 130000000 /end CHARACTERISTIC
/begin CHARACTERISTIC qsQAIR_ACCUM_L_THR "High sat limitfor integral accumulator (kg/h)" VALUE 0xFC7D64 Scalar_ULONG 0 InjTDC_CM_ufix32_En4_Bn130000000_kg_h -130000000 130000000 /end CHARACTERISTIC
/begin CHARACTERISTIC qsQAIR_DELTA_IN "Delta to add to threshold on qAir request after which use the Lean Table" VALUE 0xFC7D62 Scalar_UWORD 0 InjTDC_CM_ufix16_En4_kg_h 0 800 /end CHARACTERISTIC
/begin CHARACTERISTIC qsQAIR_DELTA_OUT "Delta to add to threshold on qAir request after which use the Lean Table" VALUE 0xFC7D60 Scalar_UWORD 0 InjTDC_CM_ufix16_En4_kg_h 0 800 /end CHARACTERISTIC
/begin CHARACTERISTIC qsQAIR_INT_THR "Threshold on max integer on the difference to go Lean" VALUE 0xFC7D5C Scalar_ULONG 0 InjTDC_CM_ufix32_En4_Bn130000000_kg_h -130000000 130000000 /end CHARACTERISTIC
/begin MEASUREMENT qsQAirReqDiff "Difference between qsQAir_Request and qsQAirReqLeanIn" ULONG InjTDC_CM_ufix32_En4_Bn130000000_kg_h 0 0 -130000000 130000000 ECU_ADDRESS 0x40003220 /end MEASUREMENT
/begin MEASUREMENT qsQAirReqLeanIn "[OUT] Air quantity requested to set on the lean mode in function of rpm" UWORD InjTDC_CM_ufix16_En4_kg_h 0 0 0 3200 ECU_ADDRESS 0x4000321C /end MEASUREMENT
/begin MEASUREMENT qsQAirReqLeanOut "[OUT] Air quantity requested to set off the lean mode in function of rpm" UWORD InjTDC_CM_ufix16_En4_kg_h 0 0 0 3200 ECU_ADDRESS 0x4000321A /end MEASUREMENT
/begin MEASUREMENT qsQInj "Injection CNG quantity during phase 1" UWORD Airq_CtrlMgmtTDC_CM_ufix16_En7_mg_cc 0 0 0 500 ECU_ADDRESS 0x40003174 /end MEASUREMENT
/begin MEASUREMENT qsQinjAdapt "Test Point sulla variabile qsQinjAdapt" UWORD InjTDC_CM_ufix16_En7_mg_cc 0 0 0 500 ECU_ADDRESS 0x40003218 /end MEASUREMENT
/begin MEASUREMENT qsQinjPreAdapt "Test Point sulla variabile qsQinjPreAdapt" UWORD InjTDC_CM_ufix16_En7_mg_cc 0 0 0 500 ECU_ADDRESS 0x40003216 /end MEASUREMENT
/begin CHARACTERISTIC qsRPMTRH_PHASE2 "RPM Threshold for Lambda Corr in Crank Phase2" VALUE 0xFC7D5A Scalar_UWORD 0 InjTDC_CM_uint16_RPM 0 10000 /end CHARACTERISTIC
/begin CHARACTERISTIC qsSTEP_CUTOF_FAR "Step di correzione del Qinj per uscita da cut-off per farfalla" VALUE 0xFC7D58 Scalar_UWORD 0 InjTDC_CM_ufix16_En7__ 0 100 /end CHARACTERISTIC
/begin CHARACTERISTIC qsSTEP_CUTOF_RPM "Step di correzione del Qinj per uscit da cut-off per giri" VALUE 0xFC7D56 Scalar_UWORD 0 InjTDC_CM_ufix16_En7__ 0 100 /end CHARACTERISTIC
/begin CHARACTERISTIC qsSTEP_ERR_CRK3 "Numero di passi per raccordo correzione lambda in crancking fase3" VALUE 0xFC7D54 Scalar_UWORD 0 InjTDC_CM_uint16_adm 1 1000 /end CHARACTERISTIC
/begin CHARACTERISTIC qsSTEP_ERR_LAMCORR "Numero di passi per raccordo correzione lambda in uscita CutOff" VALUE 0xFC7D52 Scalar_UBYTE 0 InjTDC_CM_uint8_adm 1 100 /end CHARACTERISTIC
/begin CHARACTERISTIC qsSTEP_IN_CUTOFF "Step di correzione del Qinj per ingresso in cut-off" VALUE 0xFC7D50 Scalar_UWORD 0 InjTDC_CM_ufix16_En7__ 0 100 /end CHARACTERISTIC
/begin MEASUREMENT qsStInjDesticking "Cold Injector Desticking FSM State" UBYTE InjectorParms4ms_CM_tColdInjState_adm 0 0 0 5 ECU_ADDRESS 0x400032DB /end MEASUREMENT
/begin MEASUREMENT qsStartImmInjection "Cold injector start immediate command" UBYTE InjectorParms4ms_CM_boolean_adm 0 0 0 1 ECU_ADDRESS 0x400032DA /end MEASUREMENT
/begin CHARACTERISTIC qsTAIR_LOW_THR "Manifold air temperature low threshold to activate injectors cold sticking procedure" VALUE 0xFC81F0 Scalar_UWORD 0 InjectorParms4ms_CM_ufix16_Bn40_degC -40 130 /end CHARACTERISTIC
/begin CHARACTERISTIC qsTH2O_LOW_THR "Coolant temperature low threshold to activate injectors cold sticking procedure" VALUE 0xFC81EE Scalar_UWORD 0 InjectorParms4ms_CM_ufix16_Bn40_degC -40 140 /end CHARACTERISTIC
/begin MEASUREMENT qsTInj "Injection Time" UWORD DiagSym100ms_CM_ufix16_E4_us 0 0 0 65520 ECU_ADDRESS 0x40003170 /end MEASUREMENT
/begin MEASUREMENT qsTPeak "Duration of peak time before saturation" UWORD InjectorParms4ms_CM_uint16_us 0 0 200 8200 ECU_ADDRESS 0x400032D8 /end MEASUREMENT
/begin CHARACTERISTIC qsTRAIL_LOW_THR "Rail temperature low threshold to activate injectors cold sticking procedure" VALUE 0xFC81EC Scalar_UWORD 0 InjectorParms4ms_CM_ufix16_Bn40_degC -40 150 /end CHARACTERISTIC
/begin CHARACTERISTIC qsTWUP "Threshold WarmUp Temperature" VALUE 0xFC7D4E Scalar_UWORD 0 InjTDC_CM_ufix16_Bn40_degC -40 130 /end CHARACTERISTIC
/begin CHARACTERISTIC qsTWUP_MIN_HIS "Threshold - Hysteresis WarmUp Temperature" VALUE 0xFC7D4C Scalar_UWORD 0 InjTDC_CM_ufix16_Bn40_degC -40 130 /end CHARACTERISTIC
/begin MEASUREMENT qsTjBase "Test Point sulla variabile qsTjBase" UWORD InjectorTDC_Symbol_CM_ufix16_E4_us 0 0 0 65520 ECU_ADDRESS 0x40003188 /end MEASUREMENT
/begin MEASUREMENT qsTjBaseTemp "Test Point sulla variabile qsTjbaseTemp" ULONG InjectorTDC_Symbol_CM_ufix32_E4_us 0 0 0 3000000 ECU_ADDRESS 0x40003190 /end MEASUREMENT
/begin CHARACTERISTIC qsVBPW_LOW_THR "Battery voltage (after relay) low threshold under which the injector cold sticking procedure cannot be activated." VALUE 0xFC81EA Scalar_UWORD 0 InjectorParms4ms_CM_ufix16_S50_mV 12000 36000 /end CHARACTERISTIC
/begin MEASUREMENT qsWUpLamCorr "Test Point sulla variabile qsWUpLamCorr" UWORD InjTDC_CM_ufix16_En10_adm 0 0 0 1.599609375 ECU_ADDRESS 0x40003214 /end MEASUREMENT
/begin MEASUREMENT qsWupLamCorrOn "Warm Up lambda correction flag" UBYTE Airt100ms_CM_boolean_adm 0 0 0 1 ECU_ADDRESS 0x4000316B /end MEASUREMENT
/begin CHARACTERISTIC qtDELAY_IN "Delay time in number of TDC to change from stoich to lean lambase table" MAP 0xFC7B4C Lookup2D_UWORD 0 InjTDC_CM_uint16_TDC 0 65000
 /begin AXIS_DESCR COM_AXIS NO_INPUT_QUANTITY InjTDC_CM_ufix16_En4_kg_h 16 0 3200 AXIS_PTS_REF qkQAIR_IN /end AXIS_DESCR
 /begin AXIS_DESCR COM_AXIS NO_INPUT_QUANTITY InjTDC_CM_uint16_rpm 16 0 10000 AXIS_PTS_REF qkRPM_IN /end AXIS_DESCR
/end CHARACTERISTIC
/begin CHARACTERISTIC qtDELAY_OUT "Delay time in number of TDC to change from stoich to lean lambase table" MAP 0xFC794C Lookup2D_UWORD 0 InjTDC_CM_uint16_TDC 0 65000
 /begin AXIS_DESCR COM_AXIS NO_INPUT_QUANTITY InjTDC_CM_ufix16_En4_kg_h 16 0 3200 AXIS_PTS_REF qkQAIR_OUT /end AXIS_DESCR
 /begin AXIS_DESCR COM_AXIS NO_INPUT_QUANTITY InjTDC_CM_uint16_rpm 16 0 10000 AXIS_PTS_REF qkRPM_OUT /end AXIS_DESCR
/end CHARACTERISTIC
/begin CHARACTERISTIC qtFINJ_PHASE3_4 "Injection Timing  Crank Phase 3 and Normal Mode" MAP 0xFC77CC Lookup2D_UWORD 0 InjTDC_CM_ufix16_En4_degree 0 360
 /begin AXIS_DESCR COM_AXIS NO_INPUT_QUANTITY InjTDC_CM_ufix16_En10_adm 12 0 3 AXIS_PTS_REF qkETASP_3 /end AXIS_DESCR
 /begin AXIS_DESCR COM_AXIS NO_INPUT_QUANTITY InjTDC_CM_uint16_rpm 16 0 10000 AXIS_PTS_REF qkRPM_2 /end AXIS_DESCR
/end CHARACTERISTIC
/begin CHARACTERISTIC qtHOLD_CURRENT "[TAB] Injector Hold current target" MAP 0xFC81AA Lookup2D_UWORD 0 InjectorParms4ms_CM_uint16_mA 200 8200
 /begin AXIS_DESCR COM_AXIS NO_INPUT_QUANTITY InjectorParms4ms_CM_ufix16_Bn40_degC 4 -40 140 AXIS_PTS_REF qkTEMP_INJ3 /end AXIS_DESCR
 /begin AXIS_DESCR COM_AXIS NO_INPUT_QUANTITY InjectorParms4ms_CM_ufix16_S50_mVolt 8 8000 42000 AXIS_PTS_REF qkVBPW_3 /end AXIS_DESCR
/end CHARACTERISTIC
/begin CHARACTERISTIC qtINJGAIN "Injector Gain" MAP 0xFC8058 Lookup2DSF_UWORD 0 InjectorTDC_Symbol_CM_ufix16_En1_us_mg 0 6000
 /begin AXIS_DESCR COM_AXIS NO_INPUT_QUANTITY InjectorTDC_Symbol_CM_ufix16_Bn40_degC 8 -40 150 AXIS_PTS_REF qkTRAIL_2 /end AXIS_DESCR
 /begin AXIS_DESCR COM_AXIS NO_INPUT_QUANTITY InjectorTDC_Symbol_CM_uint16_mbar 8 0 13793 AXIS_PTS_REF qkPRAIL_1 /end AXIS_DESCR
/end CHARACTERISTIC
/begin CHARACTERISTIC qtLAMBASE "Basic Lambda" MAP 0xFC75CC Lookup2D_UWORD 0 InjTDC_CM_ufix16_En10_adm 0.400390625 1.599609375
 /begin AXIS_DESCR COM_AXIS NO_INPUT_QUANTITY InjTDC_CM_ufix16_En10_adm 16 0 3 AXIS_PTS_REF qkETASP_2 /end AXIS_DESCR
 /begin AXIS_DESCR COM_AXIS NO_INPUT_QUANTITY InjTDC_CM_uint16_rpm 16 0 10000 AXIS_PTS_REF qkRPM_1 /end AXIS_DESCR
/end CHARACTERISTIC
/begin CHARACTERISTIC qtLAMBASE_LEAN "Basic Lambda for Lean Application" MAP 0xFC73CC Lookup2D_UWORD 0 InjTDC_CM_ufix16_En10_adm 0.400390625 1.599609375
 /begin AXIS_DESCR COM_AXIS NO_INPUT_QUANTITY InjTDC_CM_ufix16_En10_adm 16 0 3 AXIS_PTS_REF qkETASP_5 /end AXIS_DESCR
 /begin AXIS_DESCR COM_AXIS NO_INPUT_QUANTITY InjTDC_CM_uint16_rpm 16 0 10000 AXIS_PTS_REF qkRPM_3 /end AXIS_DESCR
/end CHARACTERISTIC
/begin CHARACTERISTIC qtLAM_WUP_H2O "Warm Up TH2O Lambda Correction" MAP 0xFC734C Lookup2D_UWORD 0 InjTDC_CM_ufix16_En10_adm 0 1.599609375
 /begin AXIS_DESCR COM_AXIS NO_INPUT_QUANTITY InjTDC_CM_ufix16_En10_adm 8 0 3 AXIS_PTS_REF qkETASP_4 /end AXIS_DESCR
 /begin AXIS_DESCR COM_AXIS NO_INPUT_QUANTITY InjTDC_CM_ufix16_Bn40_degC 8 -40 140 AXIS_PTS_REF qkTH2O_9 /end AXIS_DESCR
/end CHARACTERISTIC
/begin CHARACTERISTIC qtLAM_WUP_OIL "Warm Up  TOil Lambda Correction" MAP 0xFC72CC Lookup2D_UWORD 0 InjTDC_CM_ufix16_En10_adm 0 1.599609375
 /begin AXIS_DESCR COM_AXIS NO_INPUT_QUANTITY InjTDC_CM_ufix16_En10_adm 8 0 3 AXIS_PTS_REF qkETASP_1 /end AXIS_DESCR
 /begin AXIS_DESCR COM_AXIS NO_INPUT_QUANTITY InjTDC_CM_ufix16_Bn40_degC 8 -40 130 AXIS_PTS_REF qkTOIL /end AXIS_DESCR
/end CHARACTERISTIC
/begin CHARACTERISTIC qtPEAK_CURRENT "[TAB] Injector Peak current target" MAP 0xFC816A Lookup2D_UWORD 0 InjectorParms4ms_CM_uint16_mA 1000 8200
 /begin AXIS_DESCR COM_AXIS NO_INPUT_QUANTITY InjectorParms4ms_CM_ufix16_Bn40_degC 4 -40 140 AXIS_PTS_REF qkTEMP_INJ2 /end AXIS_DESCR
 /begin AXIS_DESCR COM_AXIS NO_INPUT_QUANTITY InjectorParms4ms_CM_ufix16_S50_mVolt 8 8000 42000 AXIS_PTS_REF qkVBPW_2 /end AXIS_DESCR
/end CHARACTERISTIC
/begin CHARACTERISTIC qtT_PEAK "[TAB] Peak phase duration" MAP 0xFC812A Lookup2D_UWORD 0 InjectorParms4ms_CM_uint16_us 200 8200
 /begin AXIS_DESCR COM_AXIS NO_INPUT_QUANTITY InjectorParms4ms_CM_ufix16_Bn40_degC 4 -40 140 AXIS_PTS_REF qkTEMP_INJ1 /end AXIS_DESCR
 /begin AXIS_DESCR COM_AXIS NO_INPUT_QUANTITY InjectorParms4ms_CM_ufix16_S50_mVolt 8 8000 42000 AXIS_PTS_REF qkVBPW_1 /end AXIS_DESCR
/end CHARACTERISTIC
/begin CHARACTERISTIC qvGAIN_CRK "Crank Lambda Correction Evolution" CURVE 0xFC72AC Lookup1D_UWORD 0 InjTDC_CM_ufix16_En10_adm 0 1.599609375
 /begin AXIS_DESCR COM_AXIS NO_INPUT_QUANTITY InjTDC_CM_ufix16_Bn40_degC 16 -40 140 AXIS_PTS_REF qkTH2O_3 /end AXIS_DESCR
/end CHARACTERISTIC
/begin CHARACTERISTIC qvINJ_O_DPRE "Injector Offset - Pressure Drop Correction" CURVE 0xFC8048 Lookup1D_UWORD 0 InjectorTDC_Symbol_CM_ufix16_E4_us 0 60000
 /begin AXIS_DESCR COM_AXIS NO_INPUT_QUANTITY InjectorTDC_Symbol_CM_uint16_mbar 8 0 13793 AXIS_PTS_REF qkPRAIL_2 /end AXIS_DESCR
/end CHARACTERISTIC
/begin CHARACTERISTIC qvINJ_O_VBPW "Injector Offset - Battery Voltage Correction" CURVE 0xFC8028 Lookup1D_UWORD 0 InjectorTDC_Symbol_CM_ufix16_E4_us 0 60000
 /begin AXIS_DESCR COM_AXIS NO_INPUT_QUANTITY InjectorTDC_Symbol_CM_ufix16_S50_mV 16 12000 36000 AXIS_PTS_REF qkVBPW /end AXIS_DESCR
/end CHARACTERISTIC
/begin CHARACTERISTIC qvLAM_TAIR_CORR "Air Temperature Lambda Correction" CURVE 0xFC728C Lookup1D_UWORD 0 InjTDC_CM_ufix16_En10_adm 0 1
 /begin AXIS_DESCR COM_AXIS NO_INPUT_QUANTITY InjTDC_CM_ufix16_Bn40_degC 16 -40 130 AXIS_PTS_REF qkTAIR_1 /end AXIS_DESCR
/end CHARACTERISTIC
/begin CHARACTERISTIC qvQAIR_REQ_LEAN_IN "Air quantity requested to set on the lean mode in function of rpm" CURVE 0xFC726C Lookup1D_UWORD 0 InjTDC_CM_ufix16_En4_kg_h 0 3200
 /begin AXIS_DESCR COM_AXIS NO_INPUT_QUANTITY InjTDC_CM_uint16_rpm 16 0 10000 AXIS_PTS_REF qkRPM_L_IN /end AXIS_DESCR
/end CHARACTERISTIC
/begin CHARACTERISTIC qvQAIR_REQ_LEAN_OUT "Air quantity requested to set off the lean mode in function of rpm" CURVE 0xFC724C Lookup1D_UWORD 0 InjTDC_CM_ufix16_En4_kg_h 0 3200
 /begin AXIS_DESCR COM_AXIS NO_INPUT_QUANTITY InjTDC_CM_uint16_rpm 16 0 10000 AXIS_PTS_REF qkRPM_L_OUT /end AXIS_DESCR
/end CHARACTERISTIC
/begin CHARACTERISTIC rfENG_RUN "[FIX] Fix for rsEngRun variable" VALUE 0xFC2D2E Scalar_UWORD 0 TF_TE_StarterMgm4ms_Symbol_CM_boolean_adm 0 1 /end CHARACTERISTIC
/begin CHARACTERISTIC rfENG_RUN_CRK "[FIX] Threshold RPM for disable starter" VALUE 0xFC2D2A Scalar_UWORD 0 TF_TE_StarterMgm4ms_Symbol_CM_uint16_rpm 0 2000 /end CHARACTERISTIC
/begin CHARACTERISTIC rfENG_RUN_CRK_EnFix "[FIX] Threshold RPM for disable starter" VALUE 0xFC2D28 Scalar_UWORD 0 TF_TE_StarterMgm4ms_Symbol_CM_FixEnableT 171 218 /end CHARACTERISTIC
/begin CHARACTERISTIC rfENG_RUN_EnFix "[FIX] Fix for rsEngRun variable" VALUE 0xFC2D2C Scalar_UWORD 0 TF_TE_StarterMgm4ms_Symbol_CM_FixEnableT 171 218 /end CHARACTERISTIC
/begin CHARACTERISTIC rfEN_START "[FIX] Fix for engine start" VALUE 0xFC2D26 Scalar_UWORD 0 TF_TE_StarterMgm4ms_Symbol_CM_boolean_adm 0 1 /end CHARACTERISTIC
/begin CHARACTERISTIC rfEN_START_EnFix "[FIX] Fix for engine start" VALUE 0xFC2D24 Scalar_UWORD 0 TF_TE_StarterMgm4ms_Symbol_CM_FixEnableT 171 218 /end CHARACTERISTIC
/begin CHARACTERISTIC rfGEAR_CPL_NEG "[FIX] Fix su rsGearCoupledNeg for engine start managment" VALUE 0xFC2D22 Scalar_UWORD 0 TF_TE_StarterMgm4ms_Symbol_CM_boolean_adm 0 1 /end CHARACTERISTIC
/begin CHARACTERISTIC rfGEAR_CPL_NEG_EnFix "[FIX] Fix su rsGearCoupledNeg for engine start managment" VALUE 0xFC2D20 Scalar_UWORD 0 TF_TE_StarterMgm4ms_Symbol_CM_FixEnableT 171 218 /end CHARACTERISTIC
/begin CHARACTERISTIC rfPARK_BRK "[FIX] Fix su rsParkBrk for engine start managment" VALUE 0xFC2D1E Scalar_UWORD 0 TF_TE_StarterMgm4ms_Symbol_CM_boolean_adm 0 1 /end CHARACTERISTIC
/begin CHARACTERISTIC rfPARK_BRK_EnFix "[FIX] Fix su rsParkBrk for engine start managment" VALUE 0xFC2D1C Scalar_UWORD 0 TF_TE_StarterMgm4ms_Symbol_CM_FixEnableT 171 218 /end CHARACTERISTIC
/begin CHARACTERISTIC rfSTARTER "[FIX] Fix for rsStarter variable" VALUE 0xFC2D1A Scalar_UWORD 0 TF_TE_StarterMgm4ms_Symbol_CM_boolean_adm 0 1 /end CHARACTERISTIC
/begin CHARACTERISTIC rfSTARTER_EnFix "[FIX] Fix for rsStarter variable" VALUE 0xFC2D18 Scalar_UWORD 0 TF_TE_StarterMgm4ms_Symbol_CM_FixEnableT 171 218 /end CHARACTERISTIC
/begin CHARACTERISTIC rfSTART_CRANK "[FIX] Fix for rsStartCrank variable (motore avviato da vano motore)" VALUE 0xFC2D16 Scalar_UWORD 0 TF_TE_StarterMgm4ms_Symbol_CM_boolean_adm 0 1 /end CHARACTERISTIC
/begin CHARACTERISTIC rfSTART_CRANK_EnFix "[FIX] Fix for rsStartCrank variable (motore avviato da vano motore)" VALUE 0xFC2D14 Scalar_UWORD 0 TF_TE_StarterMgm4ms_Symbol_CM_FixEnableT 171 218 /end CHARACTERISTIC
/begin AXIS_PTS rkTH2O "[XBK] Threshold RPM for disable starter" 0xFC2D50 NO_INPUT_QUANTITY Lookup1D_X_UWORD 0 TF_TE_StarterMgm4ms_Symbol_CM_ufix16_Bn40_degC 16 -40 140 /end AXIS_PTS
/begin MEASUREMENT rsAckCrkFrstStep "Test Point of rsAckCrkFrstStep flag" UBYTE TF_TE_StarterMgm4ms_Symbol_CM_boolean_adm 0 0 0 1 ECU_ADDRESS 0x4000237E /end MEASUREMENT
/begin MEASUREMENT rsAckStartBut "Test Point of rsAckStartBut flag" UBYTE TF_TE_StarterMgm4ms_Symbol_CM_boolean_adm 0 0 0 1 ECU_ADDRESS 0x4000237D /end MEASUREMENT
/begin CHARACTERISTIC rsEN_EMERG_START "Enable for Start emergency management" VALUE 0xFC2D0C Scalar_BOOLEAN 0 TF_TE_StarterMgm4ms_Symbol_CM_boolean_adm 0 1 /end CHARACTERISTIC
/begin MEASUREMENT rsEngRun "Flag superamento soglia di giri al cranking (threshold mappata in funzione di Th2o)" UBYTE Crkc4ms_CM_boolean_adm 0 0 0 1 ECU_ADDRESS 0x40002350 /end MEASUREMENT
/begin MEASUREMENT rsEngRunCrk "[OUT] Threshold RPM for disable starter" UWORD TF_TE_StarterMgm4ms_Symbol_CM_uint16_rpm 0 0 0 2000 ECU_ADDRESS 0x40002380 /end MEASUREMENT
/begin MEASUREMENT rsKeyEngStart "Seconda posizione chiave mascherata (zsKeyEngStart AND hsAvvInhibit)" UBYTE Crkc4ms_CM_boolean_adm 0 0 0 1 ECU_ADDRESS 0x4000234F /end MEASUREMENT
/begin CHARACTERISTIC rsPED_ACC_EM "Accelerator pedal threshold for emergengy start management" VALUE 0xFC2D12 Scalar_UWORD 0 TF_TE_StarterMgm4ms_Symbol_CM_ufix16_En4__ 0 100 /end CHARACTERISTIC
/begin MEASUREMENT rsSpeedNulCond "Define id speed equal zero " UBYTE TF_TE_StarterMgm4ms_Symbol_CM_boolean_adm 0 0 0 1 ECU_ADDRESS 0x4000237C /end MEASUREMENT
/begin MEASUREMENT rsStartCrank "Informazione di motore avviato da vano motore" UBYTE Crkc4ms_CM_boolean_adm 0 0 0 1 ECU_ADDRESS 0x4000234E /end MEASUREMENT
/begin MEASUREMENT rsStartEmerg "Test Point of rsStartEmerg flag" UBYTE TF_TE_StarterMgm4ms_Symbol_CM_boolean_adm 0 0 0 1 ECU_ADDRESS 0x4000237B /end MEASUREMENT
/begin MEASUREMENT rsStarter "Flag for driving starter" UBYTE Crkc4ms_CM_boolean_adm 0 0 0 1 ECU_ADDRESS 0x40002351 /end MEASUREMENT
/begin MEASUREMENT rsStarterCbt "Test Point of rsStarterCbt flag" UBYTE TF_TE_StarterMgm4ms_Symbol_CM_boolean_adm 0 0 0 1 ECU_ADDRESS 0x4000237A /end MEASUREMENT
/begin MEASUREMENT rsStarterStd "Test Point of rsStarterStd flag" UBYTE TF_TE_StarterMgm4ms_Symbol_CM_boolean_adm 0 0 0 1 ECU_ADDRESS 0x40002379 /end MEASUREMENT
/begin CHARACTERISTIC rsTIME_START_CBT "Time threshold in order to filter start command" VALUE 0xFC2D10 Scalar_UWORD 0 TF_TE_StarterMgm4ms_Symbol_CM_uint16_s 0 255 /end CHARACTERISTIC
/begin CHARACTERISTIC rsTIME_START_EM "Time threshold for emergengy start management" VALUE 0xFC2D0E Scalar_UWORD 0 TF_TE_StarterMgm4ms_Symbol_CM_uint16_s 0 255 /end CHARACTERISTIC
/begin CHARACTERISTIC rvENG_RUN_CRK "Threshold RPM for disable starter" CURVE 0xFC2D30 Lookup1D_UWORD 0 TF_TE_StarterMgm4ms_Symbol_CM_uint16_rpm 0 2000
 /begin AXIS_DESCR COM_AXIS NO_INPUT_QUANTITY TF_TE_StarterMgm4ms_Symbol_CM_ufix16_Bn40_degC 16 -40 140 AXIS_PTS_REF rkTH2O /end AXIS_DESCR
/end CHARACTERISTIC
/begin CHARACTERISTIC sfACT_DIAG_PHASE_Enable "[FIX] Fix sulla fase di diagnosi attiva - task base tempo" VALUE 0xFC559D Scalar_UBYTE 0 EngineState4ms_CM_FixEnableT 171 218 /end CHARACTERISTIC
/begin CHARACTERISTIC sfACT_DIAG_PHASE_Value "[FIX] Fix sulla fase di diagnosi attiva - task base tempo" VALUE 0xFC559C Scalar_UBYTE 0 EngineState4ms_CM_uint8_adm 0 2 /end CHARACTERISTIC
/begin CHARACTERISTIC sfACT_DIAG_REQ_Enable "[FIX] Fix sulla richiesta di diagnosi attiva da ETS" VALUE 0xFC559B Scalar_UBYTE 0 EngineState4ms_CM_FixEnableT 171 218 /end CHARACTERISTIC
/begin CHARACTERISTIC sfACT_DIAG_REQ_Value "[FIX] Fix sulla richiesta di diagnosi attiva da ETS" VALUE 0xFC559A Scalar_BOOLEAN 0 EngineState4ms_CM_boolean_adm 0 1 /end CHARACTERISTIC
/begin CHARACTERISTIC sfAVV_INHIBIT_Enable "[FIX] Fix sulla richiesta di inhibit avviamento" VALUE 0xFC5599 Scalar_UBYTE 0 EngineState4ms_CM_FixEnableT 171 218 /end CHARACTERISTIC
/begin CHARACTERISTIC sfAVV_INHIBIT_Value "[FIX] Fix sulla richiesta di inhibit avviamento" VALUE 0xFC5598 Scalar_BOOLEAN 0 EngineState4ms_CM_boolean_adm 0 1 /end CHARACTERISTIC
/begin CHARACTERISTIC sfAVV_INH_RUN_OFF_Enable "[FIX] Fix sulla disabilitazione di inhibit avviamento fuori da Run e Wait" VALUE 0xFC5597 Scalar_UBYTE 0 EngineState4ms_CM_FixEnableT 171 218 /end CHARACTERISTIC
/begin CHARACTERISTIC sfAVV_INH_RUN_OFF_Value "[FIX] Fix sulla disabilitazione di inhibit avviamento fuori da Run e Wait" VALUE 0xFC5596 Scalar_BOOLEAN 0 EngineState4ms_CM_boolean_adm 0 1 /end CHARACTERISTIC
/begin CHARACTERISTIC sfAVV_REQUEST_Enable "[FIX] Fix di richiesta avviamento (da abitacolo o da vano motore)" VALUE 0xFC5595 Scalar_UBYTE 0 EngineState4ms_CM_FixEnableT 171 218 /end CHARACTERISTIC
/begin CHARACTERISTIC sfAVV_REQUEST_Value "[FIX] Fix di richiesta avviamento (da abitacolo o da vano motore)" VALUE 0xFC5594 Scalar_BOOLEAN 0 EngineState4ms_CM_boolean_adm 0 1 /end CHARACTERISTIC
/begin CHARACTERISTIC sfENG_STATE_Enable "[FIX] Fix sullo stato motore" VALUE 0xFC5593 Scalar_UBYTE 0 EngineState4ms_CM_FixEnableT 171 218 /end CHARACTERISTIC
/begin CHARACTERISTIC sfENG_STATE_Value "[FIX] Fix sullo stato motore" VALUE 0xFC5592 Scalar_UBYTE 0 EngineState4ms_CM_uint8_adm 0 6 /end CHARACTERISTIC
/begin CHARACTERISTIC sfFORCE_LOAD_OFF_Enable "[FIX] Fix di disabilitazione comandi in PowerOn" VALUE 0xFC5591 Scalar_UBYTE 0 EngineState4ms_CM_FixEnableT 171 218 /end CHARACTERISTIC
/begin CHARACTERISTIC sfFORCE_LOAD_OFF_Value "[FIX] Fix di disabilitazione comandi in PowerOn" VALUE 0xFC5590 Scalar_BOOLEAN 0 EngineState4ms_CM_boolean_adm 0 1 /end CHARACTERISTIC
/begin CHARACTERISTIC sfPON_DIAG_END_Enable "[FIX] Fix di abilitazione in avviamento fine diagnosi (transizione PowerOn -> Wait)" VALUE 0xFC558F Scalar_UBYTE 0 EngineState4ms_CM_FixEnableT 171 218 /end CHARACTERISTIC
/begin CHARACTERISTIC sfPON_DIAG_END_OFF_Enable "[FIX] Fix per abilitare gestione flag DiagEnd nella transizione da PowerOn a Wait (0-> DiagEnd gestito (comportamento neutro); 1-> DiagEnd non gestito)" VALUE 0xFC558E Scalar_UBYTE 0 EngineState4ms_CM_FixEnableT 171 218 /end CHARACTERISTIC
/begin CHARACTERISTIC sfPON_DIAG_END_OFF_Value "[FIX] Fix per abilitare gestione flag DiagEnd nella transizione da PowerOn a Wait (0-> DiagEnd gestito (comportamento neutro); 1-> DiagEnd non gestito)" VALUE 0xFC558D Scalar_BOOLEAN 0 EngineState4ms_CM_boolean_adm 0 1 /end CHARACTERISTIC
/begin CHARACTERISTIC sfPON_DIAG_END_Value "[FIX] Fix di abilitazione in avviamento fine diagnosi (transizione PowerOn -> Wait)" VALUE 0xFC558C Scalar_BOOLEAN 0 EngineState4ms_CM_boolean_adm 0 1 /end CHARACTERISTIC
/begin CHARACTERISTIC sfPON_DIAG_OK_Enable "[FIX] Fix di abilitazione in avviamento transizione PowerOn -> Wait (diagnosi al PowerOn)" VALUE 0xFC558B Scalar_UBYTE 0 EngineState4ms_CM_FixEnableT 171 218 /end CHARACTERISTIC
/begin CHARACTERISTIC sfPON_DIAG_OK_Value "[FIX] Fix di abilitazione in avviamento transizione PowerOn -> Wait (diagnosi al PowerOn)" VALUE 0xFC558A Scalar_BOOLEAN 0 EngineState4ms_CM_boolean_adm 0 1 /end CHARACTERISTIC
/begin CHARACTERISTIC sfPWR_REQ_Enable "[FIX] Fix sulla richiesta di apertura/chiusura del relè di potenza" VALUE 0xFC5589 Scalar_UBYTE 0 EngineState4ms_CM_FixEnableT 171 218 /end CHARACTERISTIC
/begin CHARACTERISTIC sfPWR_REQ_Value "[FIX] Fix sulla richiesta di apertura/chiusura del relè di potenza" VALUE 0xFC5588 Scalar_BOOLEAN 0 EngineState4ms_CM_boolean_adm 0 1 /end CHARACTERISTIC
/begin CHARACTERISTIC sfSAFETY_OK_Enable "[FIX] Fix sullo stato della safety IBIT" VALUE 0xFC5587 Scalar_UBYTE 0 EngineState4ms_CM_FixEnableT 171 218 /end CHARACTERISTIC
/begin CHARACTERISTIC sfSAFETY_OK_Value "[FIX] Fix sullo stato della safety IBIT" VALUE 0xFC5586 Scalar_BOOLEAN 0 EngineState4ms_CM_boolean_adm 0 1 /end CHARACTERISTIC
/begin CHARACTERISTIC sfSTOP_REQ_CBT_Enable "[FIX] Fix di richiesta stop motore (da vano motore)" VALUE 0xFC5585 Scalar_UBYTE 0 EngineState4ms_CM_FixEnableT 171 218 /end CHARACTERISTIC
/begin CHARACTERISTIC sfSTOP_REQ_CBT_Value "[FIX] Fix di richiesta stop motore (da vano motore)" VALUE 0xFC5584 Scalar_BOOLEAN 0 EngineState4ms_CM_boolean_adm 0 1 /end CHARACTERISTIC
/begin CHARACTERISTIC sfWAIT_AVV_PHASE_Enable "[FIX] Fix di disabilitazione comandi in PowerOn" VALUE 0xFC5583 Scalar_UBYTE 0 EngineState4ms_CM_FixEnableT 171 218 /end CHARACTERISTIC
/begin CHARACTERISTIC sfWAIT_AVV_PHASE_Value "[FIX] Fix di disabilitazione comandi in PowerOn" VALUE 0xFC5582 Scalar_UBYTE 0 EngineState4ms_CM_uint8_adm 0 2 /end CHARACTERISTIC
/begin MEASUREMENT ssActDiagPhTmp "Fase della diagnosi attiva in uscita da StateFlow" UBYTE EngineState4ms_CM_uint8_adm 0 0 0 2 ECU_ADDRESS 0x40002BC4 /end MEASUREMENT
/begin MEASUREMENT ssActDiagPhase "Fasi di diagnosi attiva - task base tempo" UBYTE Egst4ms_CM_eActDiagPh_adm 0 0 0 2 ECU_ADDRESS 0x40002B8E /end MEASUREMENT
/begin MEASUREMENT ssActDiagReqTmp "Richiesta servizio di diagnosi attiva componente" UBYTE EngineState4ms_CM_boolean_adm 0 0 0 1 ECU_ADDRESS 0x40002BC3 /end MEASUREMENT
/begin MEASUREMENT ssAvvInhRunOff "Disabilitazione avviamento fuori da Run " UBYTE EngineState4ms_CM_boolean_adm 0 0 0 1 ECU_ADDRESS 0x40002BC2 /end MEASUREMENT
/begin MEASUREMENT ssAvvInhibit "Inibizione avviamento" UBYTE Egst4ms_CM_boolean_adm 0 0 0 1 ECU_ADDRESS 0x40002B90 /end MEASUREMENT
/begin MEASUREMENT ssAvvInhibitTmp "[PRE FIX] Richiesta di inhibit avviamento (da abitacolo o da vano motore)" UBYTE EngineState4ms_CM_boolean_adm 0 0 0 1 ECU_ADDRESS 0x40002BC1 /end MEASUREMENT
/begin MEASUREMENT ssAvvRequestCndTmp "Flag di richiesta avviamento (da abitacolo o da vano motore)" UBYTE EngineState4ms_CM_boolean_adm 0 0 0 1 ECU_ADDRESS 0x40002BC0 /end MEASUREMENT
/begin MEASUREMENT ssAvvRequestTmp "Flag di richiesta avviamento (da abitacolo o da vano motore). \r\n      Se sta girando l\'applicazione TE, altrimenti richiesta sempre a 0." UBYTE EngineState4ms_CM_boolean_adm 0 0 0 1 ECU_ADDRESS 0x40002BBF /end MEASUREMENT
/begin MEASUREMENT ssEngIgnited "lag di motore avviato" UBYTE DiagSym100ms_CM_boolean_adm 0 0 0 1 ECU_ADDRESS 0x40002BC5 /end MEASUREMENT
/begin MEASUREMENT ssEngState "Stato motore" UBYTE Airt100ms_CM_eEGST_adm 0 0 0 6 ECU_ADDRESS 0x40002B8F /end MEASUREMENT
/begin MEASUREMENT ssEngStateTmp "Stato motore in uscita da StateFlow" UBYTE EngineState4ms_CM_uint8_adm 0 0 0 6 ECU_ADDRESS 0x40002BBE /end MEASUREMENT
/begin MEASUREMENT ssForceLoadOff "Disabilitazione comandi in PowerOn" UBYTE Egst4ms_CM_boolean_adm 0 0 0 1 ECU_ADDRESS 0x40002B91 /end MEASUREMENT
/begin MEASUREMENT ssForceLoadOffTmp "Richiesta disabilitazione carichi in uscita da StateFlow" UBYTE EngineState4ms_CM_boolean_adm 0 0 0 1 ECU_ADDRESS 0x40002BBD /end MEASUREMENT
/begin MEASUREMENT ssPONDiagEndOff "[PRE_FIX] Flag di abilitazione DiagEnd nella transizione da PowerOn a Wait (0-> DiagEnd gestito (comportamento neutro); 1-> DiagEnd non gestito)" UBYTE EngineState4ms_CM_boolean_adm 0 0 0 1 ECU_ADDRESS 0x40002BBC /end MEASUREMENT
/begin MEASUREMENT ssPONDiagEndTmp "Flag di abilitazione avviamento (tutte le diagnosi al Power ON sono finite)" UBYTE EngineState4ms_CM_boolean_adm 0 0 0 1 ECU_ADDRESS 0x40002BBB /end MEASUREMENT
/begin MEASUREMENT ssPONDiagOkTmp "Flag di abilitazione avviamento (tutte le diagnosi al Power ON sono ok)" UBYTE EngineState4ms_CM_boolean_adm 0 0 0 1 ECU_ADDRESS 0x40002BBA /end MEASUREMENT
/begin MEASUREMENT ssPONEVRContStat "Flag sullo stato del comando del relè elettrovalvole effettuata al POWER_ON." UBYTE EngineState4ms_CM_boolean_adm 0 0 0 1 ECU_ADDRESS 0x40002BB9 /end MEASUREMENT
/begin MEASUREMENT ssPONEVRDiagStat "Flag sullo stato di fine diagnosi elettrica del relè elettrovalvole effettuata al POWER_ON." UBYTE EngineState4ms_CM_boolean_adm 0 0 0 1 ECU_ADDRESS 0x40002BB8 /end MEASUREMENT
/begin MEASUREMENT ssPONElQStat "Flag sullo stato di fine diagnosi elettrica del quadro segnali (smot e camma) effettuata al POWER_ON." UBYTE EngineState4ms_CM_boolean_adm 0 0 0 1 ECU_ADDRESS 0x40002BB7 /end MEASUREMENT
/begin MEASUREMENT ssPONPRVContStat "Flag sullo stato del comando elettrovalvola riduttore effettuata al POWER_ON." UBYTE EngineState4ms_CM_boolean_adm 0 0 0 1 ECU_ADDRESS 0x40002BB6 /end MEASUREMENT
/begin MEASUREMENT ssPONPRVDiagStat "Flag sullo stato di fine diagnosi dell`elettrovalvola riduttore effettuata al POWER_ON." UBYTE EngineState4ms_CM_boolean_adm 0 0 0 1 ECU_ADDRESS 0x40002BB5 /end MEASUREMENT
/begin MEASUREMENT ssPONPWRContStat "Flag sullo stato del contatto del power relè effettuata al POWER_ON." UBYTE EngineState4ms_CM_boolean_adm 0 0 0 1 ECU_ADDRESS 0x40002BB4 /end MEASUREMENT
/begin MEASUREMENT ssPONPWRDiagStat "Flag sullo stato di fine diagnosi del power relè effettuata al POWER_ON." UBYTE EngineState4ms_CM_boolean_adm 0 0 0 1 ECU_ADDRESS 0x40002BB3 /end MEASUREMENT
/begin MEASUREMENT ssPONSTRContStat "Flag di abilitazione all`avviamento (diag. al Power ON dello starter relay ok)" UBYTE EngineState4ms_CM_boolean_adm 0 0 0 1 ECU_ADDRESS 0x40002BB2 /end MEASUREMENT
/begin MEASUREMENT ssPONSTRDiagStat "Flag di abilitazione all`avviamento (diag. al Power ON dello starter relay conclusa)" UBYTE EngineState4ms_CM_boolean_adm 0 0 0 1 ECU_ADDRESS 0x40002BB1 /end MEASUREMENT
/begin CHARACTERISTIC ssPWLATCH_ON "Tempo di attivazione relè carichi alla perdita di chiave (motore fermato con Key-Off)" VALUE 0xFC5580 Scalar_UWORD 0 EngineState4ms_CM_ufix16_Sp1_s 0 6500 /end CHARACTERISTIC
/begin MEASUREMENT ssPWRReq "Request from engine control of switching on/off the power relay" UBYTE Egst4ms_CM_boolean_adm 0 0 0 1 ECU_ADDRESS 0x40002B92 /end MEASUREMENT
/begin MEASUREMENT ssPWRReqTmp "Richiesta chiusura Power Relay in uscita da StateFlow" UBYTE EngineState4ms_CM_boolean_adm 0 0 0 1 ECU_ADDRESS 0x40002BB0 /end MEASUREMENT
/begin MEASUREMENT ssSafetyOkTmp "Test point sul flag di fallimento della safety IBIT" UBYTE EngineState4ms_CM_boolean_adm 0 0 0 1 ECU_ADDRESS 0x40002BAF /end MEASUREMENT
/begin MEASUREMENT ssStopReqCbt "Flag di richiesta stop motore (da vano motore)" UBYTE EngineState4ms_CM_boolean_adm 0 0 0 1 ECU_ADDRESS 0x40002BAE /end MEASUREMENT
/begin CHARACTERISTIC ssWAIT_PWREL_ON "Tempo di attivazione relè carichi al Key-On con motore non ancora avviato" VALUE 0xFC557E Scalar_UWORD 0 EngineState4ms_CM_ufix16_Sp1_s 0 6500 /end CHARACTERISTIC
/begin CHARACTERISTIC ssWAIT_REQ_AVV "Tempo di attivazione relè carichi al Key-On con motore in avviamento" VALUE 0xFC557C Scalar_UWORD 0 EngineState4ms_CM_ufix16_Sp1_s 0 6500 /end CHARACTERISTIC
/begin MEASUREMENT ssWaitAvvPhTmp "Fase avviamento in uscita da StateFlow" UBYTE EngineState4ms_CM_uint8_adm 0 0 0 2 ECU_ADDRESS 0x40002BAD /end MEASUREMENT
/begin MEASUREMENT ssWaitAvvPhase "asi di Wait" UBYTE Egst4ms_CM_uint8_adm 0 0 0 2 ECU_ADDRESS 0x40002B93 /end MEASUREMENT
/begin MEASUREMENT ssWaitAvvPhaseTmp "Fase di avviamento in uscita da Stateflow dipendente da applicativo scelto (TE,TM,TC)" UBYTE EngineState4ms_CM_uint8_adm 0 0 0 2 ECU_ADDRESS 0x40002BAC /end MEASUREMENT
/begin CHARACTERISTIC tfABILITA_CL "[FIX] Abilitazione del closed loop indiretto" VALUE 0xFC20DC Scalar_UWORD 0 BoostControl50ms_Symbol_CM_boolean_adm 0 1 /end CHARACTERISTIC
/begin CHARACTERISTIC tfABILITA_CL_EnFix "[FIX] Abilitazione del closed loop indiretto" VALUE 0xFC20DA Scalar_UWORD 0 BoostControl50ms_Symbol_CM_FixEnableT 171 218 /end CHARACTERISTIC
/begin CHARACTERISTIC tfABILITA_TRANS "[FIX] Abilitazione della correzione transitori in closed loop indiretto" VALUE 0xFC20D8 Scalar_UWORD 0 BoostControl50ms_Symbol_CM_boolean_adm 0 1 /end CHARACTERISTIC
/begin CHARACTERISTIC tfABILITA_TRANS_EnFix "[FIX] Abilitazione della correzione transitori in closed loop indiretto" VALUE 0xFC20D6 Scalar_UWORD 0 BoostControl50ms_Symbol_CM_FixEnableT 171 218 /end CHARACTERISTIC
/begin CHARACTERISTIC tfATT_FI2 "[FIX] Fi2 required closing angle for Early Closing Actuation (Closed Loop)" VALUE 0xFC9CAE Scalar_UWORD 0 TE_MAirReqATDC_Symbol_CM_ufix16_En4_degE 0 4095 /end CHARACTERISTIC
/begin CHARACTERISTIC tfATT_FI2_EnFix "[FIX] Fi2 required closing angle for Early Closing Actuation (Closed Loop)" VALUE 0xFC9CAC Scalar_UWORD 0 TE_MAirReqATDC_Symbol_CM_FixEnableT 171 218 /end CHARACTERISTIC
/begin CHARACTERISTIC tfATT_WG "[FIX] Mappa Attuatore WG" VALUE 0xFC20D4 Scalar_UWORD 0 BoostControl50ms_Symbol_CM_ufix16_En3__ 0 100 /end CHARACTERISTIC
/begin CHARACTERISTIC tfATT_WG_EnFix "[FIX] Mappa Attuatore WG" VALUE 0xFC20D2 Scalar_UWORD 0 BoostControl50ms_Symbol_CM_FixEnableT 171 218 /end CHARACTERISTIC
/begin CHARACTERISTIC tfCL_DERIV "[FIX] Abilitazione della parte derivativa del closed loop indiretto" VALUE 0xFC2BB4 Scalar_LONG 0 BoostControl50ms_Symbol_CM_int32_mbar -9600000 9600000 /end CHARACTERISTIC
/begin CHARACTERISTIC tfCL_DERIV_EnFix "[FIX] Abilitazione della parte derivativa del closed loop indiretto" VALUE 0xFC2BB0 Scalar_LONG 0 BoostControl50ms_Symbol_CM_FixEnableT 171 218 /end CHARACTERISTIC
/begin CHARACTERISTIC tfCL_INT "[FIX] Abilitazione della parte integrale del closed loop indiretto" VALUE 0xFC20EC Scalar_SWORD 0 BoostControl50ms_Symbol_CM_int16_mbar -4000 4000 /end CHARACTERISTIC
/begin CHARACTERISTIC tfCL_INT_EnFix "[FIX] Abilitazione della parte integrale del closed loop indiretto" VALUE 0xFC20EA Scalar_SWORD 0 BoostControl50ms_Symbol_CM_FixEnableT 171 218 /end CHARACTERISTIC
/begin CHARACTERISTIC tfCL_PROP "[FIX] Abilitazione della parte proporzionale del closed loop indiretto" VALUE 0xFC2BAC Scalar_LONG 0 BoostControl50ms_Symbol_CM_int32_mbar -240000 240000 /end CHARACTERISTIC
/begin CHARACTERISTIC tfCL_PROP_EnFix "[FIX] Abilitazione della parte proporzionale del closed loop indiretto" VALUE 0xFC2BA8 Scalar_LONG 0 BoostControl50ms_Symbol_CM_FixEnableT 171 218 /end CHARACTERISTIC
/begin CHARACTERISTIC tfCORR_TEMP_AIR "[FIX] Correzione in Temperatura Aria" VALUE 0xFC20D0 Scalar_UWORD 0 BoostControl50ms_Symbol_CM_ufix16_En6_adm 0.5 1.5 /end CHARACTERISTIC
/begin CHARACTERISTIC tfCORR_TEMP_AIR_EnFix "[FIX] Correzione in Temperatura Aria" VALUE 0xFC20CE Scalar_UWORD 0 BoostControl50ms_Symbol_CM_FixEnableT 171 218 /end CHARACTERISTIC
/begin CHARACTERISTIC tfEN_CL_PREV "[FIX] Fix sulle abilitazioni per il Ctrl PID diretto della WG" VALUE 0xFC20CC Scalar_UWORD 0 BoostControl50ms_Symbol_CM_boolean_adm 0 1 /end CHARACTERISTIC
/begin CHARACTERISTIC tfEN_CL_PREV_EnFix "[FIX] Fix sulle abilitazioni per il Ctrl PID diretto della WG" VALUE 0xFC20CA Scalar_UWORD 0 BoostControl50ms_Symbol_CM_FixEnableT 171 218 /end CHARACTERISTIC
/begin CHARACTERISTIC tfEN_PB_DIRECT "[FIX] Fix per abilitare il Ctrl PID diretto della WG" VALUE 0xFC20C8 Scalar_UWORD 0 BoostControl50ms_Symbol_CM_boolean_adm 0 1 /end CHARACTERISTIC
/begin CHARACTERISTIC tfEN_PB_DIRECT_EnFix "[FIX] Fix per abilitare il Ctrl PID diretto della WG" VALUE 0xFC20C6 Scalar_UWORD 0 BoostControl50ms_Symbol_CM_FixEnableT 171 218 /end CHARACTERISTIC
/begin CHARACTERISTIC tfFAT_COR_PREST "[FIX] Fix su fattore correttivo prestazioni esogeno (Torque Reduction)" VALUE 0xFC20C4 Scalar_UWORD 0 BoostControl50ms_Symbol_CM_ufix16_En12_adm 0.5 10 /end CHARACTERISTIC
/begin CHARACTERISTIC tfFAT_COR_PREST_EnFix "[FIX] Fix su fattore correttivo prestazioni esogeno (Torque Reduction)" VALUE 0xFC20C2 Scalar_UWORD 0 BoostControl50ms_Symbol_CM_FixEnableT 171 218 /end CHARACTERISTIC
/begin CHARACTERISTIC tfFFW_WG "[FIX] Feed-Forward per la Waste Gate (Ctrl PID diretto)" VALUE 0xFC20C0 Scalar_UWORD 0 BoostControl50ms_Symbol_CM_ufix16_En4__ 0 100 /end CHARACTERISTIC
/begin CHARACTERISTIC tfFFW_WG_EnFix "[FIX] Feed-Forward per la Waste Gate (Ctrl PID diretto)" VALUE 0xFC20BE Scalar_UWORD 0 BoostControl50ms_Symbol_CM_FixEnableT 171 218 /end CHARACTERISTIC
/begin CHARACTERISTIC tfKD_STAZ "[FIX] Mappa Kd in Regime Stazionario" VALUE 0xFC20BC Scalar_UWORD 0 BoostControl50ms_Symbol_CM_ufix16_En7_adm 0 60 /end CHARACTERISTIC
/begin CHARACTERISTIC tfKD_STAZ_EnFix "[FIX] Mappa Kd in Regime Stazionario" VALUE 0xFC20BA Scalar_UWORD 0 BoostControl50ms_Symbol_CM_FixEnableT 171 218 /end CHARACTERISTIC
/begin CHARACTERISTIC tfKD_TRANS "[FIX] Mappa Kd in Regime Transitorio" VALUE 0xFC20B8 Scalar_UWORD 0 BoostControl50ms_Symbol_CM_ufix16_En7_adm 0 60 /end CHARACTERISTIC
/begin CHARACTERISTIC tfKD_TRANS_EnFix "[FIX] Mappa Kd in Regime Transitorio" VALUE 0xFC20B6 Scalar_UWORD 0 BoostControl50ms_Symbol_CM_FixEnableT 171 218 /end CHARACTERISTIC
/begin CHARACTERISTIC tfKD_WG_CTRL "[FIX] KD per Ctrl PID diretto della WG" VALUE 0xFC20B4 Scalar_UWORD 0 BoostControl50ms_Symbol_CM_ufix16_En15___s_mbar 0 1.99996948242 /end CHARACTERISTIC
/begin CHARACTERISTIC tfKD_WG_CTRL_EnFix "[FIX] KD per Ctrl PID diretto della WG" VALUE 0xFC20B2 Scalar_UWORD 0 BoostControl50ms_Symbol_CM_FixEnableT 171 218 /end CHARACTERISTIC
/begin CHARACTERISTIC tfKI_STAZ "[FIX] Mappa Ki in Regime Stazionario" VALUE 0xFC20B0 Scalar_UWORD 0 BoostControl50ms_Symbol_CM_ufix16_En10_adm 0 60 /end CHARACTERISTIC
/begin CHARACTERISTIC tfKI_STAZ_EnFix "[FIX] Mappa Ki in Regime Stazionario" VALUE 0xFC20AE Scalar_UWORD 0 BoostControl50ms_Symbol_CM_FixEnableT 171 218 /end CHARACTERISTIC
/begin CHARACTERISTIC tfKI_TRANS "[FIX] Mappa Ki in Regime Transitorio" VALUE 0xFC20AC Scalar_UWORD 0 BoostControl50ms_Symbol_CM_ufix16_En10_adm 0 60 /end CHARACTERISTIC
/begin CHARACTERISTIC tfKI_TRANS_EnFix "[FIX] Mappa Ki in Regime Transitorio" VALUE 0xFC20AA Scalar_UWORD 0 BoostControl50ms_Symbol_CM_FixEnableT 171 218 /end CHARACTERISTIC
/begin CHARACTERISTIC tfKI_WG_CTRL "[FIX] KI per Ctrl PID diretto della WG" VALUE 0xFC20A8 Scalar_UWORD 0 BoostControl50ms_Symbol_CM_ufix16_En15___mbar_s 0 1.99996948242 /end CHARACTERISTIC
/begin CHARACTERISTIC tfKI_WG_CTRL_EnFix "[FIX] KI per Ctrl PID diretto della WG" VALUE 0xFC20A6 Scalar_UWORD 0 BoostControl50ms_Symbol_CM_FixEnableT 171 218 /end CHARACTERISTIC
/begin CHARACTERISTIC tfKP_STAZ "[FIX] Mappa Kp in Regime Stazionario" VALUE 0xFC20A4 Scalar_UWORD 0 BoostControl50ms_Symbol_CM_ufix16_En10_adm 0 60 /end CHARACTERISTIC
/begin CHARACTERISTIC tfKP_STAZ_EnFix "[FIX] Mappa Kp in Regime Stazionario" VALUE 0xFC20A2 Scalar_UWORD 0 BoostControl50ms_Symbol_CM_FixEnableT 171 218 /end CHARACTERISTIC
/begin CHARACTERISTIC tfKP_TRANS "[FIX] Mappa Kp in Regime Transitorio" VALUE 0xFC20A0 Scalar_UWORD 0 BoostControl50ms_Symbol_CM_ufix16_En10_adm 0 60 /end CHARACTERISTIC
/begin CHARACTERISTIC tfKP_TRANS_EnFix "[FIX] Mappa Kp in Regime Transitorio" VALUE 0xFC209E Scalar_UWORD 0 BoostControl50ms_Symbol_CM_FixEnableT 171 218 /end CHARACTERISTIC
/begin CHARACTERISTIC tfKP_WG_CTRL "[FIX] KP per Ctrl PID diretto della WG" VALUE 0xFC209C Scalar_UWORD 0 BoostControl50ms_Symbol_CM_ufix16_En15___mbar_s 0 1.99996948242 /end CHARACTERISTIC
/begin CHARACTERISTIC tfKP_WG_CTRL_EnFix "[FIX] KP per Ctrl PID diretto della WG" VALUE 0xFC209A Scalar_UWORD 0 BoostControl50ms_Symbol_CM_FixEnableT 171 218 /end CHARACTERISTIC
/begin CHARACTERISTIC tfLIMIT_INT_INF "[FIX] Mappa di Limitazione Quota Integrale" VALUE 0xFC20E8 Scalar_SWORD 0 BoostControl50ms_Symbol_CM_int16_mbar -4000 4000 /end CHARACTERISTIC
/begin CHARACTERISTIC tfLIMIT_INT_INF_EnFix "[FIX] Mappa di Limitazione Quota Integrale" VALUE 0xFC20E6 Scalar_SWORD 0 BoostControl50ms_Symbol_CM_FixEnableT 171 218 /end CHARACTERISTIC
/begin CHARACTERISTIC tfLIMIT_INT_SUP "[FIX] Mappa di Limitazione superiore Quota Integrale" VALUE 0xFC20E4 Scalar_SWORD 0 BoostControl50ms_Symbol_CM_int16_mbar -4000 4000 /end CHARACTERISTIC
/begin CHARACTERISTIC tfLIMIT_INT_SUP_EnFix "[FIX] Mappa di Limitazione superiore Quota Integrale" VALUE 0xFC20E2 Scalar_SWORD 0 BoostControl50ms_Symbol_CM_FixEnableT 171 218 /end CHARACTERISTIC
/begin CHARACTERISTIC tfRIF_BAS_EC_Q_N "[FIX] Riferimento di pressione - guida economica vs. RPM e Qair_Obj" VALUE 0xFC2098 Scalar_UWORD 0 BoostControl50ms_Symbol_CM_uint16_mbar 0 4000 /end CHARACTERISTIC
/begin CHARACTERISTIC tfRIF_BAS_EC_Q_N_EnFix "[FIX] Riferimento di pressione - guida economica vs. RPM e Qair_Obj" VALUE 0xFC2096 Scalar_UWORD 0 BoostControl50ms_Symbol_CM_FixEnableT 171 218 /end CHARACTERISTIC
/begin CHARACTERISTIC tfRIF_PRESS_MAX "[FIX] Fix su soglia Max PRess nel Rif statico" VALUE 0xFC2094 Scalar_UWORD 0 BoostControl50ms_Symbol_CM_uint16_mbar 0 4000 /end CHARACTERISTIC
/begin CHARACTERISTIC tfRIF_PRESS_MAX_EnFix "[FIX] Fix su soglia Max PRess nel Rif statico" VALUE 0xFC2092 Scalar_UWORD 0 BoostControl50ms_Symbol_CM_FixEnableT 171 218 /end CHARACTERISTIC
/begin CHARACTERISTIC tfRIF_PRESS_MIN "[FIX] Fix su soglia minima di pressione boost per riferimento statico" VALUE 0xFC2090 Scalar_UWORD 0 BoostControl50ms_Symbol_CM_uint16_mbar 0 4000 /end CHARACTERISTIC
/begin CHARACTERISTIC tfRIF_PRESS_MIN_EnFix "[FIX] Fix su soglia minima di pressione boost per riferimento statico" VALUE 0xFC208E Scalar_UWORD 0 BoostControl50ms_Symbol_CM_FixEnableT 171 218 /end CHARACTERISTIC
/begin CHARACTERISTIC tfSOGLIA_INF_CO "[FIX] Soglia Inf per Commutazione Modalità Controllo Closed/Open Loop" VALUE 0xFC208C Scalar_UWORD 0 BoostControl50ms_Symbol_CM_ufix16_En10_adm 0 3 /end CHARACTERISTIC
/begin CHARACTERISTIC tfSOGLIA_INF_CO_EnFix "[FIX] Soglia Inf per Commutazione Modalità Controllo Closed/Open Loop" VALUE 0xFC208A Scalar_UWORD 0 BoostControl50ms_Symbol_CM_FixEnableT 171 218 /end CHARACTERISTIC
/begin CHARACTERISTIC tfSOGLIA_INF_WG "[FIX] Soglia inferiore apertura WG" VALUE 0xFC2088 Scalar_UWORD 0 BoostControl50ms_Symbol_CM_ufix16_En3__ 0 100 /end CHARACTERISTIC
/begin CHARACTERISTIC tfSOGLIA_INF_WG_EnFix "[FIX] Soglia inferiore apertura WG" VALUE 0xFC2086 Scalar_UWORD 0 BoostControl50ms_Symbol_CM_FixEnableT 171 218 /end CHARACTERISTIC
/begin CHARACTERISTIC tfSOGLIA_MAX "[FIX] Soglia Max pressione di Boost" VALUE 0xFC2084 Scalar_UWORD 0 BoostControl50ms_Symbol_CM_uint16_mbar 0 4000 /end CHARACTERISTIC
/begin CHARACTERISTIC tfSOGLIA_MAX_EnFix "[FIX] Soglia Max pressione di Boost" VALUE 0xFC2082 Scalar_UWORD 0 BoostControl50ms_Symbol_CM_FixEnableT 171 218 /end CHARACTERISTIC
/begin CHARACTERISTIC tfSOGLIA_SUP_CO "[FIX] Soglia Sup per Commutazione Modalità Controllo Closed/Open Loop" VALUE 0xFC2080 Scalar_UWORD 0 BoostControl50ms_Symbol_CM_ufix16_En10_adm 0 3 /end CHARACTERISTIC
/begin CHARACTERISTIC tfSOGLIA_SUP_CO_EnFix "[FIX] Soglia Sup per Commutazione Modalità Controllo Closed/Open Loop" VALUE 0xFC207E Scalar_UWORD 0 BoostControl50ms_Symbol_CM_FixEnableT 171 218 /end CHARACTERISTIC
/begin CHARACTERISTIC tfSOGLIA_SUP_WG "[FIX] Soglia superiore apertura WG" VALUE 0xFC207C Scalar_UWORD 0 BoostControl50ms_Symbol_CM_ufix16_En3__ 0 100 /end CHARACTERISTIC
/begin CHARACTERISTIC tfSOGLIA_SUP_WG_EnFix "[FIX] Soglia superiore apertura WG" VALUE 0xFC207A Scalar_UWORD 0 BoostControl50ms_Symbol_CM_FixEnableT 171 218 /end CHARACTERISTIC
/begin AXIS_PTS tkBOOST_PRESS_1 "[XBK] Mappa di Limitazione superiore Quota Integrale" 0xFC2A98 NO_INPUT_QUANTITY Lookup2D_X_UWORD 0 BoostControl50ms_Symbol_CM_uint16_mbar 8 500 4000 /end AXIS_PTS
/begin AXIS_PTS tkBOOST_PRESS_2 "[XBK] Mappa di Limitazione Quota Integrale" 0xFC2A88 NO_INPUT_QUANTITY Lookup2D_X_UWORD 0 BoostControl50ms_Symbol_CM_uint16_mbar 8 500 4000 /end AXIS_PTS
/begin AXIS_PTS tkETASP10 "[XBK] Mappa Ki in Regime Stazionario" 0xFC2A78 NO_INPUT_QUANTITY Lookup2D_X_UWORD 0 BoostControl50ms_Symbol_CM_ufix16_En10_adm 8 0 3 /end AXIS_PTS
/begin AXIS_PTS tkETASP14 "[XBK] Mappa Kd in Regime Stazionario" 0xFC2A68 NO_INPUT_QUANTITY Lookup2D_X_UWORD 0 BoostControl50ms_Symbol_CM_ufix16_En10_adm 8 0 3 /end AXIS_PTS
/begin AXIS_PTS tkETASP15 "[XBK] Mappa Kd in Regime Transitorio" 0xFC2A58 NO_INPUT_QUANTITY Lookup2D_X_UWORD 0 BoostControl50ms_Symbol_CM_ufix16_En10_adm 8 0 3 /end AXIS_PTS
/begin AXIS_PTS tkETASP7 "[XBK] Mappa Kp in Regime Transitorio" 0xFC2A48 NO_INPUT_QUANTITY Lookup2D_X_UWORD 0 BoostControl50ms_Symbol_CM_ufix16_En10_adm 8 0 3 /end AXIS_PTS
/begin AXIS_PTS tkETASP8 "[XBK] Mappa Kp in Regime Stazionario" 0xFC2A38 NO_INPUT_QUANTITY Lookup2D_X_UWORD 0 BoostControl50ms_Symbol_CM_ufix16_En10_adm 8 0 3 /end AXIS_PTS
/begin AXIS_PTS tkETASP9 "[XBK] Mappa Ki in Regime Transitorio" 0xFC2A28 NO_INPUT_QUANTITY Lookup2D_X_UWORD 0 BoostControl50ms_Symbol_CM_ufix16_En10_adm 8 0 3 /end AXIS_PTS
/begin AXIS_PTS tkFFW_WG_DP "[XBK] Feed-Forward per la Waste Gate (Ctrl PID diretto)" 0xFC2A18 NO_INPUT_QUANTITY Lookup2D_X_UWORD 0 BoostControl50ms_Symbol_CM_ufix16_En10_adm 8 0 10 /end AXIS_PTS
/begin AXIS_PTS tkFFW_WG_N "[YBK] Feed-Forward per la Waste Gate (Ctrl PID diretto)" 0xFC2A08 NO_INPUT_QUANTITY Lookup2D_X_UWORD 0 BoostControl50ms_Symbol_CM_ufix16_En4_kg_h 8 0 4095 /end AXIS_PTS
/begin AXIS_PTS tkKD_WG_CTRLCP "[XBK] KD per Ctrl PID diretto della WG" 0xFC2A00 NO_INPUT_QUANTITY Lookup2D_X_UWORD 0 BoostControl50ms_Symbol_CM_ufix16_En10_adm 4 0 10 /end AXIS_PTS
/begin AXIS_PTS tkKD_WG_CTRLEP "[YBK] KD per Ctrl PID diretto della WG" 0xFC29F2 NO_INPUT_QUANTITY Lookup2D_X_UWORD 0 BoostControl50ms_Symbol_CM_ufix16_Bn2000_mbar 7 -2000 2000 /end AXIS_PTS
/begin AXIS_PTS tkKI_WG_CTRLCP "[XBK] KI per Ctrl PID diretto della WG" 0xFC29EA NO_INPUT_QUANTITY Lookup2D_X_UWORD 0 BoostControl50ms_Symbol_CM_ufix16_En10_adm 4 0 10 /end AXIS_PTS
/begin AXIS_PTS tkKI_WG_CTRLEP "[YBK] KI per Ctrl PID diretto della WG" 0xFC29DC NO_INPUT_QUANTITY Lookup2D_X_UWORD 0 BoostControl50ms_Symbol_CM_ufix16_Bn2000_mbar 7 -2000 2000 /end AXIS_PTS
/begin AXIS_PTS tkKP_WG_CTRLCP "[XBK] KP per Ctrl PID diretto della WG" 0xFC29D4 NO_INPUT_QUANTITY Lookup2D_X_UWORD 0 BoostControl50ms_Symbol_CM_ufix16_En10_adm 4 0 10 /end AXIS_PTS
/begin AXIS_PTS tkKP_WG_CTRLEP "[YBK] KP per Ctrl PID diretto della WG" 0xFC29C6 NO_INPUT_QUANTITY Lookup2D_X_UWORD 0 BoostControl50ms_Symbol_CM_ufix16_Bn2000_mbar 7 -2000 2000 /end AXIS_PTS
/begin AXIS_PTS tkPATM2 "[XBK] Soglia Max pressione di Boost" 0xFC29B2 NO_INPUT_QUANTITY Lookup2D_X_UWORD 0 BoostControl50ms_Symbol_CM_uint16_mbar 10 0 1500 /end AXIS_PTS
/begin AXIS_PTS tkPBOOST_ATT "[XBK] Mappa Attuatore WG" 0xFC299A NO_INPUT_QUANTITY Lookup2D_X_UWORD 0 BoostControl50ms_Symbol_CM_uint16_mbar 12 500 4000 /end AXIS_PTS
/begin AXIS_PTS tkPBOOST_FI2 "[XBK] Fi2 required closing angle for Early Closing Actuation (Closed Loop)" 0xFC9E2E NO_INPUT_QUANTITY Lookup2D_X_UWORD 0 TE_MAirReqATDC_Symbol_CM_uint16_mbar 12 500 4000 /end AXIS_PTS
/begin AXIS_PTS tkRIF_BAS_EC_N "[YBK] Riferimento di pressione - guida economica vs. RPM e Qair_Obj" 0xFC2982 NO_INPUT_QUANTITY Lookup2D_X_UWORD 0 BoostControl50ms_Symbol_CM_uint16_rpm 12 0 10000 /end AXIS_PTS
/begin AXIS_PTS tkRIF_BAS_EC_QOB "[XBK] Riferimento di pressione - guida economica vs. RPM e Qair_Obj" 0xFC296A NO_INPUT_QUANTITY Lookup2D_X_UWORD 0 BoostControl50ms_Symbol_CM_ufix16_En4_Kg_h 12 0 4095 /end AXIS_PTS
/begin AXIS_PTS tkRPM10 "[YBK] Mappa Ki in Regime Stazionario" 0xFC295A NO_INPUT_QUANTITY Lookup2D_X_UWORD 0 BoostControl50ms_Symbol_CM_uint16_rpm 8 0 10000 /end AXIS_PTS
/begin AXIS_PTS tkRPM13 "[YBK] Mappa di Limitazione superiore Quota Integrale" 0xFC292A NO_INPUT_QUANTITY Lookup2D_X_UWORD 0 BoostControl50ms_Symbol_CM_uint16_rpm 8 0 10000 /end AXIS_PTS
/begin AXIS_PTS tkRPM14 "[YBK] Mappa Kd in Regime Stazionario" 0xFC291A NO_INPUT_QUANTITY Lookup2D_X_UWORD 0 BoostControl50ms_Symbol_CM_uint16_rpm 8 0 10000 /end AXIS_PTS
/begin AXIS_PTS tkRPM15 "[YBK] Mappa Kd in Regime Transitorio" 0xFC290A NO_INPUT_QUANTITY Lookup2D_X_UWORD 0 BoostControl50ms_Symbol_CM_uint16_rpm 8 0 10000 /end AXIS_PTS
/begin AXIS_PTS tkRPM18 "[YBK] Mappa di Limitazione Quota Integrale" 0xFC28DA NO_INPUT_QUANTITY Lookup2D_X_UWORD 0 BoostControl50ms_Symbol_CM_uint16_rpm 8 0 10000 /end AXIS_PTS
/begin AXIS_PTS tkRPM3 "[YBK] Soglia Max pressione di Boost" 0xFC28C6 NO_INPUT_QUANTITY Lookup2D_X_UWORD 0 BoostControl50ms_Symbol_CM_uint16_rpm 10 0 10000 /end AXIS_PTS
/begin AXIS_PTS tkRPM7 "[YBK] Mappa Kp in Regime Transitorio" 0xFC28B6 NO_INPUT_QUANTITY Lookup2D_X_UWORD 0 BoostControl50ms_Symbol_CM_uint16_rpm 8 0 10000 /end AXIS_PTS
/begin AXIS_PTS tkRPM8 "[YBK] Mappa Kp in Regime Stazionario" 0xFC28A6 NO_INPUT_QUANTITY Lookup2D_X_UWORD 0 BoostControl50ms_Symbol_CM_uint16_rpm 8 0 10000 /end AXIS_PTS
/begin AXIS_PTS tkRPM9 "[YBK] Mappa Ki in Regime Transitorio" 0xFC2896 NO_INPUT_QUANTITY Lookup2D_X_UWORD 0 BoostControl50ms_Symbol_CM_uint16_rpm 8 0 10000 /end AXIS_PTS
/begin AXIS_PTS tkRPM_ATT "[YBK] Mappa Attuatore WG" 0xFC287E NO_INPUT_QUANTITY Lookup2D_X_UWORD 0 BoostControl50ms_Symbol_CM_uint16_rpm 12 0 10000 /end AXIS_PTS
/begin AXIS_PTS tkRPM_FI2 "[YBK] Fi2 required closing angle for Early Closing Actuation (Closed Loop)" 0xFC9E16 NO_INPUT_QUANTITY Lookup2D_X_UWORD 0 TE_MAirReqATDC_Symbol_CM_uint16_rpm 12 0 10000 /end AXIS_PTS
/begin AXIS_PTS tkTAIR1 "[XBK] Correzione in Temperatura Aria" 0xFC286E NO_INPUT_QUANTITY Lookup1D_X_UWORD 0 BoostControl50ms_Symbol_CM_ufix16_Bn40__C 8 -40 130 /end AXIS_PTS
/begin CHARACTERISTIC tsANTIW_UPH "AntiWindUp superiore KI per Ctrl PID diretto della WG" VALUE 0xFC2078 Scalar_UWORD 0 BoostControl50ms_Symbol_CM_ufix16_En4__ 0 100 /end CHARACTERISTIC
/begin CHARACTERISTIC tsANTIW_UPL "AntiWindUp inferiore KI per Ctrl PID diretto della WG" VALUE 0xFC2076 Scalar_UWORD 0 BoostControl50ms_Symbol_CM_ufix16_En4_Bn100__ -100 0 /end CHARACTERISTIC
/begin MEASUREMENT tsAirSpeed "Velocità aria aspirata nella sezione del corpo farfallato" UBYTE BoostControl50ms_Symbol_CM_uint8_m_s 0 0 0 255 ECU_ADDRESS 0x400021EC /end MEASUREMENT
/begin MEASUREMENT tsAttFi2 "[OUT] Fi2 required closing angle for Early Closing Actuation (Closed Loop)" UWORD TE_MAirReqATDC_Symbol_CM_ufix16_En4_degE 0 0 0 4095 ECU_ADDRESS 0x4000377C /end MEASUREMENT
/begin MEASUREMENT tsAttWg "[OUT] Mappa Attuatore WG" UWORD BoostControl50ms_Symbol_CM_ufix16_En3__ 0 0 0 100 ECU_ADDRESS 0x4000222E /end MEASUREMENT
/begin CHARACTERISTIC tsBOOST_READY "Valore minimo (prontezza) per la WG se il controllo di giri è attivo (PTO) o se il Low Idle è attivo al di sotto di un dato regime" VALUE 0xFC2074 Scalar_UWORD 0 BoostControl50ms_Symbol_CM_ufix16_En4__ 0 100 /end CHARACTERISTIC
/begin MEASUREMENT tsCLDirect "Contributo in Closed Loop (senza Feed-Forward) del Ctrl PID WG diretto" SWORD BoostControl50ms_Symbol_CM_sfix16_En4__ 0 0 -100 100 ECU_ADDRESS 0x40002240 /end MEASUREMENT
/begin MEASUREMENT tsCompression "Fattore di Compressione obiettivo aria nella mandata del turbo (PboostObj/Patm)" UWORD BoostControl50ms_Symbol_CM_ufix16_En10_adm 0 0 0 10 ECU_ADDRESS 0x4000222C /end MEASUREMENT
/begin MEASUREMENT tsCorrTAir "Correzione in Temperatura Aria" UWORD Boost_CtrlMgmt50ms_CM_ufix16_En6_adm 0 0 0.5 1.5 ECU_ADDRESS 0x400021B6 /end MEASUREMENT
/begin MEASUREMENT tsCorrTempAir "[OUT] Correzione in Temperatura Aria" UWORD BoostControl50ms_Symbol_CM_ufix16_En6_adm 0 0 0.5 1.5 ECU_ADDRESS 0x4000222A /end MEASUREMENT
/begin CHARACTERISTIC tsDELT_UNDER_IDL "Delta giri per fissare un minimo di WG se il Low Idle è attivo al di sotto di un dato regime" VALUE 0xFC2072 Scalar_UWORD 0 BoostControl50ms_Symbol_CM_ufix16_Bn10000_rpm -10000 10000 /end CHARACTERISTIC
/begin MEASUREMENT tsDer "Parte derivativa del Closed Loop" SLONG BoostControl50ms_Symbol_CM_int32_mbar 0 0 -9600000 9600000 ECU_ADDRESS 0x40002254 /end MEASUREMENT
/begin MEASUREMENT tsDerErrPboost "Derivata errore (Pobj - Pmeas) filtrata algebricamente" SWORD BoostControl50ms_Symbol_CM_int16_mbar_s 0 0 -32000 32000 ECU_ADDRESS 0x4000223E /end MEASUREMENT
/begin CHARACTERISTIC tsEN_COMPR_INF "Limite inferiore di Compressione Turbo desiderata sotto cui disattivare il Controllo PID diretto" VALUE 0xFC2070 Scalar_UWORD 0 BoostControl50ms_Symbol_CM_ufix16_En10_adm 0 10 /end CHARACTERISTIC
/begin CHARACTERISTIC tsEN_LTD_SUPCALC "Abilitazione calcolo automatico del limite superiore sulla Pboost obiettivo" VALUE 0xFC2067 Scalar_BOOLEAN 0 BoostControl50ms_Symbol_CM_boolean_adm 0 1 /end CHARACTERISTIC
/begin CHARACTERISTIC tsEN_RIF_OBJ_CALC "Abilitazione uso Pboost obiettivo calcolata automaticamente (da ThrotMgm)" VALUE 0xFC2066 Scalar_BOOLEAN 0 BoostControl50ms_Symbol_CM_boolean_adm 0 1 /end CHARACTERISTIC
/begin CHARACTERISTIC tsEN_USE_OLDBOOST "Abilitazione comando WG con controllo PBoost originario" VALUE 0xFC2065 Scalar_BOOLEAN 0 BoostControl50ms_Symbol_CM_boolean_adm 0 1 /end CHARACTERISTIC
/begin MEASUREMENT tsEnClosedLoop "Abilitazione del Closed Loop" UBYTE Boost_CtrlMgmt50ms_CM_boolean_adm 0 0 0 1 ECU_ADDRESS 0x400021B4 /end MEASUREMENT
/begin MEASUREMENT tsEnPBDirect "Flag che indica se il Ctrl PID WG diretto è abilitato" UBYTE BoostControl50ms_Symbol_CM_boolean_adm 0 0 0 1 ECU_ADDRESS 0x400021EB /end MEASUREMENT
/begin MEASUREMENT tsErr "Differenza tra riferimento e PBoost misurata" SWORD BoostControl50ms_Symbol_CM_int16_mbar 0 0 -4000 4000 ECU_ADDRESS 0x4000223C /end MEASUREMENT
/begin MEASUREMENT tsErrClipped "Errore fra Pboost richiesta e misurata" UWORD BoostControl50ms_Symbol_CM_ufix16_Bn2000_mbar 0 0 -2000 2000 ECU_ADDRESS 0x40002228 /end MEASUREMENT
/begin MEASUREMENT tsFfwWg "[OUT] Feed-Forward per la Waste Gate (Ctrl PID diretto)" UWORD BoostControl50ms_Symbol_CM_ufix16_En4__ 0 0 0 100 ECU_ADDRESS 0x40002226 /end MEASUREMENT
/begin CHARACTERISTIC tsGAIN_DP_SP_AIR "Description_Not_Defined & Tag_Not_Defined" VALUE 0xFC206E Scalar_UWORD 0 BoostControl50ms_Symbol_CM_ufix16_En2_mbar_m_s 0 100 /end CHARACTERISTIC
/begin MEASUREMENT tsInt "Parte integrale del Closed Loop" SWORD BoostControl50ms_Symbol_CM_int16_mbar 0 0 -4000 4000 ECU_ADDRESS 0x4000223A /end MEASUREMENT
/begin MEASUREMENT tsIntakeArea "Area nella sezione del corpo farfallato" UWORD BoostControl50ms_Symbol_CM_uint16_mm2 0 0 0 50000 ECU_ADDRESS 0x40002224 /end MEASUREMENT
/begin MEASUREMENT tsKd "Fattore Kd in Regime Stazionario o in Transitorio" UWORD BoostControl50ms_Symbol_CM_ufix16_En7_s 0 0 0 60 ECU_ADDRESS 0x40002222 /end MEASUREMENT
/begin MEASUREMENT tsKdDirect "Contributo KD da Ctrl PID WG diretto" SWORD BoostControl50ms_Symbol_CM_sfix16_En4__ 0 0 -100 100 ECU_ADDRESS 0x40002238 /end MEASUREMENT
/begin MEASUREMENT tsKdStaz "[OUT] Mappa Kd in Regime Stazionario" UWORD BoostControl50ms_Symbol_CM_ufix16_En7_adm 0 0 0 60 ECU_ADDRESS 0x40002220 /end MEASUREMENT
/begin MEASUREMENT tsKdTrans "[OUT] Mappa Kd in Regime Transitorio" UWORD BoostControl50ms_Symbol_CM_ufix16_En7_adm 0 0 0 60 ECU_ADDRESS 0x4000221E /end MEASUREMENT
/begin MEASUREMENT tsKdWgCtrl "[OUT] KD per Ctrl PID diretto della WG" UWORD BoostControl50ms_Symbol_CM_ufix16_En15___s_mbar 0 0 0 1.99996948242 ECU_ADDRESS 0x4000221C /end MEASUREMENT
/begin MEASUREMENT tsKi "Fattore Ki in Regime Stazionario o in Transitorio" UWORD BoostControl50ms_Symbol_CM_ufix16_En10_1_s 0 0 0 60 ECU_ADDRESS 0x4000221A /end MEASUREMENT
/begin MEASUREMENT tsKiDirect "Contributo KI da Ctrl PID WG diretto" SWORD BoostControl50ms_Symbol_CM_sfix16_En4__ 0 0 -100 100 ECU_ADDRESS 0x40002236 /end MEASUREMENT
/begin MEASUREMENT tsKiStaz "[OUT] Mappa Ki in Regime Stazionario" UWORD BoostControl50ms_Symbol_CM_ufix16_En10_adm 0 0 0 60 ECU_ADDRESS 0x40002218 /end MEASUREMENT
/begin MEASUREMENT tsKiTrans "[OUT] Mappa Ki in Regime Transitorio" UWORD BoostControl50ms_Symbol_CM_ufix16_En10_adm 0 0 0 60 ECU_ADDRESS 0x40002216 /end MEASUREMENT
/begin MEASUREMENT tsKiWgCtrl "[OUT] KI per Ctrl PID diretto della WG" UWORD BoostControl50ms_Symbol_CM_ufix16_En15___mbar_s 0 0 0 1.99996948242 ECU_ADDRESS 0x40002214 /end MEASUREMENT
/begin MEASUREMENT tsKp "Fattore Kp in Regime Stazionario o in Transitorio" UWORD BoostControl50ms_Symbol_CM_ufix16_En10_adm 0 0 0 60 ECU_ADDRESS 0x40002212 /end MEASUREMENT
/begin MEASUREMENT tsKpDirect "Contributo KD da Ctrl PID WG diretto" SWORD BoostControl50ms_Symbol_CM_sfix16_En4__ 0 0 -100 100 ECU_ADDRESS 0x40002234 /end MEASUREMENT
/begin MEASUREMENT tsKpStaz "[OUT] Mappa Kp in Regime Stazionario" UWORD BoostControl50ms_Symbol_CM_ufix16_En10_adm 0 0 0 60 ECU_ADDRESS 0x40002210 /end MEASUREMENT
/begin MEASUREMENT tsKpTrans "[OUT] Mappa Kp in Regime Transitorio" UWORD BoostControl50ms_Symbol_CM_ufix16_En10_adm 0 0 0 60 ECU_ADDRESS 0x4000220E /end MEASUREMENT
/begin MEASUREMENT tsKpWgCtrl "[OUT] KP per Ctrl PID diretto della WG" UWORD BoostControl50ms_Symbol_CM_ufix16_En15___mbar_s 0 0 0 1.99996948242 ECU_ADDRESS 0x4000220C /end MEASUREMENT
/begin MEASUREMENT tsLimitIntInf "[OUT] Mappa di Limitazione Quota Integrale" SWORD BoostControl50ms_Symbol_CM_int16_mbar 0 0 -4000 4000 ECU_ADDRESS 0x40002232 /end MEASUREMENT
/begin MEASUREMENT tsLimitIntSup "[OUT] Mappa di Limitazione superiore Quota Integrale" SWORD BoostControl50ms_Symbol_CM_int16_mbar 0 0 -4000 4000 ECU_ADDRESS 0x40002230 /end MEASUREMENT
/begin MEASUREMENT tsPBoostCom "Uscita PBoost del controllore ClosedLoop" UWORD Boost_CtrlMgmt50ms_CM_uint16_mbar 0 0 500 4000 ECU_ADDRESS 0x400021BE /end MEASUREMENT
/begin MEASUREMENT tsPLtdSupTheo "Pressione obiettivo turbo Max possibile punto per punto (rpm)" UWORD BoostControl50ms_Symbol_CM_uint16_mbar 0 0 0 4000 ECU_ADDRESS 0x4000220A /end MEASUREMENT
/begin MEASUREMENT tsPercWGDirect "Comando WG finale dal ctrl PID diretto" UWORD BoostControl50ms_Symbol_CM_ufix16_En4__ 0 0 0 100 ECU_ADDRESS 0x40002208 /end MEASUREMENT
/begin MEASUREMENT tsProp "Parte proporzionale del Closed Loop" SLONG BoostControl50ms_Symbol_CM_int32_mbar 0 0 -240000 240000 ECU_ADDRESS 0x40002250 /end MEASUREMENT
/begin MEASUREMENT tsQuotInt "Quota integrale valle limitazione" SLONG BoostControl50ms_Symbol_CM_sfix32_En15_mbar 0 0 -4000 4000 ECU_ADDRESS 0x4000224C /end MEASUREMENT
/begin MEASUREMENT tsQuotIntRit "Quota integrale monte limitazione" SLONG BoostControl50ms_Symbol_CM_sfix32_En15_mbar 0 0 -16000 16000 ECU_ADDRESS 0x40002248 /end MEASUREMENT
/begin MEASUREMENT tsRifBasEcQN "[OUT] Riferimento di pressione - guida economica vs. RPM e Qair_Obj" UWORD BoostControl50ms_Symbol_CM_uint16_mbar 0 0 0 4000 ECU_ADDRESS 0x40002206 /end MEASUREMENT
/begin MEASUREMENT tsRifCorr "Correzione pressione di riferimento per temperatura aria" UWORD BoostControl50ms_Symbol_CM_uint16_mbar 0 0 0 16000 ECU_ADDRESS 0x40002204 /end MEASUREMENT
/begin MEASUREMENT tsRifPresBas "Pressione obiettivo Turbo teorica" UWORD BoostControl50ms_Symbol_CM_uint16_mbar 0 0 0 4000 ECU_ADDRESS 0x40002202 /end MEASUREMENT
/begin MEASUREMENT tsRifPresInter "Pressione obiettivo Turbo intermedia" UWORD BoostControl50ms_Symbol_CM_uint16_mbar 0 0 0 4000 ECU_ADDRESS 0x40002200 /end MEASUREMENT
/begin MEASUREMENT tsRifPresOffAirV "Offset Pressione obiettivo per perdite di carico (speed air)" UWORD BoostControl50ms_Symbol_CM_uint16_mbar 0 0 0 4000 ECU_ADDRESS 0x400021FE /end MEASUREMENT
/begin MEASUREMENT tsRifPresOffExh "Offset Pressione obiettivo per contropressione allo scarico" UWORD BoostControl50ms_Symbol_CM_uint16_mbar 0 0 0 4000 ECU_ADDRESS 0x400021FC /end MEASUREMENT
/begin MEASUREMENT tsRifPress "Riferimento di PBoost usato per la gestione in Open Loop e per il riferimento del Closed Loop" UWORD Boost_CtrlMgmt50ms_CM_uint16_mbar 0 0 0 4000 ECU_ADDRESS 0x400021C0 /end MEASUREMENT
/begin MEASUREMENT tsRifPressMax "Pressione obiettivo turbo Max possibile assoluta (pto Max Torque)" UWORD BoostControl50ms_Symbol_CM_uint16_mbar 0 0 0 4000 ECU_ADDRESS 0x400021FA /end MEASUREMENT
/begin MEASUREMENT tsRifStatico "Riferimento statico" UWORD BoostControl50ms_Symbol_CM_uint16_mbar 0 0 0 8000 ECU_ADDRESS 0x400021F8 /end MEASUREMENT
/begin CHARACTERISTIC tsSAT_KDERH "Saturazione superiore KD per Ctrl PID diretto della WG" VALUE 0xFC206C Scalar_UWORD 0 BoostControl50ms_Symbol_CM_uint16__ 0 100 /end CHARACTERISTIC
/begin CHARACTERISTIC tsSAT_KDERL "Saturazione inferiore KD per Ctrl PID diretto della WG" VALUE 0xFC206A Scalar_UWORD 0 BoostControl50ms_Symbol_CM_ufix16_Bn100__ -100 0 /end CHARACTERISTIC
/begin MEASUREMENT tsSogliaInfCo "[OUT] Soglia Inf per Commutazione Modalità Controllo Closed/Open Loop" UWORD BoostControl50ms_Symbol_CM_ufix16_En10_adm 0 0 0 3 ECU_ADDRESS 0x400021F6 /end MEASUREMENT
/begin MEASUREMENT tsSogliaInfWg "[OUT] Soglia inferiore apertura WG" UWORD BoostControl50ms_Symbol_CM_ufix16_En3__ 0 0 0 100 ECU_ADDRESS 0x400021F4 /end MEASUREMENT
/begin MEASUREMENT tsSogliaMax "[OUT] Soglia Max pressione di Boost" UWORD BoostControl50ms_Symbol_CM_uint16_mbar 0 0 0 4000 ECU_ADDRESS 0x400021F2 /end MEASUREMENT
/begin MEASUREMENT tsSogliaSupCo "[OUT] Soglia Sup per Commutazione Modalità Controllo Closed/Open Loop" UWORD BoostControl50ms_Symbol_CM_ufix16_En10_adm 0 0 0 3 ECU_ADDRESS 0x400021F0 /end MEASUREMENT
/begin MEASUREMENT tsSogliaSupWg "[OUT] Soglia superiore apertura WG" UWORD BoostControl50ms_Symbol_CM_ufix16_En3__ 0 0 0 100 ECU_ADDRESS 0x400021EE /end MEASUREMENT
/begin CHARACTERISTIC tsTHR_DIAMETER "Diametro [mm] corpo farfallato" VALUE 0xFC2064 Scalar_UBYTE 0 BoostControl50ms_Symbol_CM_uint8_mm 0 255 /end CHARACTERISTIC
/begin CHARACTERISTIC tsTRANSIENT_MAX "Soglia per Errore Max" VALUE 0xFC20E0 Scalar_SWORD 0 BoostControl50ms_Symbol_CM_int16_mbar -4000 4000 /end CHARACTERISTIC
/begin CHARACTERISTIC tsTRANSIENT_MIN "Soglia per Errore Min" VALUE 0xFC20DE Scalar_SWORD 0 BoostControl50ms_Symbol_CM_int16_mbar -4000 4000 /end CHARACTERISTIC
/begin MEASUREMENT tsTpNegTrans "Flag Transitorio positivo" UBYTE BoostControl50ms_Symbol_CM_boolean_adm 0 0 0 1 ECU_ADDRESS 0x400021EA /end MEASUREMENT
/begin MEASUREMENT tsTpPosTrans "Flag Transitorio negativo" UBYTE BoostControl50ms_Symbol_CM_boolean_adm 0 0 0 1 ECU_ADDRESS 0x400021E9 /end MEASUREMENT
/begin MEASUREMENT tsTransient "Riconoscimento condizione di transitorio" UBYTE BoostControl50ms_Symbol_CM_boolean_adm 0 0 0 1 ECU_ADDRESS 0x400021E8 /end MEASUREMENT
/begin CHARACTERISTIC tsWEIGHT_FACT_KI "Fattore di peso del contributo integrale" VALUE 0xFC2068 Scalar_UWORD 0 BoostControl50ms_Symbol_CM_ufix16_En4_adm 0 1 /end CHARACTERISTIC
/begin MEASUREMENT tsWGDuty "Comando in PWM per waste-gate" UWORD Boost_CtrlMgmt50ms_CM_ufix16_En3__ 0 0 0 100 ECU_ADDRESS 0x400021BA /end MEASUREMENT
/begin MEASUREMENT tsWeightFactKI "Quota integrale moltiplicata per il fattore di peso" SLONG BoostControl50ms_Symbol_CM_sfix32_En15_mbar 0 0 -4000 4000 ECU_ADDRESS 0x40002244 /end MEASUREMENT
/begin CHARACTERISTIC ttATT_FI2 "Fi2 required closing angle for Early Closing Actuation (Closed Loop)" MAP 0xFC9CF6 Lookup2DSF_UWORD 0 TE_MAirReqATDC_Symbol_CM_ufix16_En4_degE 0 4095
 /begin AXIS_DESCR COM_AXIS NO_INPUT_QUANTITY TE_MAirReqATDC_Symbol_CM_uint16_rpm 12 0 10000 AXIS_PTS_REF tkRPM_FI2 /end AXIS_DESCR
 /begin AXIS_DESCR COM_AXIS NO_INPUT_QUANTITY TE_MAirReqATDC_Symbol_CM_uint16_mbar 12 500 4000 AXIS_PTS_REF tkPBOOST_FI2 /end AXIS_DESCR
/end CHARACTERISTIC
/begin CHARACTERISTIC ttATT_WG "Mappa Attuatore WG" MAP 0xFC274E Lookup2DSF_UWORD 0 BoostControl50ms_Symbol_CM_ufix16_En3__ 0 100
 /begin AXIS_DESCR COM_AXIS NO_INPUT_QUANTITY BoostControl50ms_Symbol_CM_uint16_rpm 12 0 10000 AXIS_PTS_REF tkRPM_ATT /end AXIS_DESCR
 /begin AXIS_DESCR COM_AXIS NO_INPUT_QUANTITY BoostControl50ms_Symbol_CM_uint16_mbar 12 500 4000 AXIS_PTS_REF tkPBOOST_ATT /end AXIS_DESCR
/end CHARACTERISTIC
/begin CHARACTERISTIC ttFFW_WG "Feed-Forward per la Waste Gate (Ctrl PID diretto)" MAP 0xFC26CE Lookup2DSF_UWORD 0 BoostControl50ms_Symbol_CM_ufix16_En4__ 0 100
 /begin AXIS_DESCR COM_AXIS NO_INPUT_QUANTITY BoostControl50ms_Symbol_CM_ufix16_En4_kg_h 8 0 4095 AXIS_PTS_REF tkFFW_WG_N /end AXIS_DESCR
 /begin AXIS_DESCR COM_AXIS NO_INPUT_QUANTITY BoostControl50ms_Symbol_CM_ufix16_En10_adm 8 0 10 AXIS_PTS_REF tkFFW_WG_DP /end AXIS_DESCR
/end CHARACTERISTIC
/begin CHARACTERISTIC ttKD_STAZ "Mappa Kd in Regime Stazionario" MAP 0xFC264E Lookup2DSF_UWORD 0 BoostControl50ms_Symbol_CM_ufix16_En7_adm 0 60
 /begin AXIS_DESCR COM_AXIS NO_INPUT_QUANTITY BoostControl50ms_Symbol_CM_uint16_rpm 8 0 10000 AXIS_PTS_REF tkRPM14 /end AXIS_DESCR
 /begin AXIS_DESCR COM_AXIS NO_INPUT_QUANTITY BoostControl50ms_Symbol_CM_ufix16_En10_adm 8 0 3 AXIS_PTS_REF tkETASP14 /end AXIS_DESCR
/end CHARACTERISTIC
/begin CHARACTERISTIC ttKD_TRANS "Mappa Kd in Regime Transitorio" MAP 0xFC25CE Lookup2DSF_UWORD 0 BoostControl50ms_Symbol_CM_ufix16_En7_adm 0 60
 /begin AXIS_DESCR COM_AXIS NO_INPUT_QUANTITY BoostControl50ms_Symbol_CM_uint16_rpm 8 0 10000 AXIS_PTS_REF tkRPM15 /end AXIS_DESCR
 /begin AXIS_DESCR COM_AXIS NO_INPUT_QUANTITY BoostControl50ms_Symbol_CM_ufix16_En10_adm 8 0 3 AXIS_PTS_REF tkETASP15 /end AXIS_DESCR
/end CHARACTERISTIC
/begin CHARACTERISTIC ttKD_WG_CTRL "KD per Ctrl PID diretto della WG" MAP 0xFC2596 Lookup2DSF_UWORD 0 BoostControl50ms_Symbol_CM_ufix16_En15___s_mbar 0 1.99996948242
 /begin AXIS_DESCR COM_AXIS NO_INPUT_QUANTITY BoostControl50ms_Symbol_CM_ufix16_Bn2000_mbar 7 -2000 2000 AXIS_PTS_REF tkKD_WG_CTRLEP /end AXIS_DESCR
 /begin AXIS_DESCR COM_AXIS NO_INPUT_QUANTITY BoostControl50ms_Symbol_CM_ufix16_En10_adm 4 0 10 AXIS_PTS_REF tkKD_WG_CTRLCP /end AXIS_DESCR
/end CHARACTERISTIC
/begin CHARACTERISTIC ttKI_STAZ "Mappa Ki in Regime Stazionario" MAP 0xFC2516 Lookup2DSF_UWORD 0 BoostControl50ms_Symbol_CM_ufix16_En10_adm 0 60
 /begin AXIS_DESCR COM_AXIS NO_INPUT_QUANTITY BoostControl50ms_Symbol_CM_uint16_rpm 8 0 10000 AXIS_PTS_REF tkRPM10 /end AXIS_DESCR
 /begin AXIS_DESCR COM_AXIS NO_INPUT_QUANTITY BoostControl50ms_Symbol_CM_ufix16_En10_adm 8 0 3 AXIS_PTS_REF tkETASP10 /end AXIS_DESCR
/end CHARACTERISTIC
/begin CHARACTERISTIC ttKI_TRANS "Mappa Ki in Regime Transitorio" MAP 0xFC2496 Lookup2DSF_UWORD 0 BoostControl50ms_Symbol_CM_ufix16_En10_adm 0 60
 /begin AXIS_DESCR COM_AXIS NO_INPUT_QUANTITY BoostControl50ms_Symbol_CM_uint16_rpm 8 0 10000 AXIS_PTS_REF tkRPM9 /end AXIS_DESCR
 /begin AXIS_DESCR COM_AXIS NO_INPUT_QUANTITY BoostControl50ms_Symbol_CM_ufix16_En10_adm 8 0 3 AXIS_PTS_REF tkETASP9 /end AXIS_DESCR
/end CHARACTERISTIC
/begin CHARACTERISTIC ttKI_WG_CTRL "KI per Ctrl PID diretto della WG" MAP 0xFC245E Lookup2DSF_UWORD 0 BoostControl50ms_Symbol_CM_ufix16_En15___mbar_s 0 1.99996948242
 /begin AXIS_DESCR COM_AXIS NO_INPUT_QUANTITY BoostControl50ms_Symbol_CM_ufix16_Bn2000_mbar 7 -2000 2000 AXIS_PTS_REF tkKI_WG_CTRLEP /end AXIS_DESCR
 /begin AXIS_DESCR COM_AXIS NO_INPUT_QUANTITY BoostControl50ms_Symbol_CM_ufix16_En10_adm 4 0 10 AXIS_PTS_REF tkKI_WG_CTRLCP /end AXIS_DESCR
/end CHARACTERISTIC
/begin CHARACTERISTIC ttKP_STAZ "Mappa Kp in Regime Stazionario" MAP 0xFC23DE Lookup2DSF_UWORD 0 BoostControl50ms_Symbol_CM_ufix16_En10_adm 0 60
 /begin AXIS_DESCR COM_AXIS NO_INPUT_QUANTITY BoostControl50ms_Symbol_CM_uint16_rpm 8 0 10000 AXIS_PTS_REF tkRPM8 /end AXIS_DESCR
 /begin AXIS_DESCR COM_AXIS NO_INPUT_QUANTITY BoostControl50ms_Symbol_CM_ufix16_En10_adm 8 0 3 AXIS_PTS_REF tkETASP8 /end AXIS_DESCR
/end CHARACTERISTIC
/begin CHARACTERISTIC ttKP_TRANS "Mappa Kp in Regime Transitorio" MAP 0xFC235E Lookup2DSF_UWORD 0 BoostControl50ms_Symbol_CM_ufix16_En10_adm 0 60
 /begin AXIS_DESCR COM_AXIS NO_INPUT_QUANTITY BoostControl50ms_Symbol_CM_uint16_rpm 8 0 10000 AXIS_PTS_REF tkRPM7 /end AXIS_DESCR
 /begin AXIS_DESCR COM_AXIS NO_INPUT_QUANTITY BoostControl50ms_Symbol_CM_ufix16_En10_adm 8 0 3 AXIS_PTS_REF tkETASP7 /end AXIS_DESCR
/end CHARACTERISTIC
/begin CHARACTERISTIC ttKP_WG_CTRL "KP per Ctrl PID diretto della WG" MAP 0xFC2326 Lookup2DSF_UWORD 0 BoostControl50ms_Symbol_CM_ufix16_En15___mbar_s 0 1.99996948242
 /begin AXIS_DESCR COM_AXIS NO_INPUT_QUANTITY BoostControl50ms_Symbol_CM_ufix16_Bn2000_mbar 7 -2000 2000 AXIS_PTS_REF tkKP_WG_CTRLEP /end AXIS_DESCR
 /begin AXIS_DESCR COM_AXIS NO_INPUT_QUANTITY BoostControl50ms_Symbol_CM_ufix16_En10_adm 4 0 10 AXIS_PTS_REF tkKP_WG_CTRLCP /end AXIS_DESCR
/end CHARACTERISTIC
/begin CHARACTERISTIC ttLIMIT_INT_INF "Mappa di Limitazione Quota Integrale" MAP 0xFC2B28 Lookup2DSF_WORD 0 BoostControl50ms_Symbol_CM_int16_mbar -4000 4000
 /begin AXIS_DESCR COM_AXIS NO_INPUT_QUANTITY BoostControl50ms_Symbol_CM_uint16_rpm 8 0 10000 AXIS_PTS_REF tkRPM18 /end AXIS_DESCR
 /begin AXIS_DESCR COM_AXIS NO_INPUT_QUANTITY BoostControl50ms_Symbol_CM_uint16_mbar 8 500 4000 AXIS_PTS_REF tkBOOST_PRESS_2 /end AXIS_DESCR
/end CHARACTERISTIC
/begin CHARACTERISTIC ttLIMIT_INT_SUP "Mappa di Limitazione superiore Quota Integrale" MAP 0xFC2AA8 Lookup2DSF_WORD 0 BoostControl50ms_Symbol_CM_int16_mbar -4000 4000
 /begin AXIS_DESCR COM_AXIS NO_INPUT_QUANTITY BoostControl50ms_Symbol_CM_uint16_rpm 8 0 10000 AXIS_PTS_REF tkRPM13 /end AXIS_DESCR
 /begin AXIS_DESCR COM_AXIS NO_INPUT_QUANTITY BoostControl50ms_Symbol_CM_uint16_mbar 8 500 4000 AXIS_PTS_REF tkBOOST_PRESS_1 /end AXIS_DESCR
/end CHARACTERISTIC
/begin CHARACTERISTIC ttRIF_BAS_EC_Q_N "Riferimento di pressione - guida economica vs. RPM e Qair_Obj" MAP 0xFC2206 Lookup2DSF_UWORD 0 BoostControl50ms_Symbol_CM_uint16_mbar 0 4000
 /begin AXIS_DESCR COM_AXIS NO_INPUT_QUANTITY BoostControl50ms_Symbol_CM_uint16_rpm 12 0 10000 AXIS_PTS_REF tkRIF_BAS_EC_N /end AXIS_DESCR
 /begin AXIS_DESCR COM_AXIS NO_INPUT_QUANTITY BoostControl50ms_Symbol_CM_ufix16_En4_Kg_h 12 0 4095 AXIS_PTS_REF tkRIF_BAS_EC_QOB /end AXIS_DESCR
/end CHARACTERISTIC
/begin CHARACTERISTIC ttSOGLIA_MAX "Soglia Max pressione di Boost" MAP 0xFC213E Lookup2DSF_UWORD 0 BoostControl50ms_Symbol_CM_uint16_mbar 0 4000
 /begin AXIS_DESCR COM_AXIS NO_INPUT_QUANTITY BoostControl50ms_Symbol_CM_uint16_rpm 10 0 10000 AXIS_PTS_REF tkRPM3 /end AXIS_DESCR
 /begin AXIS_DESCR COM_AXIS NO_INPUT_QUANTITY BoostControl50ms_Symbol_CM_uint16_mbar 10 0 1500 AXIS_PTS_REF tkPATM2 /end AXIS_DESCR
/end CHARACTERISTIC
/begin CHARACTERISTIC tvCORR_TEMP_AIR "Correzione in Temperatura Aria" CURVE 0xFC212E Lookup1D_UWORD 0 BoostControl50ms_Symbol_CM_ufix16_En6_adm 0.5 1.5
 /begin AXIS_DESCR COM_AXIS NO_INPUT_QUANTITY BoostControl50ms_Symbol_CM_ufix16_Bn40__C 8 -40 130 AXIS_PTS_REF tkTAIR1 /end AXIS_DESCR
/end CHARACTERISTIC
/begin COMPU_METHOD AbilitazioneDLAM100ms_Symbol_CM_uint16_km_h "Q = V" RAT_FUNC "%5.0" "km/h" COEFFS 0 1 0 0 0 1 /end COMPU_METHOD
/begin COMPU_METHOD Abilitazione_DFSLY_100ms_Symbol_CM_uint8_adm "Q = V" RAT_FUNC "%3.0" "adm" COEFFS 0 1 0 0 0 1 /end COMPU_METHOD
/begin COMPU_METHOD Airq_CtrlMgmtTDC_CM_ufix16_En10_adm "Q = V*1024.000000" RAT_FUNC "%12.10" "adm" COEFFS 0 1024 0 0 0 1 /end COMPU_METHOD
/begin COMPU_METHOD Airq_CtrlMgmtTDC_CM_ufix16_En7_mg_cc "Q = V*128.000000" RAT_FUNC "%10.7" "mg/cc" COEFFS 0 128 0 0 0 1 /end COMPU_METHOD
/begin COMPU_METHOD Airt100ms_CM_boolean_adm "Q = V" RAT_FUNC "%1.0" "adm" COEFFS 0 1 0 0 0 1 /end COMPU_METHOD
/begin COMPU_METHOD Airt100ms_CM_eEGST_adm "Enumerated data type: eEGST" TAB_VERB "%0.6" "adm" COMPU_TAB_REF VTAB_FOR_Airt100ms_CM_eEGST_adm /end COMPU_METHOD
/begin COMPU_METHOD AngWinAcqTDC_CM_sfix16_S6_degree "Q = V/6.000000" RAT_FUNC "%0.6" "degree" COEFFS 0 1 0 0 0 6 /end COMPU_METHOD
/begin COMPU_METHOD AngWinAcqTDC_CM_ufix16_S6_degree "Q = V/6.000000" RAT_FUNC "%0.6" "degree" COEFFS 0 1 0 0 0 6 /end COMPU_METHOD
/begin COMPU_METHOD AutoTDC_CM_ufix16_En10_adm "Q = V*1024.000000" RAT_FUNC "%12.10" "adm" COEFFS 0 1024 0 0 0 1 /end COMPU_METHOD
/begin COMPU_METHOD BoostControl50ms_Symbol_CM_FixEnableT "Enumerated data type: FixEnableT" TAB_VERB "%0.6" "" COMPU_TAB_REF VTAB_FOR_BoostControl50ms_Symbol_CM_FixEnableT /end COMPU_METHOD
/begin COMPU_METHOD BoostControl50ms_Symbol_CM_boolean_adm "Q = V" RAT_FUNC "%1.0" "adm" COEFFS 0 1 0 0 0 1 /end COMPU_METHOD
/begin COMPU_METHOD BoostControl50ms_Symbol_CM_int16_mbar "Q = V" RAT_FUNC "%5.0" "mbar" COEFFS 0 1 0 0 0 1 /end COMPU_METHOD
/begin COMPU_METHOD BoostControl50ms_Symbol_CM_int16_mbar_s "Q = V" RAT_FUNC "%5.0" "mbar/s" COEFFS 0 1 0 0 0 1 /end COMPU_METHOD
/begin COMPU_METHOD BoostControl50ms_Symbol_CM_int32_mbar "Q = V" RAT_FUNC "%10.0" "mbar" COEFFS 0 1 0 0 0 1 /end COMPU_METHOD
/begin COMPU_METHOD BoostControl50ms_Symbol_CM_sfix16_En4__ "Q = V*16.000000" RAT_FUNC "%8.4" "%" COEFFS 0 16 0 0 0 1 /end COMPU_METHOD
/begin COMPU_METHOD BoostControl50ms_Symbol_CM_sfix32_En15_mbar "Q = V*32768.000000" RAT_FUNC "%21.15" "mbar" COEFFS 0 32768 0 0 0 1 /end COMPU_METHOD
/begin COMPU_METHOD BoostControl50ms_Symbol_CM_ufix16_Bn10000_rpm "Q = (V+10000.000000)/1.000000" RAT_FUNC "%0.6" "rpm" COEFFS 0 1 10000 0 0 1 /end COMPU_METHOD
/begin COMPU_METHOD BoostControl50ms_Symbol_CM_ufix16_Bn100__ "Q = (V+100.000000)/1.000000" RAT_FUNC "%0.6" "%" COEFFS 0 1 100 0 0 1 /end COMPU_METHOD
/begin COMPU_METHOD BoostControl50ms_Symbol_CM_ufix16_Bn2000_mbar "Q = (V+2000.000000)/1.000000" RAT_FUNC "%0.6" "mbar" COEFFS 0 1 2000 0 0 1 /end COMPU_METHOD
/begin COMPU_METHOD BoostControl50ms_Symbol_CM_ufix16_Bn40__C "Q = (V+40.000000)/1.000000" RAT_FUNC "%0.6" "°C" COEFFS 0 1 40 0 0 1 /end COMPU_METHOD
/begin COMPU_METHOD BoostControl50ms_Symbol_CM_ufix16_En10_1_s "Q = V*1024.000000" RAT_FUNC "%12.10" "1/s" COEFFS 0 1024 0 0 0 1 /end COMPU_METHOD
/begin COMPU_METHOD BoostControl50ms_Symbol_CM_ufix16_En10_adm "Q = V*1024.000000" RAT_FUNC "%12.10" "adm" COEFFS 0 1024 0 0 0 1 /end COMPU_METHOD
/begin COMPU_METHOD BoostControl50ms_Symbol_CM_ufix16_En12_adm "Q = V*4096.000000" RAT_FUNC "%14.12" "adm" COEFFS 0 4096 0 0 0 1 /end COMPU_METHOD
/begin COMPU_METHOD BoostControl50ms_Symbol_CM_ufix16_En15___mbar_s "Q = V*32768.000000" RAT_FUNC "%16.15" "%/mbar*s" COEFFS 0 32768 0 0 0 1 /end COMPU_METHOD
/begin COMPU_METHOD BoostControl50ms_Symbol_CM_ufix16_En15___s_mbar "Q = V*32768.000000" RAT_FUNC "%16.15" "%*s/mbar" COEFFS 0 32768 0 0 0 1 /end COMPU_METHOD
/begin COMPU_METHOD BoostControl50ms_Symbol_CM_ufix16_En2_mbar_m_s "Q = V*4.000000" RAT_FUNC "%7.2" "mbar/m*s" COEFFS 0 4 0 0 0 1 /end COMPU_METHOD
/begin COMPU_METHOD BoostControl50ms_Symbol_CM_ufix16_En3__ "Q = V*8.000000" RAT_FUNC "%7.3" "%" COEFFS 0 8 0 0 0 1 /end COMPU_METHOD
/begin COMPU_METHOD BoostControl50ms_Symbol_CM_ufix16_En4_Bn100__ "Q = (V+100.000000)*16.000000" RAT_FUNC "%0.6" "%" COEFFS 0 16 1600 0 0 1 /end COMPU_METHOD
/begin COMPU_METHOD BoostControl50ms_Symbol_CM_ufix16_En4_Kg_h "Q = V*16.000000" RAT_FUNC "%8.4" "Kg/h" COEFFS 0 16 0 0 0 1 /end COMPU_METHOD
/begin COMPU_METHOD BoostControl50ms_Symbol_CM_ufix16_En4__ "Q = V*16.000000" RAT_FUNC "%8.4" "%" COEFFS 0 16 0 0 0 1 /end COMPU_METHOD
/begin COMPU_METHOD BoostControl50ms_Symbol_CM_ufix16_En4_adm "Q = V*16.000000" RAT_FUNC "%8.4" "adm" COEFFS 0 16 0 0 0 1 /end COMPU_METHOD
/begin COMPU_METHOD BoostControl50ms_Symbol_CM_ufix16_En4_kg_h "Q = V*16.000000" RAT_FUNC "%8.4" "kg/h" COEFFS 0 16 0 0 0 1 /end COMPU_METHOD
/begin COMPU_METHOD BoostControl50ms_Symbol_CM_ufix16_En6_adm "Q = V*64.000000" RAT_FUNC "%10.6" "adm" COEFFS 0 64 0 0 0 1 /end COMPU_METHOD
/begin COMPU_METHOD BoostControl50ms_Symbol_CM_ufix16_En7_adm "Q = V*128.000000" RAT_FUNC "%10.7" "adm" COEFFS 0 128 0 0 0 1 /end COMPU_METHOD
/begin COMPU_METHOD BoostControl50ms_Symbol_CM_ufix16_En7_s "Q = V*128.000000" RAT_FUNC "%10.7" "s" COEFFS 0 128 0 0 0 1 /end COMPU_METHOD
/begin COMPU_METHOD BoostControl50ms_Symbol_CM_uint16__ "Q = V" RAT_FUNC "%5.0" "%" COEFFS 0 1 0 0 0 1 /end COMPU_METHOD
/begin COMPU_METHOD BoostControl50ms_Symbol_CM_uint16_mbar "Q = V" RAT_FUNC "%5.0" "mbar" COEFFS 0 1 0 0 0 1 /end COMPU_METHOD
/begin COMPU_METHOD BoostControl50ms_Symbol_CM_uint16_mm2 "Q = V" RAT_FUNC "%5.0" "mm2" COEFFS 0 1 0 0 0 1 /end COMPU_METHOD
/begin COMPU_METHOD BoostControl50ms_Symbol_CM_uint16_rpm "Q = V" RAT_FUNC "%5.0" "rpm" COEFFS 0 1 0 0 0 1 /end COMPU_METHOD
/begin COMPU_METHOD BoostControl50ms_Symbol_CM_uint8_m_s "Q = V" RAT_FUNC "%3.0" "m/s" COEFFS 0 1 0 0 0 1 /end COMPU_METHOD
/begin COMPU_METHOD BoostControl50ms_Symbol_CM_uint8_mm "Q = V" RAT_FUNC "%3.0" "mm" COEFFS 0 1 0 0 0 1 /end COMPU_METHOD
/begin COMPU_METHOD Boost_CtrlMgmt50ms_CM_boolean_adm "Q = V" RAT_FUNC "%1.0" "adm" COEFFS 0 1 0 0 0 1 /end COMPU_METHOD
/begin COMPU_METHOD Boost_CtrlMgmt50ms_CM_ufix16_En3__ "Q = V*8.000000" RAT_FUNC "%7.3" "%" COEFFS 0 8 0 0 0 1 /end COMPU_METHOD
/begin COMPU_METHOD Boost_CtrlMgmt50ms_CM_ufix16_En6_adm "Q = V*64.000000" RAT_FUNC "%10.6" "adm" COEFFS 0 64 0 0 0 1 /end COMPU_METHOD
/begin COMPU_METHOD Boost_CtrlMgmt50ms_CM_uint16_mbar "Q = V" RAT_FUNC "%5.0" "mbar" COEFFS 0 1 0 0 0 1 /end COMPU_METHOD
/begin COMPU_METHOD CalcADCYC_ADIDL_100ms_Symbol_CM_uint16_mbar "Q = V" RAT_FUNC "%5.0" "mbar" COEFFS 0 1 0 0 0 1 /end COMPU_METHOD
/begin COMPU_METHOD CalcADCYC_ADIDL_100ms_Symbol_CM_uint16_rpm "Q = V" RAT_FUNC "%5.0" "rpm" COEFFS 0 1 0 0 0 1 /end COMPU_METHOD
/begin COMPU_METHOD CalcGain_Adat_100ms_Symbol_CM_uint8_adm "Q = V" RAT_FUNC "%3.0" "adm" COEFFS 0 1 0 0 0 1 /end COMPU_METHOD
/begin COMPU_METHOD Cata100ms_Symbol_CM_boolean_adm "Q = V" RAT_FUNC "%1.0" "adm" COEFFS 0 1 0 0 0 1 /end COMPU_METHOD
/begin COMPU_METHOD Cata100ms_Symbol_CM_sfix16_En14_adm "Q = V*16384.000000" RAT_FUNC "%15.14" "adm" COEFFS 0 16384 0 0 0 1 /end COMPU_METHOD
/begin COMPU_METHOD Cata100ms_Symbol_CM_ufix16_Bn40_degC "Q = (V+40.000000)/1.000000" RAT_FUNC "%0.6" "degC" COEFFS 0 1 40 0 0 1 /end COMPU_METHOD
/begin COMPU_METHOD Cata100ms_Symbol_CM_ufix16_En10_adm "Q = V*1024.000000" RAT_FUNC "%12.10" "adm" COEFFS 0 1024 0 0 0 1 /end COMPU_METHOD
/begin COMPU_METHOD Cata100ms_Symbol_CM_ufix16_En15_adm "Q = V*32768.000000" RAT_FUNC "%16.15" "adm" COEFFS 0 32768 0 0 0 1 /end COMPU_METHOD
/begin COMPU_METHOD Cata100ms_Symbol_CM_ufix16_En15_degC_kg "Q = V*32768.000000" RAT_FUNC "%16.15" "degC/kg" COEFFS 0 32768 0 0 0 1 /end COMPU_METHOD
/begin COMPU_METHOD Cata100ms_Symbol_CM_ufix16_En3_mg_cc "Q = V*8.000000" RAT_FUNC "%7.3" "mg/cc" COEFFS 0 8 0 0 0 1 /end COMPU_METHOD
/begin COMPU_METHOD Cata100ms_Symbol_CM_ufix16_En7__ "Q = V*128.000000" RAT_FUNC "%10.7" "%" COEFFS 0 128 0 0 0 1 /end COMPU_METHOD
/begin COMPU_METHOD Cata100ms_Symbol_CM_ufix16_Sp1_s "Q = V*10.000000" RAT_FUNC "%0.6" "s" COEFFS 0 10 0 0 0 1 /end COMPU_METHOD
/begin COMPU_METHOD Cata100ms_Symbol_CM_uint16_adm "Q = V" RAT_FUNC "%5.0" "adm" COEFFS 0 1 0 0 0 1 /end COMPU_METHOD
/begin COMPU_METHOD Cata100ms_Symbol_CM_uint16_km_h "Q = V" RAT_FUNC "%5.0" "km/h" COEFFS 0 1 0 0 0 1 /end COMPU_METHOD
/begin COMPU_METHOD Cata100ms_Symbol_CM_uint16_mV "Q = V" RAT_FUNC "%5.0" "mV" COEFFS 0 1 0 0 0 1 /end COMPU_METHOD
/begin COMPU_METHOD Cata100ms_Symbol_CM_uint16_rpm "Q = V" RAT_FUNC "%5.0" "rpm" COEFFS 0 1 0 0 0 1 /end COMPU_METHOD
/begin COMPU_METHOD Cata100ms_Symbol_CM_uint8_adm "Q = V" RAT_FUNC "%3.0" "adm" COEFFS 0 1 0 0 0 1 /end COMPU_METHOD
/begin COMPU_METHOD CataTDC_Symbol_CM_ufix16_En15_adm "Q = V*32768.000000" RAT_FUNC "%16.15" "adm" COEFFS 0 32768 0 0 0 1 /end COMPU_METHOD
/begin COMPU_METHOD CataTDC_Symbol_CM_uint16_mV "Q = V" RAT_FUNC "%5.0" "mV" COEFFS 0 1 0 0 0 1 /end COMPU_METHOD
/begin COMPU_METHOD CataTDC_Symbol_CM_uint16_mbar "Q = V" RAT_FUNC "%5.0" "mbar" COEFFS 0 1 0 0 0 1 /end COMPU_METHOD
/begin COMPU_METHOD CataTDC_Symbol_CM_uint16_rpm "Q = V" RAT_FUNC "%5.0" "rpm" COEFFS 0 1 0 0 0 1 /end COMPU_METHOD
/begin COMPU_METHOD Crkc4ms_CM_boolean_adm "Q = V" RAT_FUNC "%1.0" "adm" COEFFS 0 1 0 0 0 1 /end COMPU_METHOD
/begin COMPU_METHOD DCmvInterface100ms_Symbol_CM_boolean_bool "Q = V" RAT_FUNC "%1.0" "bool" COEFFS 0 1 0 0 0 1 /end COMPU_METHOD
/begin COMPU_METHOD DCmvInterface100ms_Symbol_CM_sfix16_Sp01__ "Q = V*100.000000" RAT_FUNC "%0.6" "%" COEFFS 0 100 0 0 0 1 /end COMPU_METHOD
/begin COMPU_METHOD DCmvInterface100ms_Symbol_CM_ufix16_En8_adm "Q = V*256.000000" RAT_FUNC "%11.8" "adm" COEFFS 0 256 0 0 0 1 /end COMPU_METHOD
/begin COMPU_METHOD DCmvInterface100ms_Symbol_CM_ufix16_Sp1_s "Q = V*10.000000" RAT_FUNC "%0.6" "s" COEFFS 0 10 0 0 0 1 /end COMPU_METHOD
/begin COMPU_METHOD Dcat_Diagnosis100ms_CM_boolean_adm "Q = V" RAT_FUNC "%1.0" "adm" COEFFS 0 1 0 0 0 1 /end COMPU_METHOD
/begin COMPU_METHOD Dcat_Diagnosis100ms_CM_ufix16_Bn40_degC "Q = (V+40.000000)/1.000000" RAT_FUNC "%0.6" "degC" COEFFS 0 1 40 0 0 1 /end COMPU_METHOD
/begin COMPU_METHOD Dcat_Diagnosis100ms_CM_ufix16_En10_adm "Q = V*1024.000000" RAT_FUNC "%12.10" "adm" COEFFS 0 1024 0 0 0 1 /end COMPU_METHOD
/begin COMPU_METHOD Dcat_Diagnosis100ms_CM_ufix16_En15_adm "Q = V*32768.000000" RAT_FUNC "%16.15" "adm" COEFFS 0 32768 0 0 0 1 /end COMPU_METHOD
/begin COMPU_METHOD Dcat_Diagnosis100ms_CM_ufix16_Sp01__ "Q = V*100.000000" RAT_FUNC "%0.6" "%" COEFFS 0 100 0 0 0 1 /end COMPU_METHOD
/begin COMPU_METHOD Dcat_Diagnosis100ms_CM_ufix16_Sp01_hz "Q = V*100.000000" RAT_FUNC "%0.6" "hz" COEFFS 0 100 0 0 0 1 /end COMPU_METHOD
/begin COMPU_METHOD Dcat_Diagnosis100ms_CM_uint16_adm "Q = V" RAT_FUNC "%5.0" "adm" COEFFS 0 1 0 0 0 1 /end COMPU_METHOD
/begin COMPU_METHOD Dcat_Diagnosis100ms_CM_uint16_mV "Q = V" RAT_FUNC "%5.0" "mV" COEFFS 0 1 0 0 0 1 /end COMPU_METHOD
/begin COMPU_METHOD Dcat_Diagnosis100ms_CM_uint32_mV "Q = V" RAT_FUNC "%10.0" "mV" COEFFS 0 1 0 0 0 1 /end COMPU_METHOD
/begin COMPU_METHOD Dcat_Diagnosis100ms_CM_uint8_adm "Q = V" RAT_FUNC "%3.0" "adm" COEFFS 0 1 0 0 0 1 /end COMPU_METHOD
/begin COMPU_METHOD DiagSym100ms_CM_boolean_adm "Q = V" RAT_FUNC "%1.0" "adm" COEFFS 0 1 0 0 0 1 /end COMPU_METHOD
/begin COMPU_METHOD DiagSym100ms_CM_ufix16_E4_us "Q = V/16.000000" RAT_FUNC "%5.0" "us" COEFFS 0 1 0 0 0 16 /end COMPU_METHOD
/begin COMPU_METHOD DiagSym100ms_CM_ufix16_En4_degree "Q = V*16.000000" RAT_FUNC "%8.4" "degree" COEFFS 0 16 0 0 0 1 /end COMPU_METHOD
/begin COMPU_METHOD DiagSym100ms_CM_uint8_adm "Q = V" RAT_FUNC "%3.0" "adm" COEFFS 0 1 0 0 0 1 /end COMPU_METHOD
/begin COMPU_METHOD EgmdTDC_CM_boolean_adm "Q = V" RAT_FUNC "%1.0" "adm" COEFFS 0 1 0 0 0 1 /end COMPU_METHOD
/begin COMPU_METHOD Egst4ms_CM_boolean_adm "Q = V" RAT_FUNC "%1.0" "adm" COEFFS 0 1 0 0 0 1 /end COMPU_METHOD
/begin COMPU_METHOD Egst4ms_CM_eActDiagPh_adm "Enumerated data type: eActDiagPh" TAB_VERB "%0.6" "adm" COMPU_TAB_REF VTAB_FOR_Egst4ms_CM_eActDiagPh_adm /end COMPU_METHOD
/begin COMPU_METHOD Egst4ms_CM_uint8_adm "Q = V" RAT_FUNC "%3.0" "adm" COEFFS 0 1 0 0 0 1 /end COMPU_METHOD
/begin COMPU_METHOD EngineRun100ms_Symbol_CM_ufix8_S100_ms "Q = V/100.000000" RAT_FUNC "%0.6" "ms" COEFFS 0 1 0 0 0 100 /end COMPU_METHOD
/begin COMPU_METHOD EngineRun100ms_Symbol_CM_uint16_rpm "Q = V" RAT_FUNC "%5.0" "rpm" COEFFS 0 1 0 0 0 1 /end COMPU_METHOD
/begin COMPU_METHOD EngineState4ms_CM_FixEnableT "Enumerated data type: FixEnableT" TAB_VERB "%0.6" "" COMPU_TAB_REF VTAB_FOR_EngineState4ms_CM_FixEnableT /end COMPU_METHOD
/begin COMPU_METHOD EngineState4ms_CM_boolean_adm "Q = V" RAT_FUNC "%1.0" "adm" COEFFS 0 1 0 0 0 1 /end COMPU_METHOD
/begin COMPU_METHOD EngineState4ms_CM_ufix16_Sp1_s "Q = V*10.000000" RAT_FUNC "%0.6" "s" COEFFS 0 10 0 0 0 1 /end COMPU_METHOD
/begin COMPU_METHOD EngineState4ms_CM_uint8_adm "Q = V" RAT_FUNC "%3.0" "adm" COEFFS 0 1 0 0 0 1 /end COMPU_METHOD
/begin COMPU_METHOD ExitCalcDLAM100ms_Symbol_CM_uint8_adm "Q = V" RAT_FUNC "%3.0" "adm" COEFFS 0 1 0 0 0 1 /end COMPU_METHOD
/begin COMPU_METHOD FFSymUpdater100ms_CM_boolean_adm "Q = V" RAT_FUNC "%1.0" "adm" COEFFS 0 1 0 0 0 1 /end COMPU_METHOD
/begin COMPU_METHOD FFSymUpdater100ms_CM_single_deg "Q = V" RAT_FUNC "%8.6" "deg" COEFFS 0 1 0 0 0 1 /end COMPU_METHOD
/begin COMPU_METHOD FaultChkMDxTDC_CM_ufix16_En10_adm "Q = V*1024.000000" RAT_FUNC "%12.10" "adm" COEFFS 0 1024 0 0 0 1 /end COMPU_METHOD
/begin COMPU_METHOD FaultChkMDxTDC_CM_uint16_adm "Q = V" RAT_FUNC "%5.0" "adm" COEFFS 0 1 0 0 0 1 /end COMPU_METHOD
/begin COMPU_METHOD FaultChkMDxTDC_CM_uint8_adm "Q = V" RAT_FUNC "%3.0" "adm" COEFFS 0 1 0 0 0 1 /end COMPU_METHOD
/begin COMPU_METHOD FlywheelCorrTDC_CM_ufix16_Bn40_deg "Q = (V+40.000000)/1.000000" RAT_FUNC "%0.6" "deg" COEFFS 0 1 40 0 0 1 /end COMPU_METHOD
/begin COMPU_METHOD FlywheelCorrTDC_CM_uint16_adm "Q = V" RAT_FUNC "%5.0" "adm" COEFFS 0 1 0 0 0 1 /end COMPU_METHOD
/begin COMPU_METHOD FlywheelCorrTDC_CM_uint16_rpm "Q = V" RAT_FUNC "%5.0" "rpm" COEFFS 0 1 0 0 0 1 /end COMPU_METHOD
/begin COMPU_METHOD FlywheelCorrTDC_CM_uint8_adm "Q = V" RAT_FUNC "%3.0" "adm" COEFFS 0 1 0 0 0 1 /end COMPU_METHOD
/begin COMPU_METHOD Fuels_CtrlMgmt100ms_CM_boolean_adm "Q = V" RAT_FUNC "%1.0" "adm" COEFFS 0 1 0 0 0 1 /end COMPU_METHOD
/begin COMPU_METHOD Fuels_CtrlMgmt100ms_CM_ufix16_Sp004__ "Q = V*250.000000" RAT_FUNC "%0.6" "%" COEFFS 0 250 0 0 0 1 /end COMPU_METHOD
/begin COMPU_METHOD Fuels_CtrlMgmt100ms_CM_ufix16_Sp1__ "Q = V*10.000000" RAT_FUNC "%0.6" "%" COEFFS 0 10 0 0 0 1 /end COMPU_METHOD
/begin COMPU_METHOD Fuels_CtrlMgmt100ms_CM_uint8_adm "Q = V" RAT_FUNC "%3.0" "adm" COEFFS 0 1 0 0 0 1 /end COMPU_METHOD
/begin COMPU_METHOD Fuels_CtrlMgmtTDC_CM_boolean_adm "Q = V" RAT_FUNC "%1.0" "adm" COEFFS 0 1 0 0 0 1 /end COMPU_METHOD
/begin COMPU_METHOD Fuels_CtrlMgmtTDC_CM_uint8_adm "Q = V" RAT_FUNC "%3.0" "adm" COEFFS 0 1 0 0 0 1 /end COMPU_METHOD
/begin COMPU_METHOD Gain_Adat_Test_100ms_Symbol_CM_boolean_adm "Q = V" RAT_FUNC "%1.0" "adm" COEFFS 0 1 0 0 0 1 /end COMPU_METHOD
/begin COMPU_METHOD Gain_Adat_Test_100ms_Symbol_CM_sfix16_Sp004__ "Q = V*250.000000" RAT_FUNC "%0.6" "%" COEFFS 0 250 0 0 0 1 /end COMPU_METHOD
/begin COMPU_METHOD Gain_Adat_Test_100ms_Symbol_CM_ufix16_Sp004__ "Q = V*250.000000" RAT_FUNC "%0.6" "%" COEFFS 0 250 0 0 0 1 /end COMPU_METHOD
/begin COMPU_METHOD InjTDC_CM_FixEnableT "Enumerated data type: FixEnableT" TAB_VERB "%0.6" "" COMPU_TAB_REF VTAB_FOR_InjTDC_CM_FixEnableT /end COMPU_METHOD
/begin COMPU_METHOD InjTDC_CM_boolean_adm "Q = V" RAT_FUNC "%1.0" "adm" COEFFS 0 1 0 0 0 1 /end COMPU_METHOD
/begin COMPU_METHOD InjTDC_CM_sfix16_En10_adm "Q = V*1024.000000" RAT_FUNC "%12.10" "adm" COEFFS 0 1024 0 0 0 1 /end COMPU_METHOD
/begin COMPU_METHOD InjTDC_CM_ufix16_Bn40_degC "Q = (V+40.000000)/1.000000" RAT_FUNC "%0.6" "degC" COEFFS 0 1 40 0 0 1 /end COMPU_METHOD
/begin COMPU_METHOD InjTDC_CM_ufix16_En10_adm "Q = V*1024.000000" RAT_FUNC "%12.10" "adm" COEFFS 0 1024 0 0 0 1 /end COMPU_METHOD
/begin COMPU_METHOD InjTDC_CM_ufix16_En4_degree "Q = V*16.000000" RAT_FUNC "%8.4" "degree" COEFFS 0 16 0 0 0 1 /end COMPU_METHOD
/begin COMPU_METHOD InjTDC_CM_ufix16_En4_kg_h "Q = V*16.000000" RAT_FUNC "%8.4" "kg/h" COEFFS 0 16 0 0 0 1 /end COMPU_METHOD
/begin COMPU_METHOD InjTDC_CM_ufix16_En7__ "Q = V*128.000000" RAT_FUNC "%10.7" "%" COEFFS 0 128 0 0 0 1 /end COMPU_METHOD
/begin COMPU_METHOD InjTDC_CM_ufix16_En7_mg_cc "Q = V*128.000000" RAT_FUNC "%10.7" "mg/cc" COEFFS 0 128 0 0 0 1 /end COMPU_METHOD
/begin COMPU_METHOD InjTDC_CM_ufix32_En4_Bn130000000_kg_h "Q = (V+130000000.000000)*16.000000" RAT_FUNC "%0.6" "kg/h" COEFFS 0 16 2080000000 0 0 1 /end COMPU_METHOD
/begin COMPU_METHOD InjTDC_CM_uint16_RPM "Q = V" RAT_FUNC "%5.0" "RPM" COEFFS 0 1 0 0 0 1 /end COMPU_METHOD
/begin COMPU_METHOD InjTDC_CM_uint16_TDC "Q = V" RAT_FUNC "%5.0" "TDC" COEFFS 0 1 0 0 0 1 /end COMPU_METHOD
/begin COMPU_METHOD InjTDC_CM_uint16_adm "Q = V" RAT_FUNC "%5.0" "adm" COEFFS 0 1 0 0 0 1 /end COMPU_METHOD
/begin COMPU_METHOD InjTDC_CM_uint16_rpm "Q = V" RAT_FUNC "%5.0" "rpm" COEFFS 0 1 0 0 0 1 /end COMPU_METHOD
/begin COMPU_METHOD InjTDC_CM_uint8_adm "Q = V" RAT_FUNC "%3.0" "adm" COEFFS 0 1 0 0 0 1 /end COMPU_METHOD
/begin COMPU_METHOD InjectorParms4ms_CM_FixEnableT "Enumerated data type: FixEnableT" TAB_VERB "%0.6" "" COMPU_TAB_REF VTAB_FOR_InjectorParms4ms_CM_FixEnableT /end COMPU_METHOD
/begin COMPU_METHOD InjectorParms4ms_CM_boolean_adm "Q = V" RAT_FUNC "%1.0" "adm" COEFFS 0 1 0 0 0 1 /end COMPU_METHOD
/begin COMPU_METHOD InjectorParms4ms_CM_tColdInjState_adm "Enumerated data type: tColdInjState" TAB_VERB "%0.6" "adm" COMPU_TAB_REF VTAB_FOR_InjectorParms4ms_CM_tColdInjState_adm /end COMPU_METHOD
/begin COMPU_METHOD InjectorParms4ms_CM_ufix16_Bn40_degC "Q = (V+40.000000)/1.000000" RAT_FUNC "%0.6" "degC" COEFFS 0 1 40 0 0 1 /end COMPU_METHOD
/begin COMPU_METHOD InjectorParms4ms_CM_ufix16_E4_us "Q = V/16.000000" RAT_FUNC "%5.0" "us" COEFFS 0 1 0 0 0 16 /end COMPU_METHOD
/begin COMPU_METHOD InjectorParms4ms_CM_ufix16_En7_adm "Q = V*128.000000" RAT_FUNC "%10.7" "adm" COEFFS 0 128 0 0 0 1 /end COMPU_METHOD
/begin COMPU_METHOD InjectorParms4ms_CM_ufix16_S50_mV "Q = V/50.000000" RAT_FUNC "%0.6" "mV" COEFFS 0 1 0 0 0 50 /end COMPU_METHOD
/begin COMPU_METHOD InjectorParms4ms_CM_ufix16_S50_mVolt "Q = V/50.000000" RAT_FUNC "%0.6" "mVolt" COEFFS 0 1 0 0 0 50 /end COMPU_METHOD
/begin COMPU_METHOD InjectorParms4ms_CM_ufix16_Sp004_s "Q = V*250.000000" RAT_FUNC "%0.6" "s" COEFFS 0 250 0 0 0 1 /end COMPU_METHOD
/begin COMPU_METHOD InjectorParms4ms_CM_uint16_mA "Q = V" RAT_FUNC "%5.0" "mA" COEFFS 0 1 0 0 0 1 /end COMPU_METHOD
/begin COMPU_METHOD InjectorParms4ms_CM_uint16_us "Q = V" RAT_FUNC "%5.0" "us" COEFFS 0 1 0 0 0 1 /end COMPU_METHOD
/begin COMPU_METHOD InjectorParms4ms_CM_uint8_adm "Q = V" RAT_FUNC "%3.0" "adm" COEFFS 0 1 0 0 0 1 /end COMPU_METHOD
/begin COMPU_METHOD InjectorTDC_Symbol_CM_FixEnableT "Enumerated data type: FixEnableT" TAB_VERB "%0.6" "" COMPU_TAB_REF VTAB_FOR_InjectorTDC_Symbol_CM_FixEnableT /end COMPU_METHOD
/begin COMPU_METHOD InjectorTDC_Symbol_CM_boolean_adm "Q = V" RAT_FUNC "%1.0" "adm" COEFFS 0 1 0 0 0 1 /end COMPU_METHOD
/begin COMPU_METHOD InjectorTDC_Symbol_CM_ufix16_Bn40_degC "Q = (V+40.000000)/1.000000" RAT_FUNC "%0.6" "degC" COEFFS 0 1 40 0 0 1 /end COMPU_METHOD
/begin COMPU_METHOD InjectorTDC_Symbol_CM_ufix16_E4_us "Q = V/16.000000" RAT_FUNC "%5.0" "us" COEFFS 0 1 0 0 0 16 /end COMPU_METHOD
/begin COMPU_METHOD InjectorTDC_Symbol_CM_ufix16_En1_us_mg "Q = V*2.000000" RAT_FUNC "%6.1" "us/mg" COEFFS 0 2 0 0 0 1 /end COMPU_METHOD
/begin COMPU_METHOD InjectorTDC_Symbol_CM_ufix16_S50_mV "Q = V/50.000000" RAT_FUNC "%0.6" "mV" COEFFS 0 1 0 0 0 50 /end COMPU_METHOD
/begin COMPU_METHOD InjectorTDC_Symbol_CM_ufix32_E4_us "Q = V/16.000000" RAT_FUNC "%10.0" "us" COEFFS 0 1 0 0 0 16 /end COMPU_METHOD
/begin COMPU_METHOD InjectorTDC_Symbol_CM_uint16_adm "Q = V" RAT_FUNC "%5.0" "adm" COEFFS 0 1 0 0 0 1 /end COMPU_METHOD
/begin COMPU_METHOD InjectorTDC_Symbol_CM_uint16_mbar "Q = V" RAT_FUNC "%5.0" "mbar" COEFFS 0 1 0 0 0 1 /end COMPU_METHOD
/begin COMPU_METHOD InjtTDC_CM_boolean_adm "Q = V" RAT_FUNC "%1.0" "adm" COEFFS 0 1 0 0 0 1 /end COMPU_METHOD
/begin COMPU_METHOD InjtTDC_CM_ufix16_En10_adm "Q = V*1024.000000" RAT_FUNC "%12.10" "adm" COEFFS 0 1024 0 0 0 1 /end COMPU_METHOD
/begin COMPU_METHOD Injt_SetParameters4ms_CM_boolean_adm "Q = V" RAT_FUNC "%1.0" "adm" COEFFS 0 1 0 0 0 1 /end COMPU_METHOD
/begin COMPU_METHOD Injt_SetParameters4ms_CM_int16_mbar "Q = V" RAT_FUNC "%5.0" "mbar" COEFFS 0 1 0 0 0 1 /end COMPU_METHOD
/begin COMPU_METHOD MisfdTDC_CM_boolean_adm "Q = V" RAT_FUNC "%1.0" "adm" COEFFS 0 1 0 0 0 1 /end COMPU_METHOD
/begin COMPU_METHOD MisfdTDC_CM_int32_adm "Q = V" RAT_FUNC "%10.0" "adm" COEFFS 0 1 0 0 0 1 /end COMPU_METHOD
/begin COMPU_METHOD MisfdTDC_CM_ufix16_En10_adm "Q = V*1024.000000" RAT_FUNC "%12.10" "adm" COEFFS 0 1024 0 0 0 1 /end COMPU_METHOD
/begin COMPU_METHOD MisfdTDC_CM_ufix32_Sp2_us "Q = V*5.000000" RAT_FUNC "%0.6" "us" COEFFS 0 5 0 0 0 1 /end COMPU_METHOD
/begin COMPU_METHOD MisfdTDC_CM_uint16_adm "Q = V" RAT_FUNC "%5.0" "adm" COEFFS 0 1 0 0 0 1 /end COMPU_METHOD
/begin COMPU_METHOD MisfdTDC_CM_uint16_rpm "Q = V" RAT_FUNC "%5.0" "rpm" COEFFS 0 1 0 0 0 1 /end COMPU_METHOD
/begin COMPU_METHOD MisfdTDC_CM_uint8_adm "Q = V" RAT_FUNC "%3.0" "adm" COEFFS 0 1 0 0 0 1 /end COMPU_METHOD
/begin COMPU_METHOD MisfireDetectionTDC_CM_boolean_adm "Q = V" RAT_FUNC "%1.0" "adm" COEFFS 0 1 0 0 0 1 /end COMPU_METHOD
/begin COMPU_METHOD MisfireDetectionTDC_CM_int16_adm "Q = V" RAT_FUNC "%5.0" "adm" COEFFS 0 1 0 0 0 1 /end COMPU_METHOD
/begin COMPU_METHOD MisfireDetectionTDC_CM_single_adm "Q = V" RAT_FUNC "%8.6" "adm" COEFFS 0 1 0 0 0 1 /end COMPU_METHOD
/begin COMPU_METHOD MisfireDetectionTDC_CM_single_us "Q = V" RAT_FUNC "%8.6" "us" COEFFS 0 1 0 0 0 1 /end COMPU_METHOD
/begin COMPU_METHOD MisfireDetectionTDC_CM_ufix16_Bn40_degC "Q = (V+40.000000)/1.000000" RAT_FUNC "%0.6" "degC" COEFFS 0 1 40 0 0 1 /end COMPU_METHOD
/begin COMPU_METHOD MisfireDetectionTDC_CM_ufix16_En10_adm "Q = V*1024.000000" RAT_FUNC "%12.10" "adm" COEFFS 0 1024 0 0 0 1 /end COMPU_METHOD
/begin COMPU_METHOD MisfireDetectionTDC_CM_ufix16_En3_degree "Q = V*8.000000" RAT_FUNC "%7.3" "degree" COEFFS 0 8 0 0 0 1 /end COMPU_METHOD
/begin COMPU_METHOD MisfireDetectionTDC_CM_ufix16_En3_mg_cc "Q = V*8.000000" RAT_FUNC "%7.3" "mg/cc" COEFFS 0 8 0 0 0 1 /end COMPU_METHOD
/begin COMPU_METHOD MisfireDetectionTDC_CM_ufix16_En9_adm "Q = V*512.000000" RAT_FUNC "%12.9" "adm" COEFFS 0 512 0 0 0 1 /end COMPU_METHOD
/begin COMPU_METHOD MisfireDetectionTDC_CM_uint16_adm "Q = V" RAT_FUNC "%5.0" "adm" COEFFS 0 1 0 0 0 1 /end COMPU_METHOD
/begin COMPU_METHOD MisfireDetectionTDC_CM_uint16_rpm "Q = V" RAT_FUNC "%5.0" "rpm" COEFFS 0 1 0 0 0 1 /end COMPU_METHOD
/begin COMPU_METHOD MisfireDetectionTDC_CM_uint8_adm "Q = V" RAT_FUNC "%3.0" "adm" COEFFS 0 1 0 0 0 1 /end COMPU_METHOD
/begin COMPU_METHOD Pwrl4ms_CM_boolean_adm "Q = V" RAT_FUNC "%1.0" "adm" COEFFS 0 1 0 0 0 1 /end COMPU_METHOD
/begin COMPU_METHOD RecoveryPWR4ms_Symbol_CM_ufix16_E2_ms "Q = V/4.000000" RAT_FUNC "%5.0" "ms" COEFFS 0 1 0 0 0 4 /end COMPU_METHOD
/begin COMPU_METHOD TE_MAirReqATDC_Symbol_CM_FixEnableT "Enumerated data type: FixEnableT" TAB_VERB "%0.6" "" COMPU_TAB_REF VTAB_FOR_TE_MAirReqATDC_Symbol_CM_FixEnableT /end COMPU_METHOD
/begin COMPU_METHOD TE_MAirReqATDC_Symbol_CM_ufix16_En4_degE "Q = V*16.000000" RAT_FUNC "%8.4" "degE" COEFFS 0 16 0 0 0 1 /end COMPU_METHOD
/begin COMPU_METHOD TE_MAirReqATDC_Symbol_CM_uint16_mbar "Q = V" RAT_FUNC "%5.0" "mbar" COEFFS 0 1 0 0 0 1 /end COMPU_METHOD
/begin COMPU_METHOD TE_MAirReqATDC_Symbol_CM_uint16_rpm "Q = V" RAT_FUNC "%5.0" "rpm" COEFFS 0 1 0 0 0 1 /end COMPU_METHOD
/begin COMPU_METHOD TF_TE_StarterMgm4ms_Symbol_CM_FixEnableT "Enumerated data type: FixEnableT" TAB_VERB "%0.6" "" COMPU_TAB_REF VTAB_FOR_TF_TE_StarterMgm4ms_Symbol_CM_FixEnableT /end COMPU_METHOD
/begin COMPU_METHOD TF_TE_StarterMgm4ms_Symbol_CM_boolean_adm "Q = V" RAT_FUNC "%1.0" "adm" COEFFS 0 1 0 0 0 1 /end COMPU_METHOD
/begin COMPU_METHOD TF_TE_StarterMgm4ms_Symbol_CM_ufix16_Bn40_degC "Q = (V+40.000000)/1.000000" RAT_FUNC "%0.6" "degC" COEFFS 0 1 40 0 0 1 /end COMPU_METHOD
/begin COMPU_METHOD TF_TE_StarterMgm4ms_Symbol_CM_ufix16_En4__ "Q = V*16.000000" RAT_FUNC "%8.4" "%" COEFFS 0 16 0 0 0 1 /end COMPU_METHOD
/begin COMPU_METHOD TF_TE_StarterMgm4ms_Symbol_CM_uint16_rpm "Q = V" RAT_FUNC "%5.0" "rpm" COEFFS 0 1 0 0 0 1 /end COMPU_METHOD
/begin COMPU_METHOD TF_TE_StarterMgm4ms_Symbol_CM_uint16_s "Q = V" RAT_FUNC "%5.0" "s" COEFFS 0 1 0 0 0 1 /end COMPU_METHOD
/begin COMPU_METHOD Test_KO2_TDC_Symbol_CM_boolean_adm "Q = V" RAT_FUNC "%1.0" "adm" COEFFS 0 1 0 0 0 1 /end COMPU_METHOD
/begin COMPU_METHOD Test_KO2_TDC_Symbol_CM_ufix16_En15_adm "Q = V*32768.000000" RAT_FUNC "%16.15" "adm" COEFFS 0 32768 0 0 0 1 /end COMPU_METHOD
/begin COMPU_METHOD Test_KO2_TDC_Symbol_CM_uint16_adm "Q = V" RAT_FUNC "%5.0" "adm" COEFFS 0 1 0 0 0 1 /end COMPU_METHOD
/begin COMPU_METHOD Test_KO2_TDC_Symbol_CM_uint16_mbar "Q = V" RAT_FUNC "%5.0" "mbar" COEFFS 0 1 0 0 0 1 /end COMPU_METHOD
/begin COMPU_METHOD Test_KO2_TDC_Symbol_CM_uint16_tdc "Q = V" RAT_FUNC "%5.0" "tdc" COEFFS 0 1 0 0 0 1 /end COMPU_METHOD
/begin COMPU_METHOD Test_KO2_TDC_Symbol_CM_uint32_mbar "Q = V" RAT_FUNC "%10.0" "mbar" COEFFS 0 1 0 0 0 1 /end COMPU_METHOD
/begin COMPU_METHOD Test_KO2_TDC_Symbol_CM_uint32_tdc "Q = V" RAT_FUNC "%10.0" "tdc" COEFFS 0 1 0 0 0 1 /end COMPU_METHOD
/begin COMPU_METHOD Test_KO2_TDC_Symbol_CM_uint8_adm "Q = V" RAT_FUNC "%3.0" "adm" COEFFS 0 1 0 0 0 1 /end COMPU_METHOD
/begin COMPU_METHOD Test_RipCarica_TDC_Symbol_CM_boolean_adm "Q = V" RAT_FUNC "%1.0" "adm" COEFFS 0 1 0 0 0 1 /end COMPU_METHOD
/begin COMPU_METHOD Test_RipCarica_TDC_Symbol_CM_ufix16_Bn40_degC "Q = (V+40.000000)/1.000000" RAT_FUNC "%0.6" "degC" COEFFS 0 1 40 0 0 1 /end COMPU_METHOD
/begin COMPU_METHOD Test_RipCarica_TDC_Symbol_CM_ufix16_S50_mV "Q = V/50.000000" RAT_FUNC "%0.6" "mV" COEFFS 0 1 0 0 0 50 /end COMPU_METHOD
/begin COMPU_METHOD Test_RipCarica_TDC_Symbol_CM_ufix16_Sp001_V "Q = V*1000.000000" RAT_FUNC "%0.6" "V" COEFFS 0 1000 0 0 0 1 /end COMPU_METHOD
/begin COMPU_METHOD Test_RipCarica_TDC_Symbol_CM_ufix32_Sp001_V "Q = V*1000.000000" RAT_FUNC "%0.6" "V" COEFFS 0 1000 0 0 0 1 /end COMPU_METHOD
/begin COMPU_METHOD Test_RipCarica_TDC_Symbol_CM_uint16_adm "Q = V" RAT_FUNC "%5.0" "adm" COEFFS 0 1 0 0 0 1 /end COMPU_METHOD
/begin COMPU_METHOD Test_RipCarica_TDC_Symbol_CM_uint16_mbar "Q = V" RAT_FUNC "%5.0" "mbar" COEFFS 0 1 0 0 0 1 /end COMPU_METHOD
/begin COMPU_METHOD Test_RipCarica_TDC_Symbol_CM_uint16_pms "Q = V" RAT_FUNC "%5.0" "pms" COEFFS 0 1 0 0 0 1 /end COMPU_METHOD
/begin COMPU_METHOD Test_RipCarica_TDC_Symbol_CM_uint16_rpm "Q = V" RAT_FUNC "%5.0" "rpm" COEFFS 0 1 0 0 0 1 /end COMPU_METHOD
/begin COMPU_METHOD Test_RipCarica_TDC_Symbol_CM_uint16_tdc "Q = V" RAT_FUNC "%5.0" "tdc" COEFFS 0 1 0 0 0 1 /end COMPU_METHOD
/begin COMPU_METHOD Test_RipCarica_TDC_Symbol_CM_uint8_adm "Q = V" RAT_FUNC "%3.0" "adm" COEFFS 0 1 0 0 0 1 /end COMPU_METHOD
/begin COMPU_METHOD Thrp_Mgmt50ms_CM_ufix16_En4_Kg_h "Q = V*16.000000" RAT_FUNC "%8.4" "Kg/h" COEFFS 0 16 0 0 0 1 /end COMPU_METHOD
/begin COMPU_METHOD Thrp_Mgmt50ms_CM_ufix16_En4_kg_h "Q = V*16.000000" RAT_FUNC "%8.4" "kg/h" COEFFS 0 16 0 0 0 1 /end COMPU_METHOD
/begin COMPU_METHOD Thrp_Mgmt50ms_CM_ufix16_S50_mV "Q = V/50.000000" RAT_FUNC "%0.6" "mV" COEFFS 0 1 0 0 0 50 /end COMPU_METHOD
/begin COMPU_METHOD Thrp_Mgmt50ms_CM_uint16_mbar "Q = V" RAT_FUNC "%5.0" "mbar" COEFFS 0 1 0 0 0 1 /end COMPU_METHOD
/begin COMPU_METHOD Thrp_Torque2CylCutOffTDC_CM_boolean_adm "Q = V" RAT_FUNC "%1.0" "adm" COEFFS 0 1 0 0 0 1 /end COMPU_METHOD
/begin COMPU_METHOD Tnkp4ms_CM_tKeyState_adm "Enumerated data type: tKeyState" TAB_VERB "%0.6" "adm" COMPU_TAB_REF VTAB_FOR_Tnkp4ms_CM_tKeyState_adm /end COMPU_METHOD
/begin COMPU_METHOD Trqm_CtrlMgmt1s_CM_ufix16_En10___rpm "Q = V*1024.000000" RAT_FUNC "%12.10" "%/rpm" COEFFS 0 1024 0 0 0 1 /end COMPU_METHOD
/begin COMPU_METHOD Trqm_CtrlMgmt1s_CM_ufix16_En10_s "Q = V*1024.000000" RAT_FUNC "%12.10" "s" COEFFS 0 1024 0 0 0 1 /end COMPU_METHOD
/begin COMPU_METHOD Trqm_CtrlMgmt1s_CM_ufix16_En4_N_m "Q = V*16.000000" RAT_FUNC "%8.4" "N*m" COEFFS 0 16 0 0 0 1 /end COMPU_METHOD
/begin COMPU_METHOD Trqm_CtrlMgmt4ms_CM_eEGMD_adm "Enumerated data type: eEGMD" TAB_VERB "%0.6" "adm" COMPU_TAB_REF VTAB_FOR_Trqm_CtrlMgmt4ms_CM_eEGMD_adm /end COMPU_METHOD
/begin COMPU_METHOD Trqm_CtrlMgmt4ms_CM_eEGST_adm "Enumerated data type: eEGST" TAB_VERB "%0.6" "adm" COMPU_TAB_REF VTAB_FOR_Trqm_CtrlMgmt4ms_CM_eEGST_adm /end COMPU_METHOD
/begin COMPU_METHOD Trqm_CtrlMgmt4ms_CM_int16_rpm_s "Q = V" RAT_FUNC "%5.0" "rpm/s" COEFFS 0 1 0 0 0 1 /end COMPU_METHOD
/begin COMPU_METHOD Trqm_CtrlMgmt4ms_CM_sfix16_En4_degree "Q = V*16.000000" RAT_FUNC "%8.4" "degree" COEFFS 0 16 0 0 0 1 /end COMPU_METHOD
/begin COMPU_METHOD Trqm_CtrlMgmt4ms_CM_ufix16_Bn40_degC "Q = (V+40.000000)/1.000000" RAT_FUNC "%0.6" "degC" COEFFS 0 1 40 0 0 1 /end COMPU_METHOD
/begin COMPU_METHOD Trqm_CtrlMgmt4ms_CM_ufix16_E4_us "Q = V/16.000000" RAT_FUNC "%5.0" "us" COEFFS 0 1 0 0 0 16 /end COMPU_METHOD
/begin COMPU_METHOD Trqm_CtrlMgmt4ms_CM_ufix16_En10_s "Q = V*1024.000000" RAT_FUNC "%12.10" "s" COEFFS 0 1024 0 0 0 1 /end COMPU_METHOD
/begin COMPU_METHOD Trqm_CtrlMgmt4ms_CM_ufix16_En3_mg_cc "Q = V*8.000000" RAT_FUNC "%7.3" "mg/cc" COEFFS 0 8 0 0 0 1 /end COMPU_METHOD
/begin COMPU_METHOD Trqm_CtrlMgmt4ms_CM_ufix16_En4_cc "Q = V*16.000000" RAT_FUNC "%8.4" "cc" COEFFS 0 16 0 0 0 1 /end COMPU_METHOD
/begin COMPU_METHOD Trqm_CtrlMgmt4ms_CM_ufix16_En6_ks "Q = V*64.000000" RAT_FUNC "%10.6" "ks" COEFFS 0 64 0 0 0 1 /end COMPU_METHOD
/begin COMPU_METHOD Trqm_CtrlMgmt4ms_CM_ufix8_Bn125_gear "Q = (V+125.000000)/1.000000" RAT_FUNC "%0.6" "gear" COEFFS 0 1 125 0 0 1 /end COMPU_METHOD
/begin COMPU_METHOD Trqm_CtrlMgmt4ms_CM_uint16_mbar "Q = V" RAT_FUNC "%5.0" "mbar" COEFFS 0 1 0 0 0 1 /end COMPU_METHOD
/begin COMPU_METHOD Trqm_CtrlMgmtTDC_CM_boolean_adm "Q = V" RAT_FUNC "%1.0" "adm" COEFFS 0 1 0 0 0 1 /end COMPU_METHOD
/begin COMPU_METHOD Trqm_CtrlMgmtTDC_CM_eEGMD_adm "Enumerated data type: eEGMD" TAB_VERB "%0.6" "adm" COMPU_TAB_REF VTAB_FOR_Trqm_CtrlMgmtTDC_CM_eEGMD_adm /end COMPU_METHOD
/begin COMPU_METHOD Trqm_CtrlMgmtTDC_CM_eEGST_adm "Enumerated data type: eEGST" TAB_VERB "%0.6" "adm" COMPU_TAB_REF VTAB_FOR_Trqm_CtrlMgmtTDC_CM_eEGST_adm /end COMPU_METHOD
/begin COMPU_METHOD Trqm_CtrlMgmtTDC_CM_sfix16_En4_degree "Q = V*16.000000" RAT_FUNC "%8.4" "degree" COEFFS 0 16 0 0 0 1 /end COMPU_METHOD
/begin COMPU_METHOD Trqm_CtrlMgmtTDC_CM_ufix16_E4_us "Q = V/16.000000" RAT_FUNC "%5.0" "us" COEFFS 0 1 0 0 0 16 /end COMPU_METHOD
/begin COMPU_METHOD Trqm_CtrlMgmtTDC_CM_ufix16_En3_mg_cc "Q = V*8.000000" RAT_FUNC "%7.3" "mg/cc" COEFFS 0 8 0 0 0 1 /end COMPU_METHOD
/begin COMPU_METHOD Trqm_CtrlMgmtTDC_CM_ufix16_En4_N_m "Q = V*16.000000" RAT_FUNC "%8.4" "N*m" COEFFS 0 16 0 0 0 1 /end COMPU_METHOD
/begin COMPU_METHOD Trqm_CtrlMgmtTDC_CM_ufix16_En4_kg_h "Q = V*16.000000" RAT_FUNC "%8.4" "kg/h" COEFFS 0 16 0 0 0 1 /end COMPU_METHOD
/begin COMPU_METHOD Trqm_CtrlMgmtTDC_CM_ufix8_S5__ "Q = V/5.000000" RAT_FUNC "%0.6" "%" COEFFS 0 1 0 0 0 5 /end COMPU_METHOD
/begin COMPU_METHOD Trqm_DeltaRpm100ms_CM_int16_rpm_s "Q = V" RAT_FUNC "%5.0" "rpm/s" COEFFS 0 1 0 0 0 1 /end COMPU_METHOD
/begin COMPU_METHOD Trqr_RpmLimitTDC_CM_boolean_adm "Q = V" RAT_FUNC "%1.0" "adm" COEFFS 0 1 0 0 0 1 /end COMPU_METHOD
/begin COMPU_METHOD Trqr_RpmLimitTDC_CM_ufix16_En10_adm "Q = V*1024.000000" RAT_FUNC "%12.10" "adm" COEFFS 0 1024 0 0 0 1 /end COMPU_METHOD
/begin COMPU_METHOD Trqr_RpmLimitTDC_CM_uint16_rpm "Q = V" RAT_FUNC "%5.0" "rpm" COEFFS 0 1 0 0 0 1 /end COMPU_METHOD
/begin COMPU_METHOD VarMgmDLAM100ms_Symbol_CM_int16__ "Q = V" RAT_FUNC "%5.0" "%" COEFFS 0 1 0 0 0 1 /end COMPU_METHOD
/begin COMPU_METHOD VarMgmDLAM100ms_Symbol_CM_ufix16_Sp01_hz "Q = V*100.000000" RAT_FUNC "%0.6" "hz" COEFFS 0 100 0 0 0 1 /end COMPU_METHOD
/begin COMPU_METHOD VarMgmDLAM100ms_Symbol_CM_uint16_adm "Q = V" RAT_FUNC "%5.0" "adm" COEFFS 0 1 0 0 0 1 /end COMPU_METHOD
/begin COMPU_METHOD VarMgmDLAM100ms_Symbol_CM_uint16_mV "Q = V" RAT_FUNC "%5.0" "mV" COEFFS 0 1 0 0 0 1 /end COMPU_METHOD
/begin COMPU_METHOD VarMgmDLAM100ms_Symbol_CM_uint32_adm "Q = V" RAT_FUNC "%10.0" "adm" COEFFS 0 1 0 0 0 1 /end COMPU_METHOD
/begin COMPU_METHOD VarMgmDLAM100ms_Symbol_CM_uint8_adm "Q = V" RAT_FUNC "%3.0" "adm" COEFFS 0 1 0 0 0 1 /end COMPU_METHOD
/begin COMPU_METHOD Vbpw4ms_CM_eEGMD_adm "Enumerated data type: eEGMD" TAB_VERB "%0.6" "adm" COMPU_TAB_REF VTAB_FOR_Vbpw4ms_CM_eEGMD_adm /end COMPU_METHOD
/begin COMPU_METHOD Vbpw4ms_CM_eEGST_adm "Enumerated data type: eEGST" TAB_VERB "%0.6" "adm" COMPU_TAB_REF VTAB_FOR_Vbpw4ms_CM_eEGST_adm /end COMPU_METHOD
/begin COMPU_METHOD Vbpw4ms_CM_tKeyState_adm "Enumerated data type: tKeyState" TAB_VERB "%0.6" "adm" COMPU_TAB_REF VTAB_FOR_Vbpw4ms_CM_tKeyState_adm /end COMPU_METHOD
/begin COMPU_VTAB VTAB_FOR_Airt100ms_CM_eEGST_adm "Enumerated data type: eEGST" TAB_VERB 7 0 "POWER_ON" 1 "WAIT" 2 "RUN" 3 "POWER_LATCH" 4 "POWER_OFF" 5 "SHUTDOWN" 6 "ACTDIAG_WAIT" /end COMPU_VTAB
/begin COMPU_VTAB VTAB_FOR_BoostControl50ms_Symbol_CM_FixEnableT "Enumerated data type: FixEnableT" TAB_VERB 2 171 "Enable" 218 "Disable" /end COMPU_VTAB
/begin COMPU_VTAB VTAB_FOR_Egst4ms_CM_eActDiagPh_adm "Enumerated data type: eActDiagPh" TAB_VERB 3 0 "ACTDIAG_ENTRY" 1 "ACTDIAG_RUN" 2 "ACTDIAG_END" /end COMPU_VTAB
/begin COMPU_VTAB VTAB_FOR_EngineState4ms_CM_FixEnableT "Enumerated data type: FixEnableT" TAB_VERB 2 171 "Enable" 218 "Disable" /end COMPU_VTAB
/begin COMPU_VTAB VTAB_FOR_InjTDC_CM_FixEnableT "Enumerated data type: FixEnableT" TAB_VERB 2 171 "Enable" 218 "Disable" /end COMPU_VTAB
/begin COMPU_VTAB VTAB_FOR_InjectorParms4ms_CM_FixEnableT "Enumerated data type: FixEnableT" TAB_VERB 2 171 "Enable" 218 "Disable" /end COMPU_VTAB
/begin COMPU_VTAB VTAB_FOR_InjectorParms4ms_CM_tColdInjState_adm "Enumerated data type: tColdInjState" TAB_VERB 6 0 "DESTICKING_INIT" 1 "DESTICKING_START" 2 "DESTICKING_RUNNING" 3 "DESTICKING_END" 4 "DESTICKING_ABORT" 5 "DESTICKING_CMD" /end COMPU_VTAB
/begin COMPU_VTAB VTAB_FOR_InjectorTDC_Symbol_CM_FixEnableT "Enumerated data type: FixEnableT" TAB_VERB 2 171 "Enable" 218 "Disable" /end COMPU_VTAB
/begin COMPU_VTAB VTAB_FOR_TE_MAirReqATDC_Symbol_CM_FixEnableT "Enumerated data type: FixEnableT" TAB_VERB 2 171 "Enable" 218 "Disable" /end COMPU_VTAB
/begin COMPU_VTAB VTAB_FOR_TF_TE_StarterMgm4ms_Symbol_CM_FixEnableT "Enumerated data type: FixEnableT" TAB_VERB 2 171 "Enable" 218 "Disable" /end COMPU_VTAB
/begin COMPU_VTAB VTAB_FOR_Tnkp4ms_CM_tKeyState_adm "Enumerated data type: tKeyState" TAB_VERB 2 0 "KEY_OFF" 1 "KEY_ON" /end COMPU_VTAB
/begin COMPU_VTAB VTAB_FOR_Trqm_CtrlMgmt4ms_CM_eEGMD_adm "Enumerated data type: eEGMD" TAB_VERB 5 0 "NOT_DETERM" 1 "CRANK" 2 "IDLE" 3 "NORMAL" 4 "CUT_OFF" /end COMPU_VTAB
/begin COMPU_VTAB VTAB_FOR_Trqm_CtrlMgmt4ms_CM_eEGST_adm "Enumerated data type: eEGST" TAB_VERB 8 0 "POWER_ON" 1 "WAIT" 2 "RUN" 3 "POWER_LATCH" 4 "POWER_OFF" 5 "SHUTDOWN" 6 "ACTDIAG_WAIT" 7 "SAFETY_CHECK" /end COMPU_VTAB
/begin COMPU_VTAB VTAB_FOR_Trqm_CtrlMgmtTDC_CM_eEGMD_adm "Enumerated data type: eEGMD" TAB_VERB 5 0 "NOT_DETERM" 1 "CRANK" 2 "IDLE" 3 "NORMAL" 4 "CUT_OFF" /end COMPU_VTAB
/begin COMPU_VTAB VTAB_FOR_Trqm_CtrlMgmtTDC_CM_eEGST_adm "Enumerated data type: eEGST" TAB_VERB 7 0 "POWER_ON" 1 "WAIT" 2 "RUN" 3 "POWER_LATCH" 4 "POWER_OFF" 5 "SHUTDOWN" 6 "ACTDIAG_WAIT" /end COMPU_VTAB
/begin COMPU_VTAB VTAB_FOR_Vbpw4ms_CM_eEGMD_adm "Enumerated data type: eEGMD" TAB_VERB 5 0 "NOT_DETERM" 1 "CRANK" 2 "IDLE" 3 "NORMAL" 4 "CUT_OFF" /end COMPU_VTAB
/begin COMPU_VTAB VTAB_FOR_Vbpw4ms_CM_eEGST_adm "Enumerated data type: eEGST" TAB_VERB 7 0 "POWER_ON" 1 "WAIT" 2 "RUN" 3 "POWER_LATCH" 4 "POWER_OFF" 5 "SHUTDOWN" 6 "ACTDIAG_WAIT" /end COMPU_VTAB
/begin COMPU_VTAB VTAB_FOR_Vbpw4ms_CM_tKeyState_adm "Enumerated data type: tKeyState" TAB_VERB 2 0 "KEY_OFF" 1 "KEY_ON" /end COMPU_VTAB
/begin RECORD_LAYOUT Lookup1D_UWORD FNC_VALUES 1 UWORD COLUMN_DIR DIRECT /end RECORD_LAYOUT
/begin RECORD_LAYOUT Lookup1D_X_UWORD AXIS_PTS_X 1 UWORD INDEX_INCR DIRECT /end RECORD_LAYOUT
/begin RECORD_LAYOUT Lookup2DSF_UWORD FNC_VALUES 1 UWORD ROW_DIR DIRECT /end RECORD_LAYOUT
/begin RECORD_LAYOUT Lookup2DSF_WORD FNC_VALUES 1 SWORD ROW_DIR DIRECT /end RECORD_LAYOUT
/begin RECORD_LAYOUT Lookup2D_UBYTE FNC_VALUES 1 UBYTE COLUMN_DIR DIRECT /end RECORD_LAYOUT
/begin RECORD_LAYOUT Lookup2D_UWORD FNC_VALUES 1 UWORD COLUMN_DIR DIRECT /end RECORD_LAYOUT
/begin RECORD_LAYOUT Lookup2D_WORD FNC_VALUES 1 SWORD COLUMN_DIR DIRECT /end RECORD_LAYOUT
/begin RECORD_LAYOUT Lookup2D_X_UWORD AXIS_PTS_X 1 UWORD INDEX_INCR DIRECT /end RECORD_LAYOUT
/begin RECORD_LAYOUT Scalar_BOOLEAN FNC_VALUES 1 UBYTE COLUMN_DIR DIRECT /end RECORD_LAYOUT
/begin RECORD_LAYOUT Scalar_FLOAT32_IEEE FNC_VALUES 1 FLOAT32_IEEE COLUMN_DIR DIRECT /end RECORD_LAYOUT
/begin RECORD_LAYOUT Scalar_LONG FNC_VALUES 1 SLONG COLUMN_DIR DIRECT /end RECORD_LAYOUT
/begin RECORD_LAYOUT Scalar_SWORD FNC_VALUES 1 SWORD COLUMN_DIR DIRECT /end RECORD_LAYOUT
/begin RECORD_LAYOUT Scalar_UBYTE FNC_VALUES 1 UBYTE COLUMN_DIR DIRECT /end RECORD_LAYOUT
/begin RECORD_LAYOUT Scalar_ULONG FNC_VALUES 1 ULONG COLUMN_DIR DIRECT /end RECORD_LAYOUT
/begin RECORD_LAYOUT Scalar_UWORD FNC_VALUES 1 UWORD COLUMN_DIR DIRECT /end RECORD_LAYOUT
/end MODULE
/end PROJECT
