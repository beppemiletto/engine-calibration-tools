ASAP2_VERSION 1 70
/begin PROJECT XCPonCANFD "Generated for ETAS and Vector "
/begin MODULE XCPonCANFD "Generated for ETAS and Vector "
/begin MOD_COMMON "XCPonCANFD" BYTE_ORDER MSB_FIRST ALIGNMENT_BYTE 1 ALIGNMENT_WORD 2 ALIGNMENT_LONG 4 ALIGNMENT_FLOAT32_IEEE 4 ALIGNMENT_FLOAT64_IEEE 8 ALIGNMENT_INT64 8 /end MOD_COMMON
/begin AXIS_PTS dkKNOCK_ETASP "[YBK] Selection Knock SRI threshold (etasp breakpoint)" 0xFC9B4E NO_INPUT_QUANTITY Lookup2D_X_UWORD 0 FaultChkKSPxTDC_CM_ufix16_En10_adm 16 0 3 /end AXIS_PTS
/begin AXIS_PTS dkKNOCK_RPM "[XBK] Selection Knock SRI threshold (rpm breakpoint)" 0xFC9B2E NO_INPUT_QUANTITY Lookup2D_X_UWORD 0 FaultChkKSPxTDC_CM_uint16_rpm 16 0 10000 /end AXIS_PTS
/begin AXIS_PTS dkLIM_PERF_DRPM "[XBK] Limitazione ETC per Derate Mode per guasto su Iniettore o su Bobina" 0xFCB5BC NO_INPUT_QUANTITY Lookup1D_X_UWORD 0 TE_TM_RecoveryAIR_50ms_Symbol_CM_uint16_rpm 8 0 10000 /end AXIS_PTS
/begin AXIS_PTS dkRPM_BKP "[YBK] Tabella con valori di POil di warning per funzionamento motore" 0xFCAB3A NO_INPUT_QUANTITY Lookup2D_X_UWORD 0 FaultChkPO2L100ms_Symbol_CM_uint16_rpm 8 0 10000 /end AXIS_PTS
/begin AXIS_PTS dkTOIL_BKP "[XBK] Tabella con valori di POil di warning per funzionamento motore" 0xFCAB2A NO_INPUT_QUANTITY Lookup2D_X_UWORD 0 FaultChkPO2L100ms_Symbol_CM_ufix16_Bn40_degC 8 -40 130 /end AXIS_PTS
/begin AXIS_PTS dkT_TR2_TA "[XBK] Secondo Transitorio veloce di recovery temp. aria in uscita da warm up (raccordo del primo a dsSTA_TFIX)" 0xFC1E8E NO_INPUT_QUANTITY Lookup1D_X_UWORD 0 RecoverySTA100ms_Symbol_CM_ufix16_En8_s 14 0 60 /end AXIS_PTS
/begin AXIS_PTS dkT_WUP_TR1_TA "[XBK] Primo Transitorio lento di recovery temp. aria in warm up" 0xFC1E72 NO_INPUT_QUANTITY Lookup1D_X_UWORD 0 RecoverySTA100ms_Symbol_CM_ufix16_En8_s 14 0 60 /end AXIS_PTS
/begin AXIS_PTS dkVOLT_POTENZ "[XBK] Voltage fitting of second accelertor potentiomenter" 0xFCAC34 NO_INPUT_QUANTITY Lookup1D_X_UWORD 0 TE_FaultChkSPP02_4ms_CM_ufix16_En10_rpm 8 0 5 /end AXIS_PTS
/begin MEASUREMENT dsPONPRVStatSF "CNG pressure reducing valve state at power-on in uscita FSM" UBYTE DiagPRVPON4ms_Symbol_CM_uint8_adm 0 0 0 255 ECU_ADDRESS 0x40003FF0 /end MEASUREMENT
/begin MEASUREMENT dsPONPWRContStat "Power relay contact state after power-on diagnosis" UBYTE Egst4ms_CM_tFault_adm 0 0 0 88 ECU_ADDRESS 0x40004006 /end MEASUREMENT
/begin MEASUREMENT dsPONPWRDiagStat "State of power relay power-on diagnosis" UBYTE Egst4ms_CM_tDiagStat_adm 0 0 0 39 ECU_ADDRESS 0x4000400A /end MEASUREMENT
/begin MEASUREMENT dsPONPWRel "Power relay command after power-on diagnosis" UBYTE Pwrl4ms_CM_boolean_adm 0 0 0 1 ECU_ADDRESS 0x40004019 /end MEASUREMENT
/begin MEASUREMENT dsPONSTRContStat "Starter relay contact state at power-on. The state is deduced only from the diag made on the ECU cmd" UBYTE Crkc4ms_CM_tFault_adm 0 0 0 88 ECU_ADDRESS 0x4000238B /end MEASUREMENT
/begin MEASUREMENT dsPONSTRDiagStat "State of starter relay power-on diagnosis" UBYTE Crkc4ms_CM_tDiagStat_adm 0 0 0 39 ECU_ADDRESS 0x4000238A /end MEASUREMENT
/begin MEASUREMENT dsPONSTRDiagStatSF "State of starter relay power-on diagnosis in uscita FSM" UBYTE TF_TE_DiagSTR_PON4ms_CM_tDiagStat_adm 0 0 0 39 ECU_ADDRESS 0x4000239C /end MEASUREMENT
/begin MEASUREMENT dsPONSTRel "Starter relay command after power-on diagnosis" UBYTE Crkc4ms_CM_boolean_adm 0 0 0 1 ECU_ADDRESS 0x40002393 /end MEASUREMENT
/begin MEASUREMENT dsPOilPostD "Oil pressure sensor post diagnosis value" UWORD RecoverySPO100ms_Symbol_CM_ufix16_En10_V 0 0 0 5 ECU_ADDRESS 0x40003F24 /end MEASUREMENT
/begin MEASUREMENT dsPOilRec "Valore di recovery GSEC del sensore pressione olio" UWORD Oilp100ms_CM_uint16_mbar 0 0 250 6000 ECU_ADDRESS 0x40003F00 /end MEASUREMENT
/begin MEASUREMENT dsPOilV "Pressione Olio in volt elaborata dal blocco di recovery" UWORD Oilp100ms_CM_ufix16_En10_V 0 0 0 5 ECU_ADDRESS 0x40003EFC /end MEASUREMENT
/begin MEASUREMENT dsPOilVPreR "Pressione Olio in volt elaborata dal blocco di recovery" UWORD Oilp100ms_CM_ufix16_En10_V 0 0 0 5 ECU_ADDRESS 0x40003EFE /end MEASUREMENT
/begin MEASUREMENT dsPRVADiagStat "CNG electrovalves relay active diagnosis state (UNKNOWN = 39, STOPPED = 0 DURING =1 END = 2 IMPOSSIBLE = 3)" UBYTE Prvc4ms_CM_tActDiagStat_adm 0 0 0 39 ECU_ADDRESS 0x4000109D /end MEASUREMENT
/begin CHARACTERISTIC dsPRVCGND_AUTOD "Pressure reducing valve command shortcut to ground- diagnostic line enable flag" VALUE 0xFCAF34 Scalar_BOOLEAN 0 FaultChkELTPRV4ms_CM_boolean_adm 0 1 /end CHARACTERISTIC
/begin MEASUREMENT dsPRVCGND_AdiaEn "Error validation state machine enable" UBYTE Prvc4ms_CM_boolean_adm 0 0 0 1 ECU_ADDRESS 0x40003FE7 /end MEASUREMENT
/begin MEASUREMENT dsPRVCGND_AutoD "Pressure reducing valve shortcut to ground- diagnostic line enable flag" UBYTE Prvc4ms_CM_boolean_adm 0 0 0 1 ECU_ADDRESS 0x40003FE8 /end MEASUREMENT
/begin MEASUREMENT dsPRVCGND_CodErr "Error code of diagnostic line detecting CNG pressure reducing valve command shortcut to ground" UBYTE Prvc4ms_CM_tFault_adm 0 0 0 88 ECU_ADDRESS 0x40003FDE /end MEASUREMENT
/begin CHARACTERISTIC dsPRVCOL_AUTOD "Open load on pressure reducing valve command - diagnostic line enable flag" VALUE 0xFCAF33 Scalar_BOOLEAN 0 FaultChkELTPRV4ms_CM_boolean_adm 0 1 /end CHARACTERISTIC
/begin MEASUREMENT dsPRVCOL_AdiaEn "Error validation state machine enable" UBYTE Prvc4ms_CM_boolean_adm 0 0 0 1 ECU_ADDRESS 0x40003FE9 /end MEASUREMENT
/begin MEASUREMENT dsPRVCOL_AutoD "Open load on Pressure reducing valve - diagnostic line enable flag" UBYTE Prvc4ms_CM_boolean_adm 0 0 0 1 ECU_ADDRESS 0x40003FEA /end MEASUREMENT
/begin MEASUREMENT dsPRVCOL_CodErr "Error code of diagnostic line detecting open load on CNG pressure reducing valve command" UBYTE Prvc4ms_CM_tFault_adm 0 0 0 88 ECU_ADDRESS 0x40003FDF /end MEASUREMENT
/begin CHARACTERISTIC dsPRVCVB_AUTOD "Pressure reducing valve shortcut to battery - diagnostic line enable flag" VALUE 0xFCAF32 Scalar_BOOLEAN 0 FaultChkELTPRV4ms_CM_boolean_adm 0 1 /end CHARACTERISTIC
/begin MEASUREMENT dsPRVCVB_AdiaEn "Error validation state machine enable" UBYTE Prvc4ms_CM_boolean_adm 0 0 0 1 ECU_ADDRESS 0x40003FE5 /end MEASUREMENT
/begin MEASUREMENT dsPRVCVB_AutoD "Pressure reducing valve shortcut to battery - diagnostic line enable flag" UBYTE Prvc4ms_CM_boolean_adm 0 0 0 1 ECU_ADDRESS 0x40003FE6 /end MEASUREMENT
/begin MEASUREMENT dsPRVCVB_CodErr "Error code of diagnostic line detecting CNG pressure reducing valve command shortcut to battery" UBYTE Prvc4ms_CM_tFault_adm 0 0 0 88 ECU_ADDRESS 0x40003FDD /end MEASUREMENT
/begin MEASUREMENT dsPRVCmd "CNG pressure reducing valve command after the recovery" UBYTE Prvc4ms_CM_boolean_adm 0 0 0 1 ECU_ADDRESS 0x40003FE1 /end MEASUREMENT
/begin MEASUREMENT dsPRVLSADiagStat "Pressure reducing valve active diagnosis: CNG leakage Standard Proc. state (UNKNOWN = 39 STOPPED = 0 DURING =1 END = 2 IMPOSSIBLE = 3)" UBYTE Prvc4ms_CM_tActDiagStat_adm 0 0 0 39 ECU_ADDRESS 0x4000109C /end MEASUREMENT
/begin CHARACTERISTIC dsPRVPON_AUTOD "Pressure reducing valve diagnosis at power on enable flag" VALUE 0xFCAF36 Scalar_BOOLEAN 0 DiagPRVPON4ms_Symbol_CM_boolean_adm 0 1 /end CHARACTERISTIC
/begin MEASUREMENT dsPRVPON_AutoD "Pressure reducing valve power on diagnosis enable (1= enabled)" UBYTE Prvc4ms_CM_boolean_adm 0 0 0 1 ECU_ADDRESS 0x40003FE3 /end MEASUREMENT
/begin MEASUREMENT dsPRVStartPostR "Test Point of dsSTRStartPostR flag" UBYTE RecoveryPRV4ms_Symbol_CM_boolean_adm 0 0 0 1 ECU_ADDRESS 0x40003FFA /end MEASUREMENT
/begin CHARACTERISTIC dsPRV_TIMEOFF "Steps for diagnosis at power on with pressure reducing valve not driven by ECU" VALUE 0xFCAF38 Scalar_UWORD 0 DiagPRVPON4ms_Symbol_CM_ufix16_E2_ms 0 10000 /end CHARACTERISTIC
/begin CHARACTERISTIC dsPRV_TIMEON "Steps for diagnosis at power on with pressure reducing valve driven by ECU" VALUE 0xFCAF3A Scalar_UWORD 0 DiagPRVPON4ms_Symbol_CM_ufix16_E2_ms 0 10000 /end CHARACTERISTIC
/begin MEASUREMENT dsPRailRec "Valore di recovery GSEC della pressione metano nel rail" UWORD Rpre4ms_CM_uint16_mbar 0 0 0 13793 ECU_ADDRESS 0x4000405A /end MEASUREMENT
/begin MEASUREMENT dsPRailV "Pressione metano nel rail in volt elaborata dal blocco di recovery" UWORD Rpre4ms_CM_ufix16_En10_V 0 0 0 5 ECU_ADDRESS 0x40004052 /end MEASUREMENT
/begin MEASUREMENT dsPRailVPreR "Rail pressure value in Volt used by the recovery block" UWORD Rpre4ms_CM_ufix16_En10_V 0 0 0 5 ECU_ADDRESS 0x40004054 /end MEASUREMENT
/begin MEASUREMENT dsPTankRec "Valore di recovery GSEC della pressione metano nelle bombole" UWORD Tnkp4ms_CM_ufix16_E2_mbar 0 0 0 250000 ECU_ADDRESS 0x4000420C /end MEASUREMENT
/begin MEASUREMENT dsPTankV "Pressione metano nelle bombole in volt elaborata dal blocco di recovery" UWORD Tnkp4ms_CM_ufix16_En10_V 0 0 0 5 ECU_ADDRESS 0x4000420E /end MEASUREMENT
/begin MEASUREMENT dsPTankVPreR "Pressione metano nelle bombole in volt elaborata dal blocco di recovery" UWORD Tnkp4ms_CM_ufix16_En10_V 0 0 0 5 ECU_ADDRESS 0x40004210 /end MEASUREMENT
/begin CHARACTERISTIC dsPWRCC_AUTOD "Power relay diagnostic line enable flag" VALUE 0xFCAF4A Scalar_BOOLEAN 0 FaultChkPWRCC4ms_Symbol_CM_boolean_adm 0 1 /end CHARACTERISTIC
/begin MEASUREMENT dsPWRCC_AdiaEn "Error validation state machine enable" UBYTE Pwrl4ms_CM_boolean_adm 0 0 0 1 ECU_ADDRESS 0x40004018 /end MEASUREMENT
/begin MEASUREMENT dsPWRCC_CodErr "Error code of power relay stuck closed contact diagnostic line" UBYTE Pwrl4ms_CM_tFault_adm 0 0 0 89 ECU_ADDRESS 0x40004005 /end MEASUREMENT
/begin CHARACTERISTIC dsPWRCC_THRLOW "Minimun delta voltage on power relay contact" VALUE 0xFCAF4C Scalar_UWORD 0 FaultChkPWRCC4ms_Symbol_CM_ufix16_S50_mV 0 36000 /end CHARACTERISTIC
/begin CHARACTERISTIC dsPWRCGND_AUTOD "Power relay command shortcut to ground - diagnostic line enable flag" VALUE 0xFCAF42 Scalar_BOOLEAN 0 FaultChkELTPWR4ms_CM_boolean_adm 0 1 /end CHARACTERISTIC
/begin MEASUREMENT dsPWRCGND_AdiaEn "Error validation state machine enable" UBYTE Pwrl4ms_CM_boolean_adm 0 0 0 1 ECU_ADDRESS 0x4000401F /end MEASUREMENT
/begin MEASUREMENT dsPWRCGND_CodErr "Error code of power relay command shortcut to ground diagnostic line" UBYTE Pwrl4ms_CM_tFault_adm 0 0 0 89 ECU_ADDRESS 0x40004009 /end MEASUREMENT
/begin CHARACTERISTIC dsPWRCOL_AUTOD "Open load on power relay command - diagnostic line enable flag" VALUE 0xFCAF41 Scalar_BOOLEAN 0 FaultChkELTPWR4ms_CM_boolean_adm 0 1 /end CHARACTERISTIC
/begin MEASUREMENT dsPWRCOL_AdiaEn "Error validation state machine enable" UBYTE Pwrl4ms_CM_boolean_adm 0 0 0 1 ECU_ADDRESS 0x4000401C /end MEASUREMENT
/begin MEASUREMENT dsPWRCOL_CodErr "Error code of open load on power relay command diagnostic line" UBYTE Pwrl4ms_CM_tFault_adm 0 0 0 89 ECU_ADDRESS 0x40004007 /end MEASUREMENT
/begin CHARACTERISTIC dsPWRCVB_AUTOD "Power relay command shortcut to battery - diagnostic line enable flag" VALUE 0xFCAF40 Scalar_BOOLEAN 0 FaultChkELTPWR4ms_CM_boolean_adm 0 1 /end CHARACTERISTIC
/begin MEASUREMENT dsPWRCVB_AdiaEn "Error validation state machine enable" UBYTE Pwrl4ms_CM_boolean_adm 0 0 0 1 ECU_ADDRESS 0x4000401D /end MEASUREMENT
/begin MEASUREMENT dsPWRCVB_AutoD "Power relay command shortcut to Vbat diagnosis enable (1= enabled)" UBYTE Pwrl4ms_CM_boolean_adm 0 0 0 1 ECU_ADDRESS 0x4000401E /end MEASUREMENT
/begin MEASUREMENT dsPWRCVB_CodErr "Error code of power relay command shortcut to battery diagnostic line" UBYTE Pwrl4ms_CM_tFault_adm 0 0 0 89 ECU_ADDRESS 0x40004008 /end MEASUREMENT
/begin MEASUREMENT dsPWRCloseTime "Power relay closing time" UWORD Pwrl4ms_CM_ufix16_E2_ms 0 0 0 10000 ECU_ADDRESS 0x40004020 /end MEASUREMENT
/begin MEASUREMENT dsPWRClosedFlag "Flag: power relay closed,load and diagnosis enabled" UBYTE Pwrl4ms_CM_boolean_adm 0 0 0 1 ECU_ADDRESS 0x4000400C /end MEASUREMENT
/begin CHARACTERISTIC dsPWROC_AUTOD "Power relay diagnostic line enable flag" VALUE 0xFCAF4E Scalar_BOOLEAN 0 FaultChkPWROC4ms_Symbol_CM_boolean_adm 0 1 /end CHARACTERISTIC
/begin MEASUREMENT dsPWROC_AdiaEn "Error validation state machine enable" UBYTE Pwrl4ms_CM_boolean_adm 0 0 0 1 ECU_ADDRESS 0x40004016 /end MEASUREMENT
/begin MEASUREMENT dsPWROC_AutoD "Power relay stuck open diagnosis enable (1= enabled)" UBYTE Pwrl4ms_CM_boolean_adm 0 0 0 1 ECU_ADDRESS 0x40004017 /end MEASUREMENT
/begin MEASUREMENT dsPWROC_CodErr "Error code of power relay stuck open contact diagnostic line" UBYTE Pwrl4ms_CM_tFault_adm 0 0 0 89 ECU_ADDRESS 0x40004004 /end MEASUREMENT
/begin CHARACTERISTIC dsPWROC_THRHIGH "Maximum delta voltage on power relay contact" VALUE 0xFCAF50 Scalar_UWORD 0 FaultChkPWROC4ms_Symbol_CM_ufix16_S50_mV 0 36000 /end CHARACTERISTIC
/begin CHARACTERISTIC dsPWRPON_AUTOD "Power relay diagnosis at power on enable flag" VALUE 0xFCAF44 Scalar_BOOLEAN 0 DiagPWRPON4ms_Symbol_CM_boolean_adm 0 1 /end CHARACTERISTIC
/begin CHARACTERISTIC dsPWR_TIMEOFF "Time elapsed for diagnosis at power on with power relay not driven by ECU" VALUE 0xFCAF46 Scalar_UWORD 0 DiagPWRPON4ms_Symbol_CM_ufix16_E2_ms 0 10000 /end CHARACTERISTIC
/begin CHARACTERISTIC dsPWR_TIMEON "Time elapsed for diagnosis at power on with power relay driven by ECU" VALUE 0xFCAF48 Scalar_UWORD 0 DiagPWRPON4ms_Symbol_CM_ufix16_E2_ms 0 10000 /end CHARACTERISTIC
/begin MEASUREMENT dsPWRel "Power relay command after the recovery" UBYTE Pwrl4ms_CM_boolean_adm 0 0 0 1 ECU_ADDRESS 0x4000400B /end MEASUREMENT
/begin MEASUREMENT dsPercCylOff "ercentuale di Torque Reduction da decurtare sulla coppia calcolata:  coppia_eff = coppia_calc * (1 - dsPercCylOff/100)" UBYTE Thrp_Mgmt50ms_CM_ufix8_S5__ 0 0 0 100 ECU_ADDRESS 0x400041A8 /end MEASUREMENT
/begin MEASUREMENT dsPotAcc2VPreR "Segnale potenziometro secondario acceleratore in volt elaborato dal blocco di recovery" UWORD Pacc4ms_CM_ufix16_En10_V 0 0 0 5 ECU_ADDRESS 0x40003F74 /end MEASUREMENT
/begin MEASUREMENT dsPotAccPostD "Valore in Volt del potenziometro acceleratore a valle della recovery" UWORD Pacc4ms_CM_ufix16_En10_V 0 0 0 5 ECU_ADDRESS 0x40003F72 /end MEASUREMENT
/begin MEASUREMENT dsPotAccVPreR "Segnale potenziometro principale acceleratore in volt elaborato dal blocco di recovery" UWORD Pacc4ms_CM_ufix16_En10_V 0 0 0 5 ECU_ADDRESS 0x40003F76 /end MEASUREMENT
/begin MEASUREMENT dsPotActive "Modalità di funzionamento per l raccordo lineare" UBYTE Pacc4ms_CM_uint8_adm 0 0 1 5 ECU_ADDRESS 0x40003F65 /end MEASUREMENT
/begin MEASUREMENT dsPotThr1V "Testpoint potenziometro principale sulla farfalla motorizzata in Volt dopo la diagnosi" UWORD TE_TM_RecoveryFAR4ms_Symbol_CM_ufix16_En10_V 0 0 0 5 ECU_ADDRESS 0x40004192 /end MEASUREMENT
/begin MEASUREMENT dsPotThr2V "Testpoint potenziometro secondario sulla farfalla motorizzata in Volt dopo la diagnosi" UWORD TE_TM_RecoveryFAR4ms_Symbol_CM_ufix16_En10_V 0 0 0 5 ECU_ADDRESS 0x40004190 /end MEASUREMENT
/begin MEASUREMENT dsPotThrCoheV "Testpoint potenziometro farfalla motorizzata in Volt dopo la diagnosi di coerenza" UWORD TE_TM_RecoveryFAR4ms_Symbol_CM_ufix16_En10_V 0 0 0 5 ECU_ADDRESS 0x4000418E /end MEASUREMENT
/begin MEASUREMENT dsPotenzThrStaz "Valore del riferimento obiettivo farfalla alla fine del transitorio" SWORD TE_TM_FaultChkTHRST4ms_Symbol_CM_sfix16_En8__ 0 0 -10 110 ECU_ADDRESS 0x40002C8C /end MEASUREMENT
/begin MEASUREMENT dsPotenzThrV "Potenziometro farfalla motorizzata in Volt" UWORD Ethrl4ms_CM_ufix16_En10_V 0 0 0 5 ECU_ADDRESS 0x40004104 /end MEASUREMENT
/begin MEASUREMENT dsPwrlCGNDDevalidCC "Flag di abilitazione set ForceDevalid, linea PWRCC, modulo Pwrl" UBYTE FaultChkELTPWR4ms_CM_boolean_adm 0 0 0 1 ECU_ADDRESS 0x40004038 /end MEASUREMENT
/begin MEASUREMENT dsPwrlCVBDevalidOC "Flag di abilitazione set ForceDevalid, linea PWRCC, modulo Pwrl" UBYTE FaultChkELTPWR4ms_CM_boolean_adm 0 0 0 1 ECU_ADDRESS 0x40004037 /end MEASUREMENT
/begin MEASUREMENT dsPwrlOLDevalidOC "Flag di abilitazione set ForceDevalid, linea PWROC, modulo Pwrl" UBYTE FaultChkELTPWR4ms_CM_boolean_adm 0 0 0 1 ECU_ADDRESS 0x40004036 /end MEASUREMENT
/begin MEASUREMENT dsQairPercDeltaH "Delta di eccesso Qair per Diagnosi II livello per eccesso di coppia" UWORD TE_TM_FaultChkAIR2H_50ms_Symbol_CM_ufix16_En4_kg_h 0 0 0 4095 ECU_ADDRESS 0x400041CA /end MEASUREMENT
/begin MEASUREMENT dsQairPercDeltaL "Delta di eccesso Qair per Diagnosi II livello per eccesso di coppia" UWORD TE_TM_FaultChkAIR2L_50ms_Symbol_CM_ufix16_En4_kg_h 0 0 0 4095 ECU_ADDRESS 0x400041CE /end MEASUREMENT
/begin MEASUREMENT dsR15_RecValue "dsR34 Recovery Value (1- POT1_ACTIVE, 2- POT2_ACTIVE, 4- NULL_REQ)" UBYTE TE_RecoverySPP_4ms_CM_uint8_adm 0 0 1 4 ECU_ADDRESS 0x40003FD7 /end MEASUREMENT
/begin MEASUREMENT dsR34_RecValue "dsR15 Recovery Value (2- POT2_ACTIVE, 4- NULL_REQ)" UBYTE TE_RecoverySPP_4ms_CM_uint8_adm 0 0 1 4 ECU_ADDRESS 0x40003FD6 /end MEASUREMENT
/begin MEASUREMENT dsR35_RecValue "dsR35 Recovery Value (3- MIN_BET_POT, 4- NULL_REQ)" UBYTE TE_RecoverySPP_4ms_CM_uint8_adm 0 0 1 4 ECU_ADDRESS 0x40003FD5 /end MEASUREMENT
/begin MEASUREMENT dsREDLCmd "Comando RED (after Recovery)" UBYTE Lamp100ms_CM_boolean_adm 0 0 0 1 ECU_ADDRESS 0x40003758 /end MEASUREMENT
/begin CHARACTERISTIC dsREDL_AUTOD "Red Lamp diagnosis line enable flag" VALUE 0xFC9C93 Scalar_BOOLEAN 0 FaultChkELTLMP100ms_CM_boolean_adm 0 1 /end CHARACTERISTIC
/begin MEASUREMENT dsREDL_AutoD "Red Lamp command diagnois line enable flag" UBYTE Lamp100ms_CM_boolean_adm 0 0 0 1 ECU_ADDRESS 0x40003760 /end MEASUREMENT
/begin MEASUREMENT dsREDL_CodErr "Red Lamp command diagnosis line Error code" UBYTE Lamp100ms_CM_tFault_adm 0 0 0 88 ECU_ADDRESS 0x40003755 /end MEASUREMENT
/begin CHARACTERISTIC dsRPM_SRI_EVAL "RPM threshold under which the KSP diagnosis is disabled" VALUE 0xFC9B28 Scalar_UWORD 0 FaultChkKSPxTDC_CM_uint16_rpm 0 10000 /end CHARACTERISTIC
/begin MEASUREMENT dsRecTAir "Recovery sensore temp. aria - secondo transitorio raccordo al fix in uscita da warm up" UWORD RecoverySTA100ms_Symbol_CM_ufix16_Bn40_degC 0 0 -40 130 ECU_ADDRESS 0x40002058 /end MEASUREMENT
/begin MEASUREMENT dsRecTr2Ta "[OUT] Secondo Transitorio veloce di recovery temp. aria in uscita da warm up (raccordo del primo a dsSTA_TFIX)" UWORD RecoverySTA100ms_Symbol_CM_ufix16_En10_adm 0 0 0 1 ECU_ADDRESS 0x40002056 /end MEASUREMENT
/begin MEASUREMENT dsRecWupTmp "Recovery sensore temp. aria - primo transitorio prima della fine del warm up" UWORD RecoverySTA100ms_Symbol_CM_ufix16_Bn40_degC 0 0 -40 130 ECU_ADDRESS 0x40002054 /end MEASUREMENT
/begin MEASUREMENT dsRecWupTr1Ta "[OUT] Primo Transitorio lento di recovery temp. aria in warm up" UWORD RecoverySTA100ms_Symbol_CM_ufix16_En10_adm 0 0 0 1 ECU_ADDRESS 0x40002052 /end MEASUREMENT
/begin MEASUREMENT dsRemPms_CyCuOf "Time slice remaining express in PMS" UBYTE Thrp_Torque2CylCutOffTDC_CM_uint8_pms 0 0 0 100 ECU_ADDRESS 0x400041E3 /end MEASUREMENT
/begin MEASUREMENT dsRifasaEnCond "RecRifasa Enabling Condition" UBYTE RecRifasaInjTDC_CM_uint8_adm 0 0 0 255 ECU_ADDRESS 0x400032CC /end MEASUREMENT
/begin MEASUREMENT dsRifasaInjEn "Abilitazione alla procedura di verifica della fase di iniezione in caso di recovery camma" UBYTE RecRifasaInjTDC_CM_boolean_adm 0 0 0 1 ECU_ADDRESS 0x400032CB /end MEASUREMENT
/begin CHARACTERISTIC dsSAFPON_AUTOD "Safety III level diagnosis enable " VALUE 0xFCAF90 Scalar_BOOLEAN 0 FaultChkSAFPON_CM_boolean_adm 0 1 /end CHARACTERISTIC
/begin MEASUREMENT dsSAFPON_AutoD "Safety III Level - Safety PowerOn Enable diagnosis" UBYTE Saf3Init_CM_boolean_adm 0 0 0 1 ECU_ADDRESS 0x4000407A /end MEASUREMENT
/begin CHARACTERISTIC dsSAFPON_BITMASK "Safety III Level - Safety BitMask (Indicates which safety test are relevant for diagnosis)" VALUE 0xFCAF8E Scalar_UWORD 0 FaultChkSAFPON_CM_uint16_adm 0 65535 /end CHARACTERISTIC
/begin MEASUREMENT dsSAFPON_LineErr "SAFPON confirmed enable condition" UBYTE Saf3Init_CM_boolean_adm 0 0 0 1 ECU_ADDRESS 0x40004079 /end MEASUREMENT
/begin MEASUREMENT dsSAFPON_LineOk "SAFPON devalidation enable condition" UBYTE Saf3Init_CM_boolean_adm 0 0 0 1 ECU_ADDRESS 0x40004078 /end MEASUREMENT
/begin CHARACTERISTIC dsSAFRTF_AUTOD "Safety III level - Run-Time Filtered diagnosis Enable " VALUE 0xFCAF97 Scalar_BOOLEAN 0 FaultChkSAFRTF_CM_boolean_adm 0 1 /end CHARACTERISTIC
/begin MEASUREMENT dsSAFRTF_AutoD "Safety III Level - Safety Run-Time Filtered Enable diagnosis" UBYTE Saf3_50ms_CM_boolean_adm 0 0 0 1 ECU_ADDRESS 0x40004085 /end MEASUREMENT
/begin CHARACTERISTIC dsSAFRTF_BITMASK "Safety III Level - Run-Time Filtered Safety BitMask (Indicates which safety test are relevant for diagnosis)" VALUE 0xFCAF96 Scalar_UBYTE 0 FaultChkSAFRTF_CM_uint8_adm 0 255 /end CHARACTERISTIC
/begin MEASUREMENT dsSAFRTF_CodErr "Safety III level - Run-Time Filtered Code Error" UBYTE Saf3_50ms_CM_tFault_adm 0 0 0 89 ECU_ADDRESS 0x40004083 /end MEASUREMENT
/begin CHARACTERISTIC dsSAFRTI_AUTOD "Safety III level - Run-Time Immediate diagnosis Enable " VALUE 0xFCAF95 Scalar_BOOLEAN 0 FaultChkSAFRTI_CM_boolean_adm 0 1 /end CHARACTERISTIC
/begin MEASUREMENT dsSAFRTI_AutoD "Safety III Level - Safety Run-Time Immediate Enable diagnosis" UBYTE Saf3_50ms_CM_boolean_adm 0 0 0 1 ECU_ADDRESS 0x40004084 /end MEASUREMENT
/begin CHARACTERISTIC dsSAFRTI_BITMASK "Safety III Level - Run-Time Immediate Safety BitMask (Indicates which safety test are relevant for diagnosis)" VALUE 0xFCAF94 Scalar_UBYTE 0 FaultChkSAFRTI_CM_uint8_adm 0 255 /end CHARACTERISTIC
/begin MEASUREMENT dsSAFRTI_CodErr "Safety III level - Run-Time Immediate Code Error" UBYTE Saf3_50ms_CM_tFault_adm 0 0 0 89 ECU_ADDRESS 0x40004082 /end MEASUREMENT
/begin CHARACTERISTIC dsSENS_POIL_HYST "Delta per isteresi su check Pressione olio" VALUE 0xFCAAA2 Scalar_UWORD 0 FaultChkPO2L100ms_Symbol_CM_uint16_mbar 0 2000 /end CHARACTERISTIC
/begin CHARACTERISTIC dsSENS_TH2O_HYST "Delta per isteresi su check Temperatura motore" VALUE 0xFC2C99 Scalar_UBYTE 0 FaultChkTH2H100ms_Symbol_CM_uint8_degC 0 50 /end CHARACTERISTIC
/begin CHARACTERISTIC dsSENS_TH2O_ORH "Soglia di sicurezza TH2O" VALUE 0xFC2C9C Scalar_UWORD 0 FaultChkTH2H100ms_Symbol_CM_ufix16_Bn40_degC -40 140 /end CHARACTERISTIC
/begin CHARACTERISTIC dsSFM_AUTOD "Enable diagnosis on Cam sensor (phased error)" VALUE 0xFCAFEB Scalar_BOOLEAN 0 FaultChkSFM4ms_CM_boolean_adm 0 1 /end CHARACTERISTIC
/begin MEASUREMENT dsSFM_AutoD "Flag Abilitazione Diagnosi Sensore di Fase" UBYTE Sqs4ms_CM_boolean_adm 0 0 0 1 ECU_ADDRESS 0x400040B6 /end MEASUREMENT
/begin MEASUREMENT dsSFM_CodErr "Codice di errore linea Sensore di Fase" UBYTE Sqs4ms_CM_tFault_adm 0 0 0 89 ECU_ADDRESS 0x400040B3 /end MEASUREMENT
/begin CHARACTERISTIC dsSFR_AUTOD "Enable Cam Running diagnosis (phased errors: NO_SIGNAL, CAM_NTEETH_INCOHERENCE, CAM_POS_INCOHERENCE)" VALUE 0xFCAFEA Scalar_BOOLEAN 0 FaultChkSFR4ms_CM_boolean_adm 0 1 /end CHARACTERISTIC
/begin MEASUREMENT dsSFR_AutoD "Flag Abilitazione Diagnosi camma in Run" UBYTE Sqs4ms_CM_boolean_adm 0 0 0 1 ECU_ADDRESS 0x400040B5 /end MEASUREMENT
/begin MEASUREMENT dsSFR_CodErr "Codice di errore della linea di diagnosi Camma in Run" UBYTE Sqs4ms_CM_tFault_adm 0 0 0 89 ECU_ADDRESS 0x400040B2 /end MEASUREMENT
/begin CHARACTERISTIC dsSFR_START_TIME "Time required after engine running condition before activating SFR diagnosis" VALUE 0xFCAFE8 Scalar_UWORD 0 FaultChkSFR4ms_CM_ufix16_Sp004_s 0 60 /end CHARACTERISTIC
/begin CHARACTERISTIC dsSGL_CNT_T120 "Soglia sul contatore di disuniformita ciclica in caso per decidere rifasatura" VALUE 0xFC7FF0 Scalar_UWORD 0 RecRifasaInjTDC_CM_uint16_adm 0 10000 /end CHARACTERISTIC
/begin CHARACTERISTIC dsSGL_DIFF_TDC "Soglia sulla differenza fra max T120 e min T120 su 720 gradi motore per definire presenza disuniformita significativa" VALUE 0xFC7FEE Scalar_UWORD 0 RecRifasaInjTDC_CM_uint16_us 0 65000 /end CHARACTERISTIC
/begin CHARACTERISTIC dsSGL_TH20_T120 "Soglia di temperatura minima al disotto della quale la strategia è disabilita" VALUE 0xFC7FEC Scalar_UWORD 0 RecRifasaInjTDC_CM_ufix16_Bn40_degC -40 140 /end CHARACTERISTIC
/begin CHARACTERISTIC dsSGL_VAR_RPM "Soglia sulla variazione di giri motore massima in un ciclo di validazione per considerarlo significativo" VALUE 0xFC7FEA Scalar_UWORD 0 RecRifasaInjTDC_CM_uint16_adm 0 10000 /end CHARACTERISTIC
/begin MEASUREMENT dsSGMDiagCount "Number of camshaft pulses without activity on crankshaft (EpmStatus in NOSYNCH or STOPPED)." UWORD FaultChkSGM4ms_CM_uint16_adm 0 0 0 65535 ECU_ADDRESS 0x400040C2 /end MEASUREMENT
/begin CHARACTERISTIC dsSGM_AUTOD "Flag Abilitazione Diagnosi sensore CrankShaft" VALUE 0xFCAFE6 Scalar_BOOLEAN 0 FaultChkSGM4ms_CM_boolean_adm 0 1 /end CHARACTERISTIC
/begin MEASUREMENT dsSGM_AutoD "Flag Abilitazione Diagnosi Sensore di Fase" UBYTE Sqs4ms_CM_boolean_adm 0 0 0 1 ECU_ADDRESS 0x400040B4 /end MEASUREMENT
/begin MEASUREMENT dsSGM_CodErr "Codice di errore linea Sensore Giri Motore" UBYTE Sqs4ms_CM_tFault_adm 0 0 0 89 ECU_ADDRESS 0x400040B1 /end MEASUREMENT
/begin CHARACTERISTIC dsSGM_DIAG_PULSES "Number of camshaft pulses without activity on crankshaft after which consider anomalous behaviour of crankshaft sensor." VALUE 0xFCAFE4 Scalar_UWORD 0 FaultChkSGM4ms_CM_uint16_pulses 0 65535 /end CHARACTERISTIC
/begin CHARACTERISTIC dsSK1_AUTOD "Cylinder 1 Knock diagnostic line enable" VALUE 0xFC9B27 Scalar_BOOLEAN 0 FaultChkSKxTDC_CM_boolean_adm 0 1 /end CHARACTERISTIC
/begin CHARACTERISTIC dsSK2_AUTOD "Cylinder 2 Knock diagnostic line enable" VALUE 0xFC9B26 Scalar_BOOLEAN 0 FaultChkSKxTDC_CM_boolean_adm 0 1 /end CHARACTERISTIC
/begin CHARACTERISTIC dsSK3_AUTOD "Cylinder 3 Knock diagnostic line enable" VALUE 0xFC9B25 Scalar_BOOLEAN 0 FaultChkSKxTDC_CM_boolean_adm 0 1 /end CHARACTERISTIC
/begin CHARACTERISTIC dsSK4_AUTOD "Cylinder 4 Knock diagnostic line enable" VALUE 0xFC9B24 Scalar_BOOLEAN 0 FaultChkSKxTDC_CM_boolean_adm 0 1 /end CHARACTERISTIC
/begin CHARACTERISTIC dsSK5_AUTOD "Cylinder 5 Knock diagnostic line enable" VALUE 0xFC9B23 Scalar_BOOLEAN 0 FaultChkSKxTDC_CM_boolean_adm 0 1 /end CHARACTERISTIC
/begin CHARACTERISTIC dsSK6_AUTOD "Cylinder 6 Knock diagnostic line enable" VALUE 0xFC9B22 Scalar_BOOLEAN 0 FaultChkSKxTDC_CM_boolean_adm 0 1 /end CHARACTERISTIC
/begin CHARACTERISTIC dsSK7_AUTOD "Cylinder 7 Knock diagnostic line enable" VALUE 0xFC9B21 Scalar_BOOLEAN 0 FaultChkSKxTDC_CM_boolean_adm 0 1 /end CHARACTERISTIC
/begin CHARACTERISTIC dsSK8_AUTOD "Cylinder 8 Knock diagnostic line enable" VALUE 0xFC9B20 Scalar_BOOLEAN 0 FaultChkSKxTDC_CM_boolean_adm 0 1 /end CHARACTERISTIC
/begin MEASUREMENT dsSKx_AdiaEn "Error validation state machine enable for CylinderX Knock" UBYTE KnockTDC_CM_boolean_adm 0 0 0 1 ECU_ADDRESS 0x400034AD /end MEASUREMENT
/begin MEASUREMENT dsSKx_CodErr "CylinderX Knock diagnostic line error code" UBYTE KnockTDC_CM_tFault_adm 0 0 0 89 ECU_ADDRESS 0x400034A8 /end MEASUREMENT
/begin MEASUREMENT dsSLODiagTime "Finestra di validazione - tempo parziale" UWORD FaultChkSLO4ms_Symbol_CM_uint16_s 0 0 0 65000 ECU_ADDRESS 0x400025CE /end MEASUREMENT
/begin MEASUREMENT dsSLONumTrans "Contatore numero transizioni della sonda lambda" UWORD FaultChkSLO4ms_Symbol_CM_uint16_adm 0 0 0 65000 ECU_ADDRESS 0x400025CC /end MEASUREMENT
/begin CHARACTERISTIC dsSLO_AUTOD "Flag Abilitazione Diagnosi Operatività sonda lambda monte catalizzatore" VALUE 0xFC4602 Scalar_BOOLEAN 0 FaultChkSLO4ms_Symbol_CM_boolean_adm 0 1 /end CHARACTERISTIC
/begin MEASUREMENT dsSLO_AutoD "Abilitazione Diagnosi Operatività sonda lambda monte catalizzatore" UBYTE Ctit_LambdaPreDiag4ms_CM_boolean_adm 0 0 0 1 ECU_ADDRESS 0x400025BF /end MEASUREMENT
/begin MEASUREMENT dsSLO_CodErr "Lambda pre diagnostic line code error (SLO)" UBYTE Ctit_LambdaPreDiag4ms_CM_tFault_adm 0 0 0 81 ECU_ADDRESS 0x400025BD /end MEASUREMENT
/begin CHARACTERISTIC dsSLO_DIAG_TIME "Durata finestra di validazione del fault" VALUE 0xFC4606 Scalar_UWORD 0 FaultChkSLO4ms_Symbol_CM_uint16_s 0 65000 /end CHARACTERISTIC
/begin CHARACTERISTIC dsSLO_TRANS_OK "Numero di transizioni sonda operativa" VALUE 0xFC4604 Scalar_UWORD 0 FaultChkSLO4ms_Symbol_CM_uint16_adm 0 65000 /end CHARACTERISTIC
/begin MEASUREMENT dsSLOen "Abilitazione Diagnosi Operatività sonda lambda monte catalizzatore: dsTrigAutoma && dsSLO_AutoD" UBYTE Ctit_LambdaPreDiag4ms_CM_boolean_adm 0 0 0 1 ECU_ADDRESS 0x400025BC /end MEASUREMENT
/begin MEASUREMENT dsSMLamState "Stato corrente della macchina a stati di plausibilità della sonda lambda" UBYTE Ctit_LambdaCtrlTDC_CM_uint8_adm 0 0 0 3 ECU_ADDRESS 0x400023D4 /end MEASUREMENT
/begin MEASUREMENT dsSPAEnable "Flag to enable diagnosis adia validation for SPA diag line" UBYTE FaultChkSPA4ms_CM_boolean_adm 0 0 0 1 ECU_ADDRESS 0x40003EE1 /end MEASUREMENT
/begin MEASUREMENT dsSPAFreeze "Flag di accecamento della diagnosi Corto Circuito a GND della pressione collettore" UBYTE Mpre4ms_CM_boolean_adm 0 0 0 1 ECU_ADDRESS 0x40003ECF /end MEASUREMENT
/begin CHARACTERISTIC dsSPA_AB_FARF "Soglia di gradi posizione farfalla per abilitazione diagnosi (Fault check GND)" VALUE 0xFCAA6A Scalar_UWORD 0 FaultChkSPA4ms_CM_ufix16_En3_degF 0 90 /end CHARACTERISTIC
/begin CHARACTERISTIC dsSPA_AB_RPM "Soglia giri per abilitazione diagnosi pressione aria (Fault check GND)" VALUE 0xFCAA68 Scalar_UWORD 0 FaultChkSPA4ms_CM_uint16_rpm 0 10000 /end CHARACTERISTIC
/begin CHARACTERISTIC dsSPA_AB_TIME "Soglia in tempo per abilitazione diagnosi (Fault check GND)" VALUE 0xFCAA66 Scalar_UWORD 0 FaultChkSPA4ms_CM_ufix16_En8_s 0 50 /end CHARACTERISTIC
/begin CHARACTERISTIC dsSPA_AUTOD "Flag Abilitazione Diagnosi pressione aria" VALUE 0xFCAA64 Scalar_BOOLEAN 0 FaultChkSPA4ms_CM_boolean_adm 0 1 /end CHARACTERISTIC
/begin MEASUREMENT dsSPA_AutoD "Flag abilitazione diagnosi pressione aria" UBYTE Mpre4ms_CM_boolean_adm 0 0 0 1 ECU_ADDRESS 0x40003ED0 /end MEASUREMENT
/begin MEASUREMENT dsSPA_CodErr "Codice di errore linea sensore pressione aria" UBYTE Mpre4ms_CM_tFault_adm 0 0 0 88 ECU_ADDRESS 0x40003ECE /end MEASUREMENT
/begin CHARACTERISTIC dsSPA_MAPV_ORH "Soglia Superiore MAPV" VALUE 0xFCAA62 Scalar_UWORD 0 FaultChkSPA4ms_CM_ufix16_En10_V 0 5 /end CHARACTERISTIC
/begin CHARACTERISTIC dsSPA_MAPV_ORL "Soglia Inferiore MAPV" VALUE 0xFCAA60 Scalar_UWORD 0 FaultChkSPA4ms_CM_ufix16_En10_V 0 5 /end CHARACTERISTIC
/begin CHARACTERISTIC dsSPA_PFIX "Fix sulla pressione aria" VALUE 0xFCAA96 Scalar_UWORD 0 RecoverySPA4ms_Symbol_CM_uint16_mbar 150 2500 /end CHARACTERISTIC
/begin CHARACTERISTIC dsSPA_VS "Selettore linea di diagnosi associata al canale di alimentazione (Voltage Supply) sensore pressione manifold." VALUE 0xFCAA5E Scalar_UBYTE 0 FaultChkSPA4ms_CM_uint8_adm 1 3 /end CHARACTERISTIC
/begin CHARACTERISTIC dsSPB_AUTOD "Flag Abilitazione Diagnosi Pressione Metano nelle bombole" VALUE 0xFCB67E Scalar_BOOLEAN 0 FaultChkSPB4ms_CM_boolean_adm 0 1 /end CHARACTERISTIC
/begin MEASUREMENT dsSPB_AutoD "Flag abilitazione diagnosi pressione metano bombole" UBYTE Tnkp4ms_CM_boolean_adm 0 0 0 1 ECU_ADDRESS 0x40004206 /end MEASUREMENT
/begin MEASUREMENT dsSPB_CodErr "Codice di errore linea sensore pressione metano nelle bombole" UBYTE Tnkp4ms_CM_tFault_adm 0 0 0 88 ECU_ADDRESS 0x40004205 /end MEASUREMENT
/begin CHARACTERISTIC dsSPB_PFIX "Fix sulla Pressione Metano nelle bombole" VALUE 0xFCB680 Scalar_UWORD 0 RecoverySPB4ms_Symbol_CM_ufix16_E2_mbar 0 250000 /end CHARACTERISTIC
/begin CHARACTERISTIC dsSPB_PTANKV_ORH "Soglia Superiore PTANKV" VALUE 0xFCB67C Scalar_UWORD 0 FaultChkSPB4ms_CM_ufix16_En10_V 0 5 /end CHARACTERISTIC
/begin CHARACTERISTIC dsSPB_PTANKV_ORL "Soglia Inferiore PTANKV" VALUE 0xFCB67A Scalar_UWORD 0 FaultChkSPB4ms_CM_ufix16_En10_V 0 5 /end CHARACTERISTIC
/begin CHARACTERISTIC dsSPB_VS "Selettore linea di diagnosi associata al canale di alimentazione (Voltage Supply) sensore pressione bombole." VALUE 0xFCB678 Scalar_UBYTE 0 FaultChkSPB4ms_CM_uint8_adm 1 3 /end CHARACTERISTIC
/begin CHARACTERISTIC dsSPEED_AUTOD "Flag Abilitazione Diagnosi velocità veicolo da CAN" VALUE 0xFCC87E Scalar_BOOLEAN 0 TE_FaultChkSPEED4ms_Symbol_CM_boolean_adm 0 1 /end CHARACTERISTIC
/begin MEASUREMENT dsSPEED_AutoD "bilitazione automa di diagnosi SPEED" UBYTE Vfnc4ms_CM_boolean_adm 0 0 0 1 ECU_ADDRESS 0x4000464F /end MEASUREMENT
/begin MEASUREMENT dsSPEED_CodErr "odice di errore della linea SPEED" UBYTE Vfnc4ms_CM_tFault_adm 0 0 0 88 ECU_ADDRESS 0x40004646 /end MEASUREMENT
/begin CHARACTERISTIC dsSPM2H_AUTOD "Rail pressure too high diagnosi line enable" VALUE 0xFCAF8C Scalar_BOOLEAN 0 FaultChkSPM2H4ms_CM_boolean_adm 0 1 /end CHARACTERISTIC
/begin MEASUREMENT dsSPM2H_AdiaEn "Error validation state machine enable (SPM2H)" UBYTE Rpre4ms_CM_boolean_adm 0 0 0 1 ECU_ADDRESS 0x40004051 /end MEASUREMENT
/begin MEASUREMENT dsSPM2H_CodErr "SPM2H diagnosis line error code" UBYTE Rpre4ms_CM_tFault_adm 0 0 0 89 ECU_ADDRESS 0x4000404E /end MEASUREMENT
/begin CHARACTERISTIC dsSPM2H_PRAIL_HL "Rail pressure High level plausibility threshold" VALUE 0xFCAF8A Scalar_UWORD 0 FaultChkSPM2H4ms_CM_uint16_mbar 0 13793 /end CHARACTERISTIC
/begin CHARACTERISTIC dsSPMP_AB_TIME "Time since closing Tank and Regulator EVs to enable diagnosis" VALUE 0xFCAF89 Scalar_UBYTE 0 FaultChkSPMP4ms_CM_ufix8_Sp04_s 0 10 /end CHARACTERISTIC
/begin CHARACTERISTIC dsSPMP_AUTOD "Flag Abilitazione Diagnosi Pressione Metano nel Rail sotto soglia" VALUE 0xFCAF88 Scalar_BOOLEAN 0 FaultChkSPMP4ms_CM_boolean_adm 0 1 /end CHARACTERISTIC
/begin MEASUREMENT dsSPMP_AutoD "Flag Abilitazione Diagnosi Pressione Metano nel Rail sotto soglia" UBYTE Rpre4ms_CM_boolean_adm 0 0 0 1 ECU_ADDRESS 0x4000404F /end MEASUREMENT
/begin MEASUREMENT dsSPMP_CodErr "Codice di errore linea Pressione Metano nel Rail sotto soglia" UBYTE Rpre4ms_CM_tFault_adm 0 0 0 89 ECU_ADDRESS 0x4000404C /end MEASUREMENT
/begin CHARACTERISTIC dsSPMP_PRAIL_LL "Soglia di plausibilità inferiore Pressione Metano nel Rail" VALUE 0xFCAF86 Scalar_UWORD 0 FaultChkSPMP4ms_CM_uint16_mbar 0 13793 /end CHARACTERISTIC
/begin CHARACTERISTIC dsSPM_AUTOD "Flag Abilitazione Diagnosi Pressione Metano nel Rail" VALUE 0xFCAF84 Scalar_BOOLEAN 0 FaultChkSPM4ms_CM_boolean_adm 0 1 /end CHARACTERISTIC
/begin MEASUREMENT dsSPM_AutoD "Flag abilitazione diagnosi pressione metano nel rail" UBYTE Rpre4ms_CM_boolean_adm 0 0 0 1 ECU_ADDRESS 0x40004050 /end MEASUREMENT
/begin MEASUREMENT dsSPM_CodErr "Codice di errore linea sensore pressione metano nel rail" UBYTE Rpre4ms_CM_tFault_adm 0 0 0 89 ECU_ADDRESS 0x4000404D /end MEASUREMENT
/begin CHARACTERISTIC dsSPM_PFIX "Fix sulla Pressione Metano nel Rail" VALUE 0xFCAF82 Scalar_UWORD 0 RecoverySPM4ms_CM_uint16_mbar 0 13793 /end CHARACTERISTIC
/begin CHARACTERISTIC dsSPM_PRAILV_ORH "Soglia Superiore PRAILV" VALUE 0xFCAF80 Scalar_UWORD 0 FaultChkSPM4ms_CM_ufix16_En10_V 0 5 /end CHARACTERISTIC
/begin CHARACTERISTIC dsSPM_PRAILV_ORL "Soglia Inferiore PRAILV" VALUE 0xFCAF7E Scalar_UWORD 0 FaultChkSPM4ms_CM_ufix16_En10_V 0 5 /end CHARACTERISTIC
/begin CHARACTERISTIC dsSPM_VS "Selettore linea di diagnosi associata al canale di alimentazione (Voltage Supply) sensore pressione rail." VALUE 0xFCAF7D Scalar_UBYTE 0 FaultChkSPM4ms_CM_uint8_adm 1 3 /end CHARACTERISTIC
/begin CHARACTERISTIC dsSPO_AUTOD "Flag Abilitazione Diagnosi Pressione Olio" VALUE 0xFCAA9E Scalar_BOOLEAN 0 FaultChkSPO100ms_CM_boolean_adm 0 1 /end CHARACTERISTIC
/begin MEASUREMENT dsSPO_AutoD "Flag abilitazione diagnosi pressione olio" UBYTE Oilp100ms_CM_boolean_adm 0 0 0 1 ECU_ADDRESS 0x40003EFA /end MEASUREMENT
/begin MEASUREMENT dsSPO_CodErr "Codice di errore linea sensore pressione olio" UBYTE Oilp100ms_CM_tFault_adm 0 0 0 88 ECU_ADDRESS 0x40003EF8 /end MEASUREMENT
/begin CHARACTERISTIC dsSPO_PFIX "FIX di Pressione Olio" VALUE 0xFCAB7A Scalar_UWORD 0 RecoverySPO100ms_Symbol_CM_uint16_mbar 250 6000 /end CHARACTERISTIC
/begin CHARACTERISTIC dsSPO_POILV_ORH "Soglia Superiore POILV" VALUE 0xFCAA9C Scalar_UWORD 0 FaultChkSPO100ms_CM_ufix16_En10_V 0 5 /end CHARACTERISTIC
/begin CHARACTERISTIC dsSPO_POILV_ORL "Soglia Inferiore POILV" VALUE 0xFCAA9A Scalar_UWORD 0 FaultChkSPO100ms_CM_ufix16_En10_V 0 5 /end CHARACTERISTIC
/begin CHARACTERISTIC dsSPO_VS "Selettore linea di diagnosi associata al canale di alimentazione (Voltage Supply) sensore pressione olio." VALUE 0xFCAA98 Scalar_UBYTE 0 FaultChkSPO100ms_CM_uint8_adm 1 3 /end CHARACTERISTIC
/begin CHARACTERISTIC dsSPP01_AUTOD "Flag Abilitazione Diagnosi sul potenziometro principale del pedale acceleratore" VALUE 0xFCAC2B Scalar_BOOLEAN 0 TE_FaultChkSPP01_4ms_CM_boolean_adm 0 1 /end CHARACTERISTIC
/begin MEASUREMENT dsSPP01_AutoD "bilitazione della linea di diagnosi SPP01" UBYTE Pacc4ms_CM_boolean_adm 0 0 0 1 ECU_ADDRESS 0x40003F62 /end MEASUREMENT
/begin MEASUREMENT dsSPP01_CodErr "Codice di errore della linea SPP01" UBYTE Pacc4ms_CM_tFault_adm 0 0 0 88 ECU_ADDRESS 0x40003F5C /end MEASUREMENT
/begin MEASUREMENT dsSPP01_RecActive "SPP01 Recovery activation flag" UBYTE TE_RecoverySPP_4ms_CM_boolean_adm 0 0 0 1 ECU_ADDRESS 0x40003FD4 /end MEASUREMENT
/begin CHARACTERISTIC dsSPP01_VS "Voltage supplier diagnosis selector for first accelerator pedal potentiometer" VALUE 0xFCAC2A Scalar_UBYTE 0 TE_FaultChkSPP01_4ms_CM_uint8_adm 1 3 /end CHARACTERISTIC
/begin CHARACTERISTIC dsSPP02_AUTOD "Diagnosis activation flag on second acelerator pedal potentiometer" VALUE 0xFCAC29 Scalar_BOOLEAN 0 TE_FaultChkSPP02_4ms_CM_boolean_adm 0 1 /end CHARACTERISTIC
/begin MEASUREMENT dsSPP02_AutoD "Abilitazione della linea di diagnosi SPP02" UBYTE Pacc4ms_CM_boolean_adm 0 0 0 1 ECU_ADDRESS 0x40003F61 /end MEASUREMENT
/begin MEASUREMENT dsSPP02_CodErr "Codice di errore della linea SPP02" UBYTE Pacc4ms_CM_tFault_adm 0 0 0 88 ECU_ADDRESS 0x40003F5B /end MEASUREMENT
/begin MEASUREMENT dsSPP02_RecActive "SPP02 Recovery activation flag" UBYTE TE_RecoverySPP_4ms_CM_boolean_adm 0 0 0 1 ECU_ADDRESS 0x40003FD3 /end MEASUREMENT
/begin CHARACTERISTIC dsSPP02_VS "Voltage supplier diagnosis selector for second accelerator pedal potentiometer" VALUE 0xFCAC28 Scalar_UBYTE 0 TE_FaultChkSPP02_4ms_CM_uint8_adm 1 3 /end CHARACTERISTIC
/begin CHARACTERISTIC dsSPP2_ACCV_ORH "Voltage upper threshold value for diagnosis on second potentiomenter acelerator pedal." VALUE 0xFCAC26 Scalar_UWORD 0 TE_FaultChkSPP02_4ms_CM_ufix16_En10_V 0 5 /end CHARACTERISTIC
/begin CHARACTERISTIC dsSPP2_ACCV_ORL "Voltage lower threshold value for diagnosis on second potentiomenter acelerator pedal." VALUE 0xFCAC24 Scalar_UWORD 0 TE_FaultChkSPP02_4ms_CM_ufix16_En10_V 0 5 /end CHARACTERISTIC
/begin CHARACTERISTIC dsSPPC1_AUTOD "Abilitazione del check di coerenza su traccia potenziometro principale e switch Idle" VALUE 0xFCAC22 Scalar_BOOLEAN 0 TE_FaultChkSPPC1_4ms_CM_boolean_adm 0 1 /end CHARACTERISTIC
/begin MEASUREMENT dsSPPC1_AutoD "Flag Abilitazione Diagnosi SPPC1" UBYTE Pacc4ms_CM_boolean_adm 0 0 0 1 ECU_ADDRESS 0x40003F60 /end MEASUREMENT
/begin MEASUREMENT dsSPPC1_CodErr "Codice di errore della linea SPPC1" UBYTE Pacc4ms_CM_tFault_adm 0 0 0 88 ECU_ADDRESS 0x40003F5A /end MEASUREMENT
/begin CHARACTERISTIC dsSPPC2_AUTOD "Abilitazione del check di coerenza su traccia potenziometro principale e switch Idle" VALUE 0xFCAC21 Scalar_BOOLEAN 0 TE_FaultChkSPPC2_4ms_CM_boolean_adm 0 1 /end CHARACTERISTIC
/begin MEASUREMENT dsSPPC2_AutoD "Flag Abilitazione Diagnosi SPPC2" UBYTE Pacc4ms_CM_boolean_adm 0 0 0 1 ECU_ADDRESS 0x40003F5F /end MEASUREMENT
/begin MEASUREMENT dsSPPC2_CodErr "Codice di errore della linea SPPC2" UBYTE Pacc4ms_CM_tFault_adm 0 0 0 88 ECU_ADDRESS 0x40003F59 /end MEASUREMENT
/begin CHARACTERISTIC dsSPPCH_AUTOD "Acelerator potentiometers coherency check enable" VALUE 0xFCAC20 Scalar_BOOLEAN 0 TE_FaultChkSPPCH_4ms_CM_boolean_adm 0 1 /end CHARACTERISTIC
/begin MEASUREMENT dsSPPCH_AutoD "Flag Abilitazione Diagnosi SPPCH" UBYTE Pacc4ms_CM_boolean_adm 0 0 0 1 ECU_ADDRESS 0x40003F5E /end MEASUREMENT
/begin MEASUREMENT dsSPPCH_CodErr "Codice di errore della linea SPPCH" UBYTE Pacc4ms_CM_tFault_adm 0 0 0 88 ECU_ADDRESS 0x40003F58 /end MEASUREMENT
/begin MEASUREMENT dsSPPCH_RecActive "SPPCH Recovery activation flag" UBYTE TE_RecoverySPP_4ms_CM_boolean_adm 0 0 0 1 ECU_ADDRESS 0x40003FD2 /end MEASUREMENT
/begin CHARACTERISTIC dsSPP_ACCV_ORH "Soglia Superiore PTACCV potenziometro primario" VALUE 0xFCAC1E Scalar_UWORD 0 TE_FaultChkSPP01_4ms_CM_ufix16_En10_V 0 5 /end CHARACTERISTIC
/begin CHARACTERISTIC dsSPP_ACCV_ORL "Soglia Inferiore PTACCV potenziometro primario" VALUE 0xFCAC1C Scalar_UWORD 0 TE_FaultChkSPP01_4ms_CM_ufix16_En10_V 0 5 /end CHARACTERISTIC
/begin CHARACTERISTIC dsSPP_REC_NULL "Valore di recovery inferiore sul pedale acceleratore" VALUE 0xFCAC1A Scalar_UWORD 0 TE_RecoverySPP_4ms_CM_ufix16_En10_V 0 5 /end CHARACTERISTIC
/begin CHARACTERISTIC dsSPP_REC_VAL "Valore di recovery superiore sul pedale acceleratore" VALUE 0xFCAC18 Scalar_UWORD 0 TE_RecoverySPP_4ms_CM_ufix16_En10_V 0 5 /end CHARACTERISTIC
/begin CHARACTERISTIC dsSPS_AUTOD "Flag Abilitazione Diagnosi Pressione di sovralimentazione" VALUE 0xFC2BC2 Scalar_BOOLEAN 0 FaultChkSPS4ms_CM_boolean_adm 0 1 /end CHARACTERISTIC
/begin MEASUREMENT dsSPS_AutoD "Flag abilitazione diagnosi pressione di sovralimentazione" UBYTE Bpre4ms_CM_boolean_adm 0 0 0 1 ECU_ADDRESS 0x4000229E /end MEASUREMENT
/begin MEASUREMENT dsSPS_CodErr "Codice di errore linea sensore pressione di sovralimentazione" UBYTE Bpre4ms_CM_tFault_adm 0 0 0 88 ECU_ADDRESS 0x4000229D /end MEASUREMENT
/begin CHARACTERISTIC dsSPS_PBOSTV_ORH "Soglia Superiore PBOOSTV" VALUE 0xFC2BC0 Scalar_UWORD 0 FaultChkSPS4ms_CM_ufix16_En10_V 0 5 /end CHARACTERISTIC
/begin CHARACTERISTIC dsSPS_PBOSTV_ORL "Soglia Inferiore PBOOSTV" VALUE 0xFC2BBE Scalar_UWORD 0 FaultChkSPS4ms_CM_ufix16_En10_V 0 5 /end CHARACTERISTIC
/begin CHARACTERISTIC dsSPS_VS "Selettore linea di diagnosi associata al canale di alimentazione (Voltage Supply) sensore pressione boost." VALUE 0xFC2BBC Scalar_UBYTE 0 FaultChkSPS4ms_CM_uint8_adm 1 3 /end CHARACTERISTIC
/begin CHARACTERISTIC dsSPT_AUTOD "Flag Abilitazione Diagnosi Pressione Atmosferica" VALUE 0xFC1F36 Scalar_BOOLEAN 0 FaultChkSPT100ms_Symbol_CM_boolean_adm 0 1 /end CHARACTERISTIC
/begin MEASUREMENT dsSPT_AutoD "Flag abilitazione diagnosi pressione atmosferica" UBYTE Apre100ms_CM_boolean_adm 0 0 0 1 ECU_ADDRESS 0x40002069 /end MEASUREMENT
/begin MEASUREMENT dsSPT_CodErr "Codice di errore linea sensore pressione atmosferica" UBYTE Apre100ms_CM_tFault_adm 0 0 0 83 ECU_ADDRESS 0x40002068 /end MEASUREMENT
/begin CHARACTERISTIC dsSPT_PATMV_ORH "Soglia Superiore PATMV" VALUE 0xFC1F3A Scalar_UWORD 0 FaultChkSPT100ms_Symbol_CM_ufix16_En10_V 0 5 /end CHARACTERISTIC
/begin CHARACTERISTIC dsSPT_PATMV_ORL "Soglia Inferiore PATMV" VALUE 0xFC1F38 Scalar_UWORD 0 FaultChkSPT100ms_Symbol_CM_ufix16_En10_V 0 5 /end CHARACTERISTIC
/begin CHARACTERISTIC dsSPT_PFIX "FIX di Pressione Atmosferica" VALUE 0xFC1F3C Scalar_UWORD 0 RecoverySPT100ms_Symbol_CM_uint16_mbar 150 1150 /end CHARACTERISTIC
/begin CHARACTERISTIC dsSTACK_FREE_THR "Safety III Level - Stack free space threshold above which an error is signaled" VALUE 0xFCAF92 Scalar_UWORD 0 FaultChkSAFRTI_CM_ufix16_Sp1__ 0 100 /end CHARACTERISTIC
/begin CHARACTERISTIC dsSTA_AUTOD "Flag Abilitazione Diagnosi Temperatura Aria" VALUE 0xFC1E26 Scalar_BOOLEAN 0 FaultChkSTA100ms_Symbol_CM_boolean_adm 0 1 /end CHARACTERISTIC
/begin MEASUREMENT dsSTA_AutoD "Flag abilitazione diagnosi temperatura aria" UBYTE Airt100ms_CM_boolean_adm 0 0 0 1 ECU_ADDRESS 0x4000202D /end MEASUREMENT
/begin MEASUREMENT dsSTA_CodErr "Codice di errore linea sensore di temperatura aria" UBYTE Airt100ms_CM_tFault_adm 0 0 0 81 ECU_ADDRESS 0x4000202C /end MEASUREMENT
/begin CHARACTERISTIC dsSTA_TAIRV_ORH "Soglia Superiore TAIRV" VALUE 0xFC1E2A Scalar_UWORD 0 FaultChkSTA100ms_Symbol_CM_ufix16_En10_V 0 5 /end CHARACTERISTIC
/begin CHARACTERISTIC dsSTA_TAIRV_ORL "Soglia Inferiore TAIRV" VALUE 0xFC1E28 Scalar_UWORD 0 FaultChkSTA100ms_Symbol_CM_ufix16_En10_V 0 5 /end CHARACTERISTIC
/begin CHARACTERISTIC dsSTA_TFIX "FIX di Temperatura Aria" VALUE 0xFC1E2C Scalar_UWORD 0 RecoverySTA100ms_Symbol_CM_ufix16_Bn40_degC -40 130 /end CHARACTERISTIC
/begin CHARACTERISTIC dsSTC1_AUTOD "Flag Abilitazione Diagnosi di plausibilità della Temperatura Catalizzatore - linea STC1" VALUE 0xFC2C30 Scalar_BOOLEAN 0 FaultChkSTC123100ms_Symbol_CM_boolean_adm 0 1 /end CHARACTERISTIC
/begin MEASUREMENT dsSTC1_AutoD "Flag abilitazione diagnosi plausibilità temperatura valle catalizzatore - linea STC1" UBYTE Catt100ms_CM_boolean_adm 0 0 0 1 ECU_ADDRESS 0x400022F2 /end MEASUREMENT
/begin MEASUREMENT dsSTC1_CodErr "Codice di errore linea STC1 sensore temperatura valle catalizzatore" UBYTE Catt100ms_CM_tFault_adm 0 0 0 81 ECU_ADDRESS 0x400022EE /end MEASUREMENT
/begin CHARACTERISTIC dsSTC1_TK_DELTA "Valore isteresi sulla soglia di uscita dalla zona di warning" VALUE 0xFC2C36 Scalar_UWORD 0 FaultChkSTC123100ms_Symbol_CM_uint16_degC 0 500 /end CHARACTERISTIC
/begin CHARACTERISTIC dsSTC2_AUTOD "Flag Abilitazione Diagnosi di plausibilità della Temperatura Catalizzatore - linea STC2" VALUE 0xFC2C2F Scalar_BOOLEAN 0 FaultChkSTC123100ms_Symbol_CM_boolean_adm 0 1 /end CHARACTERISTIC
/begin MEASUREMENT dsSTC2_AutoD "Flag abilitazione diagnosi plausibilità temperatura valle catalizzatore - linea STC2" UBYTE Catt100ms_CM_boolean_adm 0 0 0 1 ECU_ADDRESS 0x400022F1 /end MEASUREMENT
/begin MEASUREMENT dsSTC2_CodErr "Codice di errore linea STC2 sensore temperatura valle catalizzatore" UBYTE Catt100ms_CM_tFault_adm 0 0 0 81 ECU_ADDRESS 0x400022ED /end MEASUREMENT
/begin CHARACTERISTIC dsSTC3_AUTOD "Flag Abilitazione Diagnosi di plausibilità della Temperatura Catalizzatore - linea STC3" VALUE 0xFC2C2E Scalar_BOOLEAN 0 FaultChkSTC123100ms_Symbol_CM_boolean_adm 0 1 /end CHARACTERISTIC
/begin MEASUREMENT dsSTC3_AutoD "Flag abilitazione diagnosi plausibilità temperatura valle catalizzatore - linea STC3" UBYTE Catt100ms_CM_boolean_adm 0 0 0 1 ECU_ADDRESS 0x400022F0 /end MEASUREMENT
/begin MEASUREMENT dsSTC3_CodErr "Codice di errore linea STC3 sensore temperatura valle catalizzatore" UBYTE Catt100ms_CM_tFault_adm 0 0 0 81 ECU_ADDRESS 0x400022EC /end MEASUREMENT
/begin CHARACTERISTIC dsSTC_AUTOD "Flag Abilitazione Diagnosi Temperatura Catalizzatore" VALUE 0xFC2C28 Scalar_BOOLEAN 0 FaultChkSTC100ms_Symbol_CM_boolean_adm 0 1 /end CHARACTERISTIC
/begin MEASUREMENT dsSTC_AutoD "Flag abilitazione diagnosi temperatura valle catalizzatore" UBYTE Catt100ms_CM_boolean_adm 0 0 0 1 ECU_ADDRESS 0x400022F3 /end MEASUREMENT
/begin MEASUREMENT dsSTC_CodErr "Codice di errore linea sensore temperatura valle catalizzatore" UBYTE Catt100ms_CM_tFault_adm 0 0 0 81 ECU_ADDRESS 0x400022EF /end MEASUREMENT
/begin CHARACTERISTIC dsSTC_TKATV_ORH "Soglia Superiore TKATV" VALUE 0xFC2C2C Scalar_UWORD 0 FaultChkSTC100ms_Symbol_CM_ufix16_En10_V 0 5 /end CHARACTERISTIC
/begin CHARACTERISTIC dsSTC_TKATV_ORL "Soglia Inferiore TKATV" VALUE 0xFC2C2A Scalar_UWORD 0 FaultChkSTC100ms_Symbol_CM_ufix16_En10_V 0 5 /end CHARACTERISTIC
/begin CHARACTERISTIC dsSTC_TKAT_RLON "Soglia di passaggio tra la zona di warning e quella di pericolo" VALUE 0xFC2C34 Scalar_UWORD 0 FaultChkSTC123100ms_Symbol_CM_ufix16_Bn40_degC -40 1000 /end CHARACTERISTIC
/begin CHARACTERISTIC dsSTC_TKAT_WLON "Soglia di ingresso nella zona di warning" VALUE 0xFC2C32 Scalar_UWORD 0 FaultChkSTC123100ms_Symbol_CM_ufix16_Bn40_degC -40 1000 /end CHARACTERISTIC
/begin CHARACTERISTIC dsSTEP_ADAT_CNT "Step di incremento del contatore di fault ADAT per ogni CONFIRMED di tale linea" VALUE 0xFC2017 Scalar_BYTE 0 FaultChkADAT2_4ms_CM_int8_adm 0 127 /end CHARACTERISTIC
/begin CHARACTERISTIC dsSTE_AUTOD "ECU Temperature sensor diagnosis enable flag" VALUE 0xFC4D0E Scalar_BOOLEAN 0 FaultChkSTE1s_CM_boolean_adm 0 1 /end CHARACTERISTIC
/begin MEASUREMENT dsSTE_AutoD "Enable Ecu Temperature sensor diagnosis signal" UBYTE Ecut1s_CM_boolean_adm 0 0 0 1 ECU_ADDRESS 0x40002A2F /end MEASUREMENT
/begin MEASUREMENT dsSTE_CodErr "Ecu temperature diagnosis line Error Code " UBYTE Ecut1s_CM_tFault_adm 0 0 0 88 ECU_ADDRESS 0x40002A2D /end MEASUREMENT
/begin CHARACTERISTIC dsSTE_TAIR_THR "Air Temperature threshold above wich the ECU temperature sensor diagnosis is enabled." VALUE 0xFC4D0C Scalar_UWORD 0 FaultChkSTE1s_CM_ufix16_Bn40_V -40 130 /end CHARACTERISTIC
/begin CHARACTERISTIC dsSTE_TECUV_ORH "Voltage higher threshold for ECU temperature sensor. " VALUE 0xFC4D0A Scalar_UWORD 0 FaultChkSTE1s_CM_ufix16_En10_V 0 5 /end CHARACTERISTIC
/begin CHARACTERISTIC dsSTE_TECUV_ORL "Voltage lower threshold for ECU temperature sensor. " VALUE 0xFC4D08 Scalar_UWORD 0 FaultChkSTE1s_CM_ufix16_En10_V 0 5 /end CHARACTERISTIC
/begin CHARACTERISTIC dsSTH_AUTOD "Flag Abilitazione Diagnosi Temperatura Acqua" VALUE 0xFC2C92 Scalar_BOOLEAN 0 FaultChkSTH100ms_Symbol_CM_boolean_adm 0 1 /end CHARACTERISTIC
/begin MEASUREMENT dsSTH_AutoD "Flag abilitazione diagnosi temperatura acqua" UBYTE Coot100ms_CM_boolean_adm 0 0 0 1 ECU_ADDRESS 0x40002357 /end MEASUREMENT
/begin MEASUREMENT dsSTH_CodErr "Codice di errore linea sensore di temperatura acqua" UBYTE Coot100ms_CM_tFault_adm 0 0 0 88 ECU_ADDRESS 0x40002355 /end MEASUREMENT
/begin CHARACTERISTIC dsSTH_TH2OV_ORH "Soglia Superiore TH2OV" VALUE 0xFC2C96 Scalar_UWORD 0 FaultChkSTH100ms_Symbol_CM_ufix16_En10_V 0 5 /end CHARACTERISTIC
/begin CHARACTERISTIC dsSTH_TH2OV_ORL "Soglia Inferiore TH2OV" VALUE 0xFC2C94 Scalar_UWORD 0 FaultChkSTH100ms_Symbol_CM_ufix16_En10_V 0 5 /end CHARACTERISTIC
/begin CHARACTERISTIC dsSTM_AUTOD "Flag Abilitazione Diagnosi Sensore Temperatura Metano nel Rail" VALUE 0xFC5A3C Scalar_BOOLEAN 0 FaultChkSTM100ms_Symbol_CM_boolean_adm 0 1 /end CHARACTERISTIC
/begin MEASUREMENT dsSTM_AutoD "Flag abilitazione diagnosi temperatura metano nel rail" UBYTE Gast100ms_CM_boolean_adm 0 0 0 1 ECU_ADDRESS 0x40002F71 /end MEASUREMENT
/begin MEASUREMENT dsSTM_CodErr "Codice di errore linea sensore temperatura metano nel rail" UBYTE Gast100ms_CM_tFault_adm 0 0 0 81 ECU_ADDRESS 0x40002F70 /end MEASUREMENT
/begin CHARACTERISTIC dsSTM_TFIX "Fix di Temperatura Metano nel Rail" VALUE 0xFC5A42 Scalar_UWORD 0 RecoverySTM100ms_Symbol_CM_ufix16_Bn40_degC -40 150 /end CHARACTERISTIC
/begin CHARACTERISTIC dsSTM_TRAILV_ORH "Soglia Superiore TRAILV" VALUE 0xFC5A40 Scalar_UWORD 0 FaultChkSTM100ms_Symbol_CM_ufix16_En10_V 0 5 /end CHARACTERISTIC
/begin CHARACTERISTIC dsSTM_TRAILV_ORL "Soglia Inferiore TRAILV" VALUE 0xFC5A3E Scalar_UWORD 0 FaultChkSTM100ms_Symbol_CM_ufix16_En10_V 0 5 /end CHARACTERISTIC
/begin MEASUREMENT dsSTOHRec "Valore di recovery GSEC attuato in caso di fault contemporaneo su temperatura acqua e temperatura olio" UWORD Coot100ms_CM_ufix16_Bn40_degC 0 0 -40 130 ECU_ADDRESS 0x40002958 /end MEASUREMENT
/begin MEASUREMENT dsSTOHRecCalc "h2o/oil temperature recovery value" UWORD RecoverySTOH100ms_Symbol_CM_ufix16_Bn40_degC 0 0 -40 140 ECU_ADDRESS 0x4000296A /end MEASUREMENT
/begin MEASUREMENT dsSTOHTFixInit "Temporary h2o/oil temp. recovery value" UWORD RecoverySTOH100ms_Symbol_CM_ufix16_Bn40_degC 0 0 -40 140 ECU_ADDRESS 0x40002968 /end MEASUREMENT
/begin CHARACTERISTIC dsSTOH_AUTOD "Flag Abilitazione Diagnosi Temperatura Acqua e Temperatura Olio contemporaneamente in fault" VALUE 0xFC4C27 Scalar_BOOLEAN 0 FaultChkSTOH100ms_Symbol_CM_boolean_adm 0 1 /end CHARACTERISTIC
/begin MEASUREMENT dsSTOH_AutoD "Flag abilitazione diagnosi temperatura olio e temperatura acqua" UBYTE Diag_LineSTOH100ms_CM_boolean_adm 0 0 0 1 ECU_ADDRESS 0x40002957 /end MEASUREMENT
/begin CHARACTERISTIC dsSTOH_CNT_TOT "Durata della rampa di raccordo sulla Temperatura di recovery in caso di fault contemporaneo sui sensori Temperatura ACQUA e OLIO" VALUE 0xFC4C2C Scalar_UWORD 0 RecoverySTOH100ms_Symbol_CM_ufix16_Sp1_s 0.1 3200 /end CHARACTERISTIC
/begin MEASUREMENT dsSTOH_CodErr "Codice di errore linea di diagnosi sensore temperatura olio e temperatura acqua in fault" UBYTE Diag_LineSTOH100ms_CM_tFault_adm 0 0 0 83 ECU_ADDRESS 0x40002956 /end MEASUREMENT
/begin CHARACTERISTIC dsSTOH_TFIX_F "Temperatura finale del filtro sulla temperatura di recovery" VALUE 0xFC4C2A Scalar_UWORD 0 RecoverySTOH100ms_Symbol_CM_ufix16_Bn40_degC -40 130 /end CHARACTERISTIC
/begin CHARACTERISTIC dsSTOH_TFIX_I "Temperatura iniziale del filtro sulla temperatura di recovery" VALUE 0xFC4C28 Scalar_UWORD 0 RecoverySTOH100ms_Symbol_CM_ufix16_Bn40_degC -40 130 /end CHARACTERISTIC
/begin CHARACTERISTIC dsSTO_AUTOD "Flag Abilitazione Diagnosi Temperatura Olio" VALUE 0xFCAC06 Scalar_BOOLEAN 0 FaultChkSTO100ms_CM_boolean_adm 0 1 /end CHARACTERISTIC
/begin MEASUREMENT dsSTO_AutoD "Flag abilitazione diagnosi temperatura olio" UBYTE Oilt100ms_CM_boolean_adm 0 0 0 1 ECU_ADDRESS 0x40003F28 /end MEASUREMENT
/begin MEASUREMENT dsSTO_CodErr "Codice di errore linea sensore di tempatura olio" UBYTE Oilt100ms_CM_tFault_adm 0 0 0 88 ECU_ADDRESS 0x40003F27 /end MEASUREMENT
/begin CHARACTERISTIC dsSTO_TOILV_ORH "Soglia Superiore TOILV" VALUE 0xFCAC04 Scalar_UWORD 0 FaultChkSTO100ms_CM_ufix16_En10_V 0 5 /end CHARACTERISTIC
/begin CHARACTERISTIC dsSTO_TOILV_ORL "Soglia Inferiore TOILV" VALUE 0xFCAC02 Scalar_UWORD 0 FaultChkSTO100ms_CM_ufix16_En10_V 0 5 /end CHARACTERISTIC
/begin MEASUREMENT dsSTRADiagStat "Starter relay active diagnosis state (UNKNOWN = 39, STOPPED = 0 DURING =1 END = 2 IMPOSSIBLE = 3)" UBYTE Crkc4ms_CM_uint8_adm 0 0 0 255 ECU_ADDRESS 0x400023C3 /end MEASUREMENT
/begin CHARACTERISTIC dsSTRCGNDOL_AUTOD "Enable flag of the diagnostic line detecting starter relay command shortcut to ground or Open Load" VALUE 0xFC2D0A Scalar_BOOLEAN 0 FaultChkELTSTR4ms_CM_boolean_adm 0 1 /end CHARACTERISTIC
/begin MEASUREMENT dsSTRCGNDOL_AdiaEn "Abilitazione dell`automa di diagnosi per la linea STRGNDOL" UBYTE Crkc4ms_CM_boolean_adm 0 0 0 1 ECU_ADDRESS 0x40002394 /end MEASUREMENT
/begin MEASUREMENT dsSTRCGNDOL_Autod "Starter relay command shortcut to ground or open load diagnostic line enable flag" UBYTE Crkc4ms_CM_boolean_adm 0 0 0 1 ECU_ADDRESS 0x40002395 /end MEASUREMENT
/begin MEASUREMENT dsSTRCGNDOL_CodErr "Codici Errore Linea STRCGNDOL" UBYTE Crkc4ms_CM_tFault_adm 0 0 0 88 ECU_ADDRESS 0x4000238C /end MEASUREMENT
/begin CHARACTERISTIC dsSTRCVB_AUTOD "Enable flag of the diagnostic line detecting starter relay command shortcut to battery" VALUE 0xFC2D09 Scalar_BOOLEAN 0 FaultChkELTSTR4ms_CM_boolean_adm 0 1 /end CHARACTERISTIC
/begin MEASUREMENT dsSTRCVB_AdiaEn "Error validation state machine enable" UBYTE Crkc4ms_CM_boolean_adm 0 0 0 1 ECU_ADDRESS 0x40002396 /end MEASUREMENT
/begin MEASUREMENT dsSTRCVB_Autod "Starter relay command shortcut to battery - diagnostic line enable flag" UBYTE Crkc4ms_CM_boolean_adm 0 0 0 1 ECU_ADDRESS 0x40002397 /end MEASUREMENT
/begin MEASUREMENT dsSTRCVB_CodErr "Error code of diagnostic line detecting starter relay command shortcut to battery" UBYTE Crkc4ms_CM_tFault_adm 0 0 0 88 ECU_ADDRESS 0x4000238D /end MEASUREMENT
/begin CHARACTERISTIC dsSTRPON_AUTOD "Starter relay diagnosis at power on enable flag" VALUE 0xFC2D08 Scalar_BOOLEAN 0 TF_TE_DiagSTR_PON4ms_CM_boolean_adm 0 1 /end CHARACTERISTIC
/begin CHARACTERISTIC dsSTR_TIMEOFF "Steps for diagnosis at power on with starter relay not driven by ECU" VALUE 0xFC2D06 Scalar_UWORD 0 TF_TE_DiagSTR_PON4ms_CM_ufix16_E2_ms 0 12000 /end CHARACTERISTIC
/begin MEASUREMENT dsSTRel "Starter relay command after the recovery" UBYTE Crkc4ms_CM_boolean_adm 0 0 0 1 ECU_ADDRESS 0x40002392 /end MEASUREMENT
/begin CHARACTERISTIC dsSTX_AUTOD "Exhaust manifold Temperature sensor diagnosis enable flag" VALUE 0xFC55D2 Scalar_BOOLEAN 0 FaultChkSTX100ms_CM_boolean_adm 0 1 /end CHARACTERISTIC
/begin MEASUREMENT dsSTX_AutoD "Exhaust manifold temperature enable sensor diagnosis signal." UBYTE Egt100ms_CM_boolean_adm 0 0 0 1 ECU_ADDRESS 0x40002C0D /end MEASUREMENT
/begin MEASUREMENT dsSTX_CodErr "exhaust manifold temperature sensor error code." UBYTE Egt100ms_CM_tFault_adm 0 0 0 88 ECU_ADDRESS 0x40002C0C /end MEASUREMENT
/begin CHARACTERISTIC dsSTX_TEXHV_ORH "Voltage higher threshold for exhaust manifold temperature sensor. " VALUE 0xFC55D0 Scalar_UWORD 0 FaultChkSTX100ms_CM_ufix16_En10_V 0 5 /end CHARACTERISTIC
/begin CHARACTERISTIC dsSTX_TEXHV_ORL "Voltage lower threshold for exhaust manifold temperature sensor. " VALUE 0xFC55CE Scalar_UWORD 0 FaultChkSTX100ms_CM_ufix16_En10_V 0 5 /end CHARACTERISTIC
/begin CHARACTERISTIC dsSTZ_UP_RPM "Pre-condizione sui giri per il riconoscimento dello stazionario per la diagnosi di secondo livello" VALUE 0xFCB586 Scalar_UWORD 0 TE_TM_CheckStazDiag_50ms_Symbol_CM_uint16_rpm 0 10000 /end CHARACTERISTIC
/begin CHARACTERISTIC dsSTZ_UP_TAIR "Pre-condizione sulla temperatura aria per il riconoscimento dello stazionario per la diagnosi di secondo livello" VALUE 0xFCB584 Scalar_UWORD 0 TE_TM_CheckStazDiag_50ms_Symbol_CM_ufix16_Bn40_degC -40 130 /end CHARACTERISTIC
/begin CHARACTERISTIC dsSTZ_UP_TH2O "Pre-condizione sulla temperatura acqua motore per il riconoscimento dello stazionario per la diagnosi di secondo livello" VALUE 0xFCB582 Scalar_UWORD 0 TE_TM_CheckStazDiag_50ms_Symbol_CM_ufix16_Bn40_degC -40 130 /end CHARACTERISTIC
/begin CHARACTERISTIC dsSTZ_UP_VBATT "Pre-condizione sulla tensione batteria per il riconoscimento dello stazionario per la diagnosi di secondo livello" VALUE 0xFCB580 Scalar_UWORD 0 TE_TM_CheckStazDiag_50ms_Symbol_CM_ufix16_S50_mV 12000 36000 /end CHARACTERISTIC
/begin CHARACTERISTIC dsSUO_AUTOD "Enable of the diagnostic line IDN_SUO related to Uego sensor" VALUE 0xFC9C62 Scalar_BOOLEAN 0 FaultChkSUO4ms_CM_boolean_adm 0 1 /end CHARACTERISTIC
/begin MEASUREMENT dsSUO_AdiaEn "Error validation state machine enable (SUO)" UBYTE Lamm4ms_CM_boolean_adm 0 0 0 1 ECU_ADDRESS 0x400036F3 /end MEASUREMENT
/begin MEASUREMENT dsSUO_CodErr "UEGO Lambda pre diagnostic line code error (SUO)" UBYTE Lamm4ms_CM_tFault_adm 0 0 0 88 ECU_ADDRESS 0x400036F1 /end MEASUREMENT
/begin MEASUREMENT dsSogliaAdat "Test point sulla grandezza da diagnosticare nella linea ADAT" UWORD FaultChkADATTDC_CM_ufix16_En12_adm 0 0 0.125 7.5 ECU_ADDRESS 0x400021BE /end MEASUREMENT
/begin MEASUREMENT dsSppRecNull "Valore di recovery inferiore sul pedale acceleratore" UWORD Pacc4ms_CM_ufix16_En10_V 0 0 0 5 ECU_ADDRESS 0x40003F6E /end MEASUREMENT
/begin MEASUREMENT dsSppRecVal "Delta per calcolo del valore di recovery intermedio sul pedale acceleratore" UWORD Pacc4ms_CM_ufix16_En10_V 0 0 0 5 ECU_ADDRESS 0x40003F70 /end MEASUREMENT
/begin MEASUREMENT dsStChkStzQ "Flag di stato della condizione di stazionario per Diagnosi di secondo livello" UBYTE TE_TM_CheckStazDiag_50ms_Symbol_CM_boolean_adm 0 0 0 1 ECU_ADDRESS 0x400041C0 /end MEASUREMENT
/begin MEASUREMENT dsStazCond "Flag di stato che descrive lo stato stazionario del motore per effetuare la diagnosi di secondo livello sulla Qair" UBYTE Thrp_Mgmt50ms_CM_boolean_adm 0 0 0 1 ECU_ADDRESS 0x400041AD /end MEASUREMENT
/begin MEASUREMENT dsTAirPostD "Air temperature sensor post diagnosis value" UWORD RecoverySTA100ms_Symbol_CM_ufix16_En10_V 0 0 0 5 ECU_ADDRESS 0x40002050 /end MEASUREMENT
/begin MEASUREMENT dsTAirRec "Valore di recovery GSEC della temperatura aria" UWORD Airt100ms_CM_ufix16_Bn40_degC 0 0 -40 130 ECU_ADDRESS 0x40002036 /end MEASUREMENT
/begin MEASUREMENT dsTAirV "Temperatura aria in volt elaborata dal blocco di recovery" UWORD Airt100ms_CM_ufix16_En10_V 0 0 0 5 ECU_ADDRESS 0x4000202E /end MEASUREMENT
/begin MEASUREMENT dsTAirVPreR "Temperatura aria in volt elaborata dal blocco di recovery" UWORD Airt100ms_CM_ufix16_En10_V 0 0 0 5 ECU_ADDRESS 0x40002030 /end MEASUREMENT
/begin CHARACTERISTIC dsTE2H_AUTOD "ECU Temperature too high diagnosis enable flag" VALUE 0xFC4D06 Scalar_BOOLEAN 0 FaultChkTE2H1s_CM_boolean_adm 0 1 /end CHARACTERISTIC
/begin MEASUREMENT dsTE2H_AutoD "Enable Temperature too high diagnosis signal" UBYTE Ecut1s_CM_boolean_adm 0 0 0 1 ECU_ADDRESS 0x40002A2E /end MEASUREMENT
/begin MEASUREMENT dsTE2H_CodErr "Ecu temperature too high diagnosis line Error Code " UBYTE Ecut1s_CM_tFault_adm 0 0 0 88 ECU_ADDRESS 0x40002A2C /end MEASUREMENT
/begin CHARACTERISTIC dsTE2H_THR "Ecu too high Temperature threshold " VALUE 0xFC4D04 Scalar_UWORD 0 FaultChkTE2H1s_CM_ufix16_Bn40_degC -40 150 /end CHARACTERISTIC
/begin CHARACTERISTIC dsTE2H_TIME_THR "Time threshold above wich an Ecu overtemperature is signaled." VALUE 0xFC4D02 Scalar_UWORD 0 FaultChkTE2H1s_CM_uint16_s 0 3600 /end CHARACTERISTIC
/begin MEASUREMENT dsTECURec "ECU temperature recovery value (GSEC)" UWORD Ecut1s_CM_ufix16_Bn40_degC 0 0 -40 150 ECU_ADDRESS 0x40002A30 /end MEASUREMENT
/begin MEASUREMENT dsTECUVPostD "ECU temperature sensor post diagnosis value" UWORD RecoverySTE1s_CM_ufix16_En10_V 0 0 0 5 ECU_ADDRESS 0x40002A9E /end MEASUREMENT
/begin MEASUREMENT dsTECUVPreR "Voltage ECU temperature sensor (used by recovery)" UWORD Ecut1s_CM_ufix16_En10_V 0 0 0 5 ECU_ADDRESS 0x40002A38 /end MEASUREMENT
/begin CHARACTERISTIC dsTECU_TFIX "ECU Temperature recovery value" VALUE 0xFC4D00 Scalar_UWORD 0 RecoverySTE1s_CM_ufix16_Bn40_degC -40 150 /end CHARACTERISTIC
/begin CHARACTERISTIC dsTEXH_TFIX "Exhaust manifold temperature recovery value" VALUE 0xFC55CC Scalar_UWORD 0 RecoverySTX100ms_CM_ufix16_Bn40_degC -40 1000 /end CHARACTERISTIC
/begin MEASUREMENT dsTExhRec "Exhaust manifold temperature recovery value " UWORD Egt100ms_CM_ufix16_Bn40_degC 0 0 -40 1000 ECU_ADDRESS 0x40002C0E /end MEASUREMENT
/begin MEASUREMENT dsTExhV "Exhaust manifold temperature sensor voltage (used by recovery)" UWORD Egt100ms_CM_ufix16_En10_V 0 0 0 5 ECU_ADDRESS 0x40002C14 /end MEASUREMENT
/begin MEASUREMENT dsTExhVPostD "Exhaust manifold temperature sensor post diagnosis value" UWORD RecoverySTX100ms_CM_ufix16_En10_V 0 0 0 5 ECU_ADDRESS 0x40002C2C /end MEASUREMENT
/begin MEASUREMENT dsTExhVPreR "Exhaust manifold temperature sensor voltage (used by recovery)" UWORD Egt100ms_CM_ufix16_En10_V 0 0 0 5 ECU_ADDRESS 0x40002C16 /end MEASUREMENT
/begin CHARACTERISTIC dsTH2H_AUTOD "Flag Abilitazione Diagnosi Temperatura Acqua alta" VALUE 0xFC2C98 Scalar_BOOLEAN 0 FaultChkTH2H100ms_Symbol_CM_boolean_adm 0 1 /end CHARACTERISTIC
/begin MEASUREMENT dsTH2H_AutoD "Abilitazione alla linea di diagnosi TH2H" UBYTE Coot100ms_CM_boolean_adm 0 0 0 1 ECU_ADDRESS 0x40002356 /end MEASUREMENT
/begin CHARACTERISTIC dsTH2H_CNT_THR "Tempo dopo il quale può essere abilitata la diagnosi temperatura acqua alta" VALUE 0xFC2CA0 Scalar_ULONG 0 FaultChkTH2H100ms_Symbol_CM_ufix32_Sp1_s 0 429496729.5 /end CHARACTERISTIC
/begin MEASUREMENT dsTH2H_CodErr "Codice di errore della linea di diagnosi TH2H" UBYTE Coot100ms_CM_tFault_adm 0 0 0 88 ECU_ADDRESS 0x40002354 /end MEASUREMENT
/begin CHARACTERISTIC dsTH2H_RPM_THR "Soglia in giri per abilitazione Diagnosi Temperatura Acqua alta" VALUE 0xFC2C9A Scalar_UWORD 0 FaultChkTH2H100ms_Symbol_CM_uint16_rpm 0 10000 /end CHARACTERISTIC
/begin MEASUREMENT dsTH2OPostD "H2o temperature sensor post diagnosis value" UWORD RecoverySTH100ms_CM_ufix16_En10_V 0 0 0 5 ECU_ADDRESS 0x40002370 /end MEASUREMENT
/begin CHARACTERISTIC dsTH2O_MAX_THRST "Soglia Th20 superiore per diagnosi THRST" VALUE 0xFC56E4 Scalar_UWORD 0 TE_TM_CndAbilTHRST4ms_CM_ufix16_Bn40_degC -40 140 /end CHARACTERISTIC
/begin CHARACTERISTIC dsTH2O_MIN_THRST "Soglia Th20 inferiore per diagnosi THRST" VALUE 0xFC56E2 Scalar_UWORD 0 TE_TM_CndAbilTHRST4ms_CM_ufix16_Bn40_degC -40 140 /end CHARACTERISTIC
/begin CHARACTERISTIC dsTH2O_REC "Th2o Recovery value if Oil temperature sensor unavailable" VALUE 0xFC2C90 Scalar_UWORD 0 RecoverySTH100ms_CM_ufix16_Bn40_degC -40 130 /end CHARACTERISTIC
/begin CHARACTERISTIC dsTHRCGND_AUTOD "Abilitazione della linea di diagnosi THRCVB" VALUE 0xFC56E0 Scalar_BOOLEAN 0 FaultChkELTTHR4ms_CM_boolean_adm 0 1 /end CHARACTERISTIC
/begin MEASUREMENT dsTHRCGND_AdiaEn "Abilitazione automa di diagnosi della linea THRCGND" UBYTE Ethrc4ms_CM_boolean_adm 0 0 0 1 ECU_ADDRESS 0x40002C5E /end MEASUREMENT
/begin MEASUREMENT dsTHRCGND_CodErr "Codice di errore della linea di diagnosi THRCGND" UBYTE Ethrc4ms_CM_tFault_adm 0 0 0 88 ECU_ADDRESS 0x40002C53 /end MEASUREMENT
/begin CHARACTERISTIC dsTHRCVB_AUTOD "Abilitazione della linea di diagnosi THRCVB" VALUE 0xFC56DF Scalar_BOOLEAN 0 FaultChkELTTHR4ms_CM_boolean_adm 0 1 /end CHARACTERISTIC
/begin MEASUREMENT dsTHRCVB_AdiaEn "Abilitazione automa di diagnosi della linea THRCVB" UBYTE Ethrc4ms_CM_boolean_adm 0 0 0 1 ECU_ADDRESS 0x40002C60 /end MEASUREMENT
/begin MEASUREMENT dsTHRCVB_CodErr "Codice di errore della linea di diagnosi THRCVB" UBYTE Ethrc4ms_CM_tFault_adm 0 0 0 88 ECU_ADDRESS 0x40002C55 /end MEASUREMENT
/begin CHARACTERISTIC dsTHRDR_AUTOD "Abilitazione della linea di diagnosi THRDR" VALUE 0xFC56DE Scalar_BOOLEAN 0 FaultChkELTTHR4ms_CM_boolean_adm 0 1 /end CHARACTERISTIC
/begin MEASUREMENT dsTHRDR_AdiaEn "Abilitazione automa di diagnosi della linea THRDR" UBYTE Ethrc4ms_CM_boolean_adm 0 0 0 1 ECU_ADDRESS 0x40002C5F /end MEASUREMENT
/begin MEASUREMENT dsTHRDR_CodErr "Codice di errore della linea di diagnosi THRDR" UBYTE Ethrc4ms_CM_tFault_adm 0 0 0 88 ECU_ADDRESS 0x40002C54 /end MEASUREMENT
/begin CHARACTERISTIC dsTHROT_ST_RANGE "Margine di errore nel riconoscimento stazionari farfalla" VALUE 0xFC56EC Scalar_UWORD 0 TE_TM_FaultChkTHRST4ms_Symbol_CM_ufix16_En8__ 0 110 /end CHARACTERISTIC
/begin CHARACTERISTIC dsTHROT_ST_TIME_POT "Margine di tempo nel riconoscimento stazionari posizione misurata farfalla" VALUE 0xFC56F4 Scalar_ULONG 0 TE_TM_FaultChkTHRST4ms_Symbol_CM_ufix32_Sp004_s 0 17179869.18 /end CHARACTERISTIC
/begin CHARACTERISTIC dsTHROT_ST_TIME_REF "Margine di tempo nel riconoscimento stazionari obiettivo farfalla" VALUE 0xFC56F0 Scalar_ULONG 0 TE_TM_FaultChkTHRST4ms_Symbol_CM_ufix32_Sp004_s 0 17179869.18 /end CHARACTERISTIC
/begin CHARACTERISTIC dsTHRST_AUTOD "Abilitazione della linea di diagnosi THRST" VALUE 0xFC56E8 Scalar_BOOLEAN 0 TE_TM_FaultChkTHRST4ms_Symbol_CM_boolean_adm 0 1 /end CHARACTERISTIC
/begin MEASUREMENT dsTHRST_AdiaEn "Abilitazione automa di diagnosi della linea THRST" UBYTE Ethrc4ms_CM_boolean_adm 0 0 0 1 ECU_ADDRESS 0x40002C58 /end MEASUREMENT
/begin MEASUREMENT dsTHRST_CodErr "Codice di errore della linea di diagnosi THRST" UBYTE Ethrc4ms_CM_tFault_adm 0 0 0 88 ECU_ADDRESS 0x40002C52 /end MEASUREMENT
/begin CHARACTERISTIC dsTHRST_ERR_MAX "Soglia di errore tra obiettivo e lettura farfalla per diagnosi THRST" VALUE 0xFC56EA Scalar_UWORD 0 TE_TM_FaultChkTHRST4ms_Symbol_CM_ufix16_En8__ 0 110 /end CHARACTERISTIC
/begin MEASUREMENT dsTHRST_FlgPotenzSt "lag riconoscimento stazionario lettura farfalla per la diagnosi THRST" UBYTE Ethrc4ms_CM_boolean_adm 0 0 0 1 ECU_ADDRESS 0x40002C56 /end MEASUREMENT
/begin MEASUREMENT dsTHRST_FlgRefSt "lag riconoscimento stazionario obiettivo farfalla per la diagnosi THRST" UBYTE Ethrc4ms_CM_boolean_adm 0 0 0 1 ECU_ADDRESS 0x40002C57 /end MEASUREMENT
/begin CHARACTERISTIC dsTHR_GAP "Scarto ammissibile in volt tra potenziometro primario e potenziometro secondario" VALUE 0xFCB480 Scalar_UWORD 0 TE_TM_FaultChkFARCH4ms_Symbol_CM_ufix16_En10_V 0 5 /end CHARACTERISTIC
/begin MEASUREMENT dsTKLOnDeltaTime "Durata ultimo evento con veicolo in marcia con la Red Lamp accesa - valore da salvare in EEPROM al termine del trip" ULONG Catt100ms_CM_ufix32_Sp1_s 0 0 0 429496729.5 ECU_ADDRESS 0x400022FC /end MEASUREMENT
/begin MEASUREMENT dsTKLOnTime "Tempo totale con veicolo in marcia con la Red Lamp accesa - valore da salvare in EEPROM al termine del trip" ULONG Catt100ms_CM_ufix32_Sp1_s 0 0 0 429496729.5 ECU_ADDRESS 0x40002300 /end MEASUREMENT
/begin MEASUREMENT dsTKatV "Temperatura valle catalizzatore in volt elaborata dal blocco di recovery" UWORD Catt100ms_CM_ufix16_En10_V 0 0 0 5 ECU_ADDRESS 0x400022F8 /end MEASUREMENT
/begin MEASUREMENT dsTKatVPreR "Temperatura valle catalizzatore in volt elaborata dal blocco di recovery" UWORD Catt100ms_CM_ufix16_En10_V 0 0 0 5 ECU_ADDRESS 0x400022FA /end MEASUREMENT
/begin MEASUREMENT dsTLambdaOK "Lambda temperature OK flag after recovery" UBYTE Ctit_LambdaCtrlTDC_CM_boolean_adm 0 0 0 1 ECU_ADDRESS 0x4000250D /end MEASUREMENT
/begin MEASUREMENT dsTLambdaOKPostR "Flag riscaldatore sonda lambda settato a 1 dopo la fase di riscaldamento post recovery" UBYTE RecoveryLHR100ms_CM_boolean_adm 0 0 0 1 ECU_ADDRESS 0x400025B4 /end MEASUREMENT
/begin MEASUREMENT dsTOilPostD "h2o temperature sensor post diagnosis value" UWORD RecoverySTO100ms_Symbol_CM_ufix16_En10_V 0 0 0 5 ECU_ADDRESS 0x40003F3A /end MEASUREMENT
/begin MEASUREMENT dsTOilRec "Valore di recovery GSEC della temperatura olio" UWORD Oilt100ms_CM_ufix16_Bn40_degC 0 0 -40 130 ECU_ADDRESS 0x40003F2A /end MEASUREMENT
/begin MEASUREMENT dsTOilV "Temperatura olio in volt elaborata dal blocco di recovery" UWORD Oilt100ms_CM_ufix16_En10_V 0 0 0 5 ECU_ADDRESS 0x40003F30 /end MEASUREMENT
/begin MEASUREMENT dsTOilVPreR "Temperatura olio in volt elaborata dal blocco di recovery" UWORD Oilt100ms_CM_ufix16_En10_V 0 0 0 5 ECU_ADDRESS 0x40003F32 /end MEASUREMENT
/begin CHARACTERISTIC dsTREF_PERC_MAX_THRST "Soglia superiore di percentuale farfalla obiettivo per diagnosi THRST" VALUE 0xFC56DC Scalar_SWORD 0 TE_TM_CndAbilTHRST4ms_CM_sfix16_En8__ -10 100 /end CHARACTERISTIC
/begin CHARACTERISTIC dsTREF_PERC_MIN_THRST "Soglia inferiore di percentuale farfalla obiettivo per diagnosi THRST" VALUE 0xFC56DA Scalar_SWORD 0 TE_TM_CndAbilTHRST4ms_CM_sfix16_En8__ -10 100 /end CHARACTERISTIC
/begin MEASUREMENT dsTROpenCL "lag di apertura controllo titolo in loop chiuso per torque reduction" UBYTE Fuels_CtrlMgmtTDC_CM_boolean_adm 0 0 0 1 ECU_ADDRESS 0x400041E1 /end MEASUREMENT
/begin MEASUREMENT dsTRailInit "Init della temp. aria in caso di fault del sensore prima dellÿesaurimento del warm up" UWORD RecoverySTA100ms_Symbol_CM_ufix16_Bn40_degC 0 0 -40 130 ECU_ADDRESS 0x4000204E /end MEASUREMENT
/begin MEASUREMENT dsTRailPostD "Atmospheric pressure sensor post diagnosis value" UWORD RecoverySTM100ms_Symbol_CM_ufix16_En10_V 0 0 0 5 ECU_ADDRESS 0x40002F82 /end MEASUREMENT
/begin MEASUREMENT dsTRailRec "Valore di recovery GSEC della temperatura metano nel rail" UWORD Gast100ms_CM_ufix16_Bn40_degC 0 0 -40 150 ECU_ADDRESS 0x40002F76 /end MEASUREMENT
/begin MEASUREMENT dsTRailV "Temperatura metano nel rail in volt elaborata dal blocco di recovery" UWORD Gast100ms_CM_ufix16_En10_V 0 0 0 5 ECU_ADDRESS 0x40002F78 /end MEASUREMENT
/begin MEASUREMENT dsTRailVPreR "Temperatura metano nel rail in volt elaborata dal blocco di recovery" UWORD Gast100ms_CM_ufix16_En10_V 0 0 0 5 ECU_ADDRESS 0x40002F7A /end MEASUREMENT
/begin MEASUREMENT dsTempLambdaOK "Lambda temperature OK flag after Lambda source selection" UBYTE Ctit_LambdaCtrlTDC_CM_boolean_adm 0 0 0 1 ECU_ADDRESS 0x400023CF /end MEASUREMENT
/begin MEASUREMENT dsTh2oRec "Valore di recovery GSEC della temperatura acqua" UWORD Coot100ms_CM_ufix16_Bn40_degC 0 0 -40 140 ECU_ADDRESS 0x40002360 /end MEASUREMENT
/begin MEASUREMENT dsTh2oV "Temperatura acqua in volt elaborata dal blocco di recovery" UWORD Coot100ms_CM_ufix16_En10_V 0 0 0 5 ECU_ADDRESS 0x4000235A /end MEASUREMENT
/begin MEASUREMENT dsTh2oVPreR "Temperatura acqua in volt elaborata dal blocco di recovery" UWORD Coot100ms_CM_ufix16_En10_V 0 0 0 5 ECU_ADDRESS 0x40002358 /end MEASUREMENT
/begin MEASUREMENT dsThrRefDelta "Delta riferimento obiettivo alla fine del transitorio dell obiettivo (per sviluppo)" SWORD TE_TM_FaultChkTHRST4ms_Symbol_CM_sfix16_En8__ 0 0 -120 120 ECU_ADDRESS 0x40002C8A /end MEASUREMENT
/begin MEASUREMENT dsThrRefTranTime "Durata del transitorio dell obiettivo (per sviluppo)" ULONG TE_TM_FaultChkTHRST4ms_Symbol_CM_ufix32_Sp004_s 0 0 0 17179869.18 ECU_ADDRESS 0x40002C90 /end MEASUREMENT
/begin MEASUREMENT dsThrotPos2VPreR "Segnale posizione farfalla in volt elaborata dal blocco di recovery sul potenziometro secondario" UWORD Thrp4ms_CM_ufix16_En10_V 0 0 0 5 ECU_ADDRESS 0x40004106 /end MEASUREMENT
/begin MEASUREMENT dsThrotPosVPreR "Segnale posizione farfalla in volt elaborata dal blocco di recovery" UWORD Thrp4ms_CM_ufix16_En10_V 0 0 0 5 ECU_ADDRESS 0x40004108 /end MEASUREMENT
/begin MEASUREMENT dsThrotRefEnd "Valore del riferimento obiettivo farfalla alla fine del transitorio" SWORD TE_TM_FaultChkTHRST4ms_Symbol_CM_sfix16_En8__ 0 0 -10 110 ECU_ADDRESS 0x40002C88 /end MEASUREMENT
/begin MEASUREMENT dsThrotRefPercStaz "Valore del riferimento obiettivo farfalla alla fine del transitorio" SWORD TE_TM_FaultChkTHRST4ms_Symbol_CM_sfix16_En8__ 0 0 -10 110 ECU_ADDRESS 0x40002C86 /end MEASUREMENT
/begin MEASUREMENT dsThrotRefStart "Valore del riferimento obiettivo farfalla all inizio del transitorio" SWORD TE_TM_FaultChkTHRST4ms_Symbol_CM_sfix16_En8__ 0 0 -10 110 ECU_ADDRESS 0x40002C84 /end MEASUREMENT
/begin MEASUREMENT dsTorRed_CyCuOf "Torque Reduction actuated" UBYTE Thrp_Torque2CylCutOffTDC_CM_ufix8_S5__ 0 0 0 100 ECU_ADDRESS 0x400041E0 /end MEASUREMENT
/begin MEASUREMENT dsTrigAutoma "Abilitazione lettura codice errore dell`automa relativo alla linea SLO" UBYTE Ctit_LambdaPreDiag4ms_CM_boolean_adm 0 0 0 1 ECU_ADDRESS 0x400025BE /end MEASUREMENT
/begin CHARACTERISTIC dsUDP_AUTOD "Enable of the diagnostic line IDN_UDP related to Uego sensor driver chip " VALUE 0xFC9C61 Scalar_BOOLEAN 0 FaultChkUDP4ms_CM_boolean_adm 0 1 /end CHARACTERISTIC
/begin MEASUREMENT dsUDP_AdiaEn "Error validation state machine enable (UDP)" UBYTE Lamm4ms_CM_boolean_adm 0 0 0 1 ECU_ADDRESS 0x400036F2 /end MEASUREMENT
/begin MEASUREMENT dsUDP_CodErr "UEGO Lambda pre driver chip diagnostic line code error (UDP)" UBYTE Lamm4ms_CM_tFault_adm 0 0 0 88 ECU_ADDRESS 0x400036F0 /end MEASUREMENT
/begin CHARACTERISTIC dsUEGO_CL_RANGE_ENABLE "Enable for the diagnosis on the UEGO Heater Control range" VALUE 0xFC47E6 Scalar_BOOLEAN 0 UEGOHeater4ms_CM_boolean 0 1 /end CHARACTERISTIC
/begin CHARACTERISTIC dsUEGO_TEMP_ERROR_THR "Threshold for UEGO Temperature range erorr diagnosys" VALUE 0xFC47E4 Scalar_UWORD 0 UEGOHeater4ms_CM_ufix16_En6 0 1023.984375 /end CHARACTERISTIC
/begin CHARACTERISTIC dsUEGO_TEMP_ERROR_TIMER "Timer for UEGO Temperature range erorr diagnosis" VALUE 0xFC47E2 Scalar_UWORD 0 UEGOHeater4ms_CM_uint16 0 36000 /end CHARACTERISTIC
/begin CHARACTERISTIC dsUHR_AUTOD "Enable of the diagnostic line IDN_UHR related to Uego heater" VALUE 0xFC47E1 Scalar_BOOLEAN 0 FaultChkUHR4ms_CM_boolean_adm 0 1 /end CHARACTERISTIC
/begin MEASUREMENT dsUHR_AdiaEn "Error validation state machine enable (UHR)" UBYTE Ctit_UEGOHeater4ms_CM_boolean_adm 0 0 0 1 ECU_ADDRESS 0x400025DA /end MEASUREMENT
/begin MEASUREMENT dsUHR_CodErr "UEGO Heater Lambda pre diagnostic line code error (UHR)" UBYTE Ctit_UEGOHeater4ms_CM_tFault_adm 0 0 0 88 ECU_ADDRESS 0x400025D4 /end MEASUREMENT
/begin MEASUREMENT dsUegoCLRangeActive "Diagnosys on UEGO Heater Teperature active" UBYTE Ctit_LambdaCtrlTDC_CM_boolean 0 0 0 1 ECU_ADDRESS 0x400025D6 /end MEASUREMENT
/begin MEASUREMENT dsUegoCLRangeEnable "Enable of diagnosys on UEGO heater temperature control" UBYTE Ctit_UEGOHeater4ms_CM_boolean 0 0 0 1 ECU_ADDRESS 0x400025D7 /end MEASUREMENT
/begin MEASUREMENT dsUegoHeaterDC "UEGO Heater PWM command after the recovery (UHR)" ULONG Ctit_UEGOHeater4ms_CM_ufix32_En24__ 0 0 0 100 ECU_ADDRESS 0x400025E4 /end MEASUREMENT
/begin MEASUREMENT dsUegoheaterDCPostR "UEGO Heater PWM duty cycle Post Recovery" ULONG RecoveryUHR4ms_CM_ufix32_En24__ 0 0 0 100 ECU_ADDRESS 0x400025E8 /end MEASUREMENT
/begin MEASUREMENT dsUmaMax "Massimo valore di UMA (ammesso da data sheet)" UWORD Ethrl4ms_CM_ufix16_En10_V 0 0 0 5 ECU_ADDRESS 0x40002D34 /end MEASUREMENT
/begin MEASUREMENT dsVBPWV "Tensione valle relè carichi riscalata tra 0 e 5 Volt ed elaborata dal blocco di recovery" UWORD Vbpw4ms_CM_ufix16_En10_V 0 0 0 5 ECU_ADDRESS 0x4000456C /end MEASUREMENT
/begin MEASUREMENT dsVBPWVPreR "Tensione valle relè carichi riscalata tra 0 e 5 Volt ed elaborata dal blocco di recovery" UWORD Vbpw4ms_CM_ufix16_En10_V 0 0 0 5 ECU_ADDRESS 0x4000456E /end MEASUREMENT
/begin CHARACTERISTIC dsVBPW_MIN_THRST "Soglia tensione batteria inferiore per diagnosi THRST" VALUE 0xFC56D8 Scalar_UWORD 0 TE_TM_CndAbilTHRST4ms_CM_ufix16_S50_mV 12000 36000 /end CHARACTERISTIC
/begin CHARACTERISTIC dsVBP_AB_TIME "Soglia in tempo per abilitazione diagnosi" VALUE 0xFCC62E Scalar_UWORD 0 FaultChkVBP4ms_CM_ufix16_En8_s 0 50 /end CHARACTERISTIC
/begin CHARACTERISTIC dsVBP_AUTOD "Flag Abilitazione Diagnosi tensione batteria da relè carichi" VALUE 0xFCC62C Scalar_BOOLEAN 0 FaultChkVBP4ms_CM_boolean_adm 0 1 /end CHARACTERISTIC
/begin MEASUREMENT dsVBP_AutoD "Flag abilitazione diagnosi tensione valle relè carichi" UBYTE Vbpw4ms_CM_boolean_adm 0 0 0 1 ECU_ADDRESS 0x40004566 /end MEASUREMENT
/begin MEASUREMENT dsVBP_CodErr "Codice di errore linea della tensione valle relè carichi" UBYTE Vbpw4ms_CM_tFault_adm 0 0 0 88 ECU_ADDRESS 0x40004565 /end MEASUREMENT
/begin CHARACTERISTIC dsVBP_VBPWV_LL "Soglia Inferiore VBPWV" VALUE 0xFCC62A Scalar_UWORD 0 FaultChkVBP4ms_CM_ufix16_S50_mV 6000 40000 /end CHARACTERISTIC
/begin CHARACTERISTIC dsVBP_VBPWV_UL "Soglia Superiore VBPWV" VALUE 0xFCC628 Scalar_UWORD 0 FaultChkVBP4ms_CM_ufix16_S50_mV 6000 40000 /end CHARACTERISTIC
/begin MEASUREMENT dsVBattV "Tensione batteria riscalata tra 0 e 5 Volt ed elaborata dal blocco di recovery" UWORD Batt4ms_CM_ufix16_En10_V 0 0 0 5 ECU_ADDRESS 0x400021D4 /end MEASUREMENT
/begin MEASUREMENT dsVBattVPreR "Tensione batteria riscalata tra 0 e 5 Volt ed elaborata dal blocco di recovery" UWORD Batt4ms_CM_ufix16_En10_V 0 0 0 5 ECU_ADDRESS 0x400021D6 /end MEASUREMENT
/begin MEASUREMENT dsVS1V "Tensione di reference sensori letta sul canale SensSply1 (VS1)" UWORD J1939dl_Tx1s_CM_ufix16_En10_V 0 0 0 5 ECU_ADDRESS 0x400040D2 /end MEASUREMENT
/begin CHARACTERISTIC dsVS1_AUTOD "Voltage Supplier 1 - diagnostic line enable flag" VALUE 0xFCB006 Scalar_BOOLEAN 0 FaultChkVS14ms_CM_boolean_adm 0 1 /end CHARACTERISTIC
/begin MEASUREMENT dsVS1_AdiaEn "Error validation state machine enable" UBYTE Svs4ms_CM_boolean_adm 0 0 0 1 ECU_ADDRESS 0x400040CC /end MEASUREMENT
/begin MEASUREMENT dsVS1_CodErr "Error code of diagnostic line detecting sensor supply line 1 out of regulation" UBYTE Svs4ms_CM_tFault_adm 0 0 0 88 ECU_ADDRESS 0x400040C9 /end MEASUREMENT
/begin CHARACTERISTIC dsVS1_FLTCNT "VS1 filtering counter" VALUE 0xFCB004 Scalar_UWORD 0 FaultChkVS14ms_CM_ufix16_En8_s 0 50 /end CHARACTERISTIC
/begin CHARACTERISTIC dsVS1_ORH "Soglia Superiore tensione Voltage Supplier 1" VALUE 0xFCB002 Scalar_UWORD 0 FaultChkVS14ms_CM_ufix16_En10_V 0 5.5 /end CHARACTERISTIC
/begin CHARACTERISTIC dsVS1_ORL "Soglia Inferiore tensione Voltage Supplier 1" VALUE 0xFCB000 Scalar_UWORD 0 FaultChkVS14ms_CM_ufix16_En10_V 0 5 /end CHARACTERISTIC
/begin MEASUREMENT dsVS2V "Tensione di reference sensori letta sul canale SensSply2 (VS2)" UWORD J1939dl_Tx1s_CM_ufix16_En10_V 0 0 0 5 ECU_ADDRESS 0x400040D0 /end MEASUREMENT
/begin CHARACTERISTIC dsVS2_AUTOD "Voltage Supplier 2 - diagnostic line enable flag" VALUE 0xFCAFFE Scalar_BOOLEAN 0 FaultChkVS24ms_CM_boolean_adm 0 1 /end CHARACTERISTIC
/begin MEASUREMENT dsVS2_AdiaEn "Error validation state machine enable" UBYTE Svs4ms_CM_boolean_adm 0 0 0 1 ECU_ADDRESS 0x400040CB /end MEASUREMENT
/begin MEASUREMENT dsVS2_CodErr "Error code of diagnostic line detecting sensor supply line 2 out of regulation" UBYTE Svs4ms_CM_tFault_adm 0 0 0 88 ECU_ADDRESS 0x400040C8 /end MEASUREMENT
/begin CHARACTERISTIC dsVS2_FLTCNT "VS2 filtering counter" VALUE 0xFCAFFC Scalar_UWORD 0 FaultChkVS24ms_CM_ufix16_En8_s 0 50 /end CHARACTERISTIC
/begin CHARACTERISTIC dsVS2_ORH "Soglia Superiore tensione Voltage Supplier 2" VALUE 0xFCAFFA Scalar_UWORD 0 FaultChkVS24ms_CM_ufix16_En10_V 0 5.5 /end CHARACTERISTIC
/begin CHARACTERISTIC dsVS2_ORL "Soglia Inferiore tensione Voltage Supplier 2" VALUE 0xFCAFF8 Scalar_UWORD 0 FaultChkVS24ms_CM_ufix16_En10_V 0 5 /end CHARACTERISTIC
/begin MEASUREMENT dsVS3V "Tensione di reference sensori letta sul canale SensSply3 (VS3)" UWORD J1939dl_Tx1s_CM_ufix16_En10_V 0 0 0 5 ECU_ADDRESS 0x400040CE /end MEASUREMENT
/begin CHARACTERISTIC dsVS3_AUTOD "Voltage Supplier 3 - diagnostic line enable flag" VALUE 0xFCAFF6 Scalar_BOOLEAN 0 FaultChkVS34ms_CM_boolean_adm 0 1 /end CHARACTERISTIC
/begin MEASUREMENT dsVS3_AdiaEn "Error validation state machine enable" UBYTE Svs4ms_CM_boolean_adm 0 0 0 1 ECU_ADDRESS 0x400040CA /end MEASUREMENT
/begin MEASUREMENT dsVS3_CodErr "Error code of diagnostic line detecting sensor supply line 3 out of regulation" UBYTE Svs4ms_CM_tFault_adm 0 0 0 88 ECU_ADDRESS 0x400040C7 /end MEASUREMENT
/begin CHARACTERISTIC dsVS3_FLTCNT "VS3 filtering counter" VALUE 0xFCAFF4 Scalar_UWORD 0 FaultChkVS34ms_CM_ufix16_En8_s 0 50 /end CHARACTERISTIC
/begin CHARACTERISTIC dsVS3_ORH "Soglia Superiore tensione Voltage Supplier 3" VALUE 0xFCAFF2 Scalar_UWORD 0 FaultChkVS34ms_CM_ufix16_En10_V 0 5.5 /end CHARACTERISTIC
/begin CHARACTERISTIC dsVS3_ORL "Soglia Inferiore tensione Voltage Supplier 3" VALUE 0xFCAFF0 Scalar_UWORD 0 FaultChkVS34ms_CM_ufix16_En10_V 0 5 /end CHARACTERISTIC
/begin CHARACTERISTIC dsV_NLP_MAX "Massima tensione ammessa per NLP" VALUE 0xFC578C Scalar_UWORD 0 FaultCheckLRN034ms_Symbol_CM_ufix16_En10_V 0 5 /end CHARACTERISTIC
/begin CHARACTERISTIC dsV_UMA_MAX "Massima tensione ammessa per UMA" VALUE 0xFC5786 Scalar_UWORD 0 FaultCheckLRN024ms_Symbol_CM_ufix16_En10_V 0 5 /end CHARACTERISTIC
/begin MEASUREMENT dsValCycleEnd "Evento fine di un ciclo di validazione (numero massimo consigliato di cicli di validazione = 16)" UBYTE RecRifasaInjTDC_CM_boolean_adm 0 0 0 1 ECU_ADDRESS 0x400032CA /end MEASUREMENT
/begin MEASUREMENT dsVarRpm "Differenza di giri registrata durante un ciclo di validazione" UWORD RecRifasaInjTDC_CM_uint16_adm 0 0 0 10000 ECU_ADDRESS 0x400032C8 /end MEASUREMENT
/begin CHARACTERISTIC dsWAIT_EVR_PRV_ON "Tempo di attivazione EVR e PRV in Wait con motore non avviato" VALUE 0xFC5798 Scalar_UWORD 0 RecoveryEVR4ms_Symbol_CM_ufix16_Sp004_s 0 262 /end CHARACTERISTIC
/begin MEASUREMENT dsWGTDuty "Wastegate PWM command after the recovery" UWORD Boost_CtrlMgmt50ms_CM_ufix16_En3__ 0 0 0 100 ECU_ADDRESS 0x400021F8 /end MEASUREMENT
/begin MEASUREMENT dsWGTDutyPostR "Wastegate PWM command after the recovery - test point diagnostic variable" UWORD RecoveryWGT50ms_Symbol_CM_ufix16_En3__ 0 0 0 100 ECU_ADDRESS 0x4000229A /end MEASUREMENT
/begin CHARACTERISTIC dsWGT_AUTOD "Wastegate diagnostic line enable" VALUE 0xFC2060 Scalar_BOOLEAN 0 FaultChkWGT50ms_CM_boolean_adm 0 1 /end CHARACTERISTIC
/begin MEASUREMENT dsWGT_AdiaEn "Diagnosis enabled by line calibration flag" UBYTE Boost_CtrlMgmt50ms_CM_boolean_adm 0 0 0 1 ECU_ADDRESS 0x400021F5 /end MEASUREMENT
/begin MEASUREMENT dsWGT_CodErr "Wastegate diagnostic line error code" UBYTE Boost_CtrlMgmt50ms_CM_tFault_adm 0 0 0 88 ECU_ADDRESS 0x400021F3 /end MEASUREMENT
/begin CHARACTERISTIC dsWGT_DUTYREC "Wastegate PWM command recovery value" VALUE 0xFC2BB8 Scalar_UWORD 0 RecoveryWGT50ms_Symbol_CM_ufix16_En3__ 0 100 /end CHARACTERISTIC
/begin MEASUREMENT dsWRNLCmd "Warning Lamp command (after recovery)" UBYTE Lamp100ms_CM_boolean_adm 0 0 0 1 ECU_ADDRESS 0x40003759 /end MEASUREMENT
/begin CHARACTERISTIC dsWRNL_AUTOD "Warning Lamp diagnosis line enable flag" VALUE 0xFC9C92 Scalar_BOOLEAN 0 FaultChkELTLMP100ms_CM_boolean_adm 0 1 /end CHARACTERISTIC
/begin MEASUREMENT dsWRNL_AutoD "Warning Lamp command diagnois line enable flag" UBYTE Lamp100ms_CM_boolean_adm 0 0 0 1 ECU_ADDRESS 0x4000375F /end MEASUREMENT
/begin MEASUREMENT dsWRNL_CodErr "Warning Lamp command diagnosis line Error code" UBYTE Lamp100ms_CM_tFault_adm 0 0 0 88 ECU_ADDRESS 0x40003754 /end MEASUREMENT
/begin CHARACTERISTIC dtKNOCK_SRI_THR "Knock sensor SRI threshold (to diagnose knock sensors not working properly)" MAP 0xFC9720 Lookup2D_FLOAT32_IEEE 0 FaultChkKSPxTDC_CM_single_uV 0 10000000000
 /begin AXIS_DESCR COM_AXIS NO_INPUT_QUANTITY FaultChkKSPxTDC_CM_ufix16_En10_adm 16 0 3 AXIS_PTS_REF dkKNOCK_ETASP /end AXIS_DESCR
 /begin AXIS_DESCR COM_AXIS NO_INPUT_QUANTITY FaultChkKSPxTDC_CM_uint16_rpm 16 0 10000 AXIS_PTS_REF dkKNOCK_RPM /end AXIS_DESCR
/end CHARACTERISTIC
/begin CHARACTERISTIC dtLOW_POIL_THR "Tabella con valori di POil di warning per funzionamento motore" MAP 0xFCAAAA Lookup2DSF_UWORD 0 FaultChkPO2L100ms_Symbol_CM_uint16_mbar 250 6000
 /begin AXIS_DESCR COM_AXIS NO_INPUT_QUANTITY FaultChkPO2L100ms_Symbol_CM_uint16_rpm 8 0 10000 AXIS_PTS_REF dkRPM_BKP /end AXIS_DESCR
 /begin AXIS_DESCR COM_AXIS NO_INPUT_QUANTITY FaultChkPO2L100ms_Symbol_CM_ufix16_Bn40_degC 8 -40 130 AXIS_PTS_REF dkTOIL_BKP /end AXIS_DESCR
/end CHARACTERISTIC
/begin CHARACTERISTIC dvLIM_PERF_DERAT "Limitazione ETC per Derate Mode per guasto su Iniettore o su Bobina" CURVE 0xFCB5AC Lookup1D_UWORD 0 TE_TM_RecoveryAIR_50ms_Symbol_CM_ufix16_En4__ 0 100
 /begin AXIS_DESCR COM_AXIS NO_INPUT_QUANTITY TE_TM_RecoveryAIR_50ms_Symbol_CM_uint16_rpm 8 0 10000 AXIS_PTS_REF dkLIM_PERF_DRPM /end AXIS_DESCR
/end CHARACTERISTIC
/begin CHARACTERISTIC dvPOT2ON1_FITTING "Voltage fitting of second accelertor potentiomenter" CURVE 0xFCAC08 Lookup1D_UWORD 0 TE_FaultChkSPP02_4ms_CM_ufix16_En10_V 0 5
 /begin AXIS_DESCR COM_AXIS NO_INPUT_QUANTITY TE_FaultChkSPP02_4ms_CM_ufix16_En10_rpm 8 0 5 AXIS_PTS_REF dkVOLT_POTENZ /end AXIS_DESCR
/end CHARACTERISTIC
/begin MEASUREMENT dvPotenzAcc2to1V "[OUT] Voltage fitting of second accelertor potentiomenter" UWORD TE_FaultChkSPP02_4ms_CM_ufix16_En10_V 0 0 0 5 ECU_ADDRESS 0x40003F9C /end MEASUREMENT
/begin CHARACTERISTIC dvREC_TR2_TA "Secondo Transitorio veloce di recovery temp. aria in uscita da warm up (raccordo del primo a dsSTA_TFIX)" CURVE 0xFC1E56 Lookup1D_UWORD 0 RecoverySTA100ms_Symbol_CM_ufix16_En10_adm 0 1
 /begin AXIS_DESCR COM_AXIS NO_INPUT_QUANTITY RecoverySTA100ms_Symbol_CM_ufix16_En8_s 14 0 60 AXIS_PTS_REF dkT_TR2_TA /end AXIS_DESCR
/end CHARACTERISTIC
/begin CHARACTERISTIC dvREC_WUP_TR1_TA "Primo Transitorio lento di recovery temp. aria in warm up" CURVE 0xFC1E3A Lookup1D_UWORD 0 RecoverySTA100ms_Symbol_CM_ufix16_En10_adm 0 1
 /begin AXIS_DESCR COM_AXIS NO_INPUT_QUANTITY RecoverySTA100ms_Symbol_CM_ufix16_En8_s 14 0 60 AXIS_PTS_REF dkT_WUP_TR1_TA /end AXIS_DESCR
/end CHARACTERISTIC
/begin CHARACTERISTIC efAIR_COFF_ENGBRK_Enable "[FIX] Limite inferiore - in Cut Off quando attiva strategia di Engine Brake tramite attuatore - per aria calcolata dal ramo lento" VALUE 0xFCB72A Scalar_UBYTE 0 Trqm_CtrlMgmt4ms_CM_FixEnableT 171 218 /end CHARACTERISTIC
/begin CHARACTERISTIC efAIR_COFF_ENGBRK_Value "[FIX] Limite inferiore - in Cut Off quando attiva strategia di Engine Brake tramite attuatore - per aria calcolata dal ramo lento" VALUE 0xFCB74C Scalar_UWORD 0 Trqm_CtrlMgmt4ms_CM_ufix16_En4_kg_h 0 512 /end CHARACTERISTIC
/begin CHARACTERISTIC efAIR_COFF_SMOOT "[FIX] Limite inferiore - in Cut Off - per aria calcolata dal ramo lento" VALUE 0xFCBEC4 Scalar_UWORD 0 TE_TM_TorqBasCtrl4ms_Symbol_CM_ufix16_En4_kg_h 0 512 /end CHARACTERISTIC
/begin CHARACTERISTIC efAIR_COFF_SMOOT_EnFix "[FIX] Limite inferiore - in Cut Off - per aria calcolata dal ramo lento" VALUE 0xFCBEC2 Scalar_UWORD 0 TE_TM_TorqBasCtrl4ms_Symbol_CM_FixEnableT 171 218 /end CHARACTERISTIC
/begin CHARACTERISTIC efANG_VVA_EC_OBJ "[FIX] Fi2 calibration. Fi2 required closing angle for Early Closing Actuation." VALUE 0xFC9CE8 Scalar_UWORD 0 TE_MAirReqATDC_Symbol_CM_ufix16_En4_degE 0 4095 /end CHARACTERISTIC
/begin CHARACTERISTIC efANG_VVA_EC_OBJ_EnFix "[FIX] Fi2 calibration. Fi2 required closing angle for Early Closing Actuation." VALUE 0xFC9CE6 Scalar_UWORD 0 TE_MAirReqATDC_Symbol_CM_FixEnableT 171 218 /end CHARACTERISTIC
/begin CHARACTERISTIC efANG_VVA_LO_OBJ "[FIX] Fi1 calibration. Fi1 required angle for Late Opening Actuation." VALUE 0xFC9CE4 Scalar_UWORD 0 TE_MAirReqATDC_Symbol_CM_ufix16_En4_degE 0 4095 /end CHARACTERISTIC
/begin CHARACTERISTIC efANG_VVA_LO_OBJ_EnFix "[FIX] Fi1 calibration. Fi1 required angle for Late Opening Actuation." VALUE 0xFC9CE2 Scalar_UWORD 0 TE_MAirReqATDC_Symbol_CM_FixEnableT 171 218 /end CHARACTERISTIC
/begin CHARACTERISTIC efANTIWUP_INF_HI "[FIX] Fix su AntiWindUp inferiore nel Ctrl High Idle PID" VALUE 0xFCBEC0 Scalar_UWORD 0 TE_TM_TorqBasCtrl4ms_Symbol_CM_ufix16_En4_Bn100__ -100 100 /end CHARACTERISTIC
/begin CHARACTERISTIC efANTIWUP_INF_HI_EnFix "[FIX] Fix su AntiWindUp inferiore nel Ctrl High Idle PID" VALUE 0xFCBEBE Scalar_UWORD 0 TE_TM_TorqBasCtrl4ms_Symbol_CM_FixEnableT 171 218 /end CHARACTERISTIC
/begin CHARACTERISTIC efANTIWUP_SUP_HI "[FIX] Fix su AntiWindUp superiore nel Ctrl High Idle PID" VALUE 0xFCBEBC Scalar_UWORD 0 TE_TM_TorqBasCtrl4ms_Symbol_CM_ufix16_En4__ 0 100 /end CHARACTERISTIC
/begin CHARACTERISTIC efANTIWUP_SUP_HI_EnFix "[FIX] Fix su AntiWindUp superiore nel Ctrl High Idle PID" VALUE 0xFCBEBA Scalar_UWORD 0 TE_TM_TorqBasCtrl4ms_Symbol_CM_FixEnableT 171 218 /end CHARACTERISTIC
/begin CHARACTERISTIC efANTI_WUP_H "[FIX] Fix on Antiwindup High (|MaxTorq - FFW|)" VALUE 0xFCBAA0 Scalar_UWORD 0 TE_TM_SpeedCtrl_4ms_Symbol_CM_ufix16_En4__ 0 100 /end CHARACTERISTIC
/begin CHARACTERISTIC efANTI_WUP_H_EnFix "[FIX] Fix on Antiwindup High (|MaxTorq - FFW|)" VALUE 0xFCBA9E Scalar_UWORD 0 TE_TM_SpeedCtrl_4ms_Symbol_CM_FixEnableT 171 218 /end CHARACTERISTIC
/begin CHARACTERISTIC efANTI_WUP_L "[FIX] Fix on Antiwindup Low (-|FF|)" VALUE 0xFCBAAE Scalar_SWORD 0 TE_TM_SpeedCtrl_4ms_Symbol_CM_sfix16_En4__ -100 0 /end CHARACTERISTIC
/begin CHARACTERISTIC efANTI_WUP_L_EnFix "[FIX] Fix on Antiwindup Low (-|FF|)" VALUE 0xFCBAAC Scalar_SWORD 0 TE_TM_SpeedCtrl_4ms_Symbol_CM_FixEnableT 171 218 /end CHARACTERISTIC
/begin CHARACTERISTIC efCMF_ACCESSORIES "[FIX] Fix per sommare gli accessori alle Friction Engine dichiarate" VALUE 0xFCC5AC Scalar_UWORD 0 TE_TM_TorqCalcTDC_Symbol_CM_ufix16_En4__ 0 100 /end CHARACTERISTIC
/begin CHARACTERISTIC efCMF_ACCESSORIES_EnFix "[FIX] Fix per sommare gli accessori alle Friction Engine dichiarate" VALUE 0xFCC5AA Scalar_UWORD 0 TE_TM_TorqCalcTDC_Symbol_CM_FixEnableT 171 218 /end CHARACTERISTIC
/begin CHARACTERISTIC efCMF_IST_INF "[FIX] Fix su limite inferiore del feedback di Coppia Erogata dal motore" VALUE 0xFCC5A8 Scalar_UWORD 0 TE_TM_TorqCalcTDC_Symbol_CM_ufix16_En4__ 0 100 /end CHARACTERISTIC
/begin CHARACTERISTIC efCMF_IST_INF_EnFix "[FIX] Fix su limite inferiore del feedback di Coppia Erogata dal motore" VALUE 0xFCC5A6 Scalar_UWORD 0 TE_TM_TorqCalcTDC_Symbol_CM_FixEnableT 171 218 /end CHARACTERISTIC
/begin CHARACTERISTIC efCMU2QAIR_OBJ "[FIX] Tabella di conversione della Coppia Utile obiettivo in Aria sul ramo lento" VALUE 0xFCBEB8 Scalar_UWORD 0 TE_TM_TorqBasCtrl4ms_Symbol_CM_ufix16_En4_kg_h 0 4095 /end CHARACTERISTIC
/begin CHARACTERISTIC efCMU2QAIR_OBJ_EnFix "[FIX] Tabella di conversione della Coppia Utile obiettivo in Aria sul ramo lento" VALUE 0xFCBEB6 Scalar_UWORD 0 TE_TM_TorqBasCtrl4ms_Symbol_CM_FixEnableT 171 218 /end CHARACTERISTIC
/begin CHARACTERISTIC efCMU_CTRL_MODE_Enable "[FIX] Fix su Flag di stato che vale 1 se attivo il controllo di coppia, 0 se attivo il controllo di giri" VALUE 0xFCBA32 Scalar_UBYTE 0 TE_TM_TorqBas4ms_CM_FixEnableT 171 218 /end CHARACTERISTIC
/begin CHARACTERISTIC efCMU_CTRL_MODE_Value "[FIX] Fix su Flag di stato che vale 1 se attivo il controllo di coppia, 0 se attivo il controllo di giri" VALUE 0xFCBA31 Scalar_BOOLEAN 0 TE_TM_TorqBas4ms_CM_boolean_adm 0 1 /end CHARACTERISTIC
/begin CHARACTERISTIC efCMU_DEF_RE_AIR "[FIX] Fix su richiesta di Cmu definitiva al ramo lento (Qair)" VALUE 0xFCBEB4 Scalar_UWORD 0 TE_TM_TorqBasCtrl4ms_Symbol_CM_ufix16_En4_N_m 0 4095 /end CHARACTERISTIC
/begin CHARACTERISTIC efCMU_DEF_RE_AIR_EnFix "[FIX] Fix su richiesta di Cmu definitiva al ramo lento (Qair)" VALUE 0xFCBEB2 Scalar_UWORD 0 TE_TM_TorqBasCtrl4ms_Symbol_CM_FixEnableT 171 218 /end CHARACTERISTIC
/begin CHARACTERISTIC efCMU_OBJ_LIMIT_TST "[FIX] Fix su Coppia Utile obiettivo richiesta al ciclo Otto, limitata per fuorigiri" VALUE 0xFCBEB0 Scalar_UWORD 0 TE_TM_TorqBasCtrl4ms_Symbol_CM_ufix16_En4_N_m 0 4095 /end CHARACTERISTIC
/begin CHARACTERISTIC efCMU_OBJ_LIMIT_TST_EnFix "[FIX] Fix su Coppia Utile obiettivo richiesta al ciclo Otto, limitata per fuorigiri" VALUE 0xFCBEAE Scalar_UWORD 0 TE_TM_TorqBasCtrl4ms_Symbol_CM_FixEnableT 171 218 /end CHARACTERISTIC
/begin CHARACTERISTIC efCMU_PERC_REQ_DEF_Enable "[FIX] Fix su Percentuale finale di richiesta di Coppia Utile nel Manager" VALUE 0xFCBA30 Scalar_UBYTE 0 TE_TM_TorqBas4ms_CM_FixEnableT 171 218 /end CHARACTERISTIC
/begin CHARACTERISTIC efCMU_PERC_REQ_DEF_Value "[FIX] Fix su Percentuale finale di richiesta di Coppia Utile nel Manager" VALUE 0xFCBA2E Scalar_UWORD 0 TE_TM_TorqBas4ms_CM_ufix16_En4__ 0 100 /end CHARACTERISTIC
/begin CHARACTERISTIC efCTRL_OFF_MODE_Enable "[FIX] Fix su Flag on (1) if NO Control Mode (Torque or Speed) is request" VALUE 0xFCBA2C Scalar_UBYTE 0 TE_TM_TorqBas4ms_CM_FixEnableT 171 218 /end CHARACTERISTIC
/begin CHARACTERISTIC efCTRL_OFF_MODE_Value "[FIX] Fix su Flag on (1) if NO Control Mode (Torque or Speed) is request" VALUE 0xFCBA2B Scalar_BOOLEAN 0 TE_TM_TorqBas4ms_CM_boolean_adm 0 1 /end CHARACTERISTIC
/begin CHARACTERISTIC efDELAY_LTD_GAIN_PATM "[FIX] Guadagno del ritardo limitazione Full-Load per PAtm" VALUE 0xFCBEAC Scalar_UWORD 0 TE_TM_TorqBasCtrl4ms_Symbol_CM_ufix16_En10_adm 0 10 /end CHARACTERISTIC
/begin CHARACTERISTIC efDELAY_LTD_GAIN_PATM_EnFix "[FIX] Guadagno del ritardo limitazione Full-Load per PAtm" VALUE 0xFCBEAA Scalar_UWORD 0 TE_TM_TorqBasCtrl4ms_Symbol_CM_FixEnableT 171 218 /end CHARACTERISTIC
/begin CHARACTERISTIC efDELAY_LTD_TH2O "[FIX] Ritardo limitazione Full-Load per Th2o" VALUE 0xFCBEA8 Scalar_UWORD 0 TE_TM_TorqBasCtrl4ms_Symbol_CM_uint16_s 0 3600 /end CHARACTERISTIC
/begin CHARACTERISTIC efDELAY_LTD_TH2O_EnFix "[FIX] Ritardo limitazione Full-Load per Th2o" VALUE 0xFCBEA6 Scalar_UWORD 0 TE_TM_TorqBasCtrl4ms_Symbol_CM_FixEnableT 171 218 /end CHARACTERISTIC
/begin CHARACTERISTIC efDELTA_DERRPM_ADV_HI "[FIX] Ulteriore delta giri di anticipo per ingresso in High Idle funzione della derivata di giri" VALUE 0xFCBEA4 Scalar_UWORD 0 TE_TM_TorqBasCtrl4ms_Symbol_CM_ufix16_Bn500_rpm -500 500 /end CHARACTERISTIC
/begin CHARACTERISTIC efDELTA_DERRPM_ADV_HI_EnFix "[FIX] Ulteriore delta giri di anticipo per ingresso in High Idle funzione della derivata di giri" VALUE 0xFCBEA2 Scalar_UWORD 0 TE_TM_TorqBasCtrl4ms_Symbol_CM_FixEnableT 171 218 /end CHARACTERISTIC
/begin CHARACTERISTIC efDELTA_TOT_RPM_ADV_HI "[FIX] Totale delta giri di anticipo per ingresso in HI" VALUE 0xFCBEA0 Scalar_UWORD 0 TE_TM_TorqBasCtrl4ms_Symbol_CM_uint16_rpm 0 1000 /end CHARACTERISTIC
/begin CHARACTERISTIC efDELTA_TOT_RPM_ADV_HI_EnFix "[FIX] Totale delta giri di anticipo per ingresso in HI" VALUE 0xFCBE9E Scalar_UWORD 0 TE_TM_TorqBasCtrl4ms_Symbol_CM_FixEnableT 171 218 /end CHARACTERISTIC
/begin CHARACTERISTIC efDERATE_TH2O_Enable "[FIX] Richiesta di riduzione percentuale di performance (derating per temperatura acqua)" VALUE 0xFCBA2A Scalar_UBYTE 0 TE_TM_TorqBas4ms_CM_FixEnableT 171 218 /end CHARACTERISTIC
/begin CHARACTERISTIC efDERATE_TH2O_Value "[FIX] Richiesta di riduzione percentuale di performance (derating per temperatura acqua)" VALUE 0xFCBA28 Scalar_UWORD 0 TE_TM_TorqBas4ms_CM_ufix16_En4__ 0 100 /end CHARACTERISTIC
/begin CHARACTERISTIC efDERATE_TINJ_Enable "[FIX] Fix su valore di Derate di Coppia per limitazione al Tinj massimo programmabile" VALUE 0xFCBA26 Scalar_UBYTE 0 TE_TM_TorqBas4ms_CM_FixEnableT 171 218 /end CHARACTERISTIC
/begin CHARACTERISTIC efDERATE_TINJ_Value "[FIX] Fix su valore di Derate di Coppia per limitazione al Tinj massimo programmabile" VALUE 0xFCBA24 Scalar_UWORD 0 TE_TM_TorqBas4ms_CM_ufix16_En10_adm 0 1 /end CHARACTERISTIC
/begin CHARACTERISTIC efDIS_IDLE_MODE "[FIX] Fix per disattivazione il modo motore minimo" VALUE 0xFCBA9C Scalar_UWORD 0 TE_TM_SpeedCtrl_4ms_Symbol_CM_boolean_adm 0 1 /end CHARACTERISTIC
/begin CHARACTERISTIC efDIS_IDLE_MODE_EnFix "[FIX] Fix per disattivazione il modo motore minimo" VALUE 0xFCBA9A Scalar_UWORD 0 TE_TM_SpeedCtrl_4ms_Symbol_CM_FixEnableT 171 218 /end CHARACTERISTIC
/begin CHARACTERISTIC efDP_SCA "[FIX] Fix su pompaggio allo scarico (default ON @ 0)" VALUE 0xFCBE9C Scalar_UWORD 0 TE_TM_TorqBasCtrl4ms_Symbol_CM_uint16_mbar 0 3000 /end CHARACTERISTIC
/begin CHARACTERISTIC efDP_SCA_EnFix "[FIX] Fix su pompaggio allo scarico (default ON @ 0)" VALUE 0xFCBE9A Scalar_UWORD 0 TE_TM_TorqBasCtrl4ms_Symbol_CM_FixEnableT 171 218 /end CHARACTERISTIC
/begin CHARACTERISTIC efEGT_MAX_Enable "[FIX] Fix on Exhaust temperature threshold beyond which starting derate computation " VALUE 0xFCBA22 Scalar_UBYTE 0 TE_TM_TorqBas4ms_CM_FixEnableT 171 218 /end CHARACTERISTIC
/begin CHARACTERISTIC efEGT_MAX_Value "[FIX] Fix on Exhaust temperature threshold beyond which starting derate computation " VALUE 0xFCBA20 Scalar_UWORD 0 TE_TM_TorqBas4ms_CM_ufix16_Bn40_degC -40 1000 /end CHARACTERISTIC
/begin CHARACTERISTIC efELECTRIC_LOAD "[FIX] Richiesta di coppia per carichi elettrici" VALUE 0xFC5DC6 Scalar_UWORD 0 TE_TM_FFW4ms_Symbol_CM_ufix16_En4__ 0 100 /end CHARACTERISTIC
/begin COMPU_METHOD Airt100ms_CM_boolean_adm "Q = V" RAT_FUNC "%1.0" "adm" COEFFS 0 1 0 0 0 1 /end COMPU_METHOD
/begin COMPU_METHOD Airt100ms_CM_tFault_adm "Enumerated data type: tFault" TAB_VERB "%0.6" "adm" COMPU_TAB_REF VTAB_FOR_Airt100ms_CM_tFault_adm /end COMPU_METHOD
/begin COMPU_METHOD Airt100ms_CM_ufix16_Bn40_degC "Q = (V+40.000000)/1.000000" RAT_FUNC "%0.6" "degC" COEFFS 0 1 40 0 0 1 /end COMPU_METHOD
/begin COMPU_METHOD Airt100ms_CM_ufix16_En10_V "Q = V*1024.000000" RAT_FUNC "%12.10" "V" COEFFS 0 1024 0 0 0 1 /end COMPU_METHOD
/begin COMPU_METHOD Apre100ms_CM_boolean_adm "Q = V" RAT_FUNC "%1.0" "adm" COEFFS 0 1 0 0 0 1 /end COMPU_METHOD
/begin COMPU_METHOD Apre100ms_CM_tFault_adm "Enumerated data type: tFault" TAB_VERB "%0.6" "adm" COMPU_TAB_REF VTAB_FOR_Apre100ms_CM_tFault_adm /end COMPU_METHOD
/begin COMPU_METHOD Batt4ms_CM_ufix16_En10_V "Q = V*1024.000000" RAT_FUNC "%12.10" "V" COEFFS 0 1024 0 0 0 1 /end COMPU_METHOD
/begin COMPU_METHOD Boost_CtrlMgmt50ms_CM_boolean_adm "Q = V" RAT_FUNC "%1.0" "adm" COEFFS 0 1 0 0 0 1 /end COMPU_METHOD
/begin COMPU_METHOD Boost_CtrlMgmt50ms_CM_tFault_adm "Enumerated data type: tFault" TAB_VERB "%0.6" "adm" COMPU_TAB_REF VTAB_FOR_Boost_CtrlMgmt50ms_CM_tFault_adm /end COMPU_METHOD
/begin COMPU_METHOD Boost_CtrlMgmt50ms_CM_ufix16_En3__ "Q = V*8.000000" RAT_FUNC "%7.3" "%" COEFFS 0 8 0 0 0 1 /end COMPU_METHOD
/begin COMPU_METHOD Bpre4ms_CM_boolean_adm "Q = V" RAT_FUNC "%1.0" "adm" COEFFS 0 1 0 0 0 1 /end COMPU_METHOD
/begin COMPU_METHOD Bpre4ms_CM_tFault_adm "Enumerated data type: tFault" TAB_VERB "%0.6" "adm" COMPU_TAB_REF VTAB_FOR_Bpre4ms_CM_tFault_adm /end COMPU_METHOD
/begin COMPU_METHOD Catt100ms_CM_boolean_adm "Q = V" RAT_FUNC "%1.0" "adm" COEFFS 0 1 0 0 0 1 /end COMPU_METHOD
/begin COMPU_METHOD Catt100ms_CM_tFault_adm "Enumerated data type: tFault" TAB_VERB "%0.6" "adm" COMPU_TAB_REF VTAB_FOR_Catt100ms_CM_tFault_adm /end COMPU_METHOD
/begin COMPU_METHOD Catt100ms_CM_ufix16_En10_V "Q = V*1024.000000" RAT_FUNC "%12.10" "V" COEFFS 0 1024 0 0 0 1 /end COMPU_METHOD
/begin COMPU_METHOD Catt100ms_CM_ufix32_Sp1_s "Q = V*10.000000" RAT_FUNC "%0.6" "s" COEFFS 0 10 0 0 0 1 /end COMPU_METHOD
/begin COMPU_METHOD Coot100ms_CM_boolean_adm "Q = V" RAT_FUNC "%1.0" "adm" COEFFS 0 1 0 0 0 1 /end COMPU_METHOD
/begin COMPU_METHOD Coot100ms_CM_tFault_adm "Enumerated data type: tFault" TAB_VERB "%0.6" "adm" COMPU_TAB_REF VTAB_FOR_Coot100ms_CM_tFault_adm /end COMPU_METHOD
/begin COMPU_METHOD Coot100ms_CM_ufix16_Bn40_degC "Q = (V+40.000000)/1.000000" RAT_FUNC "%0.6" "degC" COEFFS 0 1 40 0 0 1 /end COMPU_METHOD
/begin COMPU_METHOD Coot100ms_CM_ufix16_En10_V "Q = V*1024.000000" RAT_FUNC "%12.10" "V" COEFFS 0 1024 0 0 0 1 /end COMPU_METHOD
/begin COMPU_METHOD Crkc4ms_CM_boolean_adm "Q = V" RAT_FUNC "%1.0" "adm" COEFFS 0 1 0 0 0 1 /end COMPU_METHOD
/begin COMPU_METHOD Crkc4ms_CM_tDiagStat_adm "Enumerated data type: tDiagStat" TAB_VERB "%0.6" "adm" COMPU_TAB_REF VTAB_FOR_Crkc4ms_CM_tDiagStat_adm /end COMPU_METHOD
/begin COMPU_METHOD Crkc4ms_CM_tFault_adm "Enumerated data type: tFault" TAB_VERB "%0.6" "adm" COMPU_TAB_REF VTAB_FOR_Crkc4ms_CM_tFault_adm /end COMPU_METHOD
/begin COMPU_METHOD Crkc4ms_CM_uint8_adm "Q = V" RAT_FUNC "%3.0" "adm" COEFFS 0 1 0 0 0 1 /end COMPU_METHOD
/begin COMPU_METHOD Ctit_LambdaCtrlTDC_CM_boolean "Q = V" RAT_FUNC "%1.0" "" COEFFS 0 1 0 0 0 1 /end COMPU_METHOD
/begin COMPU_METHOD Ctit_LambdaCtrlTDC_CM_boolean_adm "Q = V" RAT_FUNC "%1.0" "adm" COEFFS 0 1 0 0 0 1 /end COMPU_METHOD
/begin COMPU_METHOD Ctit_LambdaCtrlTDC_CM_uint8_adm "Q = V" RAT_FUNC "%3.0" "adm" COEFFS 0 1 0 0 0 1 /end COMPU_METHOD
/begin COMPU_METHOD Ctit_LambdaPreDiag4ms_CM_boolean_adm "Q = V" RAT_FUNC "%1.0" "adm" COEFFS 0 1 0 0 0 1 /end COMPU_METHOD
/begin COMPU_METHOD Ctit_LambdaPreDiag4ms_CM_tFault_adm "Enumerated data type: tFault" TAB_VERB "%0.6" "adm" COMPU_TAB_REF VTAB_FOR_Ctit_LambdaPreDiag4ms_CM_tFault_adm /end COMPU_METHOD
/begin COMPU_METHOD Ctit_UEGOHeater4ms_CM_boolean "Q = V" RAT_FUNC "%1.0" "" COEFFS 0 1 0 0 0 1 /end COMPU_METHOD
/begin COMPU_METHOD Ctit_UEGOHeater4ms_CM_boolean_adm "Q = V" RAT_FUNC "%1.0" "adm" COEFFS 0 1 0 0 0 1 /end COMPU_METHOD
/begin COMPU_METHOD Ctit_UEGOHeater4ms_CM_tFault_adm "Enumerated data type: tFault" TAB_VERB "%0.6" "adm" COMPU_TAB_REF VTAB_FOR_Ctit_UEGOHeater4ms_CM_tFault_adm /end COMPU_METHOD
/begin COMPU_METHOD Ctit_UEGOHeater4ms_CM_ufix32_En24__ "Q = V*16777216.000000" RAT_FUNC "%26.16" "%" COEFFS 0 16777216 0 0 0 1 /end COMPU_METHOD
/begin COMPU_METHOD DiagPRVPON4ms_Symbol_CM_boolean_adm "Q = V" RAT_FUNC "%1.0" "adm" COEFFS 0 1 0 0 0 1 /end COMPU_METHOD
/begin COMPU_METHOD DiagPRVPON4ms_Symbol_CM_ufix16_E2_ms "Q = V/4.000000" RAT_FUNC "%5.0" "ms" COEFFS 0 1 0 0 0 4 /end COMPU_METHOD
/begin COMPU_METHOD DiagPRVPON4ms_Symbol_CM_uint8_adm "Q = V" RAT_FUNC "%3.0" "adm" COEFFS 0 1 0 0 0 1 /end COMPU_METHOD
/begin COMPU_METHOD DiagPWRPON4ms_Symbol_CM_boolean_adm "Q = V" RAT_FUNC "%1.0" "adm" COEFFS 0 1 0 0 0 1 /end COMPU_METHOD
/begin COMPU_METHOD DiagPWRPON4ms_Symbol_CM_ufix16_E2_ms "Q = V/4.000000" RAT_FUNC "%5.0" "ms" COEFFS 0 1 0 0 0 4 /end COMPU_METHOD
/begin COMPU_METHOD Diag_LineSTOH100ms_CM_boolean_adm "Q = V" RAT_FUNC "%1.0" "adm" COEFFS 0 1 0 0 0 1 /end COMPU_METHOD
/begin COMPU_METHOD Diag_LineSTOH100ms_CM_tFault_adm "Enumerated data type: tFault" TAB_VERB "%0.6" "adm" COMPU_TAB_REF VTAB_FOR_Diag_LineSTOH100ms_CM_tFault_adm /end COMPU_METHOD
/begin COMPU_METHOD Ecut1s_CM_boolean_adm "Q = V" RAT_FUNC "%1.0" "adm" COEFFS 0 1 0 0 0 1 /end COMPU_METHOD
/begin COMPU_METHOD Ecut1s_CM_tFault_adm "Enumerated data type: tFault" TAB_VERB "%0.6" "adm" COMPU_TAB_REF VTAB_FOR_Ecut1s_CM_tFault_adm /end COMPU_METHOD
/begin COMPU_METHOD Ecut1s_CM_ufix16_Bn40_degC "Q = (V+40.000000)/1.000000" RAT_FUNC "%0.6" "degC" COEFFS 0 1 40 0 0 1 /end COMPU_METHOD
/begin COMPU_METHOD Ecut1s_CM_ufix16_En10_V "Q = V*1024.000000" RAT_FUNC "%12.10" "V" COEFFS 0 1024 0 0 0 1 /end COMPU_METHOD
/begin COMPU_METHOD Egst4ms_CM_tDiagStat_adm "Enumerated data type: tDiagStat" TAB_VERB "%0.6" "adm" COMPU_TAB_REF VTAB_FOR_Egst4ms_CM_tDiagStat_adm /end COMPU_METHOD
/begin COMPU_METHOD Egst4ms_CM_tFault_adm "Enumerated data type: tFault" TAB_VERB "%0.6" "adm" COMPU_TAB_REF VTAB_FOR_Egst4ms_CM_tFault_adm /end COMPU_METHOD
/begin COMPU_METHOD Egt100ms_CM_boolean_adm "Q = V" RAT_FUNC "%1.0" "adm" COEFFS 0 1 0 0 0 1 /end COMPU_METHOD
/begin COMPU_METHOD Egt100ms_CM_tFault_adm "Enumerated data type: tFault" TAB_VERB "%0.6" "adm" COMPU_TAB_REF VTAB_FOR_Egt100ms_CM_tFault_adm /end COMPU_METHOD
/begin COMPU_METHOD Egt100ms_CM_ufix16_Bn40_degC "Q = (V+40.000000)/1.000000" RAT_FUNC "%0.6" "degC" COEFFS 0 1 40 0 0 1 /end COMPU_METHOD
/begin COMPU_METHOD Egt100ms_CM_ufix16_En10_V "Q = V*1024.000000" RAT_FUNC "%12.10" "V" COEFFS 0 1024 0 0 0 1 /end COMPU_METHOD
/begin COMPU_METHOD Ethrc4ms_CM_boolean_adm "Q = V" RAT_FUNC "%1.0" "adm" COEFFS 0 1 0 0 0 1 /end COMPU_METHOD
/begin COMPU_METHOD Ethrc4ms_CM_tFault_adm "Enumerated data type: tFault" TAB_VERB "%0.6" "adm" COMPU_TAB_REF VTAB_FOR_Ethrc4ms_CM_tFault_adm /end COMPU_METHOD
/begin COMPU_METHOD Ethrl4ms_CM_ufix16_En10_V "Q = V*1024.000000" RAT_FUNC "%12.10" "V" COEFFS 0 1024 0 0 0 1 /end COMPU_METHOD
/begin COMPU_METHOD FaultCheckLRN024ms_Symbol_CM_ufix16_En10_V "Q = V*1024.000000" RAT_FUNC "%12.10" "V" COEFFS 0 1024 0 0 0 1 /end COMPU_METHOD
/begin COMPU_METHOD FaultCheckLRN034ms_Symbol_CM_ufix16_En10_V "Q = V*1024.000000" RAT_FUNC "%12.10" "V" COEFFS 0 1024 0 0 0 1 /end COMPU_METHOD
/begin COMPU_METHOD FaultChkADAT2_4ms_CM_int8_adm "Q = V" RAT_FUNC "%3.0" "adm" COEFFS 0 1 0 0 0 1 /end COMPU_METHOD
/begin COMPU_METHOD FaultChkADATTDC_CM_ufix16_En12_adm "Q = V*4096.000000" RAT_FUNC "%14.12" "adm" COEFFS 0 4096 0 0 0 1 /end COMPU_METHOD
/begin COMPU_METHOD FaultChkELTLMP100ms_CM_boolean_adm "Q = V" RAT_FUNC "%1.0" "adm" COEFFS 0 1 0 0 0 1 /end COMPU_METHOD
/begin COMPU_METHOD FaultChkELTPRV4ms_CM_boolean_adm "Q = V" RAT_FUNC "%1.0" "adm" COEFFS 0 1 0 0 0 1 /end COMPU_METHOD
/begin COMPU_METHOD FaultChkELTPWR4ms_CM_boolean_adm "Q = V" RAT_FUNC "%1.0" "adm" COEFFS 0 1 0 0 0 1 /end COMPU_METHOD
/begin COMPU_METHOD FaultChkELTSTR4ms_CM_boolean_adm "Q = V" RAT_FUNC "%1.0" "adm" COEFFS 0 1 0 0 0 1 /end COMPU_METHOD
/begin COMPU_METHOD FaultChkELTTHR4ms_CM_boolean_adm "Q = V" RAT_FUNC "%1.0" "adm" COEFFS 0 1 0 0 0 1 /end COMPU_METHOD
/begin COMPU_METHOD FaultChkKSPxTDC_CM_single_uV "Q = V" RAT_FUNC "%8.6" "uV" COEFFS 0 1 0 0 0 1 /end COMPU_METHOD
/begin COMPU_METHOD FaultChkKSPxTDC_CM_ufix16_En10_adm "Q = V*1024.000000" RAT_FUNC "%12.10" "adm" COEFFS 0 1024 0 0 0 1 /end COMPU_METHOD
/begin COMPU_METHOD FaultChkKSPxTDC_CM_uint16_rpm "Q = V" RAT_FUNC "%5.0" "rpm" COEFFS 0 1 0 0 0 1 /end COMPU_METHOD
/begin COMPU_METHOD FaultChkPO2L100ms_Symbol_CM_ufix16_Bn40_degC "Q = (V+40.000000)/1.000000" RAT_FUNC "%0.6" "degC" COEFFS 0 1 40 0 0 1 /end COMPU_METHOD
/begin COMPU_METHOD FaultChkPO2L100ms_Symbol_CM_uint16_mbar "Q = V" RAT_FUNC "%5.0" "mbar" COEFFS 0 1 0 0 0 1 /end COMPU_METHOD
/begin COMPU_METHOD FaultChkPO2L100ms_Symbol_CM_uint16_rpm "Q = V" RAT_FUNC "%5.0" "rpm" COEFFS 0 1 0 0 0 1 /end COMPU_METHOD
/begin COMPU_METHOD FaultChkPWRCC4ms_Symbol_CM_boolean_adm "Q = V" RAT_FUNC "%1.0" "adm" COEFFS 0 1 0 0 0 1 /end COMPU_METHOD
/begin COMPU_METHOD FaultChkPWRCC4ms_Symbol_CM_ufix16_S50_mV "Q = V/50.000000" RAT_FUNC "%0.6" "mV" COEFFS 0 1 0 0 0 50 /end COMPU_METHOD
/begin COMPU_METHOD FaultChkPWROC4ms_Symbol_CM_boolean_adm "Q = V" RAT_FUNC "%1.0" "adm" COEFFS 0 1 0 0 0 1 /end COMPU_METHOD
/begin COMPU_METHOD FaultChkPWROC4ms_Symbol_CM_ufix16_S50_mV "Q = V/50.000000" RAT_FUNC "%0.6" "mV" COEFFS 0 1 0 0 0 50 /end COMPU_METHOD
/begin COMPU_METHOD FaultChkSAFPON_CM_boolean_adm "Q = V" RAT_FUNC "%1.0" "adm" COEFFS 0 1 0 0 0 1 /end COMPU_METHOD
/begin COMPU_METHOD FaultChkSAFPON_CM_uint16_adm "Q = V" RAT_FUNC "%5.0" "adm" COEFFS 0 1 0 0 0 1 /end COMPU_METHOD
/begin COMPU_METHOD FaultChkSAFRTF_CM_boolean_adm "Q = V" RAT_FUNC "%1.0" "adm" COEFFS 0 1 0 0 0 1 /end COMPU_METHOD
/begin COMPU_METHOD FaultChkSAFRTF_CM_uint8_adm "Q = V" RAT_FUNC "%3.0" "adm" COEFFS 0 1 0 0 0 1 /end COMPU_METHOD
/begin COMPU_METHOD FaultChkSAFRTI_CM_boolean_adm "Q = V" RAT_FUNC "%1.0" "adm" COEFFS 0 1 0 0 0 1 /end COMPU_METHOD
/begin COMPU_METHOD FaultChkSAFRTI_CM_ufix16_Sp1__ "Q = V*10.000000" RAT_FUNC "%0.6" "%" COEFFS 0 10 0 0 0 1 /end COMPU_METHOD
/begin COMPU_METHOD FaultChkSAFRTI_CM_uint8_adm "Q = V" RAT_FUNC "%3.0" "adm" COEFFS 0 1 0 0 0 1 /end COMPU_METHOD
/begin COMPU_METHOD FaultChkSFM4ms_CM_boolean_adm "Q = V" RAT_FUNC "%1.0" "adm" COEFFS 0 1 0 0 0 1 /end COMPU_METHOD
/begin COMPU_METHOD FaultChkSFR4ms_CM_boolean_adm "Q = V" RAT_FUNC "%1.0" "adm" COEFFS 0 1 0 0 0 1 /end COMPU_METHOD
/begin COMPU_METHOD FaultChkSFR4ms_CM_ufix16_Sp004_s "Q = V*250.000000" RAT_FUNC "%0.6" "s" COEFFS 0 250 0 0 0 1 /end COMPU_METHOD
/begin COMPU_METHOD FaultChkSGM4ms_CM_boolean_adm "Q = V" RAT_FUNC "%1.0" "adm" COEFFS 0 1 0 0 0 1 /end COMPU_METHOD
/begin COMPU_METHOD FaultChkSGM4ms_CM_uint16_adm "Q = V" RAT_FUNC "%5.0" "adm" COEFFS 0 1 0 0 0 1 /end COMPU_METHOD
/begin COMPU_METHOD FaultChkSGM4ms_CM_uint16_pulses "Q = V" RAT_FUNC "%5.0" "pulses" COEFFS 0 1 0 0 0 1 /end COMPU_METHOD
/begin COMPU_METHOD FaultChkSKxTDC_CM_boolean_adm "Q = V" RAT_FUNC "%1.0" "adm" COEFFS 0 1 0 0 0 1 /end COMPU_METHOD
/begin COMPU_METHOD FaultChkSLO4ms_Symbol_CM_boolean_adm "Q = V" RAT_FUNC "%1.0" "adm" COEFFS 0 1 0 0 0 1 /end COMPU_METHOD
/begin COMPU_METHOD FaultChkSLO4ms_Symbol_CM_uint16_adm "Q = V" RAT_FUNC "%5.0" "adm" COEFFS 0 1 0 0 0 1 /end COMPU_METHOD
/begin COMPU_METHOD FaultChkSLO4ms_Symbol_CM_uint16_s "Q = V" RAT_FUNC "%5.0" "s" COEFFS 0 1 0 0 0 1 /end COMPU_METHOD
/begin COMPU_METHOD FaultChkSPA4ms_CM_boolean_adm "Q = V" RAT_FUNC "%1.0" "adm" COEFFS 0 1 0 0 0 1 /end COMPU_METHOD
/begin COMPU_METHOD FaultChkSPA4ms_CM_ufix16_En10_V "Q = V*1024.000000" RAT_FUNC "%12.10" "V" COEFFS 0 1024 0 0 0 1 /end COMPU_METHOD
/begin COMPU_METHOD FaultChkSPA4ms_CM_ufix16_En3_degF "Q = V*8.000000" RAT_FUNC "%7.3" "degF" COEFFS 0 8 0 0 0 1 /end COMPU_METHOD
/begin COMPU_METHOD FaultChkSPA4ms_CM_ufix16_En8_s "Q = V*256.000000" RAT_FUNC "%11.8" "s" COEFFS 0 256 0 0 0 1 /end COMPU_METHOD
/begin COMPU_METHOD FaultChkSPA4ms_CM_uint16_rpm "Q = V" RAT_FUNC "%5.0" "rpm" COEFFS 0 1 0 0 0 1 /end COMPU_METHOD
/begin COMPU_METHOD FaultChkSPA4ms_CM_uint8_adm "Q = V" RAT_FUNC "%3.0" "adm" COEFFS 0 1 0 0 0 1 /end COMPU_METHOD
/begin COMPU_METHOD FaultChkSPB4ms_CM_boolean_adm "Q = V" RAT_FUNC "%1.0" "adm" COEFFS 0 1 0 0 0 1 /end COMPU_METHOD
/begin COMPU_METHOD FaultChkSPB4ms_CM_ufix16_En10_V "Q = V*1024.000000" RAT_FUNC "%12.10" "V" COEFFS 0 1024 0 0 0 1 /end COMPU_METHOD
/begin COMPU_METHOD FaultChkSPB4ms_CM_uint8_adm "Q = V" RAT_FUNC "%3.0" "adm" COEFFS 0 1 0 0 0 1 /end COMPU_METHOD
/begin COMPU_METHOD FaultChkSPM2H4ms_CM_boolean_adm "Q = V" RAT_FUNC "%1.0" "adm" COEFFS 0 1 0 0 0 1 /end COMPU_METHOD
/begin COMPU_METHOD FaultChkSPM2H4ms_CM_uint16_mbar "Q = V" RAT_FUNC "%5.0" "mbar" COEFFS 0 1 0 0 0 1 /end COMPU_METHOD
/begin COMPU_METHOD FaultChkSPM4ms_CM_boolean_adm "Q = V" RAT_FUNC "%1.0" "adm" COEFFS 0 1 0 0 0 1 /end COMPU_METHOD
/begin COMPU_METHOD FaultChkSPM4ms_CM_ufix16_En10_V "Q = V*1024.000000" RAT_FUNC "%12.10" "V" COEFFS 0 1024 0 0 0 1 /end COMPU_METHOD
/begin COMPU_METHOD FaultChkSPM4ms_CM_uint8_adm "Q = V" RAT_FUNC "%3.0" "adm" COEFFS 0 1 0 0 0 1 /end COMPU_METHOD
/begin COMPU_METHOD FaultChkSPMP4ms_CM_boolean_adm "Q = V" RAT_FUNC "%1.0" "adm" COEFFS 0 1 0 0 0 1 /end COMPU_METHOD
/begin COMPU_METHOD FaultChkSPMP4ms_CM_ufix8_Sp04_s "Q = V*25.000000" RAT_FUNC "%0.6" "s" COEFFS 0 25 0 0 0 1 /end COMPU_METHOD
/begin COMPU_METHOD FaultChkSPMP4ms_CM_uint16_mbar "Q = V" RAT_FUNC "%5.0" "mbar" COEFFS 0 1 0 0 0 1 /end COMPU_METHOD
/begin COMPU_METHOD FaultChkSPO100ms_CM_boolean_adm "Q = V" RAT_FUNC "%1.0" "adm" COEFFS 0 1 0 0 0 1 /end COMPU_METHOD
/begin COMPU_METHOD FaultChkSPO100ms_CM_ufix16_En10_V "Q = V*1024.000000" RAT_FUNC "%12.10" "V" COEFFS 0 1024 0 0 0 1 /end COMPU_METHOD
/begin COMPU_METHOD FaultChkSPO100ms_CM_uint8_adm "Q = V" RAT_FUNC "%3.0" "adm" COEFFS 0 1 0 0 0 1 /end COMPU_METHOD
/begin COMPU_METHOD FaultChkSPS4ms_CM_boolean_adm "Q = V" RAT_FUNC "%1.0" "adm" COEFFS 0 1 0 0 0 1 /end COMPU_METHOD
/begin COMPU_METHOD FaultChkSPS4ms_CM_ufix16_En10_V "Q = V*1024.000000" RAT_FUNC "%12.10" "V" COEFFS 0 1024 0 0 0 1 /end COMPU_METHOD
/begin COMPU_METHOD FaultChkSPS4ms_CM_uint8_adm "Q = V" RAT_FUNC "%3.0" "adm" COEFFS 0 1 0 0 0 1 /end COMPU_METHOD
/begin COMPU_METHOD FaultChkSPT100ms_Symbol_CM_boolean_adm "Q = V" RAT_FUNC "%1.0" "adm" COEFFS 0 1 0 0 0 1 /end COMPU_METHOD
/begin COMPU_METHOD FaultChkSPT100ms_Symbol_CM_ufix16_En10_V "Q = V*1024.000000" RAT_FUNC "%12.10" "V" COEFFS 0 1024 0 0 0 1 /end COMPU_METHOD
/begin COMPU_METHOD FaultChkSTA100ms_Symbol_CM_boolean_adm "Q = V" RAT_FUNC "%1.0" "adm" COEFFS 0 1 0 0 0 1 /end COMPU_METHOD
/begin COMPU_METHOD FaultChkSTA100ms_Symbol_CM_ufix16_En10_V "Q = V*1024.000000" RAT_FUNC "%12.10" "V" COEFFS 0 1024 0 0 0 1 /end COMPU_METHOD
/begin COMPU_METHOD FaultChkSTC100ms_Symbol_CM_boolean_adm "Q = V" RAT_FUNC "%1.0" "adm" COEFFS 0 1 0 0 0 1 /end COMPU_METHOD
/begin COMPU_METHOD FaultChkSTC100ms_Symbol_CM_ufix16_En10_V "Q = V*1024.000000" RAT_FUNC "%12.10" "V" COEFFS 0 1024 0 0 0 1 /end COMPU_METHOD
/begin COMPU_METHOD FaultChkSTC123100ms_Symbol_CM_boolean_adm "Q = V" RAT_FUNC "%1.0" "adm" COEFFS 0 1 0 0 0 1 /end COMPU_METHOD
/begin COMPU_METHOD FaultChkSTC123100ms_Symbol_CM_ufix16_Bn40_degC "Q = (V+40.000000)/1.000000" RAT_FUNC "%0.6" "degC" COEFFS 0 1 40 0 0 1 /end COMPU_METHOD
/begin COMPU_METHOD FaultChkSTC123100ms_Symbol_CM_uint16_degC "Q = V" RAT_FUNC "%5.0" "degC" COEFFS 0 1 0 0 0 1 /end COMPU_METHOD
/begin COMPU_METHOD FaultChkSTE1s_CM_boolean_adm "Q = V" RAT_FUNC "%1.0" "adm" COEFFS 0 1 0 0 0 1 /end COMPU_METHOD
/begin COMPU_METHOD FaultChkSTE1s_CM_ufix16_Bn40_V "Q = (V+40.000000)/1.000000" RAT_FUNC "%0.6" "V" COEFFS 0 1 40 0 0 1 /end COMPU_METHOD
/begin COMPU_METHOD FaultChkSTE1s_CM_ufix16_En10_V "Q = V*1024.000000" RAT_FUNC "%12.10" "V" COEFFS 0 1024 0 0 0 1 /end COMPU_METHOD
/begin COMPU_METHOD FaultChkSTH100ms_Symbol_CM_boolean_adm "Q = V" RAT_FUNC "%1.0" "adm" COEFFS 0 1 0 0 0 1 /end COMPU_METHOD
/begin COMPU_METHOD FaultChkSTH100ms_Symbol_CM_ufix16_En10_V "Q = V*1024.000000" RAT_FUNC "%12.10" "V" COEFFS 0 1024 0 0 0 1 /end COMPU_METHOD
/begin COMPU_METHOD FaultChkSTM100ms_Symbol_CM_boolean_adm "Q = V" RAT_FUNC "%1.0" "adm" COEFFS 0 1 0 0 0 1 /end COMPU_METHOD
/begin COMPU_METHOD FaultChkSTM100ms_Symbol_CM_ufix16_En10_V "Q = V*1024.000000" RAT_FUNC "%12.10" "V" COEFFS 0 1024 0 0 0 1 /end COMPU_METHOD
/begin COMPU_METHOD FaultChkSTO100ms_CM_boolean_adm "Q = V" RAT_FUNC "%1.0" "adm" COEFFS 0 1 0 0 0 1 /end COMPU_METHOD
/begin COMPU_METHOD FaultChkSTO100ms_CM_ufix16_En10_V "Q = V*1024.000000" RAT_FUNC "%12.10" "V" COEFFS 0 1024 0 0 0 1 /end COMPU_METHOD
/begin COMPU_METHOD FaultChkSTOH100ms_Symbol_CM_boolean_adm "Q = V" RAT_FUNC "%1.0" "adm" COEFFS 0 1 0 0 0 1 /end COMPU_METHOD
/begin COMPU_METHOD FaultChkSTX100ms_CM_boolean_adm "Q = V" RAT_FUNC "%1.0" "adm" COEFFS 0 1 0 0 0 1 /end COMPU_METHOD
/begin COMPU_METHOD FaultChkSTX100ms_CM_ufix16_En10_V "Q = V*1024.000000" RAT_FUNC "%12.10" "V" COEFFS 0 1024 0 0 0 1 /end COMPU_METHOD
/begin COMPU_METHOD FaultChkSUO4ms_CM_boolean_adm "Q = V" RAT_FUNC "%1.0" "adm" COEFFS 0 1 0 0 0 1 /end COMPU_METHOD
/begin COMPU_METHOD FaultChkTE2H1s_CM_boolean_adm "Q = V" RAT_FUNC "%1.0" "adm" COEFFS 0 1 0 0 0 1 /end COMPU_METHOD
/begin COMPU_METHOD FaultChkTE2H1s_CM_ufix16_Bn40_degC "Q = (V+40.000000)/1.000000" RAT_FUNC "%0.6" "degC" COEFFS 0 1 40 0 0 1 /end COMPU_METHOD
/begin COMPU_METHOD FaultChkTE2H1s_CM_uint16_s "Q = V" RAT_FUNC "%5.0" "s" COEFFS 0 1 0 0 0 1 /end COMPU_METHOD
/begin COMPU_METHOD FaultChkTH2H100ms_Symbol_CM_boolean_adm "Q = V" RAT_FUNC "%1.0" "adm" COEFFS 0 1 0 0 0 1 /end COMPU_METHOD
/begin COMPU_METHOD FaultChkTH2H100ms_Symbol_CM_ufix16_Bn40_degC "Q = (V+40.000000)/1.000000" RAT_FUNC "%0.6" "degC" COEFFS 0 1 40 0 0 1 /end COMPU_METHOD
/begin COMPU_METHOD FaultChkTH2H100ms_Symbol_CM_ufix32_Sp1_s "Q = V*10.000000" RAT_FUNC "%0.6" "s" COEFFS 0 10 0 0 0 1 /end COMPU_METHOD
/begin COMPU_METHOD FaultChkTH2H100ms_Symbol_CM_uint16_rpm "Q = V" RAT_FUNC "%5.0" "rpm" COEFFS 0 1 0 0 0 1 /end COMPU_METHOD
/begin COMPU_METHOD FaultChkTH2H100ms_Symbol_CM_uint8_degC "Q = V" RAT_FUNC "%3.0" "degC" COEFFS 0 1 0 0 0 1 /end COMPU_METHOD
/begin COMPU_METHOD FaultChkUDP4ms_CM_boolean_adm "Q = V" RAT_FUNC "%1.0" "adm" COEFFS 0 1 0 0 0 1 /end COMPU_METHOD
/begin COMPU_METHOD FaultChkUHR4ms_CM_boolean_adm "Q = V" RAT_FUNC "%1.0" "adm" COEFFS 0 1 0 0 0 1 /end COMPU_METHOD
/begin COMPU_METHOD FaultChkVBP4ms_CM_boolean_adm "Q = V" RAT_FUNC "%1.0" "adm" COEFFS 0 1 0 0 0 1 /end COMPU_METHOD
/begin COMPU_METHOD FaultChkVBP4ms_CM_ufix16_En8_s "Q = V*256.000000" RAT_FUNC "%11.8" "s" COEFFS 0 256 0 0 0 1 /end COMPU_METHOD
/begin COMPU_METHOD FaultChkVBP4ms_CM_ufix16_S50_mV "Q = V/50.000000" RAT_FUNC "%0.6" "mV" COEFFS 0 1 0 0 0 50 /end COMPU_METHOD
/begin COMPU_METHOD FaultChkVS14ms_CM_boolean_adm "Q = V" RAT_FUNC "%1.0" "adm" COEFFS 0 1 0 0 0 1 /end COMPU_METHOD
/begin COMPU_METHOD FaultChkVS14ms_CM_ufix16_En10_V "Q = V*1024.000000" RAT_FUNC "%12.10" "V" COEFFS 0 1024 0 0 0 1 /end COMPU_METHOD
/begin COMPU_METHOD FaultChkVS14ms_CM_ufix16_En8_s "Q = V*256.000000" RAT_FUNC "%11.8" "s" COEFFS 0 256 0 0 0 1 /end COMPU_METHOD
/begin COMPU_METHOD FaultChkVS24ms_CM_boolean_adm "Q = V" RAT_FUNC "%1.0" "adm" COEFFS 0 1 0 0 0 1 /end COMPU_METHOD
/begin COMPU_METHOD FaultChkVS24ms_CM_ufix16_En10_V "Q = V*1024.000000" RAT_FUNC "%12.10" "V" COEFFS 0 1024 0 0 0 1 /end COMPU_METHOD
/begin COMPU_METHOD FaultChkVS24ms_CM_ufix16_En8_s "Q = V*256.000000" RAT_FUNC "%11.8" "s" COEFFS 0 256 0 0 0 1 /end COMPU_METHOD
/begin COMPU_METHOD FaultChkVS34ms_CM_boolean_adm "Q = V" RAT_FUNC "%1.0" "adm" COEFFS 0 1 0 0 0 1 /end COMPU_METHOD
/begin COMPU_METHOD FaultChkVS34ms_CM_ufix16_En10_V "Q = V*1024.000000" RAT_FUNC "%12.10" "V" COEFFS 0 1024 0 0 0 1 /end COMPU_METHOD
/begin COMPU_METHOD FaultChkVS34ms_CM_ufix16_En8_s "Q = V*256.000000" RAT_FUNC "%11.8" "s" COEFFS 0 256 0 0 0 1 /end COMPU_METHOD
/begin COMPU_METHOD FaultChkWGT50ms_CM_boolean_adm "Q = V" RAT_FUNC "%1.0" "adm" COEFFS 0 1 0 0 0 1 /end COMPU_METHOD
/begin COMPU_METHOD Fuels_CtrlMgmtTDC_CM_boolean_adm "Q = V" RAT_FUNC "%1.0" "adm" COEFFS 0 1 0 0 0 1 /end COMPU_METHOD
/begin COMPU_METHOD Fuels_CtrlMgmtTDC_CM_uint16_mbar "Q = V" RAT_FUNC "%5.0" "mbar" COEFFS 0 1 0 0 0 1 /end COMPU_METHOD
/begin COMPU_METHOD Gast100ms_CM_boolean_adm "Q = V" RAT_FUNC "%1.0" "adm" COEFFS 0 1 0 0 0 1 /end COMPU_METHOD
/begin COMPU_METHOD Gast100ms_CM_tFault_adm "Enumerated data type: tFault" TAB_VERB "%0.6" "adm" COMPU_TAB_REF VTAB_FOR_Gast100ms_CM_tFault_adm /end COMPU_METHOD
/begin COMPU_METHOD Gast100ms_CM_tKeyState_adm "Enumerated data type: tKeyState" TAB_VERB "%0.6" "adm" COMPU_TAB_REF VTAB_FOR_Gast100ms_CM_tKeyState_adm /end COMPU_METHOD
/begin COMPU_METHOD Gast100ms_CM_ufix16_Bn40_degC "Q = (V+40.000000)/1.000000" RAT_FUNC "%0.6" "degC" COEFFS 0 1 40 0 0 1 /end COMPU_METHOD
/begin COMPU_METHOD Gast100ms_CM_ufix16_En10_V "Q = V*1024.000000" RAT_FUNC "%12.10" "V" COEFFS 0 1024 0 0 0 1 /end COMPU_METHOD
/begin COMPU_METHOD Idle4ms_CM_eEGMD_adm "Enumerated data type: eEGMD" TAB_VERB "%0.6" "adm" COMPU_TAB_REF VTAB_FOR_Idle4ms_CM_eEGMD_adm /end COMPU_METHOD
/begin COMPU_METHOD Idle4ms_CM_eEGST_adm "Enumerated data type: eEGST" TAB_VERB "%0.6" "adm" COMPU_TAB_REF VTAB_FOR_Idle4ms_CM_eEGST_adm /end COMPU_METHOD
/begin COMPU_METHOD Idle4ms_CM_tKeyState_adm "Enumerated data type: tKeyState" TAB_VERB "%0.6" "adm" COMPU_TAB_REF VTAB_FOR_Idle4ms_CM_tKeyState_adm /end COMPU_METHOD
/begin COMPU_METHOD Idle4ms_CM_ufix16_Bn40_degC "Q = (V+40.000000)/1.000000" RAT_FUNC "%0.6" "degC" COEFFS 0 1 40 0 0 1 /end COMPU_METHOD
/begin COMPU_METHOD Idle4ms_CM_ufix16_En10_adm "Q = V*1024.000000" RAT_FUNC "%12.10" "adm" COEFFS 0 1024 0 0 0 1 /end COMPU_METHOD
/begin COMPU_METHOD Idle4ms_CM_ufix16_S50_mV "Q = V/50.000000" RAT_FUNC "%0.6" "mV" COEFFS 0 1 0 0 0 50 /end COMPU_METHOD
/begin COMPU_METHOD Idle4ms_CM_uint16_km_h "Q = V" RAT_FUNC "%5.0" "km/h" COEFFS 0 1 0 0 0 1 /end COMPU_METHOD
/begin COMPU_METHOD Idle50ms_CM_int16_rpm_s "Q = V" RAT_FUNC "%5.0" "rpm/s" COEFFS 0 1 0 0 0 1 /end COMPU_METHOD
/begin COMPU_METHOD IgntTDC_CM_eEGMD_adm "Enumerated data type: eEGMD" TAB_VERB "%0.6" "adm" COMPU_TAB_REF VTAB_FOR_IgntTDC_CM_eEGMD_adm /end COMPU_METHOD
/begin COMPU_METHOD IgntTDC_CM_eEGST_adm "Enumerated data type: eEGST" TAB_VERB "%0.6" "adm" COMPU_TAB_REF VTAB_FOR_IgntTDC_CM_eEGST_adm /end COMPU_METHOD
/begin COMPU_METHOD IgntTDC_CM_ufix16_Bn40_degC "Q = (V+40.000000)/1.000000" RAT_FUNC "%0.6" "degC" COEFFS 0 1 40 0 0 1 /end COMPU_METHOD
/begin COMPU_METHOD IgntTDC_CM_ufix16_En10_adm "Q = V*1024.000000" RAT_FUNC "%12.10" "adm" COEFFS 0 1024 0 0 0 1 /end COMPU_METHOD
/begin COMPU_METHOD IgntTDC_CM_ufix16_En3__ "Q = V*8.000000" RAT_FUNC "%7.3" "%" COEFFS 0 8 0 0 0 1 /end COMPU_METHOD
/begin COMPU_METHOD IgntTDC_CM_ufix16_S50_mV "Q = V/50.000000" RAT_FUNC "%0.6" "mV" COEFFS 0 1 0 0 0 50 /end COMPU_METHOD
/begin COMPU_METHOD IgntTDC_CM_uint16_rpm "Q = V" RAT_FUNC "%5.0" "rpm" COEFFS 0 1 0 0 0 1 /end COMPU_METHOD
/begin COMPU_METHOD InjtTDC_CM_eCutOff_adm "Enumerated data type: eCutOff" TAB_VERB "%0.6" "adm" COMPU_TAB_REF VTAB_FOR_InjtTDC_CM_eCutOff_adm /end COMPU_METHOD
/begin COMPU_METHOD InjtTDC_CM_eEGMD_adm "Enumerated data type: eEGMD" TAB_VERB "%0.6" "adm" COMPU_TAB_REF VTAB_FOR_InjtTDC_CM_eEGMD_adm /end COMPU_METHOD
/begin COMPU_METHOD InjtTDC_CM_eEGST_adm "Enumerated data type: eEGST" TAB_VERB "%0.6" "adm" COMPU_TAB_REF VTAB_FOR_InjtTDC_CM_eEGST_adm /end COMPU_METHOD
/begin COMPU_METHOD InjtTDC_CM_ePhCrank_adm "Enumerated data type: ePhCrank" TAB_VERB "%0.6" "adm" COMPU_TAB_REF VTAB_FOR_InjtTDC_CM_ePhCrank_adm /end COMPU_METHOD
/begin COMPU_METHOD InjtTDC_CM_ufix16_Bn40_degC "Q = (V+40.000000)/1.000000" RAT_FUNC "%0.6" "degC" COEFFS 0 1 40 0 0 1 /end COMPU_METHOD
/begin COMPU_METHOD InjtTDC_CM_ufix16_En15_adm "Q = V*32768.000000" RAT_FUNC "%16.15" "adm" COEFFS 0 32768 0 0 0 1 /end COMPU_METHOD
/begin COMPU_METHOD InjtTDC_CM_ufix16_En3_mg_cc "Q = V*8.000000" RAT_FUNC "%7.3" "mg/cc" COEFFS 0 8 0 0 0 1 /end COMPU_METHOD
/begin COMPU_METHOD InjtTDC_CM_ufix16_En4_kg_h "Q = V*16.000000" RAT_FUNC "%8.4" "kg/h" COEFFS 0 16 0 0 0 1 /end COMPU_METHOD
/begin COMPU_METHOD InjtTDC_CM_ufix16_En7_mg_cc "Q = V*128.000000" RAT_FUNC "%10.7" "mg/cc" COEFFS 0 128 0 0 0 1 /end COMPU_METHOD
/begin COMPU_METHOD J1939dl_Tx1s_CM_ufix16_En10_V "Q = V*1024.000000" RAT_FUNC "%12.10" "V" COEFFS 0 1024 0 0 0 1 /end COMPU_METHOD
/begin COMPU_METHOD KnockTDC_CM_boolean_adm "Q = V" RAT_FUNC "%1.0" "adm" COEFFS 0 1 0 0 0 1 /end COMPU_METHOD
/begin COMPU_METHOD KnockTDC_CM_tFault_adm "Enumerated data type: tFault" TAB_VERB "%0.6" "adm" COMPU_TAB_REF VTAB_FOR_KnockTDC_CM_tFault_adm /end COMPU_METHOD
/begin COMPU_METHOD Lamm4ms_CM_boolean_adm "Q = V" RAT_FUNC "%1.0" "adm" COEFFS 0 1 0 0 0 1 /end COMPU_METHOD
/begin COMPU_METHOD Lamm4ms_CM_tFault_adm "Enumerated data type: tFault" TAB_VERB "%0.6" "adm" COMPU_TAB_REF VTAB_FOR_Lamm4ms_CM_tFault_adm /end COMPU_METHOD
/begin COMPU_METHOD Lamp100ms_CM_boolean_adm "Q = V" RAT_FUNC "%1.0" "adm" COEFFS 0 1 0 0 0 1 /end COMPU_METHOD
/begin COMPU_METHOD Lamp100ms_CM_tFault_adm "Enumerated data type: tFault" TAB_VERB "%0.6" "adm" COMPU_TAB_REF VTAB_FOR_Lamp100ms_CM_tFault_adm /end COMPU_METHOD
/begin COMPU_METHOD Mpre4ms_CM_boolean_adm "Q = V" RAT_FUNC "%1.0" "adm" COEFFS 0 1 0 0 0 1 /end COMPU_METHOD
/begin COMPU_METHOD Mpre4ms_CM_tFault_adm "Enumerated data type: tFault" TAB_VERB "%0.6" "adm" COMPU_TAB_REF VTAB_FOR_Mpre4ms_CM_tFault_adm /end COMPU_METHOD
/begin COMPU_METHOD Oilp100ms_CM_boolean_adm "Q = V" RAT_FUNC "%1.0" "adm" COEFFS 0 1 0 0 0 1 /end COMPU_METHOD
/begin COMPU_METHOD Oilp100ms_CM_tFault_adm "Enumerated data type: tFault" TAB_VERB "%0.6" "adm" COMPU_TAB_REF VTAB_FOR_Oilp100ms_CM_tFault_adm /end COMPU_METHOD
/begin COMPU_METHOD Oilp100ms_CM_ufix16_En10_V "Q = V*1024.000000" RAT_FUNC "%12.10" "V" COEFFS 0 1024 0 0 0 1 /end COMPU_METHOD
/begin COMPU_METHOD Oilp100ms_CM_uint16_mbar "Q = V" RAT_FUNC "%5.0" "mbar" COEFFS 0 1 0 0 0 1 /end COMPU_METHOD
/begin COMPU_METHOD Oilt100ms_CM_boolean_adm "Q = V" RAT_FUNC "%1.0" "adm" COEFFS 0 1 0 0 0 1 /end COMPU_METHOD
/begin COMPU_METHOD Oilt100ms_CM_tFault_adm "Enumerated data type: tFault" TAB_VERB "%0.6" "adm" COMPU_TAB_REF VTAB_FOR_Oilt100ms_CM_tFault_adm /end COMPU_METHOD
/begin COMPU_METHOD Oilt100ms_CM_ufix16_Bn40_degC "Q = (V+40.000000)/1.000000" RAT_FUNC "%0.6" "degC" COEFFS 0 1 40 0 0 1 /end COMPU_METHOD
/begin COMPU_METHOD Oilt100ms_CM_ufix16_En10_V "Q = V*1024.000000" RAT_FUNC "%12.10" "V" COEFFS 0 1024 0 0 0 1 /end COMPU_METHOD
/begin COMPU_METHOD Pacc4ms_CM_boolean_adm "Q = V" RAT_FUNC "%1.0" "adm" COEFFS 0 1 0 0 0 1 /end COMPU_METHOD
/begin COMPU_METHOD Pacc4ms_CM_tFault_adm "Enumerated data type: tFault" TAB_VERB "%0.6" "adm" COMPU_TAB_REF VTAB_FOR_Pacc4ms_CM_tFault_adm /end COMPU_METHOD
/begin COMPU_METHOD Pacc4ms_CM_ufix16_En10_V "Q = V*1024.000000" RAT_FUNC "%12.10" "V" COEFFS 0 1024 0 0 0 1 /end COMPU_METHOD
/begin COMPU_METHOD Pacc4ms_CM_uint8_adm "Q = V" RAT_FUNC "%3.0" "adm" COEFFS 0 1 0 0 0 1 /end COMPU_METHOD
/begin COMPU_METHOD Prvc4ms_CM_boolean_adm "Q = V" RAT_FUNC "%1.0" "adm" COEFFS 0 1 0 0 0 1 /end COMPU_METHOD
/begin COMPU_METHOD Prvc4ms_CM_tActDiagStat_adm "Enumerated data type: tActDiagStat" TAB_VERB "%0.6" "adm" COMPU_TAB_REF VTAB_FOR_Prvc4ms_CM_tActDiagStat_adm /end COMPU_METHOD
/begin COMPU_METHOD Prvc4ms_CM_tFault_adm "Enumerated data type: tFault" TAB_VERB "%0.6" "adm" COMPU_TAB_REF VTAB_FOR_Prvc4ms_CM_tFault_adm /end COMPU_METHOD
/begin COMPU_METHOD Pwrl4ms_CM_boolean_adm "Q = V" RAT_FUNC "%1.0" "adm" COEFFS 0 1 0 0 0 1 /end COMPU_METHOD
/begin COMPU_METHOD Pwrl4ms_CM_tFault_adm "Enumerated data type: tFault" TAB_VERB "%0.6" "adm" COMPU_TAB_REF VTAB_FOR_Pwrl4ms_CM_tFault_adm /end COMPU_METHOD
/begin COMPU_METHOD Pwrl4ms_CM_ufix16_E2_ms "Q = V/4.000000" RAT_FUNC "%5.0" "ms" COEFFS 0 1 0 0 0 4 /end COMPU_METHOD
/begin COMPU_METHOD RecRifasaInjTDC_CM_boolean_adm "Q = V" RAT_FUNC "%1.0" "adm" COEFFS 0 1 0 0 0 1 /end COMPU_METHOD
/begin COMPU_METHOD RecRifasaInjTDC_CM_ufix16_Bn40_degC "Q = (V+40.000000)/1.000000" RAT_FUNC "%0.6" "degC" COEFFS 0 1 40 0 0 1 /end COMPU_METHOD
/begin COMPU_METHOD RecRifasaInjTDC_CM_uint16_adm "Q = V" RAT_FUNC "%5.0" "adm" COEFFS 0 1 0 0 0 1 /end COMPU_METHOD
/begin COMPU_METHOD RecRifasaInjTDC_CM_uint16_us "Q = V" RAT_FUNC "%5.0" "us" COEFFS 0 1 0 0 0 1 /end COMPU_METHOD
/begin COMPU_METHOD RecRifasaInjTDC_CM_uint8_adm "Q = V" RAT_FUNC "%3.0" "adm" COEFFS 0 1 0 0 0 1 /end COMPU_METHOD
/begin COMPU_METHOD RecoveryEVR4ms_Symbol_CM_ufix16_Sp004_s "Q = V*250.000000" RAT_FUNC "%0.6" "s" COEFFS 0 250 0 0 0 1 /end COMPU_METHOD
/begin COMPU_METHOD RecoveryLHR100ms_CM_boolean_adm "Q = V" RAT_FUNC "%1.0" "adm" COEFFS 0 1 0 0 0 1 /end COMPU_METHOD
/begin COMPU_METHOD RecoveryPRV4ms_Symbol_CM_boolean_adm "Q = V" RAT_FUNC "%1.0" "adm" COEFFS 0 1 0 0 0 1 /end COMPU_METHOD
/begin COMPU_METHOD RecoverySPA4ms_Symbol_CM_uint16_mbar "Q = V" RAT_FUNC "%5.0" "mbar" COEFFS 0 1 0 0 0 1 /end COMPU_METHOD
/begin COMPU_METHOD RecoverySPB4ms_Symbol_CM_ufix16_E2_mbar "Q = V/4.000000" RAT_FUNC "%5.0" "mbar" COEFFS 0 1 0 0 0 4 /end COMPU_METHOD
/begin COMPU_METHOD RecoverySPM4ms_CM_uint16_mbar "Q = V" RAT_FUNC "%5.0" "mbar" COEFFS 0 1 0 0 0 1 /end COMPU_METHOD
/begin COMPU_METHOD RecoverySPO100ms_Symbol_CM_ufix16_En10_V "Q = V*1024.000000" RAT_FUNC "%12.10" "V" COEFFS 0 1024 0 0 0 1 /end COMPU_METHOD
/begin COMPU_METHOD RecoverySPO100ms_Symbol_CM_uint16_mbar "Q = V" RAT_FUNC "%5.0" "mbar" COEFFS 0 1 0 0 0 1 /end COMPU_METHOD
/begin COMPU_METHOD RecoverySPT100ms_Symbol_CM_uint16_mbar "Q = V" RAT_FUNC "%5.0" "mbar" COEFFS 0 1 0 0 0 1 /end COMPU_METHOD
/begin COMPU_METHOD RecoverySTA100ms_Symbol_CM_ufix16_Bn40_degC "Q = (V+40.000000)/1.000000" RAT_FUNC "%0.6" "degC" COEFFS 0 1 40 0 0 1 /end COMPU_METHOD
/begin COMPU_METHOD RecoverySTA100ms_Symbol_CM_ufix16_En10_V "Q = V*1024.000000" RAT_FUNC "%12.10" "V" COEFFS 0 1024 0 0 0 1 /end COMPU_METHOD
/begin COMPU_METHOD RecoverySTA100ms_Symbol_CM_ufix16_En10_adm "Q = V*1024.000000" RAT_FUNC "%12.10" "adm" COEFFS 0 1024 0 0 0 1 /end COMPU_METHOD
/begin COMPU_METHOD RecoverySTA100ms_Symbol_CM_ufix16_En8_s "Q = V*256.000000" RAT_FUNC "%11.8" "s" COEFFS 0 256 0 0 0 1 /end COMPU_METHOD
/begin COMPU_METHOD RecoverySTE1s_CM_ufix16_Bn40_degC "Q = (V+40.000000)/1.000000" RAT_FUNC "%0.6" "degC" COEFFS 0 1 40 0 0 1 /end COMPU_METHOD
/begin COMPU_METHOD RecoverySTE1s_CM_ufix16_En10_V "Q = V*1024.000000" RAT_FUNC "%12.10" "V" COEFFS 0 1024 0 0 0 1 /end COMPU_METHOD
/begin COMPU_METHOD RecoverySTH100ms_CM_ufix16_Bn40_degC "Q = (V+40.000000)/1.000000" RAT_FUNC "%0.6" "degC" COEFFS 0 1 40 0 0 1 /end COMPU_METHOD
/begin COMPU_METHOD RecoverySTH100ms_CM_ufix16_En10_V "Q = V*1024.000000" RAT_FUNC "%12.10" "V" COEFFS 0 1024 0 0 0 1 /end COMPU_METHOD
/begin COMPU_METHOD RecoverySTM100ms_Symbol_CM_ufix16_Bn40_degC "Q = (V+40.000000)/1.000000" RAT_FUNC "%0.6" "degC" COEFFS 0 1 40 0 0 1 /end COMPU_METHOD
/begin COMPU_METHOD RecoverySTM100ms_Symbol_CM_ufix16_En10_V "Q = V*1024.000000" RAT_FUNC "%12.10" "V" COEFFS 0 1024 0 0 0 1 /end COMPU_METHOD
/begin COMPU_METHOD RecoverySTO100ms_Symbol_CM_ufix16_En10_V "Q = V*1024.000000" RAT_FUNC "%12.10" "V" COEFFS 0 1024 0 0 0 1 /end COMPU_METHOD
/begin COMPU_METHOD RecoverySTOH100ms_Symbol_CM_ufix16_Bn40_degC "Q = (V+40.000000)/1.000000" RAT_FUNC "%0.6" "degC" COEFFS 0 1 40 0 0 1 /end COMPU_METHOD
/begin COMPU_METHOD RecoverySTOH100ms_Symbol_CM_ufix16_Sp1_s "Q = V*10.000000" RAT_FUNC "%0.6" "s" COEFFS 0 10 0 0 0 1 /end COMPU_METHOD
/begin COMPU_METHOD RecoverySTX100ms_CM_ufix16_Bn40_degC "Q = (V+40.000000)/1.000000" RAT_FUNC "%0.6" "degC" COEFFS 0 1 40 0 0 1 /end COMPU_METHOD
/begin COMPU_METHOD RecoverySTX100ms_CM_ufix16_En10_V "Q = V*1024.000000" RAT_FUNC "%12.10" "V" COEFFS 0 1024 0 0 0 1 /end COMPU_METHOD
/begin COMPU_METHOD RecoveryUHR4ms_CM_ufix32_En24__ "Q = V*16777216.000000" RAT_FUNC "%26.16" "%" COEFFS 0 16777216 0 0 0 1 /end COMPU_METHOD
/begin COMPU_METHOD RecoveryWGT50ms_Symbol_CM_ufix16_En3__ "Q = V*8.000000" RAT_FUNC "%7.3" "%" COEFFS 0 8 0 0 0 1 /end COMPU_METHOD
/begin COMPU_METHOD Rpre4ms_CM_boolean_adm "Q = V" RAT_FUNC "%1.0" "adm" COEFFS 0 1 0 0 0 1 /end COMPU_METHOD
/begin COMPU_METHOD Rpre4ms_CM_tFault_adm "Enumerated data type: tFault" TAB_VERB "%0.6" "adm" COMPU_TAB_REF VTAB_FOR_Rpre4ms_CM_tFault_adm /end COMPU_METHOD
/begin COMPU_METHOD Rpre4ms_CM_ufix16_En10_V "Q = V*1024.000000" RAT_FUNC "%12.10" "V" COEFFS 0 1024 0 0 0 1 /end COMPU_METHOD
/begin COMPU_METHOD Rpre4ms_CM_uint16_mbar "Q = V" RAT_FUNC "%5.0" "mbar" COEFFS 0 1 0 0 0 1 /end COMPU_METHOD
/begin COMPU_METHOD Saf3Init_CM_boolean_adm "Q = V" RAT_FUNC "%1.0" "adm" COEFFS 0 1 0 0 0 1 /end COMPU_METHOD
/begin COMPU_METHOD Saf3_50ms_CM_boolean_adm "Q = V" RAT_FUNC "%1.0" "adm" COEFFS 0 1 0 0 0 1 /end COMPU_METHOD
/begin COMPU_METHOD Saf3_50ms_CM_tFault_adm "Enumerated data type: tFault" TAB_VERB "%0.6" "adm" COMPU_TAB_REF VTAB_FOR_Saf3_50ms_CM_tFault_adm /end COMPU_METHOD
/begin COMPU_METHOD Sqs4ms_CM_boolean_adm "Q = V" RAT_FUNC "%1.0" "adm" COEFFS 0 1 0 0 0 1 /end COMPU_METHOD
/begin COMPU_METHOD Sqs4ms_CM_tFault_adm "Enumerated data type: tFault" TAB_VERB "%0.6" "adm" COMPU_TAB_REF VTAB_FOR_Sqs4ms_CM_tFault_adm /end COMPU_METHOD
/begin COMPU_METHOD Svs4ms_CM_boolean_adm "Q = V" RAT_FUNC "%1.0" "adm" COEFFS 0 1 0 0 0 1 /end COMPU_METHOD
/begin COMPU_METHOD Svs4ms_CM_tFault_adm "Enumerated data type: tFault" TAB_VERB "%0.6" "adm" COMPU_TAB_REF VTAB_FOR_Svs4ms_CM_tFault_adm /end COMPU_METHOD
/begin COMPU_METHOD TE_FaultChkSPEED4ms_Symbol_CM_boolean_adm "Q = V" RAT_FUNC "%1.0" "adm" COEFFS 0 1 0 0 0 1 /end COMPU_METHOD
/begin COMPU_METHOD TE_FaultChkSPP01_4ms_CM_boolean_adm "Q = V" RAT_FUNC "%1.0" "adm" COEFFS 0 1 0 0 0 1 /end COMPU_METHOD
/begin COMPU_METHOD TE_FaultChkSPP01_4ms_CM_ufix16_En10_V "Q = V*1024.000000" RAT_FUNC "%12.10" "V" COEFFS 0 1024 0 0 0 1 /end COMPU_METHOD
/begin COMPU_METHOD TE_FaultChkSPP01_4ms_CM_uint8_adm "Q = V" RAT_FUNC "%3.0" "adm" COEFFS 0 1 0 0 0 1 /end COMPU_METHOD
/begin COMPU_METHOD TE_FaultChkSPP02_4ms_CM_boolean_adm "Q = V" RAT_FUNC "%1.0" "adm" COEFFS 0 1 0 0 0 1 /end COMPU_METHOD
/begin COMPU_METHOD TE_FaultChkSPP02_4ms_CM_ufix16_En10_V "Q = V*1024.000000" RAT_FUNC "%12.10" "V" COEFFS 0 1024 0 0 0 1 /end COMPU_METHOD
/begin COMPU_METHOD TE_FaultChkSPP02_4ms_CM_ufix16_En10_rpm "Q = V*1024.000000" RAT_FUNC "%12.10" "rpm" COEFFS 0 1024 0 0 0 1 /end COMPU_METHOD
/begin COMPU_METHOD TE_FaultChkSPP02_4ms_CM_uint8_adm "Q = V" RAT_FUNC "%3.0" "adm" COEFFS 0 1 0 0 0 1 /end COMPU_METHOD
/begin COMPU_METHOD TE_FaultChkSPPC1_4ms_CM_boolean_adm "Q = V" RAT_FUNC "%1.0" "adm" COEFFS 0 1 0 0 0 1 /end COMPU_METHOD
/begin COMPU_METHOD TE_FaultChkSPPC2_4ms_CM_boolean_adm "Q = V" RAT_FUNC "%1.0" "adm" COEFFS 0 1 0 0 0 1 /end COMPU_METHOD
/begin COMPU_METHOD TE_FaultChkSPPCH_4ms_CM_boolean_adm "Q = V" RAT_FUNC "%1.0" "adm" COEFFS 0 1 0 0 0 1 /end COMPU_METHOD
/begin COMPU_METHOD TE_MAirReqATDC_Symbol_CM_FixEnableT "Enumerated data type: FixEnableT" TAB_VERB "%0.6" "" COMPU_TAB_REF VTAB_FOR_TE_MAirReqATDC_Symbol_CM_FixEnableT /end COMPU_METHOD
/begin COMPU_METHOD TE_MAirReqATDC_Symbol_CM_ufix16_En4_degE "Q = V*16.000000" RAT_FUNC "%8.4" "degE" COEFFS 0 16 0 0 0 1 /end COMPU_METHOD
/begin COMPU_METHOD TE_RecoverySPP_4ms_CM_boolean_adm "Q = V" RAT_FUNC "%1.0" "adm" COEFFS 0 1 0 0 0 1 /end COMPU_METHOD
/begin COMPU_METHOD TE_RecoverySPP_4ms_CM_ufix16_En10_V "Q = V*1024.000000" RAT_FUNC "%12.10" "V" COEFFS 0 1024 0 0 0 1 /end COMPU_METHOD
/begin COMPU_METHOD TE_RecoverySPP_4ms_CM_uint8_adm "Q = V" RAT_FUNC "%3.0" "adm" COEFFS 0 1 0 0 0 1 /end COMPU_METHOD
/begin COMPU_METHOD TE_TM_CheckStazDiag_50ms_Symbol_CM_boolean_adm "Q = V" RAT_FUNC "%1.0" "adm" COEFFS 0 1 0 0 0 1 /end COMPU_METHOD
/begin COMPU_METHOD TE_TM_CheckStazDiag_50ms_Symbol_CM_ufix16_Bn40_degC "Q = (V+40.000000)/1.000000" RAT_FUNC "%0.6" "degC" COEFFS 0 1 40 0 0 1 /end COMPU_METHOD
/begin COMPU_METHOD TE_TM_CheckStazDiag_50ms_Symbol_CM_ufix16_S50_mV "Q = V/50.000000" RAT_FUNC "%0.6" "mV" COEFFS 0 1 0 0 0 50 /end COMPU_METHOD
/begin COMPU_METHOD TE_TM_CheckStazDiag_50ms_Symbol_CM_uint16_rpm "Q = V" RAT_FUNC "%5.0" "rpm" COEFFS 0 1 0 0 0 1 /end COMPU_METHOD
/begin COMPU_METHOD TE_TM_CndAbilTHRST4ms_CM_sfix16_En8__ "Q = V*256.000000" RAT_FUNC "%11.8" "%" COEFFS 0 256 0 0 0 1 /end COMPU_METHOD
/begin COMPU_METHOD TE_TM_CndAbilTHRST4ms_CM_ufix16_Bn40_degC "Q = (V+40.000000)/1.000000" RAT_FUNC "%0.6" "degC" COEFFS 0 1 40 0 0 1 /end COMPU_METHOD
/begin COMPU_METHOD TE_TM_CndAbilTHRST4ms_CM_ufix16_S50_mV "Q = V/50.000000" RAT_FUNC "%0.6" "mV" COEFFS 0 1 0 0 0 50 /end COMPU_METHOD
/begin COMPU_METHOD TE_TM_FFW4ms_Symbol_CM_ufix16_En4__ "Q = V*16.000000" RAT_FUNC "%8.4" "%" COEFFS 0 16 0 0 0 1 /end COMPU_METHOD
/begin COMPU_METHOD TE_TM_FaultChkAIR2H_50ms_Symbol_CM_ufix16_En4_kg_h "Q = V*16.000000" RAT_FUNC "%8.4" "kg/h" COEFFS 0 16 0 0 0 1 /end COMPU_METHOD
/begin COMPU_METHOD TE_TM_FaultChkAIR2L_50ms_Symbol_CM_ufix16_En4_kg_h "Q = V*16.000000" RAT_FUNC "%8.4" "kg/h" COEFFS 0 16 0 0 0 1 /end COMPU_METHOD
/begin COMPU_METHOD TE_TM_FaultChkFARCH4ms_Symbol_CM_ufix16_En10_V "Q = V*1024.000000" RAT_FUNC "%12.10" "V" COEFFS 0 1024 0 0 0 1 /end COMPU_METHOD
/begin COMPU_METHOD TE_TM_FaultChkTHRST4ms_Symbol_CM_boolean_adm "Q = V" RAT_FUNC "%1.0" "adm" COEFFS 0 1 0 0 0 1 /end COMPU_METHOD
/begin COMPU_METHOD TE_TM_FaultChkTHRST4ms_Symbol_CM_sfix16_En8__ "Q = V*256.000000" RAT_FUNC "%11.8" "%" COEFFS 0 256 0 0 0 1 /end COMPU_METHOD
/begin COMPU_METHOD TE_TM_FaultChkTHRST4ms_Symbol_CM_ufix16_En8__ "Q = V*256.000000" RAT_FUNC "%11.8" "%" COEFFS 0 256 0 0 0 1 /end COMPU_METHOD
/begin COMPU_METHOD TE_TM_FaultChkTHRST4ms_Symbol_CM_ufix32_Sp004_s "Q = V*250.000000" RAT_FUNC "%0.6" "s" COEFFS 0 250 0 0 0 1 /end COMPU_METHOD
/begin COMPU_METHOD TE_TM_RecoveryAIR_50ms_Symbol_CM_ufix16_En4__ "Q = V*16.000000" RAT_FUNC "%8.4" "%" COEFFS 0 16 0 0 0 1 /end COMPU_METHOD
/begin COMPU_METHOD TE_TM_RecoveryAIR_50ms_Symbol_CM_uint16_rpm "Q = V" RAT_FUNC "%5.0" "rpm" COEFFS 0 1 0 0 0 1 /end COMPU_METHOD
/begin COMPU_METHOD TE_TM_RecoveryFAR4ms_Symbol_CM_ufix16_En10_V "Q = V*1024.000000" RAT_FUNC "%12.10" "V" COEFFS 0 1024 0 0 0 1 /end COMPU_METHOD
/begin COMPU_METHOD TE_TM_SpeedCtrl_4ms_Symbol_CM_FixEnableT "Enumerated data type: FixEnableT" TAB_VERB "%0.6" "" COMPU_TAB_REF VTAB_FOR_TE_TM_SpeedCtrl_4ms_Symbol_CM_FixEnableT /end COMPU_METHOD
/begin COMPU_METHOD TE_TM_SpeedCtrl_4ms_Symbol_CM_boolean_adm "Q = V" RAT_FUNC "%1.0" "adm" COEFFS 0 1 0 0 0 1 /end COMPU_METHOD
/begin COMPU_METHOD TE_TM_SpeedCtrl_4ms_Symbol_CM_sfix16_En4__ "Q = V*16.000000" RAT_FUNC "%8.4" "%" COEFFS 0 16 0 0 0 1 /end COMPU_METHOD
/begin COMPU_METHOD TE_TM_SpeedCtrl_4ms_Symbol_CM_ufix16_En4__ "Q = V*16.000000" RAT_FUNC "%8.4" "%" COEFFS 0 16 0 0 0 1 /end COMPU_METHOD
/begin COMPU_METHOD TE_TM_TorqBas4ms_CM_FixEnableT "Enumerated data type: FixEnableT" TAB_VERB "%0.6" "" COMPU_TAB_REF VTAB_FOR_TE_TM_TorqBas4ms_CM_FixEnableT /end COMPU_METHOD
/begin COMPU_METHOD TE_TM_TorqBas4ms_CM_boolean_adm "Q = V" RAT_FUNC "%1.0" "adm" COEFFS 0 1 0 0 0 1 /end COMPU_METHOD
/begin COMPU_METHOD TE_TM_TorqBas4ms_CM_ufix16_Bn40_degC "Q = (V+40.000000)/1.000000" RAT_FUNC "%0.6" "degC" COEFFS 0 1 40 0 0 1 /end COMPU_METHOD
/begin COMPU_METHOD TE_TM_TorqBas4ms_CM_ufix16_En10_adm "Q = V*1024.000000" RAT_FUNC "%12.10" "adm" COEFFS 0 1024 0 0 0 1 /end COMPU_METHOD
/begin COMPU_METHOD TE_TM_TorqBas4ms_CM_ufix16_En4__ "Q = V*16.000000" RAT_FUNC "%8.4" "%" COEFFS 0 16 0 0 0 1 /end COMPU_METHOD
/begin COMPU_METHOD TE_TM_TorqBasCtrl4ms_Symbol_CM_FixEnableT "Enumerated data type: FixEnableT" TAB_VERB "%0.6" "" COMPU_TAB_REF VTAB_FOR_TE_TM_TorqBasCtrl4ms_Symbol_CM_FixEnableT /end COMPU_METHOD
/begin COMPU_METHOD TE_TM_TorqBasCtrl4ms_Symbol_CM_ufix16_Bn500_rpm "Q = (V+500.000000)/1.000000" RAT_FUNC "%0.6" "rpm" COEFFS 0 1 500 0 0 1 /end COMPU_METHOD
/begin COMPU_METHOD TE_TM_TorqBasCtrl4ms_Symbol_CM_ufix16_En10_adm "Q = V*1024.000000" RAT_FUNC "%12.10" "adm" COEFFS 0 1024 0 0 0 1 /end COMPU_METHOD
/begin COMPU_METHOD TE_TM_TorqBasCtrl4ms_Symbol_CM_ufix16_En4_Bn100__ "Q = (V+100.000000)*16.000000" RAT_FUNC "%0.6" "%" COEFFS 0 16 1600 0 0 1 /end COMPU_METHOD
/begin COMPU_METHOD TE_TM_TorqBasCtrl4ms_Symbol_CM_ufix16_En4_N_m "Q = V*16.000000" RAT_FUNC "%8.4" "N*m" COEFFS 0 16 0 0 0 1 /end COMPU_METHOD
/begin COMPU_METHOD TE_TM_TorqBasCtrl4ms_Symbol_CM_ufix16_En4__ "Q = V*16.000000" RAT_FUNC "%8.4" "%" COEFFS 0 16 0 0 0 1 /end COMPU_METHOD
/begin COMPU_METHOD TE_TM_TorqBasCtrl4ms_Symbol_CM_ufix16_En4_kg_h "Q = V*16.000000" RAT_FUNC "%8.4" "kg/h" COEFFS 0 16 0 0 0 1 /end COMPU_METHOD
/begin COMPU_METHOD TE_TM_TorqBasCtrl4ms_Symbol_CM_uint16_mbar "Q = V" RAT_FUNC "%5.0" "mbar" COEFFS 0 1 0 0 0 1 /end COMPU_METHOD
/begin COMPU_METHOD TE_TM_TorqBasCtrl4ms_Symbol_CM_uint16_rpm "Q = V" RAT_FUNC "%5.0" "rpm" COEFFS 0 1 0 0 0 1 /end COMPU_METHOD
/begin COMPU_METHOD TE_TM_TorqBasCtrl4ms_Symbol_CM_uint16_s "Q = V" RAT_FUNC "%5.0" "s" COEFFS 0 1 0 0 0 1 /end COMPU_METHOD
/begin COMPU_METHOD TE_TM_TorqCalcTDC_Symbol_CM_FixEnableT "Enumerated data type: FixEnableT" TAB_VERB "%0.6" "" COMPU_TAB_REF VTAB_FOR_TE_TM_TorqCalcTDC_Symbol_CM_FixEnableT /end COMPU_METHOD
/begin COMPU_METHOD TE_TM_TorqCalcTDC_Symbol_CM_ufix16_En4__ "Q = V*16.000000" RAT_FUNC "%8.4" "%" COEFFS 0 16 0 0 0 1 /end COMPU_METHOD
/begin COMPU_METHOD TF_TE_DiagSTR_PON4ms_CM_boolean_adm "Q = V" RAT_FUNC "%1.0" "adm" COEFFS 0 1 0 0 0 1 /end COMPU_METHOD
/begin COMPU_METHOD TF_TE_DiagSTR_PON4ms_CM_tDiagStat_adm "Enumerated data type: tDiagStat" TAB_VERB "%0.6" "adm" COMPU_TAB_REF VTAB_FOR_TF_TE_DiagSTR_PON4ms_CM_tDiagStat_adm /end COMPU_METHOD
/begin COMPU_METHOD TF_TE_DiagSTR_PON4ms_CM_ufix16_E2_ms "Q = V/4.000000" RAT_FUNC "%5.0" "ms" COEFFS 0 1 0 0 0 4 /end COMPU_METHOD
/begin COMPU_METHOD Thrp4ms_CM_ufix16_En10_V "Q = V*1024.000000" RAT_FUNC "%12.10" "V" COEFFS 0 1024 0 0 0 1 /end COMPU_METHOD
/begin COMPU_METHOD Thrp_Mgmt50ms_CM_boolean_adm "Q = V" RAT_FUNC "%1.0" "adm" COEFFS 0 1 0 0 0 1 /end COMPU_METHOD
/begin COMPU_METHOD Thrp_Mgmt50ms_CM_ufix8_S5__ "Q = V/5.000000" RAT_FUNC "%0.6" "%" COEFFS 0 1 0 0 0 5 /end COMPU_METHOD
/begin COMPU_METHOD Thrp_Torque2CylCutOffTDC_CM_ufix8_S5__ "Q = V/5.000000" RAT_FUNC "%0.6" "%" COEFFS 0 1 0 0 0 5 /end COMPU_METHOD
/begin COMPU_METHOD Thrp_Torque2CylCutOffTDC_CM_uint8_pms "Q = V" RAT_FUNC "%3.0" "pms" COEFFS 0 1 0 0 0 1 /end COMPU_METHOD
/begin COMPU_METHOD Tnkp4ms_CM_boolean_adm "Q = V" RAT_FUNC "%1.0" "adm" COEFFS 0 1 0 0 0 1 /end COMPU_METHOD
/begin COMPU_METHOD Tnkp4ms_CM_tFault_adm "Enumerated data type: tFault" TAB_VERB "%0.6" "adm" COMPU_TAB_REF VTAB_FOR_Tnkp4ms_CM_tFault_adm /end COMPU_METHOD
/begin COMPU_METHOD Tnkp4ms_CM_ufix16_E2_mbar "Q = V/4.000000" RAT_FUNC "%5.0" "mbar" COEFFS 0 1 0 0 0 4 /end COMPU_METHOD
/begin COMPU_METHOD Tnkp4ms_CM_ufix16_En10_V "Q = V*1024.000000" RAT_FUNC "%12.10" "V" COEFFS 0 1024 0 0 0 1 /end COMPU_METHOD
/begin COMPU_METHOD Trqm_CtrlMgmt4ms_CM_FixEnableT "Enumerated data type: FixEnableT" TAB_VERB "%0.6" "" COMPU_TAB_REF VTAB_FOR_Trqm_CtrlMgmt4ms_CM_FixEnableT /end COMPU_METHOD
/begin COMPU_METHOD Trqm_CtrlMgmt4ms_CM_ufix16_En4_kg_h "Q = V*16.000000" RAT_FUNC "%8.4" "kg/h" COEFFS 0 16 0 0 0 1 /end COMPU_METHOD
/begin COMPU_METHOD UEGOHeater4ms_CM_boolean "Q = V" RAT_FUNC "%1.0" "" COEFFS 0 1 0 0 0 1 /end COMPU_METHOD
/begin COMPU_METHOD UEGOHeater4ms_CM_ufix16_En6 "Q = V*64.000000" RAT_FUNC "%10.6" "" COEFFS 0 64 0 0 0 1 /end COMPU_METHOD
/begin COMPU_METHOD UEGOHeater4ms_CM_uint16 "Q = V" RAT_FUNC "%5.0" "" COEFFS 0 1 0 0 0 1 /end COMPU_METHOD
/begin COMPU_METHOD Vbpw4ms_CM_boolean_adm "Q = V" RAT_FUNC "%1.0" "adm" COEFFS 0 1 0 0 0 1 /end COMPU_METHOD
/begin COMPU_METHOD Vbpw4ms_CM_tFault_adm "Enumerated data type: tFault" TAB_VERB "%0.6" "adm" COMPU_TAB_REF VTAB_FOR_Vbpw4ms_CM_tFault_adm /end COMPU_METHOD
/begin COMPU_METHOD Vbpw4ms_CM_ufix16_En10_V "Q = V*1024.000000" RAT_FUNC "%12.10" "V" COEFFS 0 1024 0 0 0 1 /end COMPU_METHOD
/begin COMPU_METHOD Vfnc4ms_CM_boolean_adm "Q = V" RAT_FUNC "%1.0" "adm" COEFFS 0 1 0 0 0 1 /end COMPU_METHOD
/begin COMPU_METHOD Vfnc4ms_CM_tFault_adm "Enumerated data type: tFault" TAB_VERB "%0.6" "adm" COMPU_TAB_REF VTAB_FOR_Vfnc4ms_CM_tFault_adm /end COMPU_METHOD
/begin COMPU_VTAB VTAB_FOR_Airt100ms_CM_tFault_adm "Enumerated data type: tFault" TAB_VERB 82 0 "NO_FAULT" 1 "SIGNAL_TOO_LOW" 2 "SIGNAL_TOO_BIG" 3 "SC_TO_BATTERY" 4 "SC_TO_GND" 5 "SIGNAL_NOT_PLAUSIBLE" 6 "OC_OR_SC_TO_BATTERY" 7 "OC_OR_SC_TO_GND" 8 "OC" 9 "NO_SIGNAL" 10 "SIGNAL_DELAYED" 11 "TRASMISSION_IMPOSSIBLE" 12 "COMPONENT_DAMAGED" 13 "CONDITION_NOT_CORRECT" 14 "MECHANICAL_PROBLEM" 15 "GENERIC_FAULT" 16 "DERIVATIVE_TOO_HIGH" 17 "DERIVATIVE_TOO_LOW" 18 "CONTROL_ERROR" 19 "ALIM_KO" 20 "ADC_KO" 21 "CAN_OFF" 22 "AIRQCONTROL_ERROR" 23 "FBCONTROL_ERROR" 24 "RPCONTROL_ERROR" 25 "SAFETY_KO" 26 "SC_HS_LS" 27 "SC_TO_GND_HS" 28 "TPU_ERROR" 29 "OC_OR_SC_TO_GND_LS" 30 "SC_TO_BAT_LS" 31 "OVER_TEMPERATURE" 32 "SC_TO_GND_LS" 33 "SC_TO_BAT_HS" 34 "CLOSED" 35 "OPEN" 36 "LOAD_DUMP" 37 "STUCK_OPEN" 38 "STUCK_CLOSED" 39 "UNKNOWN_STATE" 40 "UNDERVOLTAGE" 41 "STUCK_ON" 42 "STUCK_OFF" 43 "ON" 44 "OFF" 45 "THR_INCOHERENCE" 46 "PDL_INCOHERENCE" 47 "POT_2_FAULT" 48 "QAIR_UNDER_ESTIM" 49 "QAIR_OVER_ESTIM" 50 "RSCOPEN_ERROR" 51 "RSCWAIT_ERROR" 52 "RSCCLOSE_ERROR" 53 "OSCCLOSE_ERROR" 54 "OSCOPEN_ERROR" 55 "DTC_ERROR" 56 "NLP_ERROR" 57 "UMA_ERROR" 58 "TEMP_PREWARNING" 59 "TEMP_WARNING" 60 "THR_LRN_ERROR" 61 "COMM_ERROR" 62 "MMP_ERROR" 63 "SMP_ERROR" 64 "EOBD_ERROR" 65 "ENERGY_ERROR" 66 "GAIN_ERROR" 67 "KO2_HPRAIL_ERROR" 68 "KO2_LPRAIL_ERROR" 69 "OFFS_ERROR" 70 "SWT_INCOHERENCE" 71 "MFLV_INCOHERENCE" 72 "SET_PLUS_FAULT" 73 "SET_MINUS_FAULT" 74 "OFF_FAULT" 75 "SET_FAULT" 76 "RESUME_FAULT" 77 "HOLD_FAULT" 78 "STOP_CABIN_TILT_FAULT" 79 "START_CABIN_TILT_FAULT" 80 "NUMBER_OF_FAULT" 81 "ANY_FAULT" /end COMPU_VTAB
/begin COMPU_VTAB VTAB_FOR_Apre100ms_CM_tFault_adm "Enumerated data type: tFault" TAB_VERB 84 0 "NO_FAULT" 1 "SIGNAL_TOO_LOW" 2 "SIGNAL_TOO_BIG" 3 "SC_TO_BATTERY" 4 "SC_TO_GND" 5 "SIGNAL_NOT_PLAUSIBLE" 6 "OC_OR_SC_TO_BATTERY" 7 "OC_OR_SC_TO_GND" 8 "OC" 9 "NO_SIGNAL" 10 "SIGNAL_DELAYED" 11 "TRASMISSION_IMPOSSIBLE" 12 "COMPONENT_DAMAGED" 13 "CONDITION_NOT_CORRECT_" 14 "MECHANICAL_PROBLEM" 15 "GENERIC_FAULT" 16 "DERIVATIVE_TOO_HIGH" 17 "DERIVATIVE_TOO_LOW" 18 "CONTROL_ERROR" 19 "ALIM_KO" 20 "ADC_KO" 21 "CAN_OFF" 22 "AIRQCONTROL_ERROR" 23 "FBCONTROL_ERROR" 24 "RPCONTROL_ERROR" 25 "SAFETY_KO" 26 "SC_HS_LS" 27 "SC_TO_GND_HS" 28 "TPU_ERROR" 29 "OC_OR_SC_TO_GND_LS" 30 "SC_TO_BAT_LS" 31 "OVERTEMPERATURE" 32 "SC_TO_GND_LS" 33 "SC_TO_BAT_HS" 34 "CLOSED" 35 "OPEN" 36 "LOAD_DUMP" 37 "STUCK_OPEN" 38 "STUCK_CLOSED" 39 "UNKNOWN_STATE" 40 "UNDERVOLTAGE" 41 "STUCK_ON" 42 "STUCK_OFF" 43 "ON" 44 "OFF" 45 "THR_INCOHERENCE" 46 "PDL_INCOHERENCE" 47 "POT_2_FAULT" 48 "QAIR_UNDER_ESTIM" 49 "QAIR_OVER_ESTIM" 50 "RSCOPEN_ERROR" 51 "RSCWAIT_ERROR" 52 "RSCCLOSE_ERROR" 53 "OSCCLOSE_ERROR" 54 "OSCOPEN_ERROR" 55 "DTC_ERROR" 56 "NLP_ERROR" 57 "UMA_ERROR" 58 "TEMP_PREWARNING" 59 "TEMP_WARNING" 60 "THR_LRN_ERROR" 61 "COMM_ERROR" 62 "MMP_ERROR" 63 "SMP_ERROR" 64 "EOBD_ERROR" 65 "ENERGY_ERROR" 66 "GAIN_ERROR" 67 "KO2_HPRAIL_ERROR" 68 "KO2_LPRAIL_ERROR" 69 "OFFS_ERROR" 70 "SWT_INCOHERENCE" 71 "MFLV_INCOHERENCE" 72 "SET_PLUS_FAULT" 73 "SET_MINUS_FAULT" 74 "OFF_FAULT" 75 "SET_FAULT" 76 "RESUME_FAULT" 77 "HOLD_FAULT" 78 "STOP_CABIN_TILT_FAULT" 79 "START_CABIN_TILT_FAULT" 80 "STUCK_CLOSED_OR_OPEN_LOAD" 81 "OVERCURR" 82 "NUMBER_OF_FAULT" 83 "ANY_FAULT" /end COMPU_VTAB
/begin COMPU_VTAB VTAB_FOR_Boost_CtrlMgmt50ms_CM_tFault_adm "Enumerated data type: tFault" TAB_VERB 89 0 "NO_FAULT" 1 "SIGNAL_TOO_LOW" 2 "SIGNAL_TOO_BIG" 3 "SC_TO_BATTERY" 4 "SC_TO_GND" 5 "SIGNAL_NOT_PLAUSIBLE" 6 "OC_OR_SC_TO_BATTERY" 7 "OC_OR_SC_TO_GND" 8 "OC" 9 "NO_SIGNAL" 10 "SIGNAL_DELAYED" 11 "TRASMISSION_IMPOSSIBLE" 12 "COMPONENT_DAMAGED" 13 "TEST_CONDITION_NOT_CORRECT" 14 "MECHANICAL_PROBLEM" 15 "GENERIC_FAULT" 16 "DERIVATIVE_TOO_HIGH" 17 "DERIVATIVE_TOO_LOW" 18 "CONTROL_ERROR" 19 "ALIM_KO" 20 "ADC_KO" 21 "CAN_OFF" 22 "AIRQCONTROL_ERROR" 23 "FBCONTROL_ERROR" 24 "RPCONTROL_ERROR" 25 "SAFETY_KO" 26 "SC_HS_LS" 27 "SC_TO_GND_HS" 28 "TPU_ERROR" 29 "OC_OR_SC_TO_GND_LS" 30 "SC_TO_BAT_LS" 31 "OVERTEMPERATURE" 32 "SC_TO_GND_LS" 33 "SC_TO_BAT_HS" 34 "CLOSED" 35 "OPEN" 36 "LOAD_DUMP" 37 "STUCK_OPEN" 38 "STUCK_CLOSED" 39 "UNKNOWN_STATE" 40 "UNDERVOLTAGE" 41 "STUCK_ON" 42 "STUCK_OFF" 43 "ON" 44 "OFF" 45 "THR_INCOHERENCE" 46 "PDL_INCOHERENCE" 47 "POT_2_FAULT" 48 "QAIR_UNDER_ESTIM" 49 "QAIR_OVER_ESTIM" 50 "RSCOPEN_ERROR" 51 "RSCWAIT_ERROR" 52 "RSCCLOSE_ERROR" 53 "OSCCLOSE_ERROR" 54 "OSCOPEN_ERROR" 55 "DTC_ERROR" 56 "NLP_ERROR" 57 "UMA_ERROR" 58 "TEMP_PREWARNING" 59 "TEMP_WARNING" 60 "THR_LRN_ERROR" 61 "COMM_ERROR" 62 "MMP_ERROR" 63 "SMP_ERROR" 64 "EOBD_ERROR" 65 "ENERGY_ERROR" 66 "GAIN_ERROR" 67 "KO2_HPRAIL_ERROR" 68 "KO2_LPRAIL_ERROR" 69 "OFFS_ERROR" 70 "SWT_INCOHERENCE" 71 "MFLV_INCOHERENCE" 72 "SET_PLUS_FAULT" 73 "SET_MINUS_FAULT" 74 "OFF_FAULT" 75 "SET_FAULT" 76 "RESUME_FAULT" 77 "HOLD_FAULT" 78 "STOP_CABIN_TILT_FAULT" 79 "START_CABIN_TILT_FAULT" 80 "STUCK_CLOSED_OR_OPEN_LOAD" 81 "OVERCURR" 82 "CAM_NTEETH_INCOHERENCE" 83 "CAM_POS_INCOHERENCE" 84 "SERIAL_ERROR" 85 "CHIP_FAULT" 86 "SC_PHASES" 87 "NUMBER_OF_FAULT" 88 "ANY_FAULT" /end COMPU_VTAB
/begin COMPU_VTAB VTAB_FOR_Bpre4ms_CM_tFault_adm "Enumerated data type: tFault" TAB_VERB 89 0 "NO_FAULT" 1 "SIGNAL_TOO_LOW" 2 "SIGNAL_TOO_BIG" 3 "SC_TO_BATTERY" 4 "SC_TO_GND" 5 "SIGNAL_NOT_PLAUSIBLE" 6 "OC_OR_SC_TO_BATTERY" 7 "OC_OR_SC_TO_GND" 8 "OC" 9 "NO_SIGNAL" 10 "SIGNAL_DELAYED" 11 "TRASMISSION_IMPOSSIBLE" 12 "COMPONENT_DAMAGED" 13 "TEST_CONDITION_NOT_CORRECT" 14 "MECHANICAL_PROBLEM" 15 "GENERIC_FAULT" 16 "DERIVATIVE_TOO_HIGH" 17 "DERIVATIVE_TOO_LOW" 18 "CONTROL_ERROR" 19 "ALIM_KO" 20 "ADC_KO" 21 "CAN_OFF" 22 "AIRQCONTROL_ERROR" 23 "FBCONTROL_ERROR" 24 "RPCONTROL_ERROR" 25 "SAFETY_KO" 26 "SC_HS_LS" 27 "SC_TO_GND_HS" 28 "TPU_ERROR" 29 "OC_OR_SC_TO_GND_LS" 30 "SC_TO_BAT_LS" 31 "OVERTEMPERATURE" 32 "SC_TO_GND_LS" 33 "SC_TO_BAT_HS" 34 "CLOSED" 35 "OPEN" 36 "LOAD_DUMP" 37 "STUCK_OPEN" 38 "STUCK_CLOSED" 39 "UNKNOWN_STATE" 40 "UNDERVOLTAGE" 41 "STUCK_ON" 42 "STUCK_OFF" 43 "ON" 44 "OFF" 45 "THR_INCOHERENCE" 46 "PDL_INCOHERENCE" 47 "POT_2_FAULT" 48 "QAIR_UNDER_ESTIM" 49 "QAIR_OVER_ESTIM" 50 "RSCOPEN_ERROR" 51 "RSCWAIT_ERROR" 52 "RSCCLOSE_ERROR" 53 "OSCCLOSE_ERROR" 54 "OSCOPEN_ERROR" 55 "DTC_ERROR" 56 "NLP_ERROR" 57 "UMA_ERROR" 58 "TEMP_PREWARNING" 59 "TEMP_WARNING" 60 "THR_LRN_ERROR" 61 "COMM_ERROR" 62 "MMP_ERROR" 63 "SMP_ERROR" 64 "EOBD_ERROR" 65 "ENERGY_ERROR" 66 "GAIN_ERROR" 67 "KO2_HPRAIL_ERROR" 68 "KO2_LPRAIL_ERROR" 69 "OFFS_ERROR" 70 "SWT_INCOHERENCE" 71 "MFLV_INCOHERENCE" 72 "SET_PLUS_FAULT" 73 "SET_MINUS_FAULT" 74 "OFF_FAULT" 75 "SET_FAULT" 76 "RESUME_FAULT" 77 "HOLD_FAULT" 78 "STOP_CABIN_TILT_FAULT" 79 "START_CABIN_TILT_FAULT" 80 "STUCK_CLOSED_OR_OPEN_LOAD" 81 "OVERCURR" 82 "CAM_NTEETH_INCOHERENCE" 83 "CAM_POS_INCOHERENCE" 84 "SERIAL_ERROR" 85 "CHIP_FAULT" 86 "SC_PHASES" 87 "NUMBER_OF_FAULT" 88 "ANY_FAULT" /end COMPU_VTAB
/begin COMPU_VTAB VTAB_FOR_Catt100ms_CM_tFault_adm "Enumerated data type: tFault" TAB_VERB 82 0 "NO_FAULT" 1 "SIGNAL_TOO_LOW" 2 "SIGNAL_TOO_BIG" 3 "SC_TO_BATTERY" 4 "SC_TO_GND" 5 "SIGNAL_NOT_PLAUSIBLE" 6 "OC_OR_SC_TO_BATTERY" 7 "OC_OR_SC_TO_GND" 8 "OC" 9 "NO_SIGNAL" 10 "SIGNAL_DELAYED" 11 "TRASMISSION_IMPOSSIBLE" 12 "COMPONENT_DAMAGED" 13 "CONDITION_NOT_CORRECT" 14 "MECHANICAL_PROBLEM" 15 "GENERIC_FAULT" 16 "DERIVATIVE_TOO_HIGH" 17 "DERIVATIVE_TOO_LOW" 18 "CONTROL_ERROR" 19 "ALIM_KO" 20 "ADC_KO" 21 "CAN_OFF" 22 "AIRQCONTROL_ERROR" 23 "FBCONTROL_ERROR" 24 "RPCONTROL_ERROR" 25 "SAFETY_KO" 26 "SC_HS_LS" 27 "SC_TO_GND_HS" 28 "TPU_ERROR" 29 "OC_OR_SC_TO_GND_LS" 30 "SC_TO_BAT_LS" 31 "OVER_TEMPERATURE" 32 "SC_TO_GND_LS" 33 "SC_TO_BAT_HS" 34 "CLOSED" 35 "OPEN" 36 "LOAD_DUMP" 37 "STUCK_OPEN" 38 "STUCK_CLOSED" 39 "UNKNOWN_STATE" 40 "UNDERVOLTAGE" 41 "STUCK_ON" 42 "STUCK_OFF" 43 "ON" 44 "OFF" 45 "THR_INCOHERENCE" 46 "PDL_INCOHERENCE" 47 "POT_2_FAULT" 48 "QAIR_UNDER_ESTIM" 49 "QAIR_OVER_ESTIM" 50 "RSCOPEN_ERROR" 51 "RSCWAIT_ERROR" 52 "RSCCLOSE_ERROR" 53 "OSCCLOSE_ERROR" 54 "OSCOPEN_ERROR" 55 "DTC_ERROR" 56 "NLP_ERROR" 57 "UMA_ERROR" 58 "TEMP_PREWARNING" 59 "TEMP_WARNING" 60 "THR_LRN_ERROR" 61 "COMM_ERROR" 62 "MMP_ERROR" 63 "SMP_ERROR" 64 "EOBD_ERROR" 65 "ENERGY_ERROR" 66 "GAIN_ERROR" 67 "KO2_HPRAIL_ERROR" 68 "KO2_LPRAIL_ERROR" 69 "OFFS_ERROR" 70 "SWT_INCOHERENCE" 71 "MFLV_INCOHERENCE" 72 "SET_PLUS_FAULT" 73 "SET_MINUS_FAULT" 74 "OFF_FAULT" 75 "SET_FAULT" 76 "RESUME_FAULT" 77 "HOLD_FAULT" 78 "STOP_CABIN_TILT_FAULT" 79 "START_CABIN_TILT_FAULT" 80 "NUMBER_OF_FAULT" 81 "ANY_FAULT" /end COMPU_VTAB
/begin COMPU_VTAB VTAB_FOR_Coot100ms_CM_tFault_adm "Enumerated data type: tFault" TAB_VERB 89 0 "NO_FAULT" 1 "SIGNAL_TOO_LOW" 2 "SIGNAL_TOO_BIG" 3 "SC_TO_BATTERY" 4 "SC_TO_GND" 5 "SIGNAL_NOT_PLAUSIBLE" 6 "OC_OR_SC_TO_BATTERY" 7 "OC_OR_SC_TO_GND" 8 "OC" 9 "NO_SIGNAL" 10 "SIGNAL_DELAYED" 11 "TRASMISSION_IMPOSSIBLE" 12 "COMPONENT_DAMAGED" 13 "TEST_CONDITION_NOT_CORRECT" 14 "MECHANICAL_PROBLEM" 15 "GENERIC_FAULT" 16 "DERIVATIVE_TOO_HIGH" 17 "DERIVATIVE_TOO_LOW" 18 "CONTROL_ERROR" 19 "ALIM_KO" 20 "ADC_KO" 21 "CAN_OFF" 22 "AIRQCONTROL_ERROR" 23 "FBCONTROL_ERROR" 24 "RPCONTROL_ERROR" 25 "SAFETY_KO" 26 "SC_HS_LS" 27 "SC_TO_GND_HS" 28 "TPU_ERROR" 29 "OC_OR_SC_TO_GND_LS" 30 "SC_TO_BAT_LS" 31 "OVERTEMPERATURE" 32 "SC_TO_GND_LS" 33 "SC_TO_BAT_HS" 34 "CLOSED" 35 "OPEN" 36 "LOAD_DUMP" 37 "STUCK_OPEN" 38 "STUCK_CLOSED" 39 "UNKNOWN_STATE" 40 "UNDERVOLTAGE" 41 "STUCK_ON" 42 "STUCK_OFF" 43 "ON" 44 "OFF" 45 "THR_INCOHERENCE" 46 "PDL_INCOHERENCE" 47 "POT_2_FAULT" 48 "QAIR_UNDER_ESTIM" 49 "QAIR_OVER_ESTIM" 50 "RSCOPEN_ERROR" 51 "RSCWAIT_ERROR" 52 "RSCCLOSE_ERROR" 53 "OSCCLOSE_ERROR" 54 "OSCOPEN_ERROR" 55 "DTC_ERROR" 56 "NLP_ERROR" 57 "UMA_ERROR" 58 "TEMP_PREWARNING" 59 "TEMP_WARNING" 60 "THR_LRN_ERROR" 61 "COMM_ERROR" 62 "MMP_ERROR" 63 "SMP_ERROR" 64 "EOBD_ERROR" 65 "ENERGY_ERROR" 66 "GAIN_ERROR" 67 "KO2_HPRAIL_ERROR" 68 "KO2_LPRAIL_ERROR" 69 "OFFS_ERROR" 70 "SWT_INCOHERENCE" 71 "MFLV_INCOHERENCE" 72 "SET_PLUS_FAULT" 73 "SET_MINUS_FAULT" 74 "OFF_FAULT" 75 "SET_FAULT" 76 "RESUME_FAULT" 77 "HOLD_FAULT" 78 "STOP_CABIN_TILT_FAULT" 79 "START_CABIN_TILT_FAULT" 80 "STUCK_CLOSED_OR_OPEN_LOAD" 81 "OVERCURR" 82 "CAM_NTEETH_INCOHERENCE" 83 "CAM_POS_INCOHERENCE" 84 "SERIAL_ERROR" 85 "CHIP_FAULT" 86 "SC_PHASES" 87 "NUMBER_OF_FAULT" 88 "ANY_FAULT" /end COMPU_VTAB
/begin COMPU_VTAB VTAB_FOR_Crkc4ms_CM_tDiagStat_adm "Enumerated data type: tDiagStat" TAB_VERB 4 0 "ENTRY" 1 "DURING" 2 "END" 39 "UNKNOWN_DIAGSTAT" /end COMPU_VTAB
/begin COMPU_VTAB VTAB_FOR_Crkc4ms_CM_tFault_adm "Enumerated data type: tFault" TAB_VERB 89 0 "NO_FAULT" 1 "SIGNAL_TOO_LOW" 2 "SIGNAL_TOO_BIG" 3 "SC_TO_BATTERY" 4 "SC_TO_GND" 5 "SIGNAL_NOT_PLAUSIBLE" 6 "OC_OR_SC_TO_BATTERY" 7 "OC_OR_SC_TO_GND" 8 "OC" 9 "NO_SIGNAL" 10 "SIGNAL_DELAYED" 11 "TRASMISSION_IMPOSSIBLE" 12 "COMPONENT_DAMAGED" 13 "TEST_CONDITION_NOT_CORRECT" 14 "MECHANICAL_PROBLEM" 15 "GENERIC_FAULT" 16 "DERIVATIVE_TOO_HIGH" 17 "DERIVATIVE_TOO_LOW" 18 "CONTROL_ERROR" 19 "ALIM_KO" 20 "ADC_KO" 21 "CAN_OFF" 22 "AIRQCONTROL_ERROR" 23 "FBCONTROL_ERROR" 24 "RPCONTROL_ERROR" 25 "SAFETY_KO" 26 "SC_HS_LS" 27 "SC_TO_GND_HS" 28 "TPU_ERROR" 29 "OC_OR_SC_TO_GND_LS" 30 "SC_TO_BAT_LS" 31 "OVERTEMPERATURE" 32 "SC_TO_GND_LS" 33 "SC_TO_BAT_HS" 34 "CLOSED" 35 "OPEN" 36 "LOAD_DUMP" 37 "STUCK_OPEN" 38 "STUCK_CLOSED" 39 "UNKNOWN_STATE" 40 "UNDERVOLTAGE" 41 "STUCK_ON" 42 "STUCK_OFF" 43 "ON" 44 "OFF" 45 "THR_INCOHERENCE" 46 "PDL_INCOHERENCE" 47 "POT_2_FAULT" 48 "QAIR_UNDER_ESTIM" 49 "QAIR_OVER_ESTIM" 50 "RSCOPEN_ERROR" 51 "RSCWAIT_ERROR" 52 "RSCCLOSE_ERROR" 53 "OSCCLOSE_ERROR" 54 "OSCOPEN_ERROR" 55 "DTC_ERROR" 56 "NLP_ERROR" 57 "UMA_ERROR" 58 "TEMP_PREWARNING" 59 "TEMP_WARNING" 60 "THR_LRN_ERROR" 61 "COMM_ERROR" 62 "MMP_ERROR" 63 "SMP_ERROR" 64 "EOBD_ERROR" 65 "ENERGY_ERROR" 66 "GAIN_ERROR" 67 "KO2_HPRAIL_ERROR" 68 "KO2_LPRAIL_ERROR" 69 "OFFS_ERROR" 70 "SWT_INCOHERENCE" 71 "MFLV_INCOHERENCE" 72 "SET_PLUS_FAULT" 73 "SET_MINUS_FAULT" 74 "OFF_FAULT" 75 "SET_FAULT" 76 "RESUME_FAULT" 77 "HOLD_FAULT" 78 "STOP_CABIN_TILT_FAULT" 79 "START_CABIN_TILT_FAULT" 80 "STUCK_CLOSED_OR_OPEN_LOAD" 81 "OVERCURR" 82 "CAM_NTEETH_INCOHERENCE" 83 "CAM_POS_INCOHERENCE" 84 "SERIAL_ERROR" 85 "CHIP_FAULT" 86 "SC_PHASES" 87 "NUMBER_OF_FAULT" 88 "ANY_FAULT" /end COMPU_VTAB
/begin COMPU_VTAB VTAB_FOR_Ctit_LambdaPreDiag4ms_CM_tFault_adm "Enumerated data type: tFault" TAB_VERB 82 0 "NO_FAULT" 1 "SIGNAL_TOO_LOW" 2 "SIGNAL_TOO_BIG" 3 "SC_TO_BATTERY" 4 "SC_TO_GND" 5 "SIGNAL_NOT_PLAUSIBLE" 6 "OC_OR_SC_TO_BATTERY" 7 "OC_OR_SC_TO_GND" 8 "OC" 9 "NO_SIGNAL" 10 "SIGNAL_DELAYED" 11 "TRASMISSION_IMPOSSIBLE" 12 "COMPONENT_DAMAGED" 13 "CONDITION_NOT_CORRECT" 14 "MECHANICAL_PROBLEM" 15 "GENERIC_FAULT" 16 "DERIVATIVE_TOO_HIGH" 17 "DERIVATIVE_TOO_LOW" 18 "CONTROL_ERROR" 19 "ALIM_KO" 20 "ADC_KO" 21 "CAN_OFF" 22 "AIRQCONTROL_ERROR" 23 "FBCONTROL_ERROR" 24 "RPCONTROL_ERROR" 25 "SAFETY_KO" 26 "SC_HS_LS" 27 "SC_TO_GND_HS" 28 "TPU_ERROR" 29 "OC_OR_SC_TO_GND_LS" 30 "SC_TO_BAT_LS" 31 "OVER_TEMPERATURE" 32 "SC_TO_GND_LS" 33 "SC_TO_BAT_HS" 34 "CLOSED" 35 "OPEN" 36 "LOAD_DUMP" 37 "STUCK_OPEN" 38 "STUCK_CLOSED" 39 "UNKNOWN_STATE" 40 "UNDERVOLTAGE" 41 "STUCK_ON" 42 "STUCK_OFF" 43 "ON" 44 "OFF" 45 "THR_INCOHERENCE" 46 "PDL_INCOHERENCE" 47 "POT_2_FAULT" 48 "QAIR_UNDER_ESTIM" 49 "QAIR_OVER_ESTIM" 50 "RSCOPEN_ERROR" 51 "RSCWAIT_ERROR" 52 "RSCCLOSE_ERROR" 53 "OSCCLOSE_ERROR" 54 "OSCOPEN_ERROR" 55 "DTC_ERROR" 56 "NLP_ERROR" 57 "UMA_ERROR" 58 "TEMP_PREWARNING" 59 "TEMP_WARNING" 60 "THR_LRN_ERROR" 61 "COMM_ERROR" 62 "MMP_ERROR" 63 "SMP_ERROR" 64 "EOBD_ERROR" 65 "ENERGY_ERROR" 66 "GAIN_ERROR" 67 "KO2_HPRAIL_ERROR" 68 "KO2_LPRAIL_ERROR" 69 "OFFS_ERROR" 70 "SWT_INCOHERENCE" 71 "MFLV_INCOHERENCE" 72 "SET_PLUS_FAULT" 73 "SET_MINUS_FAULT" 74 "OFF_FAULT" 75 "SET_FAULT" 76 "RESUME_FAULT" 77 "HOLD_FAULT" 78 "STOP_CABIN_TILT_FAULT" 79 "START_CABIN_TILT_FAULT" 80 "NUMBER_OF_FAULT" 81 "ANY_FAULT" /end COMPU_VTAB
/begin COMPU_VTAB VTAB_FOR_Ctit_UEGOHeater4ms_CM_tFault_adm "Enumerated data type: tFault" TAB_VERB 89 0 "NO_FAULT" 1 "SIGNAL_TOO_LOW" 2 "SIGNAL_TOO_BIG" 3 "SC_TO_BATTERY" 4 "SC_TO_GND" 5 "SIGNAL_NOT_PLAUSIBLE" 6 "OC_OR_SC_TO_BATTERY" 7 "OC_OR_SC_TO_GND" 8 "OC" 9 "NO_SIGNAL" 10 "SIGNAL_DELAYED" 11 "TRASMISSION_IMPOSSIBLE" 12 "COMPONENT_DAMAGED" 13 "TEST_CONDITION_NOT_CORRECT" 14 "MECHANICAL_PROBLEM" 15 "GENERIC_FAULT" 16 "DERIVATIVE_TOO_HIGH" 17 "DERIVATIVE_TOO_LOW" 18 "CONTROL_ERROR" 19 "ALIM_KO" 20 "ADC_KO" 21 "CAN_OFF" 22 "AIRQCONTROL_ERROR" 23 "FBCONTROL_ERROR" 24 "RPCONTROL_ERROR" 25 "SAFETY_KO" 26 "SC_HS_LS" 27 "SC_TO_GND_HS" 28 "TPU_ERROR" 29 "OC_OR_SC_TO_GND_LS" 30 "SC_TO_BAT_LS" 31 "OVERTEMPERATURE" 32 "SC_TO_GND_LS" 33 "SC_TO_BAT_HS" 34 "CLOSED" 35 "OPEN" 36 "LOAD_DUMP" 37 "STUCK_OPEN" 38 "STUCK_CLOSED" 39 "UNKNOWN_STATE" 40 "UNDERVOLTAGE" 41 "STUCK_ON" 42 "STUCK_OFF" 43 "ON" 44 "OFF" 45 "THR_INCOHERENCE" 46 "PDL_INCOHERENCE" 47 "POT_2_FAULT" 48 "QAIR_UNDER_ESTIM" 49 "QAIR_OVER_ESTIM" 50 "RSCOPEN_ERROR" 51 "RSCWAIT_ERROR" 52 "RSCCLOSE_ERROR" 53 "OSCCLOSE_ERROR" 54 "OSCOPEN_ERROR" 55 "DTC_ERROR" 56 "NLP_ERROR" 57 "UMA_ERROR" 58 "TEMP_PREWARNING" 59 "TEMP_WARNING" 60 "THR_LRN_ERROR" 61 "COMM_ERROR" 62 "MMP_ERROR" 63 "SMP_ERROR" 64 "EOBD_ERROR" 65 "ENERGY_ERROR" 66 "GAIN_ERROR" 67 "KO2_HPRAIL_ERROR" 68 "KO2_LPRAIL_ERROR" 69 "OFFS_ERROR" 70 "SWT_INCOHERENCE" 71 "MFLV_INCOHERENCE" 72 "SET_PLUS_FAULT" 73 "SET_MINUS_FAULT" 74 "OFF_FAULT" 75 "SET_FAULT" 76 "RESUME_FAULT" 77 "HOLD_FAULT" 78 "STOP_CABIN_TILT_FAULT" 79 "START_CABIN_TILT_FAULT" 80 "STUCK_CLOSED_OR_OPEN_LOAD" 81 "OVERCURR" 82 "CAM_NTEETH_INCOHERENCE" 83 "CAM_POS_INCOHERENCE" 84 "SERIAL_ERROR" 85 "CHIP_FAULT" 86 "SC_PHASES" 87 "NUMBER_OF_FAULT" 88 "ANY_FAULT" /end COMPU_VTAB
/begin COMPU_VTAB VTAB_FOR_Diag_LineSTOH100ms_CM_tFault_adm "Enumerated data type: tFault" TAB_VERB 84 0 "NO_FAULT" 1 "SIGNAL_TOO_LOW" 2 "SIGNAL_TOO_BIG" 3 "SC_TO_BATTERY" 4 "SC_TO_GND" 5 "SIGNAL_NOT_PLAUSIBLE" 6 "OC_OR_SC_TO_BATTERY" 7 "OC_OR_SC_TO_GND" 8 "OC" 9 "NO_SIGNAL" 10 "SIGNAL_DELAYED" 11 "TRASMISSION_IMPOSSIBLE" 12 "COMPONENT_DAMAGED" 13 "CONDITION_NOT_CORRECT_" 14 "MECHANICAL_PROBLEM" 15 "GENERIC_FAULT" 16 "DERIVATIVE_TOO_HIGH" 17 "DERIVATIVE_TOO_LOW" 18 "CONTROL_ERROR" 19 "ALIM_KO" 20 "ADC_KO" 21 "CAN_OFF" 22 "AIRQCONTROL_ERROR" 23 "FBCONTROL_ERROR" 24 "RPCONTROL_ERROR" 25 "SAFETY_KO" 26 "SC_HS_LS" 27 "SC_TO_GND_HS" 28 "TPU_ERROR" 29 "OC_OR_SC_TO_GND_LS" 30 "SC_TO_BAT_LS" 31 "OVERTEMPERATURE" 32 "SC_TO_GND_LS" 33 "SC_TO_BAT_HS" 34 "CLOSED" 35 "OPEN" 36 "LOAD_DUMP" 37 "STUCK_OPEN" 38 "STUCK_CLOSED" 39 "UNKNOWN_STATE" 40 "UNDERVOLTAGE" 41 "STUCK_ON" 42 "STUCK_OFF" 43 "ON" 44 "OFF" 45 "THR_INCOHERENCE" 46 "PDL_INCOHERENCE" 47 "POT_2_FAULT" 48 "QAIR_UNDER_ESTIM" 49 "QAIR_OVER_ESTIM" 50 "RSCOPEN_ERROR" 51 "RSCWAIT_ERROR" 52 "RSCCLOSE_ERROR" 53 "OSCCLOSE_ERROR" 54 "OSCOPEN_ERROR" 55 "DTC_ERROR" 56 "NLP_ERROR" 57 "UMA_ERROR" 58 "TEMP_PREWARNING" 59 "TEMP_WARNING" 60 "THR_LRN_ERROR" 61 "COMM_ERROR" 62 "MMP_ERROR" 63 "SMP_ERROR" 64 "EOBD_ERROR" 65 "ENERGY_ERROR" 66 "GAIN_ERROR" 67 "KO2_HPRAIL_ERROR" 68 "KO2_LPRAIL_ERROR" 69 "OFFS_ERROR" 70 "SWT_INCOHERENCE" 71 "MFLV_INCOHERENCE" 72 "SET_PLUS_FAULT" 73 "SET_MINUS_FAULT" 74 "OFF_FAULT" 75 "SET_FAULT" 76 "RESUME_FAULT" 77 "HOLD_FAULT" 78 "STOP_CABIN_TILT_FAULT" 79 "START_CABIN_TILT_FAULT" 80 "STUCK_CLOSED_OR_OPEN_LOAD" 81 "OVERCURR" 82 "NUMBER_OF_FAULT" 83 "ANY_FAULT" /end COMPU_VTAB
/begin COMPU_VTAB VTAB_FOR_Ecut1s_CM_tFault_adm "Enumerated data type: tFault" TAB_VERB 89 0 "NO_FAULT" 1 "SIGNAL_TOO_LOW" 2 "SIGNAL_TOO_BIG" 3 "SC_TO_BATTERY" 4 "SC_TO_GND" 5 "SIGNAL_NOT_PLAUSIBLE" 6 "OC_OR_SC_TO_BATTERY" 7 "OC_OR_SC_TO_GND" 8 "OC" 9 "NO_SIGNAL" 10 "SIGNAL_DELAYED" 11 "TRASMISSION_IMPOSSIBLE" 12 "COMPONENT_DAMAGED" 13 "TEST_CONDITION_NOT_CORRECT" 14 "MECHANICAL_PROBLEM" 15 "GENERIC_FAULT" 16 "DERIVATIVE_TOO_HIGH" 17 "DERIVATIVE_TOO_LOW" 18 "CONTROL_ERROR" 19 "ALIM_KO" 20 "ADC_KO" 21 "CAN_OFF" 22 "AIRQCONTROL_ERROR" 23 "FBCONTROL_ERROR" 24 "RPCONTROL_ERROR" 25 "SAFETY_KO" 26 "SC_HS_LS" 27 "SC_TO_GND_HS" 28 "TPU_ERROR" 29 "OC_OR_SC_TO_GND_LS" 30 "SC_TO_BAT_LS" 31 "OVERTEMPERATURE" 32 "SC_TO_GND_LS" 33 "SC_TO_BAT_HS" 34 "CLOSED" 35 "OPEN" 36 "LOAD_DUMP" 37 "STUCK_OPEN" 38 "STUCK_CLOSED" 39 "UNKNOWN_STATE" 40 "UNDERVOLTAGE" 41 "STUCK_ON" 42 "STUCK_OFF" 43 "ON" 44 "OFF" 45 "THR_INCOHERENCE" 46 "PDL_INCOHERENCE" 47 "POT_2_FAULT" 48 "QAIR_UNDER_ESTIM" 49 "QAIR_OVER_ESTIM" 50 "RSCOPEN_ERROR" 51 "RSCWAIT_ERROR" 52 "RSCCLOSE_ERROR" 53 "OSCCLOSE_ERROR" 54 "OSCOPEN_ERROR" 55 "DTC_ERROR" 56 "NLP_ERROR" 57 "UMA_ERROR" 58 "TEMP_PREWARNING" 59 "TEMP_WARNING" 60 "THR_LRN_ERROR" 61 "COMM_ERROR" 62 "MMP_ERROR" 63 "SMP_ERROR" 64 "EOBD_ERROR" 65 "ENERGY_ERROR" 66 "GAIN_ERROR" 67 "KO2_HPRAIL_ERROR" 68 "KO2_LPRAIL_ERROR" 69 "OFFS_ERROR" 70 "SWT_INCOHERENCE" 71 "MFLV_INCOHERENCE" 72 "SET_PLUS_FAULT" 73 "SET_MINUS_FAULT" 74 "OFF_FAULT" 75 "SET_FAULT" 76 "RESUME_FAULT" 77 "HOLD_FAULT" 78 "STOP_CABIN_TILT_FAULT" 79 "START_CABIN_TILT_FAULT" 80 "STUCK_CLOSED_OR_OPEN_LOAD" 81 "OVERCURR" 82 "CAM_NTEETH_INCOHERENCE" 83 "CAM_POS_INCOHERENCE" 84 "SERIAL_ERROR" 85 "CHIP_FAULT" 86 "SC_PHASES" 87 "NUMBER_OF_FAULT" 88 "ANY_FAULT" /end COMPU_VTAB
/begin COMPU_VTAB VTAB_FOR_Egst4ms_CM_tDiagStat_adm "Enumerated data type: tDiagStat" TAB_VERB 4 0 "ENTRY" 1 "DURING" 2 "END" 39 "UNKNOWN_DIAGSTAT" /end COMPU_VTAB
/begin COMPU_VTAB VTAB_FOR_Egst4ms_CM_tFault_adm "Enumerated data type: tFault" TAB_VERB 89 0 "NO_FAULT" 1 "SIGNAL_TOO_LOW" 2 "SIGNAL_TOO_BIG" 3 "SC_TO_BATTERY" 4 "SC_TO_GND" 5 "SIGNAL_NOT_PLAUSIBLE" 6 "OC_OR_SC_TO_BATTERY" 7 "OC_OR_SC_TO_GND" 8 "OC" 9 "NO_SIGNAL" 10 "SIGNAL_DELAYED" 11 "TRASMISSION_IMPOSSIBLE" 12 "COMPONENT_DAMAGED" 13 "TEST_CONDITION_NOT_CORRECT" 14 "MECHANICAL_PROBLEM" 15 "GENERIC_FAULT" 16 "DERIVATIVE_TOO_HIGH" 17 "DERIVATIVE_TOO_LOW" 18 "CONTROL_ERROR" 19 "ALIM_KO" 20 "ADC_KO" 21 "CAN_OFF" 22 "AIRQCONTROL_ERROR" 23 "FBCONTROL_ERROR" 24 "RPCONTROL_ERROR" 25 "SAFETY_KO" 26 "SC_HS_LS" 27 "SC_TO_GND_HS" 28 "TPU_ERROR" 29 "OC_OR_SC_TO_GND_LS" 30 "SC_TO_BAT_LS" 31 "OVERTEMPERATURE" 32 "SC_TO_GND_LS" 33 "SC_TO_BAT_HS" 34 "CLOSED" 35 "OPEN" 36 "LOAD_DUMP" 37 "STUCK_OPEN" 38 "STUCK_CLOSED" 39 "UNKNOWN_STATE" 40 "UNDERVOLTAGE" 41 "STUCK_ON" 42 "STUCK_OFF" 43 "ON" 44 "OFF" 45 "THR_INCOHERENCE" 46 "PDL_INCOHERENCE" 47 "POT_2_FAULT" 48 "QAIR_UNDER_ESTIM" 49 "QAIR_OVER_ESTIM" 50 "RSCOPEN_ERROR" 51 "RSCWAIT_ERROR" 52 "RSCCLOSE_ERROR" 53 "OSCCLOSE_ERROR" 54 "OSCOPEN_ERROR" 55 "DTC_ERROR" 56 "NLP_ERROR" 57 "UMA_ERROR" 58 "TEMP_PREWARNING" 59 "TEMP_WARNING" 60 "THR_LRN_ERROR" 61 "COMM_ERROR" 62 "MMP_ERROR" 63 "SMP_ERROR" 64 "EOBD_ERROR" 65 "ENERGY_ERROR" 66 "GAIN_ERROR" 67 "KO2_HPRAIL_ERROR" 68 "KO2_LPRAIL_ERROR" 69 "OFFS_ERROR" 70 "SWT_INCOHERENCE" 71 "MFLV_INCOHERENCE" 72 "SET_PLUS_FAULT" 73 "SET_MINUS_FAULT" 74 "OFF_FAULT" 75 "SET_FAULT" 76 "RESUME_FAULT" 77 "HOLD_FAULT" 78 "STOP_CABIN_TILT_FAULT" 79 "START_CABIN_TILT_FAULT" 80 "STUCK_CLOSED_OR_OPEN_LOAD" 81 "OVERCURR" 82 "CAM_NTEETH_INCOHERENCE" 83 "CAM_POS_INCOHERENCE" 84 "SERIAL_ERROR" 85 "CHIP_FAULT" 86 "SC_PHASES" 87 "NUMBER_OF_FAULT" 88 "ANY_FAULT" /end COMPU_VTAB
/begin COMPU_VTAB VTAB_FOR_Egt100ms_CM_tFault_adm "Enumerated data type: tFault" TAB_VERB 89 0 "NO_FAULT" 1 "SIGNAL_TOO_LOW" 2 "SIGNAL_TOO_BIG" 3 "SC_TO_BATTERY" 4 "SC_TO_GND" 5 "SIGNAL_NOT_PLAUSIBLE" 6 "OC_OR_SC_TO_BATTERY" 7 "OC_OR_SC_TO_GND" 8 "OC" 9 "NO_SIGNAL" 10 "SIGNAL_DELAYED" 11 "TRASMISSION_IMPOSSIBLE" 12 "COMPONENT_DAMAGED" 13 "TEST_CONDITION_NOT_CORRECT" 14 "MECHANICAL_PROBLEM" 15 "GENERIC_FAULT" 16 "DERIVATIVE_TOO_HIGH" 17 "DERIVATIVE_TOO_LOW" 18 "CONTROL_ERROR" 19 "ALIM_KO" 20 "ADC_KO" 21 "CAN_OFF" 22 "AIRQCONTROL_ERROR" 23 "FBCONTROL_ERROR" 24 "RPCONTROL_ERROR" 25 "SAFETY_KO" 26 "SC_HS_LS" 27 "SC_TO_GND_HS" 28 "TPU_ERROR" 29 "OC_OR_SC_TO_GND_LS" 30 "SC_TO_BAT_LS" 31 "OVERTEMPERATURE" 32 "SC_TO_GND_LS" 33 "SC_TO_BAT_HS" 34 "CLOSED" 35 "OPEN" 36 "LOAD_DUMP" 37 "STUCK_OPEN" 38 "STUCK_CLOSED" 39 "UNKNOWN_STATE" 40 "UNDERVOLTAGE" 41 "STUCK_ON" 42 "STUCK_OFF" 43 "ON" 44 "OFF" 45 "THR_INCOHERENCE" 46 "PDL_INCOHERENCE" 47 "POT_2_FAULT" 48 "QAIR_UNDER_ESTIM" 49 "QAIR_OVER_ESTIM" 50 "RSCOPEN_ERROR" 51 "RSCWAIT_ERROR" 52 "RSCCLOSE_ERROR" 53 "OSCCLOSE_ERROR" 54 "OSCOPEN_ERROR" 55 "DTC_ERROR" 56 "NLP_ERROR" 57 "UMA_ERROR" 58 "TEMP_PREWARNING" 59 "TEMP_WARNING" 60 "THR_LRN_ERROR" 61 "COMM_ERROR" 62 "MMP_ERROR" 63 "SMP_ERROR" 64 "EOBD_ERROR" 65 "ENERGY_ERROR" 66 "GAIN_ERROR" 67 "KO2_HPRAIL_ERROR" 68 "KO2_LPRAIL_ERROR" 69 "OFFS_ERROR" 70 "SWT_INCOHERENCE" 71 "MFLV_INCOHERENCE" 72 "SET_PLUS_FAULT" 73 "SET_MINUS_FAULT" 74 "OFF_FAULT" 75 "SET_FAULT" 76 "RESUME_FAULT" 77 "HOLD_FAULT" 78 "STOP_CABIN_TILT_FAULT" 79 "START_CABIN_TILT_FAULT" 80 "STUCK_CLOSED_OR_OPEN_LOAD" 81 "OVERCURR" 82 "CAM_NTEETH_INCOHERENCE" 83 "CAM_POS_INCOHERENCE" 84 "SERIAL_ERROR" 85 "CHIP_FAULT" 86 "SC_PHASES" 87 "NUMBER_OF_FAULT" 88 "ANY_FAULT" /end COMPU_VTAB
/begin COMPU_VTAB VTAB_FOR_Ethrc4ms_CM_tFault_adm "Enumerated data type: tFault" TAB_VERB 89 0 "NO_FAULT" 1 "SIGNAL_TOO_LOW" 2 "SIGNAL_TOO_BIG" 3 "SC_TO_BATTERY" 4 "SC_TO_GND" 5 "SIGNAL_NOT_PLAUSIBLE" 6 "OC_OR_SC_TO_BATTERY" 7 "OC_OR_SC_TO_GND" 8 "OC" 9 "NO_SIGNAL" 10 "SIGNAL_DELAYED" 11 "TRASMISSION_IMPOSSIBLE" 12 "COMPONENT_DAMAGED" 13 "TEST_CONDITION_NOT_CORRECT" 14 "MECHANICAL_PROBLEM" 15 "GENERIC_FAULT" 16 "DERIVATIVE_TOO_HIGH" 17 "DERIVATIVE_TOO_LOW" 18 "CONTROL_ERROR" 19 "ALIM_KO" 20 "ADC_KO" 21 "CAN_OFF" 22 "AIRQCONTROL_ERROR" 23 "FBCONTROL_ERROR" 24 "RPCONTROL_ERROR" 25 "SAFETY_KO" 26 "SC_HS_LS" 27 "SC_TO_GND_HS" 28 "TPU_ERROR" 29 "OC_OR_SC_TO_GND_LS" 30 "SC_TO_BAT_LS" 31 "OVERTEMPERATURE" 32 "SC_TO_GND_LS" 33 "SC_TO_BAT_HS" 34 "CLOSED" 35 "OPEN" 36 "LOAD_DUMP" 37 "STUCK_OPEN" 38 "STUCK_CLOSED" 39 "UNKNOWN_STATE" 40 "UNDERVOLTAGE" 41 "STUCK_ON" 42 "STUCK_OFF" 43 "ON" 44 "OFF" 45 "THR_INCOHERENCE" 46 "PDL_INCOHERENCE" 47 "POT_2_FAULT" 48 "QAIR_UNDER_ESTIM" 49 "QAIR_OVER_ESTIM" 50 "RSCOPEN_ERROR" 51 "RSCWAIT_ERROR" 52 "RSCCLOSE_ERROR" 53 "OSCCLOSE_ERROR" 54 "OSCOPEN_ERROR" 55 "DTC_ERROR" 56 "NLP_ERROR" 57 "UMA_ERROR" 58 "TEMP_PREWARNING" 59 "TEMP_WARNING" 60 "THR_LRN_ERROR" 61 "COMM_ERROR" 62 "MMP_ERROR" 63 "SMP_ERROR" 64 "EOBD_ERROR" 65 "ENERGY_ERROR" 66 "GAIN_ERROR" 67 "KO2_HPRAIL_ERROR" 68 "KO2_LPRAIL_ERROR" 69 "OFFS_ERROR" 70 "SWT_INCOHERENCE" 71 "MFLV_INCOHERENCE" 72 "SET_PLUS_FAULT" 73 "SET_MINUS_FAULT" 74 "OFF_FAULT" 75 "SET_FAULT" 76 "RESUME_FAULT" 77 "HOLD_FAULT" 78 "STOP_CABIN_TILT_FAULT" 79 "START_CABIN_TILT_FAULT" 80 "STUCK_CLOSED_OR_OPEN_LOAD" 81 "OVERCURR" 82 "CAM_NTEETH_INCOHERENCE" 83 "CAM_POS_INCOHERENCE" 84 "SERIAL_ERROR" 85 "CHIP_FAULT" 86 "SC_PHASES" 87 "NUMBER_OF_FAULT" 88 "ANY_FAULT" /end COMPU_VTAB
/begin COMPU_VTAB VTAB_FOR_Gast100ms_CM_tFault_adm "Enumerated data type: tFault" TAB_VERB 82 0 "NO_FAULT" 1 "SIGNAL_TOO_LOW" 2 "SIGNAL_TOO_BIG" 3 "SC_TO_BATTERY" 4 "SC_TO_GND" 5 "SIGNAL_NOT_PLAUSIBLE" 6 "OC_OR_SC_TO_BATTERY" 7 "OC_OR_SC_TO_GND" 8 "OC" 9 "NO_SIGNAL" 10 "SIGNAL_DELAYED" 11 "TRASMISSION_IMPOSSIBLE" 12 "COMPONENT_DAMAGED" 13 "CONDITION_NOT_CORRECT" 14 "MECHANICAL_PROBLEM" 15 "GENERIC_FAULT" 16 "DERIVATIVE_TOO_HIGH" 17 "DERIVATIVE_TOO_LOW" 18 "CONTROL_ERROR" 19 "ALIM_KO" 20 "ADC_KO" 21 "CAN_OFF" 22 "AIRQCONTROL_ERROR" 23 "FBCONTROL_ERROR" 24 "RPCONTROL_ERROR" 25 "SAFETY_KO" 26 "SC_HS_LS" 27 "SC_TO_GND_HS" 28 "TPU_ERROR" 29 "OC_OR_SC_TO_GND_LS" 30 "SC_TO_BAT_LS" 31 "OVER_TEMPERATURE" 32 "SC_TO_GND_LS" 33 "SC_TO_BAT_HS" 34 "CLOSED" 35 "OPEN" 36 "LOAD_DUMP" 37 "STUCK_OPEN" 38 "STUCK_CLOSED" 39 "UNKNOWN_STATE" 40 "UNDERVOLTAGE" 41 "STUCK_ON" 42 "STUCK_OFF" 43 "ON" 44 "OFF" 45 "THR_INCOHERENCE" 46 "PDL_INCOHERENCE" 47 "POT_2_FAULT" 48 "QAIR_UNDER_ESTIM" 49 "QAIR_OVER_ESTIM" 50 "RSCOPEN_ERROR" 51 "RSCWAIT_ERROR" 52 "RSCCLOSE_ERROR" 53 "OSCCLOSE_ERROR" 54 "OSCOPEN_ERROR" 55 "DTC_ERROR" 56 "NLP_ERROR" 57 "UMA_ERROR" 58 "TEMP_PREWARNING" 59 "TEMP_WARNING" 60 "THR_LRN_ERROR" 61 "COMM_ERROR" 62 "MMP_ERROR" 63 "SMP_ERROR" 64 "EOBD_ERROR" 65 "ENERGY_ERROR" 66 "GAIN_ERROR" 67 "KO2_HPRAIL_ERROR" 68 "KO2_LPRAIL_ERROR" 69 "OFFS_ERROR" 70 "SWT_INCOHERENCE" 71 "MFLV_INCOHERENCE" 72 "SET_PLUS_FAULT" 73 "SET_MINUS_FAULT" 74 "OFF_FAULT" 75 "SET_FAULT" 76 "RESUME_FAULT" 77 "HOLD_FAULT" 78 "STOP_CABIN_TILT_FAULT" 79 "START_CABIN_TILT_FAULT" 80 "NUMBER_OF_FAULT" 81 "ANY_FAULT" /end COMPU_VTAB
/begin COMPU_VTAB VTAB_FOR_Gast100ms_CM_tKeyState_adm "Enumerated data type: tKeyState" TAB_VERB 2 0 "KEY_OFF" 1 "KEY_ON" /end COMPU_VTAB
/begin COMPU_VTAB VTAB_FOR_Idle4ms_CM_eEGMD_adm "Enumerated data type: eEGMD" TAB_VERB 5 0 "NOT_DETERM" 1 "CRANK" 2 "IDLE" 3 "NORMAL" 4 "CUT_OFF" /end COMPU_VTAB
/begin COMPU_VTAB VTAB_FOR_Idle4ms_CM_eEGST_adm "Enumerated data type: eEGST" TAB_VERB 7 0 "POWER_ON" 1 "WAIT" 2 "RUN" 3 "POWER_LATCH" 4 "POWER_OFF" 5 "SHUTDOWN" 6 "ACTDIAG_WAIT" /end COMPU_VTAB
/begin COMPU_VTAB VTAB_FOR_Idle4ms_CM_tKeyState_adm "Enumerated data type: tKeyState" TAB_VERB 2 0 "KEY_OFF" 1 "KEY_ON" /end COMPU_VTAB
/begin COMPU_VTAB VTAB_FOR_IgntTDC_CM_eEGMD_adm "Enumerated data type: eEGMD" TAB_VERB 5 0 "NOT_DETERM" 1 "CRANK" 2 "IDLE" 3 "NORMAL" 4 "CUT_OFF" /end COMPU_VTAB
/begin COMPU_VTAB VTAB_FOR_IgntTDC_CM_eEGST_adm "Enumerated data type: eEGST" TAB_VERB 8 0 "POWER_ON" 1 "WAIT" 2 "RUN" 3 "POWER_LATCH" 4 "POWER_OFF" 5 "SHUTDOWN" 6 "ACTDIAG_WAIT" 7 "SAFETY_CHECK" /end COMPU_VTAB
/begin COMPU_VTAB VTAB_FOR_InjtTDC_CM_eCutOff_adm "Enumerated data type: eCutOff" TAB_VERB 5 0 "WAIT_CUT_OFF" 1 "CUT_OFF_ENTRY" 2 "CUT_OFF_ACTIVE" 3 "EXIT_CUT_OFF_RPM" 4 "EXIT_CUT_OFF_THROT" /end COMPU_VTAB
/begin COMPU_VTAB VTAB_FOR_InjtTDC_CM_eEGMD_adm "Enumerated data type: eEGMD" TAB_VERB 5 0 "NOT_DETERM" 1 "CRANK" 2 "IDLE" 3 "NORMAL" 4 "CUT_OFF" /end COMPU_VTAB
/begin COMPU_VTAB VTAB_FOR_InjtTDC_CM_eEGST_adm "Enumerated data type: eEGST" TAB_VERB 8 0 "POWER_ON" 1 "WAIT" 2 "RUN" 3 "POWER_LATCH" 4 "POWER_OFF" 5 "SHUTDOWN" 6 "ACTDIAG_WAIT" 7 "SAFETY_CHECK" /end COMPU_VTAB
/begin COMPU_VTAB VTAB_FOR_InjtTDC_CM_ePhCrank_adm "Enumerated data type: ePhCrank" TAB_VERB 5 0 "PH_NULL" 1 "PHASE1" 2 "PHASE2" 3 "PHASE3" 4 "END_CRANK" /end COMPU_VTAB
/begin COMPU_VTAB VTAB_FOR_KnockTDC_CM_tFault_adm "Enumerated data type: tFault" TAB_VERB 90 0 "NO_FAULT" 1 "SIGNAL_TOO_LOW" 2 "SIGNAL_TOO_BIG" 3 "SC_TO_BATTERY" 4 "SC_TO_GND" 5 "SIGNAL_NOT_PLAUSIBLE" 6 "OC_OR_SC_TO_BATTERY" 7 "OC_OR_SC_TO_GND" 8 "OC" 9 "NO_SIGNAL" 10 "SIGNAL_DELAYED" 11 "TRASMISSION_IMPOSSIBLE" 12 "COMPONENT_DAMAGED" 13 "TEST_CONDITION_NOT_CORRECT" 14 "MECHANICAL_PROBLEM" 15 "GENERIC_FAULT" 16 "DERIVATIVE_TOO_HIGH" 17 "DERIVATIVE_TOO_LOW" 18 "CONTROL_ERROR" 19 "ALIM_KO" 20 "ADC_KO" 21 "CAN_OFF" 22 "AIRQCONTROL_ERROR" 23 "FBCONTROL_ERROR" 24 "RPCONTROL_ERROR" 25 "SAFETY_KO" 26 "SC_HS_LS" 27 "SC_TO_GND_HS" 28 "TPU_ERROR" 29 "OC_OR_SC_TO_GND_LS" 30 "SC_TO_BAT_LS" 31 "OVERTEMPERATURE" 32 "SC_TO_GND_LS" 33 "SC_TO_BAT_HS" 34 "CLOSED" 35 "OPEN" 36 "LOAD_DUMP" 37 "STUCK_OPEN" 38 "STUCK_CLOSED" 39 "UNKNOWN_STATE" 40 "UNDERVOLTAGE" 41 "STUCK_ON" 42 "STUCK_OFF" 43 "ON" 44 "OFF" 45 "THR_INCOHERENCE" 46 "PDL_INCOHERENCE" 47 "POT_2_FAULT" 48 "QAIR_UNDER_ESTIM" 49 "QAIR_OVER_ESTIM" 50 "RSCOPEN_ERROR" 51 "RSCWAIT_ERROR" 52 "RSCCLOSE_ERROR" 53 "OSCCLOSE_ERROR" 54 "OSCOPEN_ERROR" 55 "DTC_ERROR" 56 "NLP_ERROR" 57 "UMA_ERROR" 58 "TEMP_PREWARNING" 59 "TEMP_WARNING" 60 "THR_LRN_ERROR" 61 "COMM_ERROR" 62 "MMP_ERROR" 63 "SMP_ERROR" 64 "EOBD_ERROR" 65 "ENERGY_ERROR" 66 "GAIN_ERROR" 67 "KO2_HPRAIL_ERROR" 68 "KO2_LPRAIL_ERROR" 69 "OFFS_ERROR" 70 "SWT_INCOHERENCE" 71 "MFLV_INCOHERENCE" 72 "SET_PLUS_FAULT" 73 "SET_MINUS_FAULT" 74 "OFF_FAULT" 75 "SET_FAULT" 76 "RESUME_FAULT" 77 "HOLD_FAULT" 78 "STOP_CABIN_TILT_FAULT" 79 "START_CABIN_TILT_FAULT" 80 "STUCK_CLOSED_OR_OPEN_LOAD" 81 "OVERCURR" 82 "CAM_NTEETH_INCOHERENCE" 83 "CAM_POS_INCOHERENCE" 84 "SERIAL_ERROR" 85 "CHIP_FAULT" 86 "SC_PHASES" 87 "STACK_ERROR" 88 "NUMBER_OF_FAULT" 89 "ANY_FAULT" /end COMPU_VTAB
/begin COMPU_VTAB VTAB_FOR_Lamm4ms_CM_tFault_adm "Enumerated data type: tFault" TAB_VERB 89 0 "NO_FAULT" 1 "SIGNAL_TOO_LOW" 2 "SIGNAL_TOO_BIG" 3 "SC_TO_BATTERY" 4 "SC_TO_GND" 5 "SIGNAL_NOT_PLAUSIBLE" 6 "OC_OR_SC_TO_BATTERY" 7 "OC_OR_SC_TO_GND" 8 "OC" 9 "NO_SIGNAL" 10 "SIGNAL_DELAYED" 11 "TRASMISSION_IMPOSSIBLE" 12 "COMPONENT_DAMAGED" 13 "TEST_CONDITION_NOT_CORRECT" 14 "MECHANICAL_PROBLEM" 15 "GENERIC_FAULT" 16 "DERIVATIVE_TOO_HIGH" 17 "DERIVATIVE_TOO_LOW" 18 "CONTROL_ERROR" 19 "ALIM_KO" 20 "ADC_KO" 21 "CAN_OFF" 22 "AIRQCONTROL_ERROR" 23 "FBCONTROL_ERROR" 24 "RPCONTROL_ERROR" 25 "SAFETY_KO" 26 "SC_HS_LS" 27 "SC_TO_GND_HS" 28 "TPU_ERROR" 29 "OC_OR_SC_TO_GND_LS" 30 "SC_TO_BAT_LS" 31 "OVERTEMPERATURE" 32 "SC_TO_GND_LS" 33 "SC_TO_BAT_HS" 34 "CLOSED" 35 "OPEN" 36 "LOAD_DUMP" 37 "STUCK_OPEN" 38 "STUCK_CLOSED" 39 "UNKNOWN_STATE" 40 "UNDERVOLTAGE" 41 "STUCK_ON" 42 "STUCK_OFF" 43 "ON" 44 "OFF" 45 "THR_INCOHERENCE" 46 "PDL_INCOHERENCE" 47 "POT_2_FAULT" 48 "QAIR_UNDER_ESTIM" 49 "QAIR_OVER_ESTIM" 50 "RSCOPEN_ERROR" 51 "RSCWAIT_ERROR" 52 "RSCCLOSE_ERROR" 53 "OSCCLOSE_ERROR" 54 "OSCOPEN_ERROR" 55 "DTC_ERROR" 56 "NLP_ERROR" 57 "UMA_ERROR" 58 "TEMP_PREWARNING" 59 "TEMP_WARNING" 60 "THR_LRN_ERROR" 61 "COMM_ERROR" 62 "MMP_ERROR" 63 "SMP_ERROR" 64 "EOBD_ERROR" 65 "ENERGY_ERROR" 66 "GAIN_ERROR" 67 "KO2_HPRAIL_ERROR" 68 "KO2_LPRAIL_ERROR" 69 "OFFS_ERROR" 70 "SWT_INCOHERENCE" 71 "MFLV_INCOHERENCE" 72 "SET_PLUS_FAULT" 73 "SET_MINUS_FAULT" 74 "OFF_FAULT" 75 "SET_FAULT" 76 "RESUME_FAULT" 77 "HOLD_FAULT" 78 "STOP_CABIN_TILT_FAULT" 79 "START_CABIN_TILT_FAULT" 80 "STUCK_CLOSED_OR_OPEN_LOAD" 81 "OVERCURR" 82 "CAM_NTEETH_INCOHERENCE" 83 "CAM_POS_INCOHERENCE" 84 "SERIAL_ERROR" 85 "CHIP_FAULT" 86 "SC_PHASES" 87 "NUMBER_OF_FAULT" 88 "ANY_FAULT" /end COMPU_VTAB
/begin COMPU_VTAB VTAB_FOR_Lamp100ms_CM_tFault_adm "Enumerated data type: tFault" TAB_VERB 89 0 "NO_FAULT" 1 "SIGNAL_TOO_LOW" 2 "SIGNAL_TOO_BIG" 3 "SC_TO_BATTERY" 4 "SC_TO_GND" 5 "SIGNAL_NOT_PLAUSIBLE" 6 "OC_OR_SC_TO_BATTERY" 7 "OC_OR_SC_TO_GND" 8 "OC" 9 "NO_SIGNAL" 10 "SIGNAL_DELAYED" 11 "TRASMISSION_IMPOSSIBLE" 12 "COMPONENT_DAMAGED" 13 "TEST_CONDITION_NOT_CORRECT" 14 "MECHANICAL_PROBLEM" 15 "GENERIC_FAULT" 16 "DERIVATIVE_TOO_HIGH" 17 "DERIVATIVE_TOO_LOW" 18 "CONTROL_ERROR" 19 "ALIM_KO" 20 "ADC_KO" 21 "CAN_OFF" 22 "AIRQCONTROL_ERROR" 23 "FBCONTROL_ERROR" 24 "RPCONTROL_ERROR" 25 "SAFETY_KO" 26 "SC_HS_LS" 27 "SC_TO_GND_HS" 28 "TPU_ERROR" 29 "OC_OR_SC_TO_GND_LS" 30 "SC_TO_BAT_LS" 31 "OVERTEMPERATURE" 32 "SC_TO_GND_LS" 33 "SC_TO_BAT_HS" 34 "CLOSED" 35 "OPEN" 36 "LOAD_DUMP" 37 "STUCK_OPEN" 38 "STUCK_CLOSED" 39 "UNKNOWN_STATE" 40 "UNDERVOLTAGE" 41 "STUCK_ON" 42 "STUCK_OFF" 43 "ON" 44 "OFF" 45 "THR_INCOHERENCE" 46 "PDL_INCOHERENCE" 47 "POT_2_FAULT" 48 "QAIR_UNDER_ESTIM" 49 "QAIR_OVER_ESTIM" 50 "RSCOPEN_ERROR" 51 "RSCWAIT_ERROR" 52 "RSCCLOSE_ERROR" 53 "OSCCLOSE_ERROR" 54 "OSCOPEN_ERROR" 55 "DTC_ERROR" 56 "NLP_ERROR" 57 "UMA_ERROR" 58 "TEMP_PREWARNING" 59 "TEMP_WARNING" 60 "THR_LRN_ERROR" 61 "COMM_ERROR" 62 "MMP_ERROR" 63 "SMP_ERROR" 64 "EOBD_ERROR" 65 "ENERGY_ERROR" 66 "GAIN_ERROR" 67 "KO2_HPRAIL_ERROR" 68 "KO2_LPRAIL_ERROR" 69 "OFFS_ERROR" 70 "SWT_INCOHERENCE" 71 "MFLV_INCOHERENCE" 72 "SET_PLUS_FAULT" 73 "SET_MINUS_FAULT" 74 "OFF_FAULT" 75 "SET_FAULT" 76 "RESUME_FAULT" 77 "HOLD_FAULT" 78 "STOP_CABIN_TILT_FAULT" 79 "START_CABIN_TILT_FAULT" 80 "STUCK_CLOSED_OR_OPEN_LOAD" 81 "OVERCURR" 82 "CAM_NTEETH_INCOHERENCE" 83 "CAM_POS_INCOHERENCE" 84 "SERIAL_ERROR" 85 "CHIP_FAULT" 86 "SC_PHASES" 87 "NUMBER_OF_FAULT" 88 "ANY_FAULT" /end COMPU_VTAB
/begin COMPU_VTAB VTAB_FOR_Mpre4ms_CM_tFault_adm "Enumerated data type: tFault" TAB_VERB 89 0 "NO_FAULT" 1 "SIGNAL_TOO_LOW" 2 "SIGNAL_TOO_BIG" 3 "SC_TO_BATTERY" 4 "SC_TO_GND" 5 "SIGNAL_NOT_PLAUSIBLE" 6 "OC_OR_SC_TO_BATTERY" 7 "OC_OR_SC_TO_GND" 8 "OC" 9 "NO_SIGNAL" 10 "SIGNAL_DELAYED" 11 "TRASMISSION_IMPOSSIBLE" 12 "COMPONENT_DAMAGED" 13 "TEST_CONDITION_NOT_CORRECT" 14 "MECHANICAL_PROBLEM" 15 "GENERIC_FAULT" 16 "DERIVATIVE_TOO_HIGH" 17 "DERIVATIVE_TOO_LOW" 18 "CONTROL_ERROR" 19 "ALIM_KO" 20 "ADC_KO" 21 "CAN_OFF" 22 "AIRQCONTROL_ERROR" 23 "FBCONTROL_ERROR" 24 "RPCONTROL_ERROR" 25 "SAFETY_KO" 26 "SC_HS_LS" 27 "SC_TO_GND_HS" 28 "TPU_ERROR" 29 "OC_OR_SC_TO_GND_LS" 30 "SC_TO_BAT_LS" 31 "OVERTEMPERATURE" 32 "SC_TO_GND_LS" 33 "SC_TO_BAT_HS" 34 "CLOSED" 35 "OPEN" 36 "LOAD_DUMP" 37 "STUCK_OPEN" 38 "STUCK_CLOSED" 39 "UNKNOWN_STATE" 40 "UNDERVOLTAGE" 41 "STUCK_ON" 42 "STUCK_OFF" 43 "ON" 44 "OFF" 45 "THR_INCOHERENCE" 46 "PDL_INCOHERENCE" 47 "POT_2_FAULT" 48 "QAIR_UNDER_ESTIM" 49 "QAIR_OVER_ESTIM" 50 "RSCOPEN_ERROR" 51 "RSCWAIT_ERROR" 52 "RSCCLOSE_ERROR" 53 "OSCCLOSE_ERROR" 54 "OSCOPEN_ERROR" 55 "DTC_ERROR" 56 "NLP_ERROR" 57 "UMA_ERROR" 58 "TEMP_PREWARNING" 59 "TEMP_WARNING" 60 "THR_LRN_ERROR" 61 "COMM_ERROR" 62 "MMP_ERROR" 63 "SMP_ERROR" 64 "EOBD_ERROR" 65 "ENERGY_ERROR" 66 "GAIN_ERROR" 67 "KO2_HPRAIL_ERROR" 68 "KO2_LPRAIL_ERROR" 69 "OFFS_ERROR" 70 "SWT_INCOHERENCE" 71 "MFLV_INCOHERENCE" 72 "SET_PLUS_FAULT" 73 "SET_MINUS_FAULT" 74 "OFF_FAULT" 75 "SET_FAULT" 76 "RESUME_FAULT" 77 "HOLD_FAULT" 78 "STOP_CABIN_TILT_FAULT" 79 "START_CABIN_TILT_FAULT" 80 "STUCK_CLOSED_OR_OPEN_LOAD" 81 "OVERCURR" 82 "CAM_NTEETH_INCOHERENCE" 83 "CAM_POS_INCOHERENCE" 84 "SERIAL_ERROR" 85 "CHIP_FAULT" 86 "SC_PHASES" 87 "NUMBER_OF_FAULT" 88 "ANY_FAULT" /end COMPU_VTAB
/begin COMPU_VTAB VTAB_FOR_Oilp100ms_CM_tFault_adm "Enumerated data type: tFault" TAB_VERB 89 0 "NO_FAULT" 1 "SIGNAL_TOO_LOW" 2 "SIGNAL_TOO_BIG" 3 "SC_TO_BATTERY" 4 "SC_TO_GND" 5 "SIGNAL_NOT_PLAUSIBLE" 6 "OC_OR_SC_TO_BATTERY" 7 "OC_OR_SC_TO_GND" 8 "OC" 9 "NO_SIGNAL" 10 "SIGNAL_DELAYED" 11 "TRASMISSION_IMPOSSIBLE" 12 "COMPONENT_DAMAGED" 13 "TEST_CONDITION_NOT_CORRECT" 14 "MECHANICAL_PROBLEM" 15 "GENERIC_FAULT" 16 "DERIVATIVE_TOO_HIGH" 17 "DERIVATIVE_TOO_LOW" 18 "CONTROL_ERROR" 19 "ALIM_KO" 20 "ADC_KO" 21 "CAN_OFF" 22 "AIRQCONTROL_ERROR" 23 "FBCONTROL_ERROR" 24 "RPCONTROL_ERROR" 25 "SAFETY_KO" 26 "SC_HS_LS" 27 "SC_TO_GND_HS" 28 "TPU_ERROR" 29 "OC_OR_SC_TO_GND_LS" 30 "SC_TO_BAT_LS" 31 "OVERTEMPERATURE" 32 "SC_TO_GND_LS" 33 "SC_TO_BAT_HS" 34 "CLOSED" 35 "OPEN" 36 "LOAD_DUMP" 37 "STUCK_OPEN" 38 "STUCK_CLOSED" 39 "UNKNOWN_STATE" 40 "UNDERVOLTAGE" 41 "STUCK_ON" 42 "STUCK_OFF" 43 "ON" 44 "OFF" 45 "THR_INCOHERENCE" 46 "PDL_INCOHERENCE" 47 "POT_2_FAULT" 48 "QAIR_UNDER_ESTIM" 49 "QAIR_OVER_ESTIM" 50 "RSCOPEN_ERROR" 51 "RSCWAIT_ERROR" 52 "RSCCLOSE_ERROR" 53 "OSCCLOSE_ERROR" 54 "OSCOPEN_ERROR" 55 "DTC_ERROR" 56 "NLP_ERROR" 57 "UMA_ERROR" 58 "TEMP_PREWARNING" 59 "TEMP_WARNING" 60 "THR_LRN_ERROR" 61 "COMM_ERROR" 62 "MMP_ERROR" 63 "SMP_ERROR" 64 "EOBD_ERROR" 65 "ENERGY_ERROR" 66 "GAIN_ERROR" 67 "KO2_HPRAIL_ERROR" 68 "KO2_LPRAIL_ERROR" 69 "OFFS_ERROR" 70 "SWT_INCOHERENCE" 71 "MFLV_INCOHERENCE" 72 "SET_PLUS_FAULT" 73 "SET_MINUS_FAULT" 74 "OFF_FAULT" 75 "SET_FAULT" 76 "RESUME_FAULT" 77 "HOLD_FAULT" 78 "STOP_CABIN_TILT_FAULT" 79 "START_CABIN_TILT_FAULT" 80 "STUCK_CLOSED_OR_OPEN_LOAD" 81 "OVERCURR" 82 "CAM_NTEETH_INCOHERENCE" 83 "CAM_POS_INCOHERENCE" 84 "SERIAL_ERROR" 85 "CHIP_FAULT" 86 "SC_PHASES" 87 "NUMBER_OF_FAULT" 88 "ANY_FAULT" /end COMPU_VTAB
/begin COMPU_VTAB VTAB_FOR_Oilt100ms_CM_tFault_adm "Enumerated data type: tFault" TAB_VERB 89 0 "NO_FAULT" 1 "SIGNAL_TOO_LOW" 2 "SIGNAL_TOO_BIG" 3 "SC_TO_BATTERY" 4 "SC_TO_GND" 5 "SIGNAL_NOT_PLAUSIBLE" 6 "OC_OR_SC_TO_BATTERY" 7 "OC_OR_SC_TO_GND" 8 "OC" 9 "NO_SIGNAL" 10 "SIGNAL_DELAYED" 11 "TRASMISSION_IMPOSSIBLE" 12 "COMPONENT_DAMAGED" 13 "TEST_CONDITION_NOT_CORRECT" 14 "MECHANICAL_PROBLEM" 15 "GENERIC_FAULT" 16 "DERIVATIVE_TOO_HIGH" 17 "DERIVATIVE_TOO_LOW" 18 "CONTROL_ERROR" 19 "ALIM_KO" 20 "ADC_KO" 21 "CAN_OFF" 22 "AIRQCONTROL_ERROR" 23 "FBCONTROL_ERROR" 24 "RPCONTROL_ERROR" 25 "SAFETY_KO" 26 "SC_HS_LS" 27 "SC_TO_GND_HS" 28 "TPU_ERROR" 29 "OC_OR_SC_TO_GND_LS" 30 "SC_TO_BAT_LS" 31 "OVERTEMPERATURE" 32 "SC_TO_GND_LS" 33 "SC_TO_BAT_HS" 34 "CLOSED" 35 "OPEN" 36 "LOAD_DUMP" 37 "STUCK_OPEN" 38 "STUCK_CLOSED" 39 "UNKNOWN_STATE" 40 "UNDERVOLTAGE" 41 "STUCK_ON" 42 "STUCK_OFF" 43 "ON" 44 "OFF" 45 "THR_INCOHERENCE" 46 "PDL_INCOHERENCE" 47 "POT_2_FAULT" 48 "QAIR_UNDER_ESTIM" 49 "QAIR_OVER_ESTIM" 50 "RSCOPEN_ERROR" 51 "RSCWAIT_ERROR" 52 "RSCCLOSE_ERROR" 53 "OSCCLOSE_ERROR" 54 "OSCOPEN_ERROR" 55 "DTC_ERROR" 56 "NLP_ERROR" 57 "UMA_ERROR" 58 "TEMP_PREWARNING" 59 "TEMP_WARNING" 60 "THR_LRN_ERROR" 61 "COMM_ERROR" 62 "MMP_ERROR" 63 "SMP_ERROR" 64 "EOBD_ERROR" 65 "ENERGY_ERROR" 66 "GAIN_ERROR" 67 "KO2_HPRAIL_ERROR" 68 "KO2_LPRAIL_ERROR" 69 "OFFS_ERROR" 70 "SWT_INCOHERENCE" 71 "MFLV_INCOHERENCE" 72 "SET_PLUS_FAULT" 73 "SET_MINUS_FAULT" 74 "OFF_FAULT" 75 "SET_FAULT" 76 "RESUME_FAULT" 77 "HOLD_FAULT" 78 "STOP_CABIN_TILT_FAULT" 79 "START_CABIN_TILT_FAULT" 80 "STUCK_CLOSED_OR_OPEN_LOAD" 81 "OVERCURR" 82 "CAM_NTEETH_INCOHERENCE" 83 "CAM_POS_INCOHERENCE" 84 "SERIAL_ERROR" 85 "CHIP_FAULT" 86 "SC_PHASES" 87 "NUMBER_OF_FAULT" 88 "ANY_FAULT" /end COMPU_VTAB
/begin COMPU_VTAB VTAB_FOR_Pacc4ms_CM_tFault_adm "Enumerated data type: tFault" TAB_VERB 89 0 "NO_FAULT" 1 "SIGNAL_TOO_LOW" 2 "SIGNAL_TOO_BIG" 3 "SC_TO_BATTERY" 4 "SC_TO_GND" 5 "SIGNAL_NOT_PLAUSIBLE" 6 "OC_OR_SC_TO_BATTERY" 7 "OC_OR_SC_TO_GND" 8 "OC" 9 "NO_SIGNAL" 10 "SIGNAL_DELAYED" 11 "TRASMISSION_IMPOSSIBLE" 12 "COMPONENT_DAMAGED" 13 "TEST_CONDITION_NOT_CORRECT" 14 "MECHANICAL_PROBLEM" 15 "GENERIC_FAULT" 16 "DERIVATIVE_TOO_HIGH" 17 "DERIVATIVE_TOO_LOW" 18 "CONTROL_ERROR" 19 "ALIM_KO" 20 "ADC_KO" 21 "CAN_OFF" 22 "AIRQCONTROL_ERROR" 23 "FBCONTROL_ERROR" 24 "RPCONTROL_ERROR" 25 "SAFETY_KO" 26 "SC_HS_LS" 27 "SC_TO_GND_HS" 28 "TPU_ERROR" 29 "OC_OR_SC_TO_GND_LS" 30 "SC_TO_BAT_LS" 31 "OVERTEMPERATURE" 32 "SC_TO_GND_LS" 33 "SC_TO_BAT_HS" 34 "CLOSED" 35 "OPEN" 36 "LOAD_DUMP" 37 "STUCK_OPEN" 38 "STUCK_CLOSED" 39 "UNKNOWN_STATE" 40 "UNDERVOLTAGE" 41 "STUCK_ON" 42 "STUCK_OFF" 43 "ON" 44 "OFF" 45 "THR_INCOHERENCE" 46 "PDL_INCOHERENCE" 47 "POT_2_FAULT" 48 "QAIR_UNDER_ESTIM" 49 "QAIR_OVER_ESTIM" 50 "RSCOPEN_ERROR" 51 "RSCWAIT_ERROR" 52 "RSCCLOSE_ERROR" 53 "OSCCLOSE_ERROR" 54 "OSCOPEN_ERROR" 55 "DTC_ERROR" 56 "NLP_ERROR" 57 "UMA_ERROR" 58 "TEMP_PREWARNING" 59 "TEMP_WARNING" 60 "THR_LRN_ERROR" 61 "COMM_ERROR" 62 "MMP_ERROR" 63 "SMP_ERROR" 64 "EOBD_ERROR" 65 "ENERGY_ERROR" 66 "GAIN_ERROR" 67 "KO2_HPRAIL_ERROR" 68 "KO2_LPRAIL_ERROR" 69 "OFFS_ERROR" 70 "SWT_INCOHERENCE" 71 "MFLV_INCOHERENCE" 72 "SET_PLUS_FAULT" 73 "SET_MINUS_FAULT" 74 "OFF_FAULT" 75 "SET_FAULT" 76 "RESUME_FAULT" 77 "HOLD_FAULT" 78 "STOP_CABIN_TILT_FAULT" 79 "START_CABIN_TILT_FAULT" 80 "STUCK_CLOSED_OR_OPEN_LOAD" 81 "OVERCURR" 82 "CAM_NTEETH_INCOHERENCE" 83 "CAM_POS_INCOHERENCE" 84 "SERIAL_ERROR" 85 "CHIP_FAULT" 86 "SC_PHASES" 87 "NUMBER_OF_FAULT" 88 "ANY_FAULT" /end COMPU_VTAB
/begin COMPU_VTAB VTAB_FOR_Prvc4ms_CM_tActDiagStat_adm "Enumerated data type: tActDiagStat" TAB_VERB 5 0 "STOPPED_AD" 1 "DURING_AD" 2 "END_AD" 3 "IMPOSSIBLE_AD" 39 "UNKNOWN_AD" /end COMPU_VTAB
/begin COMPU_VTAB VTAB_FOR_Prvc4ms_CM_tFault_adm "Enumerated data type: tFault" TAB_VERB 89 0 "NO_FAULT" 1 "SIGNAL_TOO_LOW" 2 "SIGNAL_TOO_BIG" 3 "SC_TO_BATTERY" 4 "SC_TO_GND" 5 "SIGNAL_NOT_PLAUSIBLE" 6 "OC_OR_SC_TO_BATTERY" 7 "OC_OR_SC_TO_GND" 8 "OC" 9 "NO_SIGNAL" 10 "SIGNAL_DELAYED" 11 "TRASMISSION_IMPOSSIBLE" 12 "COMPONENT_DAMAGED" 13 "TEST_CONDITION_NOT_CORRECT" 14 "MECHANICAL_PROBLEM" 15 "GENERIC_FAULT" 16 "DERIVATIVE_TOO_HIGH" 17 "DERIVATIVE_TOO_LOW" 18 "CONTROL_ERROR" 19 "ALIM_KO" 20 "ADC_KO" 21 "CAN_OFF" 22 "AIRQCONTROL_ERROR" 23 "FBCONTROL_ERROR" 24 "RPCONTROL_ERROR" 25 "SAFETY_KO" 26 "SC_HS_LS" 27 "SC_TO_GND_HS" 28 "TPU_ERROR" 29 "OC_OR_SC_TO_GND_LS" 30 "SC_TO_BAT_LS" 31 "OVERTEMPERATURE" 32 "SC_TO_GND_LS" 33 "SC_TO_BAT_HS" 34 "CLOSED" 35 "OPEN" 36 "LOAD_DUMP" 37 "STUCK_OPEN" 38 "STUCK_CLOSED" 39 "UNKNOWN_STATE" 40 "UNDERVOLTAGE" 41 "STUCK_ON" 42 "STUCK_OFF" 43 "ON" 44 "OFF" 45 "THR_INCOHERENCE" 46 "PDL_INCOHERENCE" 47 "POT_2_FAULT" 48 "QAIR_UNDER_ESTIM" 49 "QAIR_OVER_ESTIM" 50 "RSCOPEN_ERROR" 51 "RSCWAIT_ERROR" 52 "RSCCLOSE_ERROR" 53 "OSCCLOSE_ERROR" 54 "OSCOPEN_ERROR" 55 "DTC_ERROR" 56 "NLP_ERROR" 57 "UMA_ERROR" 58 "TEMP_PREWARNING" 59 "TEMP_WARNING" 60 "THR_LRN_ERROR" 61 "COMM_ERROR" 62 "MMP_ERROR" 63 "SMP_ERROR" 64 "EOBD_ERROR" 65 "ENERGY_ERROR" 66 "GAIN_ERROR" 67 "KO2_HPRAIL_ERROR" 68 "KO2_LPRAIL_ERROR" 69 "OFFS_ERROR" 70 "SWT_INCOHERENCE" 71 "MFLV_INCOHERENCE" 72 "SET_PLUS_FAULT" 73 "SET_MINUS_FAULT" 74 "OFF_FAULT" 75 "SET_FAULT" 76 "RESUME_FAULT" 77 "HOLD_FAULT" 78 "STOP_CABIN_TILT_FAULT" 79 "START_CABIN_TILT_FAULT" 80 "STUCK_CLOSED_OR_OPEN_LOAD" 81 "OVERCURR" 82 "CAM_NTEETH_INCOHERENCE" 83 "CAM_POS_INCOHERENCE" 84 "SERIAL_ERROR" 85 "CHIP_FAULT" 86 "SC_PHASES" 87 "NUMBER_OF_FAULT" 88 "ANY_FAULT" /end COMPU_VTAB
/begin COMPU_VTAB VTAB_FOR_Pwrl4ms_CM_tFault_adm "Enumerated data type: tFault" TAB_VERB 90 0 "NO_FAULT" 1 "SIGNAL_TOO_LOW" 2 "SIGNAL_TOO_BIG" 3 "SC_TO_BATTERY" 4 "SC_TO_GND" 5 "SIGNAL_NOT_PLAUSIBLE" 6 "OC_OR_SC_TO_BATTERY" 7 "OC_OR_SC_TO_GND" 8 "OC" 9 "NO_SIGNAL" 10 "SIGNAL_DELAYED" 11 "TRASMISSION_IMPOSSIBLE" 12 "COMPONENT_DAMAGED" 13 "TEST_CONDITION_NOT_CORRECT" 14 "MECHANICAL_PROBLEM" 15 "GENERIC_FAULT" 16 "DERIVATIVE_TOO_HIGH" 17 "DERIVATIVE_TOO_LOW" 18 "CONTROL_ERROR" 19 "ALIM_KO" 20 "ADC_KO" 21 "CAN_OFF" 22 "AIRQCONTROL_ERROR" 23 "FBCONTROL_ERROR" 24 "RPCONTROL_ERROR" 25 "SAFETY_KO" 26 "SC_HS_LS" 27 "SC_TO_GND_HS" 28 "TPU_ERROR" 29 "OC_OR_SC_TO_GND_LS" 30 "SC_TO_BAT_LS" 31 "OVERTEMPERATURE" 32 "SC_TO_GND_LS" 33 "SC_TO_BAT_HS" 34 "CLOSED" 35 "OPEN" 36 "LOAD_DUMP" 37 "STUCK_OPEN" 38 "STUCK_CLOSED" 39 "UNKNOWN_STATE" 40 "UNDERVOLTAGE" 41 "STUCK_ON" 42 "STUCK_OFF" 43 "ON" 44 "OFF" 45 "THR_INCOHERENCE" 46 "PDL_INCOHERENCE" 47 "POT_2_FAULT" 48 "QAIR_UNDER_ESTIM" 49 "QAIR_OVER_ESTIM" 50 "RSCOPEN_ERROR" 51 "RSCWAIT_ERROR" 52 "RSCCLOSE_ERROR" 53 "OSCCLOSE_ERROR" 54 "OSCOPEN_ERROR" 55 "DTC_ERROR" 56 "NLP_ERROR" 57 "UMA_ERROR" 58 "TEMP_PREWARNING" 59 "TEMP_WARNING" 60 "THR_LRN_ERROR" 61 "COMM_ERROR" 62 "MMP_ERROR" 63 "SMP_ERROR" 64 "EOBD_ERROR" 65 "ENERGY_ERROR" 66 "GAIN_ERROR" 67 "KO2_HPRAIL_ERROR" 68 "KO2_LPRAIL_ERROR" 69 "OFFS_ERROR" 70 "SWT_INCOHERENCE" 71 "MFLV_INCOHERENCE" 72 "SET_PLUS_FAULT" 73 "SET_MINUS_FAULT" 74 "OFF_FAULT" 75 "SET_FAULT" 76 "RESUME_FAULT" 77 "HOLD_FAULT" 78 "STOP_CABIN_TILT_FAULT" 79 "START_CABIN_TILT_FAULT" 80 "STUCK_CLOSED_OR_OPEN_LOAD" 81 "OVERCURR" 82 "CAM_NTEETH_INCOHERENCE" 83 "CAM_POS_INCOHERENCE" 84 "SERIAL_ERROR" 85 "CHIP_FAULT" 86 "SC_PHASES" 87 "STACK_ERROR" 88 "NUMBER_OF_FAULT" 89 "ANY_FAULT" /end COMPU_VTAB
/begin COMPU_VTAB VTAB_FOR_Rpre4ms_CM_tFault_adm "Enumerated data type: tFault" TAB_VERB 90 0 "NO_FAULT" 1 "SIGNAL_TOO_LOW" 2 "SIGNAL_TOO_BIG" 3 "SC_TO_BATTERY" 4 "SC_TO_GND" 5 "SIGNAL_NOT_PLAUSIBLE" 6 "OC_OR_SC_TO_BATTERY" 7 "OC_OR_SC_TO_GND" 8 "OC" 9 "NO_SIGNAL" 10 "SIGNAL_DELAYED" 11 "TRASMISSION_IMPOSSIBLE" 12 "COMPONENT_DAMAGED" 13 "TEST_CONDITION_NOT_CORRECT" 14 "MECHANICAL_PROBLEM" 15 "GENERIC_FAULT" 16 "DERIVATIVE_TOO_HIGH" 17 "DERIVATIVE_TOO_LOW" 18 "CONTROL_ERROR" 19 "ALIM_KO" 20 "ADC_KO" 21 "CAN_OFF" 22 "AIRQCONTROL_ERROR" 23 "FBCONTROL_ERROR" 24 "RPCONTROL_ERROR" 25 "SAFETY_KO" 26 "SC_HS_LS" 27 "SC_TO_GND_HS" 28 "TPU_ERROR" 29 "OC_OR_SC_TO_GND_LS" 30 "SC_TO_BAT_LS" 31 "OVERTEMPERATURE" 32 "SC_TO_GND_LS" 33 "SC_TO_BAT_HS" 34 "CLOSED" 35 "OPEN" 36 "LOAD_DUMP" 37 "STUCK_OPEN" 38 "STUCK_CLOSED" 39 "UNKNOWN_STATE" 40 "UNDERVOLTAGE" 41 "STUCK_ON" 42 "STUCK_OFF" 43 "ON" 44 "OFF" 45 "THR_INCOHERENCE" 46 "PDL_INCOHERENCE" 47 "POT_2_FAULT" 48 "QAIR_UNDER_ESTIM" 49 "QAIR_OVER_ESTIM" 50 "RSCOPEN_ERROR" 51 "RSCWAIT_ERROR" 52 "RSCCLOSE_ERROR" 53 "OSCCLOSE_ERROR" 54 "OSCOPEN_ERROR" 55 "DTC_ERROR" 56 "NLP_ERROR" 57 "UMA_ERROR" 58 "TEMP_PREWARNING" 59 "TEMP_WARNING" 60 "THR_LRN_ERROR" 61 "COMM_ERROR" 62 "MMP_ERROR" 63 "SMP_ERROR" 64 "EOBD_ERROR" 65 "ENERGY_ERROR" 66 "GAIN_ERROR" 67 "KO2_HPRAIL_ERROR" 68 "KO2_LPRAIL_ERROR" 69 "OFFS_ERROR" 70 "SWT_INCOHERENCE" 71 "MFLV_INCOHERENCE" 72 "SET_PLUS_FAULT" 73 "SET_MINUS_FAULT" 74 "OFF_FAULT" 75 "SET_FAULT" 76 "RESUME_FAULT" 77 "HOLD_FAULT" 78 "STOP_CABIN_TILT_FAULT" 79 "START_CABIN_TILT_FAULT" 80 "STUCK_CLOSED_OR_OPEN_LOAD" 81 "OVERCURR" 82 "CAM_NTEETH_INCOHERENCE" 83 "CAM_POS_INCOHERENCE" 84 "SERIAL_ERROR" 85 "CHIP_FAULT" 86 "SC_PHASES" 87 "STACK_ERROR" 88 "NUMBER_OF_FAULT" 89 "ANY_FAULT" /end COMPU_VTAB
/begin COMPU_VTAB VTAB_FOR_Saf3_50ms_CM_tFault_adm "Enumerated data type: tFault" TAB_VERB 90 0 "NO_FAULT" 1 "SIGNAL_TOO_LOW" 2 "SIGNAL_TOO_BIG" 3 "SC_TO_BATTERY" 4 "SC_TO_GND" 5 "SIGNAL_NOT_PLAUSIBLE" 6 "OC_OR_SC_TO_BATTERY" 7 "OC_OR_SC_TO_GND" 8 "OC" 9 "NO_SIGNAL" 10 "SIGNAL_DELAYED" 11 "TRASMISSION_IMPOSSIBLE" 12 "COMPONENT_DAMAGED" 13 "TEST_CONDITION_NOT_CORRECT" 14 "MECHANICAL_PROBLEM" 15 "GENERIC_FAULT" 16 "DERIVATIVE_TOO_HIGH" 17 "DERIVATIVE_TOO_LOW" 18 "CONTROL_ERROR" 19 "ALIM_KO" 20 "ADC_KO" 21 "CAN_OFF" 22 "AIRQCONTROL_ERROR" 23 "FBCONTROL_ERROR" 24 "RPCONTROL_ERROR" 25 "SAFETY_KO" 26 "SC_HS_LS" 27 "SC_TO_GND_HS" 28 "TPU_ERROR" 29 "OC_OR_SC_TO_GND_LS" 30 "SC_TO_BAT_LS" 31 "OVERTEMPERATURE" 32 "SC_TO_GND_LS" 33 "SC_TO_BAT_HS" 34 "CLOSED" 35 "OPEN" 36 "LOAD_DUMP" 37 "STUCK_OPEN" 38 "STUCK_CLOSED" 39 "UNKNOWN_STATE" 40 "UNDERVOLTAGE" 41 "STUCK_ON" 42 "STUCK_OFF" 43 "ON" 44 "OFF" 45 "THR_INCOHERENCE" 46 "PDL_INCOHERENCE" 47 "POT_2_FAULT" 48 "QAIR_UNDER_ESTIM" 49 "QAIR_OVER_ESTIM" 50 "RSCOPEN_ERROR" 51 "RSCWAIT_ERROR" 52 "RSCCLOSE_ERROR" 53 "OSCCLOSE_ERROR" 54 "OSCOPEN_ERROR" 55 "DTC_ERROR" 56 "NLP_ERROR" 57 "UMA_ERROR" 58 "TEMP_PREWARNING" 59 "TEMP_WARNING" 60 "THR_LRN_ERROR" 61 "COMM_ERROR" 62 "MMP_ERROR" 63 "SMP_ERROR" 64 "EOBD_ERROR" 65 "ENERGY_ERROR" 66 "GAIN_ERROR" 67 "KO2_HPRAIL_ERROR" 68 "KO2_LPRAIL_ERROR" 69 "OFFS_ERROR" 70 "SWT_INCOHERENCE" 71 "MFLV_INCOHERENCE" 72 "SET_PLUS_FAULT" 73 "SET_MINUS_FAULT" 74 "OFF_FAULT" 75 "SET_FAULT" 76 "RESUME_FAULT" 77 "HOLD_FAULT" 78 "STOP_CABIN_TILT_FAULT" 79 "START_CABIN_TILT_FAULT" 80 "STUCK_CLOSED_OR_OPEN_LOAD" 81 "OVERCURR" 82 "CAM_NTEETH_INCOHERENCE" 83 "CAM_POS_INCOHERENCE" 84 "SERIAL_ERROR" 85 "CHIP_FAULT" 86 "SC_PHASES" 87 "STACK_ERROR" 88 "NUMBER_OF_FAULT" 89 "ANY_FAULT" /end COMPU_VTAB
/begin COMPU_VTAB VTAB_FOR_Sqs4ms_CM_tFault_adm "Enumerated data type: tFault" TAB_VERB 90 0 "NO_FAULT" 1 "SIGNAL_TOO_LOW" 2 "SIGNAL_TOO_BIG" 3 "SC_TO_BATTERY" 4 "SC_TO_GND" 5 "SIGNAL_NOT_PLAUSIBLE" 6 "OC_OR_SC_TO_BATTERY" 7 "OC_OR_SC_TO_GND" 8 "OC" 9 "NO_SIGNAL" 10 "SIGNAL_DELAYED" 11 "TRASMISSION_IMPOSSIBLE" 12 "COMPONENT_DAMAGED" 13 "TEST_CONDITION_NOT_CORRECT" 14 "MECHANICAL_PROBLEM" 15 "GENERIC_FAULT" 16 "DERIVATIVE_TOO_HIGH" 17 "DERIVATIVE_TOO_LOW" 18 "CONTROL_ERROR" 19 "ALIM_KO" 20 "ADC_KO" 21 "CAN_OFF" 22 "AIRQCONTROL_ERROR" 23 "FBCONTROL_ERROR" 24 "RPCONTROL_ERROR" 25 "SAFETY_KO" 26 "SC_HS_LS" 27 "SC_TO_GND_HS" 28 "TPU_ERROR" 29 "OC_OR_SC_TO_GND_LS" 30 "SC_TO_BAT_LS" 31 "OVERTEMPERATURE" 32 "SC_TO_GND_LS" 33 "SC_TO_BAT_HS" 34 "CLOSED" 35 "OPEN" 36 "LOAD_DUMP" 37 "STUCK_OPEN" 38 "STUCK_CLOSED" 39 "UNKNOWN_STATE" 40 "UNDERVOLTAGE" 41 "STUCK_ON" 42 "STUCK_OFF" 43 "ON" 44 "OFF" 45 "THR_INCOHERENCE" 46 "PDL_INCOHERENCE" 47 "POT_2_FAULT" 48 "QAIR_UNDER_ESTIM" 49 "QAIR_OVER_ESTIM" 50 "RSCOPEN_ERROR" 51 "RSCWAIT_ERROR" 52 "RSCCLOSE_ERROR" 53 "OSCCLOSE_ERROR" 54 "OSCOPEN_ERROR" 55 "DTC_ERROR" 56 "NLP_ERROR" 57 "UMA_ERROR" 58 "TEMP_PREWARNING" 59 "TEMP_WARNING" 60 "THR_LRN_ERROR" 61 "COMM_ERROR" 62 "MMP_ERROR" 63 "SMP_ERROR" 64 "EOBD_ERROR" 65 "ENERGY_ERROR" 66 "GAIN_ERROR" 67 "KO2_HPRAIL_ERROR" 68 "KO2_LPRAIL_ERROR" 69 "OFFS_ERROR" 70 "SWT_INCOHERENCE" 71 "MFLV_INCOHERENCE" 72 "SET_PLUS_FAULT" 73 "SET_MINUS_FAULT" 74 "OFF_FAULT" 75 "SET_FAULT" 76 "RESUME_FAULT" 77 "HOLD_FAULT" 78 "STOP_CABIN_TILT_FAULT" 79 "START_CABIN_TILT_FAULT" 80 "STUCK_CLOSED_OR_OPEN_LOAD" 81 "OVERCURR" 82 "CAM_NTEETH_INCOHERENCE" 83 "CAM_POS_INCOHERENCE" 84 "SERIAL_ERROR" 85 "CHIP_FAULT" 86 "SC_PHASES" 87 "STACK_ERROR" 88 "NUMBER_OF_FAULT" 89 "ANY_FAULT" /end COMPU_VTAB
/begin COMPU_VTAB VTAB_FOR_Svs4ms_CM_tFault_adm "Enumerated data type: tFault" TAB_VERB 89 0 "NO_FAULT" 1 "SIGNAL_TOO_LOW" 2 "SIGNAL_TOO_BIG" 3 "SC_TO_BATTERY" 4 "SC_TO_GND" 5 "SIGNAL_NOT_PLAUSIBLE" 6 "OC_OR_SC_TO_BATTERY" 7 "OC_OR_SC_TO_GND" 8 "OC" 9 "NO_SIGNAL" 10 "SIGNAL_DELAYED" 11 "TRASMISSION_IMPOSSIBLE" 12 "COMPONENT_DAMAGED" 13 "TEST_CONDITION_NOT_CORRECT" 14 "MECHANICAL_PROBLEM" 15 "GENERIC_FAULT" 16 "DERIVATIVE_TOO_HIGH" 17 "DERIVATIVE_TOO_LOW" 18 "CONTROL_ERROR" 19 "ALIM_KO" 20 "ADC_KO" 21 "CAN_OFF" 22 "AIRQCONTROL_ERROR" 23 "FBCONTROL_ERROR" 24 "RPCONTROL_ERROR" 25 "SAFETY_KO" 26 "SC_HS_LS" 27 "SC_TO_GND_HS" 28 "TPU_ERROR" 29 "OC_OR_SC_TO_GND_LS" 30 "SC_TO_BAT_LS" 31 "OVERTEMPERATURE" 32 "SC_TO_GND_LS" 33 "SC_TO_BAT_HS" 34 "CLOSED" 35 "OPEN" 36 "LOAD_DUMP" 37 "STUCK_OPEN" 38 "STUCK_CLOSED" 39 "UNKNOWN_STATE" 40 "UNDERVOLTAGE" 41 "STUCK_ON" 42 "STUCK_OFF" 43 "ON" 44 "OFF" 45 "THR_INCOHERENCE" 46 "PDL_INCOHERENCE" 47 "POT_2_FAULT" 48 "QAIR_UNDER_ESTIM" 49 "QAIR_OVER_ESTIM" 50 "RSCOPEN_ERROR" 51 "RSCWAIT_ERROR" 52 "RSCCLOSE_ERROR" 53 "OSCCLOSE_ERROR" 54 "OSCOPEN_ERROR" 55 "DTC_ERROR" 56 "NLP_ERROR" 57 "UMA_ERROR" 58 "TEMP_PREWARNING" 59 "TEMP_WARNING" 60 "THR_LRN_ERROR" 61 "COMM_ERROR" 62 "MMP_ERROR" 63 "SMP_ERROR" 64 "EOBD_ERROR" 65 "ENERGY_ERROR" 66 "GAIN_ERROR" 67 "KO2_HPRAIL_ERROR" 68 "KO2_LPRAIL_ERROR" 69 "OFFS_ERROR" 70 "SWT_INCOHERENCE" 71 "MFLV_INCOHERENCE" 72 "SET_PLUS_FAULT" 73 "SET_MINUS_FAULT" 74 "OFF_FAULT" 75 "SET_FAULT" 76 "RESUME_FAULT" 77 "HOLD_FAULT" 78 "STOP_CABIN_TILT_FAULT" 79 "START_CABIN_TILT_FAULT" 80 "STUCK_CLOSED_OR_OPEN_LOAD" 81 "OVERCURR" 82 "CAM_NTEETH_INCOHERENCE" 83 "CAM_POS_INCOHERENCE" 84 "SERIAL_ERROR" 85 "CHIP_FAULT" 86 "SC_PHASES" 87 "NUMBER_OF_FAULT" 88 "ANY_FAULT" /end COMPU_VTAB
/begin COMPU_VTAB VTAB_FOR_TE_MAirReqATDC_Symbol_CM_FixEnableT "Enumerated data type: FixEnableT" TAB_VERB 2 171 "Enable" 218 "Disable" /end COMPU_VTAB
/begin COMPU_VTAB VTAB_FOR_TE_TM_SpeedCtrl_4ms_Symbol_CM_FixEnableT "Enumerated data type: FixEnableT" TAB_VERB 2 171 "Enable" 218 "Disable" /end COMPU_VTAB
/begin COMPU_VTAB VTAB_FOR_TE_TM_TorqBas4ms_CM_FixEnableT "Enumerated data type: FixEnableT" TAB_VERB 2 171 "Enable" 218 "Disable" /end COMPU_VTAB
/begin COMPU_VTAB VTAB_FOR_TE_TM_TorqBasCtrl4ms_Symbol_CM_FixEnableT "Enumerated data type: FixEnableT" TAB_VERB 2 171 "Enable" 218 "Disable" /end COMPU_VTAB
/begin COMPU_VTAB VTAB_FOR_TE_TM_TorqCalcTDC_Symbol_CM_FixEnableT "Enumerated data type: FixEnableT" TAB_VERB 2 171 "Enable" 218 "Disable" /end COMPU_VTAB
/begin COMPU_VTAB VTAB_FOR_TF_TE_DiagSTR_PON4ms_CM_tDiagStat_adm "Enumerated data type: tDiagStat" TAB_VERB 4 0 "ENTRY" 1 "DURING" 2 "END" 39 "UNKNOWN_DIAGSTAT" /end COMPU_VTAB
/begin COMPU_VTAB VTAB_FOR_Tnkp4ms_CM_tFault_adm "Enumerated data type: tFault" TAB_VERB 89 0 "NO_FAULT" 1 "SIGNAL_TOO_LOW" 2 "SIGNAL_TOO_BIG" 3 "SC_TO_BATTERY" 4 "SC_TO_GND" 5 "SIGNAL_NOT_PLAUSIBLE" 6 "OC_OR_SC_TO_BATTERY" 7 "OC_OR_SC_TO_GND" 8 "OC" 9 "NO_SIGNAL" 10 "SIGNAL_DELAYED" 11 "TRASMISSION_IMPOSSIBLE" 12 "COMPONENT_DAMAGED" 13 "TEST_CONDITION_NOT_CORRECT" 14 "MECHANICAL_PROBLEM" 15 "GENERIC_FAULT" 16 "DERIVATIVE_TOO_HIGH" 17 "DERIVATIVE_TOO_LOW" 18 "CONTROL_ERROR" 19 "ALIM_KO" 20 "ADC_KO" 21 "CAN_OFF" 22 "AIRQCONTROL_ERROR" 23 "FBCONTROL_ERROR" 24 "RPCONTROL_ERROR" 25 "SAFETY_KO" 26 "SC_HS_LS" 27 "SC_TO_GND_HS" 28 "TPU_ERROR" 29 "OC_OR_SC_TO_GND_LS" 30 "SC_TO_BAT_LS" 31 "OVERTEMPERATURE" 32 "SC_TO_GND_LS" 33 "SC_TO_BAT_HS" 34 "CLOSED" 35 "OPEN" 36 "LOAD_DUMP" 37 "STUCK_OPEN" 38 "STUCK_CLOSED" 39 "UNKNOWN_STATE" 40 "UNDERVOLTAGE" 41 "STUCK_ON" 42 "STUCK_OFF" 43 "ON" 44 "OFF" 45 "THR_INCOHERENCE" 46 "PDL_INCOHERENCE" 47 "POT_2_FAULT" 48 "QAIR_UNDER_ESTIM" 49 "QAIR_OVER_ESTIM" 50 "RSCOPEN_ERROR" 51 "RSCWAIT_ERROR" 52 "RSCCLOSE_ERROR" 53 "OSCCLOSE_ERROR" 54 "OSCOPEN_ERROR" 55 "DTC_ERROR" 56 "NLP_ERROR" 57 "UMA_ERROR" 58 "TEMP_PREWARNING" 59 "TEMP_WARNING" 60 "THR_LRN_ERROR" 61 "COMM_ERROR" 62 "MMP_ERROR" 63 "SMP_ERROR" 64 "EOBD_ERROR" 65 "ENERGY_ERROR" 66 "GAIN_ERROR" 67 "KO2_HPRAIL_ERROR" 68 "KO2_LPRAIL_ERROR" 69 "OFFS_ERROR" 70 "SWT_INCOHERENCE" 71 "MFLV_INCOHERENCE" 72 "SET_PLUS_FAULT" 73 "SET_MINUS_FAULT" 74 "OFF_FAULT" 75 "SET_FAULT" 76 "RESUME_FAULT" 77 "HOLD_FAULT" 78 "STOP_CABIN_TILT_FAULT" 79 "START_CABIN_TILT_FAULT" 80 "STUCK_CLOSED_OR_OPEN_LOAD" 81 "OVERCURR" 82 "CAM_NTEETH_INCOHERENCE" 83 "CAM_POS_INCOHERENCE" 84 "SERIAL_ERROR" 85 "CHIP_FAULT" 86 "SC_PHASES" 87 "NUMBER_OF_FAULT" 88 "ANY_FAULT" /end COMPU_VTAB
/begin COMPU_VTAB VTAB_FOR_Trqm_CtrlMgmt4ms_CM_FixEnableT "Enumerated data type: FixEnableT" TAB_VERB 2 171 "Enable" 218 "Disable" /end COMPU_VTAB
/begin COMPU_VTAB VTAB_FOR_Vbpw4ms_CM_tFault_adm "Enumerated data type: tFault" TAB_VERB 89 0 "NO_FAULT" 1 "SIGNAL_TOO_LOW" 2 "SIGNAL_TOO_BIG" 3 "SC_TO_BATTERY" 4 "SC_TO_GND" 5 "SIGNAL_NOT_PLAUSIBLE" 6 "OC_OR_SC_TO_BATTERY" 7 "OC_OR_SC_TO_GND" 8 "OC" 9 "NO_SIGNAL" 10 "SIGNAL_DELAYED" 11 "TRASMISSION_IMPOSSIBLE" 12 "COMPONENT_DAMAGED" 13 "TEST_CONDITION_NOT_CORRECT" 14 "MECHANICAL_PROBLEM" 15 "GENERIC_FAULT" 16 "DERIVATIVE_TOO_HIGH" 17 "DERIVATIVE_TOO_LOW" 18 "CONTROL_ERROR" 19 "ALIM_KO" 20 "ADC_KO" 21 "CAN_OFF" 22 "AIRQCONTROL_ERROR" 23 "FBCONTROL_ERROR" 24 "RPCONTROL_ERROR" 25 "SAFETY_KO" 26 "SC_HS_LS" 27 "SC_TO_GND_HS" 28 "TPU_ERROR" 29 "OC_OR_SC_TO_GND_LS" 30 "SC_TO_BAT_LS" 31 "OVERTEMPERATURE" 32 "SC_TO_GND_LS" 33 "SC_TO_BAT_HS" 34 "CLOSED" 35 "OPEN" 36 "LOAD_DUMP" 37 "STUCK_OPEN" 38 "STUCK_CLOSED" 39 "UNKNOWN_STATE" 40 "UNDERVOLTAGE" 41 "STUCK_ON" 42 "STUCK_OFF" 43 "ON" 44 "OFF" 45 "THR_INCOHERENCE" 46 "PDL_INCOHERENCE" 47 "POT_2_FAULT" 48 "QAIR_UNDER_ESTIM" 49 "QAIR_OVER_ESTIM" 50 "RSCOPEN_ERROR" 51 "RSCWAIT_ERROR" 52 "RSCCLOSE_ERROR" 53 "OSCCLOSE_ERROR" 54 "OSCOPEN_ERROR" 55 "DTC_ERROR" 56 "NLP_ERROR" 57 "UMA_ERROR" 58 "TEMP_PREWARNING" 59 "TEMP_WARNING" 60 "THR_LRN_ERROR" 61 "COMM_ERROR" 62 "MMP_ERROR" 63 "SMP_ERROR" 64 "EOBD_ERROR" 65 "ENERGY_ERROR" 66 "GAIN_ERROR" 67 "KO2_HPRAIL_ERROR" 68 "KO2_LPRAIL_ERROR" 69 "OFFS_ERROR" 70 "SWT_INCOHERENCE" 71 "MFLV_INCOHERENCE" 72 "SET_PLUS_FAULT" 73 "SET_MINUS_FAULT" 74 "OFF_FAULT" 75 "SET_FAULT" 76 "RESUME_FAULT" 77 "HOLD_FAULT" 78 "STOP_CABIN_TILT_FAULT" 79 "START_CABIN_TILT_FAULT" 80 "STUCK_CLOSED_OR_OPEN_LOAD" 81 "OVERCURR" 82 "CAM_NTEETH_INCOHERENCE" 83 "CAM_POS_INCOHERENCE" 84 "SERIAL_ERROR" 85 "CHIP_FAULT" 86 "SC_PHASES" 87 "NUMBER_OF_FAULT" 88 "ANY_FAULT" /end COMPU_VTAB
/begin COMPU_VTAB VTAB_FOR_Vfnc4ms_CM_tFault_adm "Enumerated data type: tFault" TAB_VERB 89 0 "NO_FAULT" 1 "SIGNAL_TOO_LOW" 2 "SIGNAL_TOO_BIG" 3 "SC_TO_BATTERY" 4 "SC_TO_GND" 5 "SIGNAL_NOT_PLAUSIBLE" 6 "OC_OR_SC_TO_BATTERY" 7 "OC_OR_SC_TO_GND" 8 "OC" 9 "NO_SIGNAL" 10 "SIGNAL_DELAYED" 11 "TRASMISSION_IMPOSSIBLE" 12 "COMPONENT_DAMAGED" 13 "TEST_CONDITION_NOT_CORRECT" 14 "MECHANICAL_PROBLEM" 15 "GENERIC_FAULT" 16 "DERIVATIVE_TOO_HIGH" 17 "DERIVATIVE_TOO_LOW" 18 "CONTROL_ERROR" 19 "ALIM_KO" 20 "ADC_KO" 21 "CAN_OFF" 22 "AIRQCONTROL_ERROR" 23 "FBCONTROL_ERROR" 24 "RPCONTROL_ERROR" 25 "SAFETY_KO" 26 "SC_HS_LS" 27 "SC_TO_GND_HS" 28 "TPU_ERROR" 29 "OC_OR_SC_TO_GND_LS" 30 "SC_TO_BAT_LS" 31 "OVERTEMPERATURE" 32 "SC_TO_GND_LS" 33 "SC_TO_BAT_HS" 34 "CLOSED" 35 "OPEN" 36 "LOAD_DUMP" 37 "STUCK_OPEN" 38 "STUCK_CLOSED" 39 "UNKNOWN_STATE" 40 "UNDERVOLTAGE" 41 "STUCK_ON" 42 "STUCK_OFF" 43 "ON" 44 "OFF" 45 "THR_INCOHERENCE" 46 "PDL_INCOHERENCE" 47 "POT_2_FAULT" 48 "QAIR_UNDER_ESTIM" 49 "QAIR_OVER_ESTIM" 50 "RSCOPEN_ERROR" 51 "RSCWAIT_ERROR" 52 "RSCCLOSE_ERROR" 53 "OSCCLOSE_ERROR" 54 "OSCOPEN_ERROR" 55 "DTC_ERROR" 56 "NLP_ERROR" 57 "UMA_ERROR" 58 "TEMP_PREWARNING" 59 "TEMP_WARNING" 60 "THR_LRN_ERROR" 61 "COMM_ERROR" 62 "MMP_ERROR" 63 "SMP_ERROR" 64 "EOBD_ERROR" 65 "ENERGY_ERROR" 66 "GAIN_ERROR" 67 "KO2_HPRAIL_ERROR" 68 "KO2_LPRAIL_ERROR" 69 "OFFS_ERROR" 70 "SWT_INCOHERENCE" 71 "MFLV_INCOHERENCE" 72 "SET_PLUS_FAULT" 73 "SET_MINUS_FAULT" 74 "OFF_FAULT" 75 "SET_FAULT" 76 "RESUME_FAULT" 77 "HOLD_FAULT" 78 "STOP_CABIN_TILT_FAULT" 79 "START_CABIN_TILT_FAULT" 80 "STUCK_CLOSED_OR_OPEN_LOAD" 81 "OVERCURR" 82 "CAM_NTEETH_INCOHERENCE" 83 "CAM_POS_INCOHERENCE" 84 "SERIAL_ERROR" 85 "CHIP_FAULT" 86 "SC_PHASES" 87 "NUMBER_OF_FAULT" 88 "ANY_FAULT" /end COMPU_VTAB
/begin RECORD_LAYOUT Lookup1D_UWORD FNC_VALUES 1 UWORD COLUMN_DIR DIRECT /end RECORD_LAYOUT
/begin RECORD_LAYOUT Lookup1D_X_UWORD AXIS_PTS_X 1 UWORD INDEX_INCR DIRECT /end RECORD_LAYOUT
/begin RECORD_LAYOUT Lookup2DSF_UWORD FNC_VALUES 1 UWORD ROW_DIR DIRECT /end RECORD_LAYOUT
/begin RECORD_LAYOUT Lookup2D_FLOAT32_IEEE FNC_VALUES 1 FLOAT32_IEEE COLUMN_DIR DIRECT /end RECORD_LAYOUT
/begin RECORD_LAYOUT Lookup2D_X_UWORD AXIS_PTS_X 1 UWORD INDEX_INCR DIRECT /end RECORD_LAYOUT
/begin RECORD_LAYOUT Scalar_BOOLEAN FNC_VALUES 1 UBYTE COLUMN_DIR DIRECT /end RECORD_LAYOUT
/begin RECORD_LAYOUT Scalar_BYTE FNC_VALUES 1 SBYTE COLUMN_DIR DIRECT /end RECORD_LAYOUT
/begin RECORD_LAYOUT Scalar_SWORD FNC_VALUES 1 SWORD COLUMN_DIR DIRECT /end RECORD_LAYOUT
/begin RECORD_LAYOUT Scalar_UBYTE FNC_VALUES 1 UBYTE COLUMN_DIR DIRECT /end RECORD_LAYOUT
/begin RECORD_LAYOUT Scalar_ULONG FNC_VALUES 1 ULONG COLUMN_DIR DIRECT /end RECORD_LAYOUT
/begin RECORD_LAYOUT Scalar_UWORD FNC_VALUES 1 UWORD COLUMN_DIR DIRECT /end RECORD_LAYOUT
/end MODULE
/end PROJECT
