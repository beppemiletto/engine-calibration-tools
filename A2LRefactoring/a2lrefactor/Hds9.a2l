ASAP2_VERSION 1 70
/begin PROJECT XCPonCANFD "Generated for ETAS and Vector "
/begin MODULE XCPonCANFD "Generated for ETAS and Vector "
/begin MOD_COMMON "XCPonCANFD" BYTE_ORDER MSB_FIRST ALIGNMENT_BYTE 1 ALIGNMENT_WORD 2 ALIGNMENT_LONG 4 ALIGNMENT_FLOAT32_IEEE 4 ALIGNMENT_FLOAT64_IEEE 8 ALIGNMENT_INT64 8 /end MOD_COMMON
/begin MEASUREMENT xDiagMgm_UegoHeater_OF.u16CntGenericError "Current Number of Generic Error" UWORD NO_COMPU_METHOD 0 0 0 65000 ECU_ADDRESS 0x400019BC SYMBOL_LINK "xDiagMgm_UegoHeater_OF" 4 /end MEASUREMENT
/begin MEASUREMENT xDiagMgm_UegoHeater_OF.u16CntLoadEnableError "Current Number of Load Enable Error" UWORD NO_COMPU_METHOD 0 0 0 65000 ECU_ADDRESS 0x400019BE SYMBOL_LINK "xDiagMgm_UegoHeater_OF" 6 /end MEASUREMENT
/begin MEASUREMENT xDiagMgm_UegoHeater_OF.u16CntReset "Current Number of diag Reset " UWORD NO_COMPU_METHOD 0 0 0 65000 ECU_ADDRESS 0x400019BA SYMBOL_LINK "xDiagMgm_UegoHeater_OF" 2 /end MEASUREMENT
/begin MEASUREMENT xDiagMgm_UegoHeater_OF.u16ThrReset "Maximum number of diag Reset allowed (zero means NO DIAG enable)" UWORD NO_COMPU_METHOD 0 0 0 65000 ECU_ADDRESS 0x400019C0 SYMBOL_LINK "xDiagMgm_UegoHeater_OF" 8 /end MEASUREMENT
/begin MEASUREMENT xDiagMgm_UegoSensor.eDiagStatus "Diagnosis failure code" UBYTE eDiagStatus.Conversion 0 0 0 255 ECU_ADDRESS 0x40001B34 SYMBOL_LINK "xDiagMgm_UegoSensor" 0 /end MEASUREMENT
/begin MEASUREMENT xDiagMgm_UegoSensor.u16CntGenericError "Current Number of Generic Error" UWORD NO_COMPU_METHOD 0 0 0 65000 ECU_ADDRESS 0x40001B38 SYMBOL_LINK "xDiagMgm_UegoSensor" 4 /end MEASUREMENT
/begin MEASUREMENT xDiagMgm_UegoSensor.u16CntLoadEnableError "Current Number of Load Enable Error" UWORD NO_COMPU_METHOD 0 0 0 65000 ECU_ADDRESS 0x40001B3A SYMBOL_LINK "xDiagMgm_UegoSensor" 6 /end MEASUREMENT
/begin MEASUREMENT xDiagMgm_UegoSensor.u16CntReset "Current Number of diag Reset " UWORD NO_COMPU_METHOD 0 0 0 65000 ECU_ADDRESS 0x40001B36 SYMBOL_LINK "xDiagMgm_UegoSensor" 2 /end MEASUREMENT
/begin MEASUREMENT xDiagMgm_UegoSensor.u16ThrReset "Maximum number of diag Reset allowed (zero means NO DIAG enable)" UWORD NO_COMPU_METHOD 0 0 0 65000 ECU_ADDRESS 0x40001B3C SYMBOL_LINK "xDiagMgm_UegoSensor" 8 /end MEASUREMENT
/begin MEASUREMENT xDiagMgm_WarnLamp_OD.eDiagStatus "Diagnosis failure code" UBYTE eDiagStatus.Conversion 0 0 0 255 ECU_ADDRESS 0x40001A08 SYMBOL_LINK "xDiagMgm_WarnLamp_OD" 0 /end MEASUREMENT
/begin MEASUREMENT xDiagMgm_WarnLamp_OD.u16CntGenericError "Current Number of Generic Error" UWORD NO_COMPU_METHOD 0 0 0 65000 ECU_ADDRESS 0x40001A0C SYMBOL_LINK "xDiagMgm_WarnLamp_OD" 4 /end MEASUREMENT
/begin MEASUREMENT xDiagMgm_WarnLamp_OD.u16CntLoadEnableError "Current Number of Load Enable Error" UWORD NO_COMPU_METHOD 0 0 0 65000 ECU_ADDRESS 0x40001A0E SYMBOL_LINK "xDiagMgm_WarnLamp_OD" 6 /end MEASUREMENT
/begin MEASUREMENT xDiagMgm_WarnLamp_OD.u16CntReset "Current Number of diag Reset " UWORD NO_COMPU_METHOD 0 0 0 65000 ECU_ADDRESS 0x40001A0A SYMBOL_LINK "xDiagMgm_WarnLamp_OD" 2 /end MEASUREMENT
/begin MEASUREMENT xDiagMgm_WarnLamp_OD.u16ThrReset "Maximum number of diag Reset allowed (zero means NO DIAG enable)" UWORD NO_COMPU_METHOD 0 0 0 65000 ECU_ADDRESS 0x40001A10 SYMBOL_LINK "xDiagMgm_WarnLamp_OD" 8 /end MEASUREMENT
/begin CHARACTERISTIC xGobdCalData.InjRelatedFlag "Flag che permette la variazizone del valore di inizializzazione del driving cycle counter" VAL_BLK 0xFCD053 __UBYTE_Z 0 NO_COMPU_METHOD 0 255 MATRIX_DIM 133 SYMBOL_LINK "xGobdCalData" 3 /end CHARACTERISTIC
/begin CHARACTERISTIC xGobdCalData.NumDefTripErcd "Counter Driving Cycle initial value con flag InjRelated FALSE" VALUE 0xFCD051 __UBYTE_Z 0 NO_COMPU_METHOD 0 255 SYMBOL_LINK "xGobdCalData" 1 /end CHARACTERISTIC
/begin CHARACTERISTIC xGobdCalData.NumDefTripInjc "Counter Driving Cycle initial value con flag InjRelated TRUE" VALUE 0xFCD050 __UBYTE_Z 0 NO_COMPU_METHOD 0 255 SYMBOL_LINK "xGobdCalData" 0 /end CHARACTERISTIC
/begin CHARACTERISTIC xGobdCalData.NumMilOkTrip "Counter Driving Cycle initial value when entered in MILON condition" VALUE 0xFCD052 __UBYTE_Z 0 NO_COMPU_METHOD 0 255 SYMBOL_LINK "xGobdCalData" 2 /end CHARACTERISTIC
/begin CHARACTERISTIC xGobdCalData.SpnCode "SPN diagnosis code- GOBD" VAL_BLK 0xFCD0D8 __UWORD_Z 0 NO_COMPU_METHOD 0 65535 MATRIX_DIM 133 SYMBOL_LINK "xGobdCalData" 136 /end CHARACTERISTIC
/begin CHARACTERISTIC ADAT2_GSEC "ADAT2 Active Recovery for OBD Diagnosis - GSEC" CURVE 0xFCD952 Lookup1D_UBYTE 0 NO_COMPU_METHOD 0 255
 /begin AXIS_DESCR FIX_AXIS NO_INPUT_QUANTITY NO_COMPU_METHOD 16 0 15 BYTE_ORDER MSB_LAST FIX_AXIS_PAR_DIST 0 1 16 /end AXIS_DESCR
 BYTE_ORDER MSB_LAST SYMBOL_LINK "xGsecCalData" 1904 /end CHARACTERISTIC
/begin CHARACTERISTIC ADAT_GSEC "ADAT Active Recovery for OBD Diagnosis - GSEC" CURVE 0xFCD942 Lookup1D_UBYTE 0 NO_COMPU_METHOD 0 255
 /begin AXIS_DESCR FIX_AXIS NO_INPUT_QUANTITY NO_COMPU_METHOD 16 0 15 BYTE_ORDER MSB_LAST FIX_AXIS_PAR_DIST 0 1 16 /end AXIS_DESCR
 BYTE_ORDER MSB_LAST SYMBOL_LINK "xGsecCalData" 1888 /end CHARACTERISTIC
/begin CHARACTERISTIC AIR2H_GSEC "AIR2H Active Recovery for OBD Diagnosis - GSEC" CURVE 0xFCD582 Lookup1D_UBYTE 0 NO_COMPU_METHOD 0 255
 /begin AXIS_DESCR FIX_AXIS NO_INPUT_QUANTITY NO_COMPU_METHOD 16 0 15 BYTE_ORDER MSB_LAST FIX_AXIS_PAR_DIST 0 1 16 /end AXIS_DESCR
 BYTE_ORDER MSB_LAST SYMBOL_LINK "xGsecCalData" 928 /end CHARACTERISTIC
/begin CHARACTERISTIC AIR2L_GSEC "AIR2L Active Recovery for OBD Diagnosis - GSEC" CURVE 0xFCD592 Lookup1D_UBYTE 0 NO_COMPU_METHOD 0 255
 /begin AXIS_DESCR FIX_AXIS NO_INPUT_QUANTITY NO_COMPU_METHOD 16 0 15 BYTE_ORDER MSB_LAST FIX_AXIS_PAR_DIST 0 1 16 /end AXIS_DESCR
 BYTE_ORDER MSB_LAST SYMBOL_LINK "xGsecCalData" 944 /end CHARACTERISTIC
/begin CHARACTERISTIC BAT_GSEC "BAT Active Recovery for OBD Diagnosis - GSEC" CURVE 0xFCD2A2 Lookup1D_UBYTE 0 NO_COMPU_METHOD 0 255
 /begin AXIS_DESCR FIX_AXIS NO_INPUT_QUANTITY NO_COMPU_METHOD 16 0 15 BYTE_ORDER MSB_LAST FIX_AXIS_PAR_DIST 0 1 16 /end AXIS_DESCR
 BYTE_ORDER MSB_LAST SYMBOL_LINK "xGsecCalData" 192 /end CHARACTERISTIC
/begin CHARACTERISTIC BRKCH_GSEC "BRKCH Active Recovery for OBD Diagnosis - GSEC" CURVE 0xFCD6B2 Lookup1D_UBYTE 0 NO_COMPU_METHOD 0 255
 /begin AXIS_DESCR FIX_AXIS NO_INPUT_QUANTITY NO_COMPU_METHOD 16 0 15 BYTE_ORDER MSB_LAST FIX_AXIS_PAR_DIST 0 1 16 /end AXIS_DESCR
 BYTE_ORDER MSB_LAST SYMBOL_LINK "xGsecCalData" 1232 /end CHARACTERISTIC
/begin CHARACTERISTIC CLO1_GSEC "CLO1 Active Recovery for OBD Diagnosis - GSEC" CURVE 0xFCD502 Lookup1D_UBYTE 0 NO_COMPU_METHOD 0 255
 /begin AXIS_DESCR FIX_AXIS NO_INPUT_QUANTITY NO_COMPU_METHOD 16 0 15 BYTE_ORDER MSB_LAST FIX_AXIS_PAR_DIST 0 1 16 /end AXIS_DESCR
 BYTE_ORDER MSB_LAST SYMBOL_LINK "xGsecCalData" 800 /end CHARACTERISTIC
/begin CHARACTERISTIC CLO2_GSEC "CLO2 Active Recovery for OBD Diagnosis - GSEC" CURVE 0xFCD512 Lookup1D_UBYTE 0 NO_COMPU_METHOD 0 255
 /begin AXIS_DESCR FIX_AXIS NO_INPUT_QUANTITY NO_COMPU_METHOD 16 0 15 BYTE_ORDER MSB_LAST FIX_AXIS_PAR_DIST 0 1 16 /end AXIS_DESCR
 BYTE_ORDER MSB_LAST SYMBOL_LINK "xGsecCalData" 816 /end CHARACTERISTIC
/begin CHARACTERISTIC CLO3_GSEC "CLO3 Active Recovery for OBD Diagnosis - GSEC" CURVE 0xFCD522 Lookup1D_UBYTE 0 NO_COMPU_METHOD 0 255
 /begin AXIS_DESCR FIX_AXIS NO_INPUT_QUANTITY NO_COMPU_METHOD 16 0 15 BYTE_ORDER MSB_LAST FIX_AXIS_PAR_DIST 0 1 16 /end AXIS_DESCR
 BYTE_ORDER MSB_LAST SYMBOL_LINK "xGsecCalData" 832 /end CHARACTERISTIC
/begin CHARACTERISTIC CLO4_GSEC "CLO4 Active Recovery for OBD Diagnosis - GSEC" CURVE 0xFCD532 Lookup1D_UBYTE 0 NO_COMPU_METHOD 0 255
 /begin AXIS_DESCR FIX_AXIS NO_INPUT_QUANTITY NO_COMPU_METHOD 16 0 15 BYTE_ORDER MSB_LAST FIX_AXIS_PAR_DIST 0 1 16 /end AXIS_DESCR
 BYTE_ORDER MSB_LAST SYMBOL_LINK "xGsecCalData" 848 /end CHARACTERISTIC
/begin CHARACTERISTIC COIL1_GSEC "COIL1 Active Recovery for OBD Diagnosis - GSEC" CURVE 0xFCD2D2 Lookup1D_UBYTE 0 NO_COMPU_METHOD 0 255
 /begin AXIS_DESCR FIX_AXIS NO_INPUT_QUANTITY NO_COMPU_METHOD 16 0 15 BYTE_ORDER MSB_LAST FIX_AXIS_PAR_DIST 0 1 16 /end AXIS_DESCR
 BYTE_ORDER MSB_LAST SYMBOL_LINK "xGsecCalData" 240 /end CHARACTERISTIC
/begin CHARACTERISTIC COIL2_GSEC "COIL2 Active Recovery for OBD Diagnosis - GSEC" CURVE 0xFCD2E2 Lookup1D_UBYTE 0 NO_COMPU_METHOD 0 255
 /begin AXIS_DESCR FIX_AXIS NO_INPUT_QUANTITY NO_COMPU_METHOD 16 0 15 BYTE_ORDER MSB_LAST FIX_AXIS_PAR_DIST 0 1 16 /end AXIS_DESCR
 BYTE_ORDER MSB_LAST SYMBOL_LINK "xGsecCalData" 256 /end CHARACTERISTIC
/begin CHARACTERISTIC COIL3_GSEC "COIL3 Active Recovery for OBD Diagnosis - GSEC" CURVE 0xFCD2F2 Lookup1D_UBYTE 0 NO_COMPU_METHOD 0 255
 /begin AXIS_DESCR FIX_AXIS NO_INPUT_QUANTITY NO_COMPU_METHOD 16 0 15 BYTE_ORDER MSB_LAST FIX_AXIS_PAR_DIST 0 1 16 /end AXIS_DESCR
 BYTE_ORDER MSB_LAST SYMBOL_LINK "xGsecCalData" 272 /end CHARACTERISTIC
/begin CHARACTERISTIC COIL4_GSEC "COIL4 Active Recovery for OBD Diagnosis - GSEC" CURVE 0xFCD302 Lookup1D_UBYTE 0 NO_COMPU_METHOD 0 255
 /begin AXIS_DESCR FIX_AXIS NO_INPUT_QUANTITY NO_COMPU_METHOD 16 0 15 BYTE_ORDER MSB_LAST FIX_AXIS_PAR_DIST 0 1 16 /end AXIS_DESCR
 BYTE_ORDER MSB_LAST SYMBOL_LINK "xGsecCalData" 288 /end CHARACTERISTIC
/begin CHARACTERISTIC COIL5_GSEC "COIL5 Active Recovery for OBD Diagnosis - GSEC" CURVE 0xFCD312 Lookup1D_UBYTE 0 NO_COMPU_METHOD 0 255
 /begin AXIS_DESCR FIX_AXIS NO_INPUT_QUANTITY NO_COMPU_METHOD 16 0 15 BYTE_ORDER MSB_LAST FIX_AXIS_PAR_DIST 0 1 16 /end AXIS_DESCR
 BYTE_ORDER MSB_LAST SYMBOL_LINK "xGsecCalData" 304 /end CHARACTERISTIC
/begin CHARACTERISTIC COIL6_GSEC "COIL6 Active Recovery for OBD Diagnosis - GSEC" CURVE 0xFCD322 Lookup1D_UBYTE 0 NO_COMPU_METHOD 0 255
 /begin AXIS_DESCR FIX_AXIS NO_INPUT_QUANTITY NO_COMPU_METHOD 16 0 15 BYTE_ORDER MSB_LAST FIX_AXIS_PAR_DIST 0 1 16 /end AXIS_DESCR
 BYTE_ORDER MSB_LAST SYMBOL_LINK "xGsecCalData" 320 /end CHARACTERISTIC
/begin CHARACTERISTIC COIL7_GSEC "COIL7 Active Recovery for OBD Diagnosis - GSEC" CURVE 0xFCD332 Lookup1D_UBYTE 0 NO_COMPU_METHOD 0 255
 /begin AXIS_DESCR FIX_AXIS NO_INPUT_QUANTITY NO_COMPU_METHOD 16 0 15 BYTE_ORDER MSB_LAST FIX_AXIS_PAR_DIST 0 1 16 /end AXIS_DESCR
 BYTE_ORDER MSB_LAST SYMBOL_LINK "xGsecCalData" 336 /end CHARACTERISTIC
/begin CHARACTERISTIC COIL8_GSEC "COIL8 Active Recovery for OBD Diagnosis - GSEC" CURVE 0xFCD342 Lookup1D_UBYTE 0 NO_COMPU_METHOD 0 255
 /begin AXIS_DESCR FIX_AXIS NO_INPUT_QUANTITY NO_COMPU_METHOD 16 0 15 BYTE_ORDER MSB_LAST FIX_AXIS_PAR_DIST 0 1 16 /end AXIS_DESCR
 BYTE_ORDER MSB_LAST SYMBOL_LINK "xGsecCalData" 352 /end CHARACTERISTIC
/begin CHARACTERISTIC CTSP_GSEC "CTSP Active Recovery for OBD Diagnosis - GSEC" CURVE 0xFCD982 Lookup1D_UBYTE 0 NO_COMPU_METHOD 0 255
 /begin AXIS_DESCR FIX_AXIS NO_INPUT_QUANTITY NO_COMPU_METHOD 16 0 15 BYTE_ORDER MSB_LAST FIX_AXIS_PAR_DIST 0 1 16 /end AXIS_DESCR
 BYTE_ORDER MSB_LAST SYMBOL_LINK "xGsecCalData" 1952 /end CHARACTERISTIC
/begin CHARACTERISTIC CTST_GSEC "CTST Active Recovery for OBD Diagnosis - GSEC" CURVE 0xFCD992 Lookup1D_UBYTE 0 NO_COMPU_METHOD 0 255
 /begin AXIS_DESCR FIX_AXIS NO_INPUT_QUANTITY NO_COMPU_METHOD 16 0 15 BYTE_ORDER MSB_LAST FIX_AXIS_PAR_DIST 0 1 16 /end AXIS_DESCR
 BYTE_ORDER MSB_LAST SYMBOL_LINK "xGsecCalData" 1968 /end CHARACTERISTIC
/begin CHARACTERISTIC DCAT_GSEC "DCAT Active Recovery for OBD Diagnosis - GSEC" CURVE 0xFCDA02 Lookup1D_UBYTE 0 NO_COMPU_METHOD 0 255
 /begin AXIS_DESCR FIX_AXIS NO_INPUT_QUANTITY NO_COMPU_METHOD 16 0 15 BYTE_ORDER MSB_LAST FIX_AXIS_PAR_DIST 0 1 16 /end AXIS_DESCR
 BYTE_ORDER MSB_LAST SYMBOL_LINK "xGsecCalData" 2080 /end CHARACTERISTIC
/begin CHARACTERISTIC DCMV_GSEC "DCMV Active Recovery for OBD Diagnosis - GSEC" CURVE 0xFCDA12 Lookup1D_UBYTE 0 NO_COMPU_METHOD 0 255
 /begin AXIS_DESCR FIX_AXIS NO_INPUT_QUANTITY NO_COMPU_METHOD 16 0 15 BYTE_ORDER MSB_LAST FIX_AXIS_PAR_DIST 0 1 16 /end AXIS_DESCR
 BYTE_ORDER MSB_LAST SYMBOL_LINK "xGsecCalData" 2096 /end CHARACTERISTIC
/begin CHARACTERISTIC DFLF_GSEC "DFLF Active Recovery for EOBD Diagnosis - GSEC" CURVE 0xFCD9D2 Lookup1D_UBYTE 0 NO_COMPU_METHOD 0 255
 /begin AXIS_DESCR FIX_AXIS NO_INPUT_QUANTITY NO_COMPU_METHOD 16 0 15 BYTE_ORDER MSB_LAST FIX_AXIS_PAR_DIST 0 1 16 /end AXIS_DESCR
 BYTE_ORDER MSB_LAST SYMBOL_LINK "xGsecCalData" 2032 /end CHARACTERISTIC
/begin CHARACTERISTIC DFLL_GSEC "DFLL Active Recovery for EOBD Diagnosis - GSEC" CURVE 0xFCD9E2 Lookup1D_UBYTE 0 NO_COMPU_METHOD 0 255
 /begin AXIS_DESCR FIX_AXIS NO_INPUT_QUANTITY NO_COMPU_METHOD 16 0 15 BYTE_ORDER MSB_LAST FIX_AXIS_PAR_DIST 0 1 16 /end AXIS_DESCR
 BYTE_ORDER MSB_LAST SYMBOL_LINK "xGsecCalData" 2048 /end CHARACTERISTIC
/begin CHARACTERISTIC DFLR_GSEC "DFLR Active Recovery for OBD Diagnosis - GSEC" CURVE 0xFCD9F2 Lookup1D_UBYTE 0 NO_COMPU_METHOD 0 255
 /begin AXIS_DESCR FIX_AXIS NO_INPUT_QUANTITY NO_COMPU_METHOD 16 0 15 BYTE_ORDER MSB_LAST FIX_AXIS_PAR_DIST 0 1 16 /end AXIS_DESCR
 BYTE_ORDER MSB_LAST SYMBOL_LINK "xGsecCalData" 2064 /end CHARACTERISTIC
/begin CHARACTERISTIC DLAM_GSEC "DLAM Active Recovery for OBD Diagnosis - GSEC" CURVE 0xFCDA22 Lookup1D_UBYTE 0 NO_COMPU_METHOD 0 255
 /begin AXIS_DESCR FIX_AXIS NO_INPUT_QUANTITY NO_COMPU_METHOD 16 0 15 BYTE_ORDER MSB_LAST FIX_AXIS_PAR_DIST 0 1 16 /end AXIS_DESCR
 BYTE_ORDER MSB_LAST SYMBOL_LINK "xGsecCalData" 2112 /end CHARACTERISTIC
/begin CHARACTERISTIC EGRC_GSEC "EGRC Active Recovery for OBD Diagnosis - GSEC" CURVE 0xFCD8B2 Lookup1D_UBYTE 0 NO_COMPU_METHOD 0 255
 /begin AXIS_DESCR FIX_AXIS NO_INPUT_QUANTITY NO_COMPU_METHOD 16 0 15 BYTE_ORDER MSB_LAST FIX_AXIS_PAR_DIST 0 1 16 /end AXIS_DESCR
 BYTE_ORDER MSB_LAST SYMBOL_LINK "xGsecCalData" 1744 /end CHARACTERISTIC
/begin CHARACTERISTIC EGRP_GSEC "EGRP Active Recovery for OBD Diagnosis - GSEC" CURVE 0xFCD892 Lookup1D_UBYTE 0 NO_COMPU_METHOD 0 255
 /begin AXIS_DESCR FIX_AXIS NO_INPUT_QUANTITY NO_COMPU_METHOD 16 0 15 BYTE_ORDER MSB_LAST FIX_AXIS_PAR_DIST 0 1 16 /end AXIS_DESCR
 BYTE_ORDER MSB_LAST SYMBOL_LINK "xGsecCalData" 1712 /end CHARACTERISTIC
/begin CHARACTERISTIC EGRV_GSEC "EGRV Active Recovery for OBD Diagnosis - GSEC" CURVE 0xFCD8A2 Lookup1D_UBYTE 0 NO_COMPU_METHOD 0 255
 /begin AXIS_DESCR FIX_AXIS NO_INPUT_QUANTITY NO_COMPU_METHOD 16 0 15 BYTE_ORDER MSB_LAST FIX_AXIS_PAR_DIST 0 1 16 /end AXIS_DESCR
 BYTE_ORDER MSB_LAST SYMBOL_LINK "xGsecCalData" 1728 /end CHARACTERISTIC
/begin CHARACTERISTIC ENGBRK_GSEC "Engine Brake Active Recovery for OBD Diagnosis - GSEC" CURVE 0xFCD8C2 Lookup1D_UBYTE 0 NO_COMPU_METHOD 0 255
 /begin AXIS_DESCR FIX_AXIS NO_INPUT_QUANTITY NO_COMPU_METHOD 16 0 15 BYTE_ORDER MSB_LAST FIX_AXIS_PAR_DIST 0 1 16 /end AXIS_DESCR
 BYTE_ORDER MSB_LAST SYMBOL_LINK "xGsecCalData" 1760 /end CHARACTERISTIC
/begin CHARACTERISTIC EVRCGND_GSEC "EVRCGND Active Recovery for OBD Diagnosis - GSEC" CURVE 0xFCD442 Lookup1D_UBYTE 0 NO_COMPU_METHOD 0 255
 /begin AXIS_DESCR FIX_AXIS NO_INPUT_QUANTITY NO_COMPU_METHOD 16 0 15 BYTE_ORDER MSB_LAST FIX_AXIS_PAR_DIST 0 1 16 /end AXIS_DESCR
 BYTE_ORDER MSB_LAST SYMBOL_LINK "xGsecCalData" 608 /end CHARACTERISTIC
/begin CHARACTERISTIC EVRCOL_GSEC "EVRCOL Active Recovery for OBD Diagnosis - GSEC" CURVE 0xFCD432 Lookup1D_UBYTE 0 NO_COMPU_METHOD 0 255
 /begin AXIS_DESCR FIX_AXIS NO_INPUT_QUANTITY NO_COMPU_METHOD 16 0 15 BYTE_ORDER MSB_LAST FIX_AXIS_PAR_DIST 0 1 16 /end AXIS_DESCR
 BYTE_ORDER MSB_LAST SYMBOL_LINK "xGsecCalData" 592 /end CHARACTERISTIC
/begin CHARACTERISTIC EVRCVB_GSEC "EVRCVB Active Recovery for OBD Diagnosis - GSEC" CURVE 0xFCD452 Lookup1D_UBYTE 0 NO_COMPU_METHOD 0 255
 /begin AXIS_DESCR FIX_AXIS NO_INPUT_QUANTITY NO_COMPU_METHOD 16 0 15 BYTE_ORDER MSB_LAST FIX_AXIS_PAR_DIST 0 1 16 /end AXIS_DESCR
 BYTE_ORDER MSB_LAST SYMBOL_LINK "xGsecCalData" 624 /end CHARACTERISTIC
/begin CHARACTERISTIC FAN1_GSEC "FAN1 Active Recovery for OBD Diagnosis - GSEC" CURVE 0xFCD5D2 Lookup1D_UBYTE 0 NO_COMPU_METHOD 0 255
 /begin AXIS_DESCR FIX_AXIS NO_INPUT_QUANTITY NO_COMPU_METHOD 16 0 15 BYTE_ORDER MSB_LAST FIX_AXIS_PAR_DIST 0 1 16 /end AXIS_DESCR
 BYTE_ORDER MSB_LAST SYMBOL_LINK "xGsecCalData" 1008 /end CHARACTERISTIC
/begin CHARACTERISTIC FAN2_GSEC "FAN2 Active Recovery for OBD Diagnosis - GSEC" CURVE 0xFCD5E2 Lookup1D_UBYTE 0 NO_COMPU_METHOD 0 255
 /begin AXIS_DESCR FIX_AXIS NO_INPUT_QUANTITY NO_COMPU_METHOD 16 0 15 BYTE_ORDER MSB_LAST FIX_AXIS_PAR_DIST 0 1 16 /end AXIS_DESCR
 BYTE_ORDER MSB_LAST SYMBOL_LINK "xGsecCalData" 1024 /end CHARACTERISTIC
/begin CHARACTERISTIC FAR01_GSEC "FAR01 Active Recovery for OBD Diagnosis - GSEC" CURVE 0xFCD282 Lookup1D_UBYTE 0 NO_COMPU_METHOD 0 255
 /begin AXIS_DESCR FIX_AXIS NO_INPUT_QUANTITY NO_COMPU_METHOD 16 0 15 BYTE_ORDER MSB_LAST FIX_AXIS_PAR_DIST 0 1 16 /end AXIS_DESCR
 BYTE_ORDER MSB_LAST SYMBOL_LINK "xGsecCalData" 160 /end CHARACTERISTIC
/begin CHARACTERISTIC FAR02_GSEC "FAR02 Active Recovery for OBD Diagnosis - GSEC" CURVE 0xFCD542 Lookup1D_UBYTE 0 NO_COMPU_METHOD 0 255
 /begin AXIS_DESCR FIX_AXIS NO_INPUT_QUANTITY NO_COMPU_METHOD 16 0 15 BYTE_ORDER MSB_LAST FIX_AXIS_PAR_DIST 0 1 16 /end AXIS_DESCR
 BYTE_ORDER MSB_LAST SYMBOL_LINK "xGsecCalData" 864 /end CHARACTERISTIC
/begin CHARACTERISTIC FAR12_GSEC "FAR12 Active Recovery for OBD Diagnosis - GSEC" CURVE 0xFCD962 Lookup1D_UBYTE 0 NO_COMPU_METHOD 0 255
 /begin AXIS_DESCR FIX_AXIS NO_INPUT_QUANTITY NO_COMPU_METHOD 16 0 15 BYTE_ORDER MSB_LAST FIX_AXIS_PAR_DIST 0 1 16 /end AXIS_DESCR
 BYTE_ORDER MSB_LAST SYMBOL_LINK "xGsecCalData" 1920 /end CHARACTERISTIC
/begin CHARACTERISTIC FARCH_GSEC "FARCH Active Recovery for OBD Diagnosis - GSEC" CURVE 0xFCD552 Lookup1D_UBYTE 0 NO_COMPU_METHOD 0 255
 /begin AXIS_DESCR FIX_AXIS NO_INPUT_QUANTITY NO_COMPU_METHOD 16 0 15 BYTE_ORDER MSB_LAST FIX_AXIS_PAR_DIST 0 1 16 /end AXIS_DESCR
 BYTE_ORDER MSB_LAST SYMBOL_LINK "xGsecCalData" 880 /end CHARACTERISTIC
/begin CHARACTERISTIC INJ1_GSEC "INJ1 Active Recovery for OBD Diagnosis - GSEC" CURVE 0xFCD352 Lookup1D_UBYTE 0 NO_COMPU_METHOD 0 255
 /begin AXIS_DESCR FIX_AXIS NO_INPUT_QUANTITY NO_COMPU_METHOD 16 0 15 BYTE_ORDER MSB_LAST FIX_AXIS_PAR_DIST 0 1 16 /end AXIS_DESCR
 BYTE_ORDER MSB_LAST SYMBOL_LINK "xGsecCalData" 368 /end CHARACTERISTIC
/begin CHARACTERISTIC INJ2_GSEC "INJ2 Active Recovery for OBD Diagnosis - GSEC" CURVE 0xFCD362 Lookup1D_UBYTE 0 NO_COMPU_METHOD 0 255
 /begin AXIS_DESCR FIX_AXIS NO_INPUT_QUANTITY NO_COMPU_METHOD 16 0 15 BYTE_ORDER MSB_LAST FIX_AXIS_PAR_DIST 0 1 16 /end AXIS_DESCR
 BYTE_ORDER MSB_LAST SYMBOL_LINK "xGsecCalData" 384 /end CHARACTERISTIC
/begin CHARACTERISTIC INJ3_GSEC "INJ3 Active Recovery for OBD Diagnosis - GSEC" CURVE 0xFCD372 Lookup1D_UBYTE 0 NO_COMPU_METHOD 0 255
 /begin AXIS_DESCR FIX_AXIS NO_INPUT_QUANTITY NO_COMPU_METHOD 16 0 15 BYTE_ORDER MSB_LAST FIX_AXIS_PAR_DIST 0 1 16 /end AXIS_DESCR
 BYTE_ORDER MSB_LAST SYMBOL_LINK "xGsecCalData" 400 /end CHARACTERISTIC
/begin CHARACTERISTIC INJ4_GSEC "INJ4 Active Recovery for OBD Diagnosis - GSEC" CURVE 0xFCD382 Lookup1D_UBYTE 0 NO_COMPU_METHOD 0 255
 /begin AXIS_DESCR FIX_AXIS NO_INPUT_QUANTITY NO_COMPU_METHOD 16 0 15 BYTE_ORDER MSB_LAST FIX_AXIS_PAR_DIST 0 1 16 /end AXIS_DESCR
 BYTE_ORDER MSB_LAST SYMBOL_LINK "xGsecCalData" 416 /end CHARACTERISTIC
/begin CHARACTERISTIC INJ5_GSEC "INJ5 Active Recovery for OBD Diagnosis - GSEC" CURVE 0xFCD392 Lookup1D_UBYTE 0 NO_COMPU_METHOD 0 255
 /begin AXIS_DESCR FIX_AXIS NO_INPUT_QUANTITY NO_COMPU_METHOD 16 0 15 BYTE_ORDER MSB_LAST FIX_AXIS_PAR_DIST 0 1 16 /end AXIS_DESCR
 BYTE_ORDER MSB_LAST SYMBOL_LINK "xGsecCalData" 432 /end CHARACTERISTIC
/begin CHARACTERISTIC INJ6_GSEC "INJ6 Active Recovery for OBD Diagnosis - GSEC" CURVE 0xFCD3A2 Lookup1D_UBYTE 0 NO_COMPU_METHOD 0 255
 /begin AXIS_DESCR FIX_AXIS NO_INPUT_QUANTITY NO_COMPU_METHOD 16 0 15 BYTE_ORDER MSB_LAST FIX_AXIS_PAR_DIST 0 1 16 /end AXIS_DESCR
 BYTE_ORDER MSB_LAST SYMBOL_LINK "xGsecCalData" 448 /end CHARACTERISTIC
/begin CHARACTERISTIC INJ7_GSEC "INJ7 Active Recovery for OBD Diagnosis - GSEC" CURVE 0xFCD3B2 Lookup1D_UBYTE 0 NO_COMPU_METHOD 0 255
 /begin AXIS_DESCR FIX_AXIS NO_INPUT_QUANTITY NO_COMPU_METHOD 16 0 15 BYTE_ORDER MSB_LAST FIX_AXIS_PAR_DIST 0 1 16 /end AXIS_DESCR
 BYTE_ORDER MSB_LAST SYMBOL_LINK "xGsecCalData" 464 /end CHARACTERISTIC
/begin CHARACTERISTIC INJ8_GSEC "INJ8 Active Recovery for OBD Diagnosis - GSEC" CURVE 0xFCD3C2 Lookup1D_UBYTE 0 NO_COMPU_METHOD 0 255
 /begin AXIS_DESCR FIX_AXIS NO_INPUT_QUANTITY NO_COMPU_METHOD 16 0 15 BYTE_ORDER MSB_LAST FIX_AXIS_PAR_DIST 0 1 16 /end AXIS_DESCR
 BYTE_ORDER MSB_LAST SYMBOL_LINK "xGsecCalData" 480 /end CHARACTERISTIC
/begin CHARACTERISTIC KSP1_GSEC "KSP1 Active Recovery for OBD Diagnosis - GSEC" CURVE 0xFCD872 Lookup1D_UBYTE 0 NO_COMPU_METHOD 0 255
 /begin AXIS_DESCR FIX_AXIS NO_INPUT_QUANTITY NO_COMPU_METHOD 16 0 15 BYTE_ORDER MSB_LAST FIX_AXIS_PAR_DIST 0 1 16 /end AXIS_DESCR
 BYTE_ORDER MSB_LAST SYMBOL_LINK "xGsecCalData" 1680 /end CHARACTERISTIC
/begin CHARACTERISTIC KSP2_GSEC "KSP2 Active Recovery for OBD Diagnosis - GSEC" CURVE 0xFCD882 Lookup1D_UBYTE 0 NO_COMPU_METHOD 0 255
 /begin AXIS_DESCR FIX_AXIS NO_INPUT_QUANTITY NO_COMPU_METHOD 16 0 15 BYTE_ORDER MSB_LAST FIX_AXIS_PAR_DIST 0 1 16 /end AXIS_DESCR
 BYTE_ORDER MSB_LAST SYMBOL_LINK "xGsecCalData" 1696 /end CHARACTERISTIC
/begin CHARACTERISTIC LHR2_GSEC "LHR2 Active Recovery for OBD Diagnosis - GSEC" CURVE 0xFCD5C2 Lookup1D_UBYTE 0 NO_COMPU_METHOD 0 255
 /begin AXIS_DESCR FIX_AXIS NO_INPUT_QUANTITY NO_COMPU_METHOD 16 0 15 BYTE_ORDER MSB_LAST FIX_AXIS_PAR_DIST 0 1 16 /end AXIS_DESCR
 BYTE_ORDER MSB_LAST SYMBOL_LINK "xGsecCalData" 992 /end CHARACTERISTIC
/begin CHARACTERISTIC LHR_GSEC "LHR Active Recovery for OBD Diagnosis - GSEC" CURVE 0xFCD492 Lookup1D_UBYTE 0 NO_COMPU_METHOD 0 255
 /begin AXIS_DESCR FIX_AXIS NO_INPUT_QUANTITY NO_COMPU_METHOD 16 0 15 BYTE_ORDER MSB_LAST FIX_AXIS_PAR_DIST 0 1 16 /end AXIS_DESCR
 BYTE_ORDER MSB_LAST SYMBOL_LINK "xGsecCalData" 688 /end CHARACTERISTIC
/begin CHARACTERISTIC LRN01_GSEC "LRN01 Active Recovery for OBD Diagnosis - GSEC" CURVE 0xFCD8F2 Lookup1D_UBYTE 0 NO_COMPU_METHOD 0 255
 /begin AXIS_DESCR FIX_AXIS NO_INPUT_QUANTITY NO_COMPU_METHOD 16 0 15 BYTE_ORDER MSB_LAST FIX_AXIS_PAR_DIST 0 1 16 /end AXIS_DESCR
 BYTE_ORDER MSB_LAST SYMBOL_LINK "xGsecCalData" 1808 /end CHARACTERISTIC
/begin CHARACTERISTIC LRN02_GSEC "LRN02 Active Recovery for OBD Diagnosis - GSEC" CURVE 0xFCD902 Lookup1D_UBYTE 0 NO_COMPU_METHOD 0 255
 /begin AXIS_DESCR FIX_AXIS NO_INPUT_QUANTITY NO_COMPU_METHOD 16 0 15 BYTE_ORDER MSB_LAST FIX_AXIS_PAR_DIST 0 1 16 /end AXIS_DESCR
 BYTE_ORDER MSB_LAST SYMBOL_LINK "xGsecCalData" 1824 /end CHARACTERISTIC
/begin CHARACTERISTIC LRN03_GSEC "LRN03 Active Recovery for OBD Diagnosis - GSEC" CURVE 0xFCD912 Lookup1D_UBYTE 0 NO_COMPU_METHOD 0 255
 /begin AXIS_DESCR FIX_AXIS NO_INPUT_QUANTITY NO_COMPU_METHOD 16 0 15 BYTE_ORDER MSB_LAST FIX_AXIS_PAR_DIST 0 1 16 /end AXIS_DESCR
 BYTE_ORDER MSB_LAST SYMBOL_LINK "xGsecCalData" 1840 /end CHARACTERISTIC
/begin CHARACTERISTIC MD1_GSEC "MD1 Active Recovery for OBD Diagnosis - GSEC" CURVE 0xFCD7D2 Lookup1D_UBYTE 0 NO_COMPU_METHOD 0 255
 /begin AXIS_DESCR FIX_AXIS NO_INPUT_QUANTITY NO_COMPU_METHOD 16 0 15 BYTE_ORDER MSB_LAST FIX_AXIS_PAR_DIST 0 1 16 /end AXIS_DESCR
 BYTE_ORDER MSB_LAST SYMBOL_LINK "xGsecCalData" 1520 /end CHARACTERISTIC
/begin CHARACTERISTIC MD2_GSEC "MD2 Active Recovery for OBD Diagnosis - GSEC" CURVE 0xFCD7E2 Lookup1D_UBYTE 0 NO_COMPU_METHOD 0 255
 /begin AXIS_DESCR FIX_AXIS NO_INPUT_QUANTITY NO_COMPU_METHOD 16 0 15 BYTE_ORDER MSB_LAST FIX_AXIS_PAR_DIST 0 1 16 /end AXIS_DESCR
 BYTE_ORDER MSB_LAST SYMBOL_LINK "xGsecCalData" 1536 /end CHARACTERISTIC
/begin CHARACTERISTIC MD3_GSEC "MD1 Active Recovery for OBD Diagnosis - GSEC" CURVE 0xFCD7F2 Lookup1D_UBYTE 0 NO_COMPU_METHOD 0 255
 /begin AXIS_DESCR FIX_AXIS NO_INPUT_QUANTITY NO_COMPU_METHOD 16 0 15 BYTE_ORDER MSB_LAST FIX_AXIS_PAR_DIST 0 1 16 /end AXIS_DESCR
 BYTE_ORDER MSB_LAST SYMBOL_LINK "xGsecCalData" 1552 /end CHARACTERISTIC
/begin CHARACTERISTIC MD4_GSEC "MD4 Active Recovery for OBD Diagnosis - GSEC" CURVE 0xFCD802 Lookup1D_UBYTE 0 NO_COMPU_METHOD 0 255
 /begin AXIS_DESCR FIX_AXIS NO_INPUT_QUANTITY NO_COMPU_METHOD 16 0 15 BYTE_ORDER MSB_LAST FIX_AXIS_PAR_DIST 0 1 16 /end AXIS_DESCR
 BYTE_ORDER MSB_LAST SYMBOL_LINK "xGsecCalData" 1568 /end CHARACTERISTIC
/begin CHARACTERISTIC MD5_GSEC "MD5 Active Recovery for OBD Diagnosis - GSEC" CURVE 0xFCD812 Lookup1D_UBYTE 0 NO_COMPU_METHOD 0 255
 /begin AXIS_DESCR FIX_AXIS NO_INPUT_QUANTITY NO_COMPU_METHOD 16 0 15 BYTE_ORDER MSB_LAST FIX_AXIS_PAR_DIST 0 1 16 /end AXIS_DESCR
 BYTE_ORDER MSB_LAST SYMBOL_LINK "xGsecCalData" 1584 /end CHARACTERISTIC
/begin CHARACTERISTIC MD6_GSEC "MD6 Active Recovery for OBD Diagnosis - GSEC" CURVE 0xFCD822 Lookup1D_UBYTE 0 NO_COMPU_METHOD 0 255
 /begin AXIS_DESCR FIX_AXIS NO_INPUT_QUANTITY NO_COMPU_METHOD 16 0 15 BYTE_ORDER MSB_LAST FIX_AXIS_PAR_DIST 0 1 16 /end AXIS_DESCR
 BYTE_ORDER MSB_LAST SYMBOL_LINK "xGsecCalData" 1600 /end CHARACTERISTIC
/begin CHARACTERISTIC MD7_GSEC "MD7 Active Recovery for OBD Diagnosis - GSEC" CURVE 0xFCD832 Lookup1D_UBYTE 0 NO_COMPU_METHOD 0 255
 /begin AXIS_DESCR FIX_AXIS NO_INPUT_QUANTITY NO_COMPU_METHOD 16 0 15 BYTE_ORDER MSB_LAST FIX_AXIS_PAR_DIST 0 1 16 /end AXIS_DESCR
 BYTE_ORDER MSB_LAST SYMBOL_LINK "xGsecCalData" 1616 /end CHARACTERISTIC
/begin CHARACTERISTIC MD8_GSEC "MD8 Active Recovery for OBD Diagnosis - GSEC" CURVE 0xFCD842 Lookup1D_UBYTE 0 NO_COMPU_METHOD 0 255
 /begin AXIS_DESCR FIX_AXIS NO_INPUT_QUANTITY NO_COMPU_METHOD 16 0 15 BYTE_ORDER MSB_LAST FIX_AXIS_PAR_DIST 0 1 16 /end AXIS_DESCR
 BYTE_ORDER MSB_LAST SYMBOL_LINK "xGsecCalData" 1632 /end CHARACTERISTIC
/begin CHARACTERISTIC MDR_GSEC "MDR Active Recovery for OBD Diagnosis - GSEC" CURVE 0xFCD852 Lookup1D_UBYTE 0 NO_COMPU_METHOD 0 255
 /begin AXIS_DESCR FIX_AXIS NO_INPUT_QUANTITY NO_COMPU_METHOD 16 0 15 BYTE_ORDER MSB_LAST FIX_AXIS_PAR_DIST 0 1 16 /end AXIS_DESCR
 BYTE_ORDER MSB_LAST SYMBOL_LINK "xGsecCalData" 1648 /end CHARACTERISTIC
/begin CHARACTERISTIC MFLV_GSEC "MFLV Active Recovery for OBD Diagnosis - GSEC" CURVE 0xFCD972 Lookup1D_UBYTE 0 NO_COMPU_METHOD 0 255
 /begin AXIS_DESCR FIX_AXIS NO_INPUT_QUANTITY NO_COMPU_METHOD 16 0 15 BYTE_ORDER MSB_LAST FIX_AXIS_PAR_DIST 0 1 16 /end AXIS_DESCR
 BYTE_ORDER MSB_LAST SYMBOL_LINK "xGsecCalData" 1936 /end CHARACTERISTIC
/begin CHARACTERISTIC MIL_GSEC "MIL Active Recovery for OBD Diagnosis - GSEC" CURVE 0xFCD792 Lookup1D_UBYTE 0 NO_COMPU_METHOD 0 255
 /begin AXIS_DESCR FIX_AXIS NO_INPUT_QUANTITY NO_COMPU_METHOD 16 0 15 BYTE_ORDER MSB_LAST FIX_AXIS_PAR_DIST 0 1 16 /end AXIS_DESCR
 BYTE_ORDER MSB_LAST SYMBOL_LINK "xGsecCalData" 1456 /end CHARACTERISTIC
/begin CHARACTERISTIC PO2L_GSEC "PO2L Active Recovery for OBD Diagnosis - GSEC" CURVE 0xFCD602 Lookup1D_UBYTE 0 NO_COMPU_METHOD 0 255
 /begin AXIS_DESCR FIX_AXIS NO_INPUT_QUANTITY NO_COMPU_METHOD 16 0 15 BYTE_ORDER MSB_LAST FIX_AXIS_PAR_DIST 0 1 16 /end AXIS_DESCR
 BYTE_ORDER MSB_LAST SYMBOL_LINK "xGsecCalData" 1056 /end CHARACTERISTIC
/begin CHARACTERISTIC PRVCGND_GSEC "PRVCGND Active Recovery for OBD Diagnosis - GSEC" CURVE 0xFCD472 Lookup1D_UBYTE 0 NO_COMPU_METHOD 0 255
 /begin AXIS_DESCR FIX_AXIS NO_INPUT_QUANTITY NO_COMPU_METHOD 16 0 15 BYTE_ORDER MSB_LAST FIX_AXIS_PAR_DIST 0 1 16 /end AXIS_DESCR
 BYTE_ORDER MSB_LAST SYMBOL_LINK "xGsecCalData" 656 /end CHARACTERISTIC
/begin CHARACTERISTIC PRVCOL_GSEC "PRVCOL Active Recovery for OBD Diagnosis - GSEC" CURVE 0xFCD462 Lookup1D_UBYTE 0 NO_COMPU_METHOD 0 255
 /begin AXIS_DESCR FIX_AXIS NO_INPUT_QUANTITY NO_COMPU_METHOD 16 0 15 BYTE_ORDER MSB_LAST FIX_AXIS_PAR_DIST 0 1 16 /end AXIS_DESCR
 BYTE_ORDER MSB_LAST SYMBOL_LINK "xGsecCalData" 640 /end CHARACTERISTIC
/begin CHARACTERISTIC PRVCVB_GSEC "PRVCVB Active Recovery for OBD Diagnosis - GSEC" CURVE 0xFCD482 Lookup1D_UBYTE 0 NO_COMPU_METHOD 0 255
 /begin AXIS_DESCR FIX_AXIS NO_INPUT_QUANTITY NO_COMPU_METHOD 16 0 15 BYTE_ORDER MSB_LAST FIX_AXIS_PAR_DIST 0 1 16 /end AXIS_DESCR
 BYTE_ORDER MSB_LAST SYMBOL_LINK "xGsecCalData" 672 /end CHARACTERISTIC
/begin CHARACTERISTIC PWRCC_GSEC "PWRCC Active Recovery for OBD Diagnosis - GSEC" CURVE 0xFCD412 Lookup1D_UBYTE 0 NO_COMPU_METHOD 0 255
 /begin AXIS_DESCR FIX_AXIS NO_INPUT_QUANTITY NO_COMPU_METHOD 16 0 15 BYTE_ORDER MSB_LAST FIX_AXIS_PAR_DIST 0 1 16 /end AXIS_DESCR
 BYTE_ORDER MSB_LAST SYMBOL_LINK "xGsecCalData" 560 /end CHARACTERISTIC
/begin CHARACTERISTIC PWRCGND_GSEC "PWRCGND Active Recovery for OBD Diagnosis - GSEC" CURVE 0xFCD3E2 Lookup1D_UBYTE 0 NO_COMPU_METHOD 0 255
 /begin AXIS_DESCR FIX_AXIS NO_INPUT_QUANTITY NO_COMPU_METHOD 16 0 15 BYTE_ORDER MSB_LAST FIX_AXIS_PAR_DIST 0 1 16 /end AXIS_DESCR
 BYTE_ORDER MSB_LAST SYMBOL_LINK "xGsecCalData" 512 /end CHARACTERISTIC
/begin CHARACTERISTIC PWRCOL_GSEC "PWRCOL Active Recovery for OBD Diagnosis - GSEC" CURVE 0xFCD3D2 Lookup1D_UBYTE 0 NO_COMPU_METHOD 0 255
 /begin AXIS_DESCR FIX_AXIS NO_INPUT_QUANTITY NO_COMPU_METHOD 16 0 15 BYTE_ORDER MSB_LAST FIX_AXIS_PAR_DIST 0 1 16 /end AXIS_DESCR
 BYTE_ORDER MSB_LAST SYMBOL_LINK "xGsecCalData" 496 /end CHARACTERISTIC
/begin CHARACTERISTIC PWRCVB_GSEC "PWRCVB Active Recovery for OBD Diagnosis - GSEC" CURVE 0xFCD3F2 Lookup1D_UBYTE 0 NO_COMPU_METHOD 0 255
 /begin AXIS_DESCR FIX_AXIS NO_INPUT_QUANTITY NO_COMPU_METHOD 16 0 15 BYTE_ORDER MSB_LAST FIX_AXIS_PAR_DIST 0 1 16 /end AXIS_DESCR
 BYTE_ORDER MSB_LAST SYMBOL_LINK "xGsecCalData" 528 /end CHARACTERISTIC
/begin CHARACTERISTIC PWROC_GSEC "PWROC Active Recovery for OBD Diagnosis - GSEC" CURVE 0xFCD402 Lookup1D_UBYTE 0 NO_COMPU_METHOD 0 255
 /begin AXIS_DESCR FIX_AXIS NO_INPUT_QUANTITY NO_COMPU_METHOD 16 0 15 BYTE_ORDER MSB_LAST FIX_AXIS_PAR_DIST 0 1 16 /end AXIS_DESCR
 BYTE_ORDER MSB_LAST SYMBOL_LINK "xGsecCalData" 544 /end CHARACTERISTIC
/begin CHARACTERISTIC REDL_GSEC "REDL Active Recovery for OBD Diagnosis - GSEC" CURVE 0xFCD782 Lookup1D_UBYTE 0 NO_COMPU_METHOD 0 255
 /begin AXIS_DESCR FIX_AXIS NO_INPUT_QUANTITY NO_COMPU_METHOD 16 0 15 BYTE_ORDER MSB_LAST FIX_AXIS_PAR_DIST 0 1 16 /end AXIS_DESCR
 BYTE_ORDER MSB_LAST SYMBOL_LINK "xGsecCalData" 1440 /end CHARACTERISTIC
/begin CHARACTERISTIC SAFPON_GSEC "SAFPON Active Recovery for OBD Diagnosis - GSEC" CURVE 0xFCD5A2 Lookup1D_UBYTE 0 NO_COMPU_METHOD 0 255
 /begin AXIS_DESCR FIX_AXIS NO_INPUT_QUANTITY NO_COMPU_METHOD 16 0 15 BYTE_ORDER MSB_LAST FIX_AXIS_PAR_DIST 0 1 16 /end AXIS_DESCR
 BYTE_ORDER MSB_LAST SYMBOL_LINK "xGsecCalData" 960 /end CHARACTERISTIC
/begin CHARACTERISTIC SAFRTF_GSEC "SAFRTF Active Recovery for OBD Diagnosis - GSEC" CURVE 0xFCD5B2 Lookup1D_UBYTE 0 NO_COMPU_METHOD 0 255
 /begin AXIS_DESCR FIX_AXIS NO_INPUT_QUANTITY NO_COMPU_METHOD 16 0 15 BYTE_ORDER MSB_LAST FIX_AXIS_PAR_DIST 0 1 16 /end AXIS_DESCR
 BYTE_ORDER MSB_LAST SYMBOL_LINK "xGsecCalData" 976 /end CHARACTERISTIC
/begin CHARACTERISTIC SAFRTI_GSEC "SAFRTI Active Recovery for OBD Diagnosis - GSEC" CURVE 0xFCD9B2 Lookup1D_UBYTE 0 NO_COMPU_METHOD 0 255
 /begin AXIS_DESCR FIX_AXIS NO_INPUT_QUANTITY NO_COMPU_METHOD 16 0 15 BYTE_ORDER MSB_LAST FIX_AXIS_PAR_DIST 0 1 16 /end AXIS_DESCR
 BYTE_ORDER MSB_LAST SYMBOL_LINK "xGsecCalData" 2000 /end CHARACTERISTIC
/begin CHARACTERISTIC SFM_GSEC "SFM Active Recovery for OBD Diagnosis - GSEC" CURVE 0xFCD922 Lookup1D_UBYTE 0 NO_COMPU_METHOD 0 255
 /begin AXIS_DESCR FIX_AXIS NO_INPUT_QUANTITY NO_COMPU_METHOD 16 0 15 BYTE_ORDER MSB_LAST FIX_AXIS_PAR_DIST 0 1 16 /end AXIS_DESCR
 BYTE_ORDER MSB_LAST SYMBOL_LINK "xGsecCalData" 1856 /end CHARACTERISTIC
/begin CHARACTERISTIC SFR_GSEC "SFR Active Recovery for OBD Diagnosis - GSEC" CURVE 0xFCD932 Lookup1D_UBYTE 0 NO_COMPU_METHOD 0 255
 /begin AXIS_DESCR FIX_AXIS NO_INPUT_QUANTITY NO_COMPU_METHOD 16 0 15 BYTE_ORDER MSB_LAST FIX_AXIS_PAR_DIST 0 1 16 /end AXIS_DESCR
 BYTE_ORDER MSB_LAST SYMBOL_LINK "xGsecCalData" 1872 /end CHARACTERISTIC
/begin CHARACTERISTIC SGM_GSEC "SGM Active Recovery for OBD Diagnosis - GSEC" CURVE 0xFCD422 Lookup1D_UBYTE 0 NO_COMPU_METHOD 0 255
 /begin AXIS_DESCR FIX_AXIS NO_INPUT_QUANTITY NO_COMPU_METHOD 16 0 15 BYTE_ORDER MSB_LAST FIX_AXIS_PAR_DIST 0 1 16 /end AXIS_DESCR
 BYTE_ORDER MSB_LAST SYMBOL_LINK "xGsecCalData" 576 /end CHARACTERISTIC
/begin CHARACTERISTIC SK1_GSEC "SK1 Active Recovery for OBD Diagnosis - GSEC" CURVE 0xFCD6F2 Lookup1D_UBYTE 0 NO_COMPU_METHOD 0 255
 /begin AXIS_DESCR FIX_AXIS NO_INPUT_QUANTITY NO_COMPU_METHOD 16 0 15 BYTE_ORDER MSB_LAST FIX_AXIS_PAR_DIST 0 1 16 /end AXIS_DESCR
 BYTE_ORDER MSB_LAST SYMBOL_LINK "xGsecCalData" 1296 /end CHARACTERISTIC
/begin CHARACTERISTIC SK2_GSEC "SK2 Active Recovery for OBD Diagnosis - GSEC" CURVE 0xFCD702 Lookup1D_UBYTE 0 NO_COMPU_METHOD 0 255
 /begin AXIS_DESCR FIX_AXIS NO_INPUT_QUANTITY NO_COMPU_METHOD 16 0 15 BYTE_ORDER MSB_LAST FIX_AXIS_PAR_DIST 0 1 16 /end AXIS_DESCR
 BYTE_ORDER MSB_LAST SYMBOL_LINK "xGsecCalData" 1312 /end CHARACTERISTIC
/begin CHARACTERISTIC SK3_GSEC "SK3 Active Recovery for OBD Diagnosis - GSEC" CURVE 0xFCD712 Lookup1D_UBYTE 0 NO_COMPU_METHOD 0 255
 /begin AXIS_DESCR FIX_AXIS NO_INPUT_QUANTITY NO_COMPU_METHOD 16 0 15 BYTE_ORDER MSB_LAST FIX_AXIS_PAR_DIST 0 1 16 /end AXIS_DESCR
 BYTE_ORDER MSB_LAST SYMBOL_LINK "xGsecCalData" 1328 /end CHARACTERISTIC
/begin CHARACTERISTIC SK4_GSEC "SK4 Active Recovery for OBD Diagnosis - GSEC" CURVE 0xFCD722 Lookup1D_UBYTE 0 NO_COMPU_METHOD 0 255
 /begin AXIS_DESCR FIX_AXIS NO_INPUT_QUANTITY NO_COMPU_METHOD 16 0 15 BYTE_ORDER MSB_LAST FIX_AXIS_PAR_DIST 0 1 16 /end AXIS_DESCR
 BYTE_ORDER MSB_LAST SYMBOL_LINK "xGsecCalData" 1344 /end CHARACTERISTIC
/begin CHARACTERISTIC SK5_GSEC "SK5 Active Recovery for OBD Diagnosis - GSEC" CURVE 0xFCD732 Lookup1D_UBYTE 0 NO_COMPU_METHOD 0 255
 /begin AXIS_DESCR FIX_AXIS NO_INPUT_QUANTITY NO_COMPU_METHOD 16 0 15 BYTE_ORDER MSB_LAST FIX_AXIS_PAR_DIST 0 1 16 /end AXIS_DESCR
 BYTE_ORDER MSB_LAST SYMBOL_LINK "xGsecCalData" 1360 /end CHARACTERISTIC
/begin CHARACTERISTIC SK6_GSEC "SK6 Active Recovery for OBD Diagnosis - GSEC" CURVE 0xFCD742 Lookup1D_UBYTE 0 NO_COMPU_METHOD 0 255
 /begin AXIS_DESCR FIX_AXIS NO_INPUT_QUANTITY NO_COMPU_METHOD 16 0 15 BYTE_ORDER MSB_LAST FIX_AXIS_PAR_DIST 0 1 16 /end AXIS_DESCR
 BYTE_ORDER MSB_LAST SYMBOL_LINK "xGsecCalData" 1376 /end CHARACTERISTIC
/begin CHARACTERISTIC SK7_GSEC "SK7 Active Recovery for OBD Diagnosis - GSEC" CURVE 0xFCD752 Lookup1D_UBYTE 0 NO_COMPU_METHOD 0 255
 /begin AXIS_DESCR FIX_AXIS NO_INPUT_QUANTITY NO_COMPU_METHOD 16 0 15 BYTE_ORDER MSB_LAST FIX_AXIS_PAR_DIST 0 1 16 /end AXIS_DESCR
 BYTE_ORDER MSB_LAST SYMBOL_LINK "xGsecCalData" 1392 /end CHARACTERISTIC
/begin CHARACTERISTIC SK8_GSEC "SK8 Active Recovery for OBD Diagnosis - GSEC" CURVE 0xFCD762 Lookup1D_UBYTE 0 NO_COMPU_METHOD 0 255
 /begin AXIS_DESCR FIX_AXIS NO_INPUT_QUANTITY NO_COMPU_METHOD 16 0 15 BYTE_ORDER MSB_LAST FIX_AXIS_PAR_DIST 0 1 16 /end AXIS_DESCR
 BYTE_ORDER MSB_LAST SYMBOL_LINK "xGsecCalData" 1408 /end CHARACTERISTIC
/begin CHARACTERISTIC SLO_GSEC "SLO Active Recovery for OBD Diagnosis - GSEC" CURVE 0xFCD8E2 Lookup1D_UBYTE 0 NO_COMPU_METHOD 0 255
 /begin AXIS_DESCR FIX_AXIS NO_INPUT_QUANTITY NO_COMPU_METHOD 16 0 15 BYTE_ORDER MSB_LAST FIX_AXIS_PAR_DIST 0 1 16 /end AXIS_DESCR
 BYTE_ORDER MSB_LAST SYMBOL_LINK "xGsecCalData" 1792 /end CHARACTERISTIC
/begin CHARACTERISTIC SPA_GSEC "SPA Active Recovery for OBD Diagnosis - GSEC" CURVE 0xFCD292 Lookup1D_UBYTE 0 NO_COMPU_METHOD 0 255
 /begin AXIS_DESCR FIX_AXIS NO_INPUT_QUANTITY NO_COMPU_METHOD 16 0 15 BYTE_ORDER MSB_LAST FIX_AXIS_PAR_DIST 0 1 16 /end AXIS_DESCR
 BYTE_ORDER MSB_LAST SYMBOL_LINK "xGsecCalData" 176 /end CHARACTERISTIC
/begin CHARACTERISTIC SPB_GSEC "SPB Active Recovery for OBD Diagnosis - GSEC" CURVE 0xFCD262 Lookup1D_UBYTE 0 NO_COMPU_METHOD 0 255
 /begin AXIS_DESCR FIX_AXIS NO_INPUT_QUANTITY NO_COMPU_METHOD 16 0 15 BYTE_ORDER MSB_LAST FIX_AXIS_PAR_DIST 0 1 16 /end AXIS_DESCR
 BYTE_ORDER MSB_LAST SYMBOL_LINK "xGsecCalData" 128 /end CHARACTERISTIC
/begin CHARACTERISTIC SPEED_GSEC "SPEED Active Recovery for OBD Diagnosis - GSEC" CURVE 0xFCD622 Lookup1D_UBYTE 0 NO_COMPU_METHOD 0 255
 /begin AXIS_DESCR FIX_AXIS NO_INPUT_QUANTITY NO_COMPU_METHOD 16 0 15 BYTE_ORDER MSB_LAST FIX_AXIS_PAR_DIST 0 1 16 /end AXIS_DESCR
 BYTE_ORDER MSB_LAST SYMBOL_LINK "xGsecCalData" 1088 /end CHARACTERISTIC
/begin CHARACTERISTIC SPM2H_GSEC "SPM2H Active Recovery for OBD Diagnosis - GSEC" CURVE 0xFCD862 Lookup1D_UBYTE 0 NO_COMPU_METHOD 0 255
 /begin AXIS_DESCR FIX_AXIS NO_INPUT_QUANTITY NO_COMPU_METHOD 16 0 15 BYTE_ORDER MSB_LAST FIX_AXIS_PAR_DIST 0 1 16 /end AXIS_DESCR
 BYTE_ORDER MSB_LAST SYMBOL_LINK "xGsecCalData" 1664 /end CHARACTERISTIC
/begin CHARACTERISTIC SPMP_GSEC "SPMP Active Recovery for OBD Diagnosis - GSEC" CURVE 0xFCD4A2 Lookup1D_UBYTE 0 NO_COMPU_METHOD 0 255
 /begin AXIS_DESCR FIX_AXIS NO_INPUT_QUANTITY NO_COMPU_METHOD 16 0 15 BYTE_ORDER MSB_LAST FIX_AXIS_PAR_DIST 0 1 16 /end AXIS_DESCR
 BYTE_ORDER MSB_LAST SYMBOL_LINK "xGsecCalData" 704 /end CHARACTERISTIC
/begin CHARACTERISTIC SPM_GSEC "SPM Active Recovery for OBD Diagnosis - GSEC" CURVE 0xFCD252 Lookup1D_UBYTE 0 NO_COMPU_METHOD 0 255
 /begin AXIS_DESCR FIX_AXIS NO_INPUT_QUANTITY NO_COMPU_METHOD 16 0 15 BYTE_ORDER MSB_LAST FIX_AXIS_PAR_DIST 0 1 16 /end AXIS_DESCR
 BYTE_ORDER MSB_LAST SYMBOL_LINK "xGsecCalData" 112 /end CHARACTERISTIC
/begin CHARACTERISTIC SPO_GSEC "SPO Active Recovery for OBD Diagnosis - GSEC" CURVE 0xFCD212 Lookup1D_UBYTE 0 NO_COMPU_METHOD 0 255
 /begin AXIS_DESCR FIX_AXIS NO_INPUT_QUANTITY NO_COMPU_METHOD 16 0 15 BYTE_ORDER MSB_LAST FIX_AXIS_PAR_DIST 0 1 16 /end AXIS_DESCR
 BYTE_ORDER MSB_LAST SYMBOL_LINK "xGsecCalData" 48 /end CHARACTERISTIC
/begin CHARACTERISTIC SPP01_GSEC "SPP01 Active Recovery for OBD Diagnosis - GSEC" CURVE 0xFCD662 Lookup1D_UBYTE 0 NO_COMPU_METHOD 0 255
 /begin AXIS_DESCR FIX_AXIS NO_INPUT_QUANTITY NO_COMPU_METHOD 16 0 15 BYTE_ORDER MSB_LAST FIX_AXIS_PAR_DIST 0 1 16 /end AXIS_DESCR
 BYTE_ORDER MSB_LAST SYMBOL_LINK "xGsecCalData" 1152 /end CHARACTERISTIC
/begin CHARACTERISTIC SPP02_GSEC "SPP02 Active Recovery for OBD Diagnosis - GSEC" CURVE 0xFCD672 Lookup1D_UBYTE 0 NO_COMPU_METHOD 0 255
 /begin AXIS_DESCR FIX_AXIS NO_INPUT_QUANTITY NO_COMPU_METHOD 16 0 15 BYTE_ORDER MSB_LAST FIX_AXIS_PAR_DIST 0 1 16 /end AXIS_DESCR
 BYTE_ORDER MSB_LAST SYMBOL_LINK "xGsecCalData" 1168 /end CHARACTERISTIC
/begin CHARACTERISTIC SPPC1_GSEC "SPPC1 Active Recovery for OBD Diagnosis - GSEC" CURVE 0xFCD692 Lookup1D_UBYTE 0 NO_COMPU_METHOD 0 255
 /begin AXIS_DESCR FIX_AXIS NO_INPUT_QUANTITY NO_COMPU_METHOD 16 0 15 BYTE_ORDER MSB_LAST FIX_AXIS_PAR_DIST 0 1 16 /end AXIS_DESCR
 BYTE_ORDER MSB_LAST SYMBOL_LINK "xGsecCalData" 1200 /end CHARACTERISTIC
/begin CHARACTERISTIC SPPC2_GSEC "SPPC2 Active Recovery for OBD Diagnosis - GSEC" CURVE 0xFCD682 Lookup1D_UBYTE 0 NO_COMPU_METHOD 0 255
 /begin AXIS_DESCR FIX_AXIS NO_INPUT_QUANTITY NO_COMPU_METHOD 16 0 15 BYTE_ORDER MSB_LAST FIX_AXIS_PAR_DIST 0 1 16 /end AXIS_DESCR
 BYTE_ORDER MSB_LAST SYMBOL_LINK "xGsecCalData" 1184 /end CHARACTERISTIC
/begin CHARACTERISTIC SPPCH_GSEC "SPPCH Active Recovery for OBD Diagnosis - GSEC" CURVE 0xFCD6C2 Lookup1D_UBYTE 0 NO_COMPU_METHOD 0 255
 /begin AXIS_DESCR FIX_AXIS NO_INPUT_QUANTITY NO_COMPU_METHOD 16 0 15 BYTE_ORDER MSB_LAST FIX_AXIS_PAR_DIST 0 1 16 /end AXIS_DESCR
 BYTE_ORDER MSB_LAST SYMBOL_LINK "xGsecCalData" 1248 /end CHARACTERISTIC
/begin CHARACTERISTIC SPS_GSEC "SPS Active Recovery for OBD Diagnosis - GSEC" CURVE 0xFCD272 Lookup1D_UBYTE 0 NO_COMPU_METHOD 0 255
 /begin AXIS_DESCR FIX_AXIS NO_INPUT_QUANTITY NO_COMPU_METHOD 16 0 15 BYTE_ORDER MSB_LAST FIX_AXIS_PAR_DIST 0 1 16 /end AXIS_DESCR
 BYTE_ORDER MSB_LAST SYMBOL_LINK "xGsecCalData" 144 /end CHARACTERISTIC
/begin CHARACTERISTIC SPT_GSEC "SPT Active Recovery for OBD Diagnosis - GSEC" CURVE 0xFCD222 Lookup1D_UBYTE 0 NO_COMPU_METHOD 0 255
 /begin AXIS_DESCR FIX_AXIS NO_INPUT_QUANTITY NO_COMPU_METHOD 16 0 15 BYTE_ORDER MSB_LAST FIX_AXIS_PAR_DIST 0 1 16 /end AXIS_DESCR
 BYTE_ORDER MSB_LAST SYMBOL_LINK "xGsecCalData" 64 /end CHARACTERISTIC
/begin CHARACTERISTIC STA_GSEC "STA Active Recovery for OBD Diagnosis - GSEC" CURVE 0xFCD202 Lookup1D_UBYTE 0 NO_COMPU_METHOD 0 255
 /begin AXIS_DESCR FIX_AXIS NO_INPUT_QUANTITY NO_COMPU_METHOD 16 0 15 BYTE_ORDER MSB_LAST FIX_AXIS_PAR_DIST 0 1 16 /end AXIS_DESCR
 BYTE_ORDER MSB_LAST SYMBOL_LINK "xGsecCalData" 32 /end CHARACTERISTIC
/begin CHARACTERISTIC STC1_GSEC "STC1 Active Recovery for OBD Diagnosis - GSEC" CURVE 0xFCD4B2 Lookup1D_UBYTE 0 NO_COMPU_METHOD 0 255
 /begin AXIS_DESCR FIX_AXIS NO_INPUT_QUANTITY NO_COMPU_METHOD 16 0 15 BYTE_ORDER MSB_LAST FIX_AXIS_PAR_DIST 0 1 16 /end AXIS_DESCR
 BYTE_ORDER MSB_LAST SYMBOL_LINK "xGsecCalData" 720 /end CHARACTERISTIC
/begin CHARACTERISTIC STC2_GSEC "STC2 Active Recovery for OBD Diagnosis - GSEC" CURVE 0xFCD4C2 Lookup1D_UBYTE 0 NO_COMPU_METHOD 0 255
 /begin AXIS_DESCR FIX_AXIS NO_INPUT_QUANTITY NO_COMPU_METHOD 16 0 15 BYTE_ORDER MSB_LAST FIX_AXIS_PAR_DIST 0 1 16 /end AXIS_DESCR
 BYTE_ORDER MSB_LAST SYMBOL_LINK "xGsecCalData" 736 /end CHARACTERISTIC
/begin CHARACTERISTIC STC3_GSEC "STC3 Active Recovery for OBD Diagnosis - GSEC" CURVE 0xFCD8D2 Lookup1D_UBYTE 0 NO_COMPU_METHOD 0 255
 /begin AXIS_DESCR FIX_AXIS NO_INPUT_QUANTITY NO_COMPU_METHOD 16 0 15 BYTE_ORDER MSB_LAST FIX_AXIS_PAR_DIST 0 1 16 /end AXIS_DESCR
 BYTE_ORDER MSB_LAST SYMBOL_LINK "xGsecCalData" 1776 /end CHARACTERISTIC
/begin CHARACTERISTIC STC_GSEC "STC Active Recovery for OBD Diagnosis - GSEC" CURVE 0xFCD242 Lookup1D_UBYTE 0 NO_COMPU_METHOD 0 255
 /begin AXIS_DESCR FIX_AXIS NO_INPUT_QUANTITY NO_COMPU_METHOD 16 0 15 BYTE_ORDER MSB_LAST FIX_AXIS_PAR_DIST 0 1 16 /end AXIS_DESCR
 BYTE_ORDER MSB_LAST SYMBOL_LINK "xGsecCalData" 96 /end CHARACTERISTIC
/begin CHARACTERISTIC STE_GSEC "STE Active Recovery for OBD Diagnosis - GSEC" CURVE 0xFCD7A2 Lookup1D_UBYTE 0 NO_COMPU_METHOD 0 255
 /begin AXIS_DESCR FIX_AXIS NO_INPUT_QUANTITY NO_COMPU_METHOD 16 0 15 BYTE_ORDER MSB_LAST FIX_AXIS_PAR_DIST 0 1 16 /end AXIS_DESCR
 BYTE_ORDER MSB_LAST SYMBOL_LINK "xGsecCalData" 1472 /end CHARACTERISTIC
/begin CHARACTERISTIC STH_GSEC "STH Active Recovery for OBD Diagnosis - GSEC" CURVE 0xFCD1E2 Lookup1D_UBYTE 0 NO_COMPU_METHOD 0 255
 /begin AXIS_DESCR FIX_AXIS NO_INPUT_QUANTITY NO_COMPU_METHOD 16 0 15 BYTE_ORDER MSB_LAST FIX_AXIS_PAR_DIST 0 1 16 /end AXIS_DESCR
 BYTE_ORDER MSB_LAST SYMBOL_LINK "xGsecCalData" 0 /end CHARACTERISTIC
/begin CHARACTERISTIC STM_GSEC "STM Active Recovery for OBD Diagnosis - GSEC" CURVE 0xFCD232 Lookup1D_UBYTE 0 NO_COMPU_METHOD 0 255
 /begin AXIS_DESCR FIX_AXIS NO_INPUT_QUANTITY NO_COMPU_METHOD 16 0 15 BYTE_ORDER MSB_LAST FIX_AXIS_PAR_DIST 0 1 16 /end AXIS_DESCR
 BYTE_ORDER MSB_LAST SYMBOL_LINK "xGsecCalData" 80 /end CHARACTERISTIC
/begin CHARACTERISTIC STOH_GSEC "STOH Active Recovery for OBD Diagnosis - GSEC" CURVE 0xFCD9C2 Lookup1D_UBYTE 0 NO_COMPU_METHOD 0 255
 /begin AXIS_DESCR FIX_AXIS NO_INPUT_QUANTITY NO_COMPU_METHOD 16 0 15 BYTE_ORDER MSB_LAST FIX_AXIS_PAR_DIST 0 1 16 /end AXIS_DESCR
 BYTE_ORDER MSB_LAST SYMBOL_LINK "xGsecCalData" 2016 /end CHARACTERISTIC
/begin CHARACTERISTIC STO_GSEC "STO Active Recovery for OBD Diagnosis - GSEC" CURVE 0xFCD1F2 Lookup1D_UBYTE 0 NO_COMPU_METHOD 0 255
 /begin AXIS_DESCR FIX_AXIS NO_INPUT_QUANTITY NO_COMPU_METHOD 16 0 15 BYTE_ORDER MSB_LAST FIX_AXIS_PAR_DIST 0 1 16 /end AXIS_DESCR
 BYTE_ORDER MSB_LAST SYMBOL_LINK "xGsecCalData" 16 /end CHARACTERISTIC
/begin CHARACTERISTIC STRCGNDOL_GSEC "STRCGNDOL Active Recovery for OBD Diagnosis - GSEC" CURVE 0xFCD642 Lookup1D_UBYTE 0 NO_COMPU_METHOD 0 255
 /begin AXIS_DESCR FIX_AXIS NO_INPUT_QUANTITY NO_COMPU_METHOD 16 0 15 BYTE_ORDER MSB_LAST FIX_AXIS_PAR_DIST 0 1 16 /end AXIS_DESCR
 BYTE_ORDER MSB_LAST SYMBOL_LINK "xGsecCalData" 1120 /end CHARACTERISTIC
/begin CHARACTERISTIC STRCVB_GSEC "STRCVB Active Recovery for OBD Diagnosis - GSEC" CURVE 0xFCD652 Lookup1D_UBYTE 0 NO_COMPU_METHOD 0 255
 /begin AXIS_DESCR FIX_AXIS NO_INPUT_QUANTITY NO_COMPU_METHOD 16 0 15 BYTE_ORDER MSB_LAST FIX_AXIS_PAR_DIST 0 1 16 /end AXIS_DESCR
 BYTE_ORDER MSB_LAST SYMBOL_LINK "xGsecCalData" 1136 /end CHARACTERISTIC
/begin CHARACTERISTIC STX_GSEC "STX Active Recovery for OBD Diagnosis - GSEC" CURVE 0xFCD7C2 Lookup1D_UBYTE 0 NO_COMPU_METHOD 0 255
 /begin AXIS_DESCR FIX_AXIS NO_INPUT_QUANTITY NO_COMPU_METHOD 16 0 15 BYTE_ORDER MSB_LAST FIX_AXIS_PAR_DIST 0 1 16 /end AXIS_DESCR
 BYTE_ORDER MSB_LAST SYMBOL_LINK "xGsecCalData" 1504 /end CHARACTERISTIC
/begin CHARACTERISTIC SUO_GSEC "SUO Active Recovery for OBD Diagnosis - GSEC" CURVE 0xFCD6C2 Lookup1D_UBYTE 0 NO_COMPU_METHOD 0 255
 /begin AXIS_DESCR FIX_AXIS NO_INPUT_QUANTITY NO_COMPU_METHOD 16 0 15 BYTE_ORDER MSB_LAST FIX_AXIS_PAR_DIST 0 1 16 /end AXIS_DESCR
 BYTE_ORDER MSB_LAST SYMBOL_LINK "xGsecCalData" 1248 /end CHARACTERISTIC
/begin CHARACTERISTIC TE2H_GSEC "TE2H Active Recovery for OBD Diagnosis - GSEC" CURVE 0xFCD7B2 Lookup1D_UBYTE 0 NO_COMPU_METHOD 0 255
 /begin AXIS_DESCR FIX_AXIS NO_INPUT_QUANTITY NO_COMPU_METHOD 16 0 15 BYTE_ORDER MSB_LAST FIX_AXIS_PAR_DIST 0 1 16 /end AXIS_DESCR
 BYTE_ORDER MSB_LAST SYMBOL_LINK "xGsecCalData" 1488 /end CHARACTERISTIC
/begin CHARACTERISTIC TH2H_GSEC "TH2H Active Recovery for OBD Diagnosis - GSEC" CURVE 0xFCD5F2 Lookup1D_UBYTE 0 NO_COMPU_METHOD 0 255
 /begin AXIS_DESCR FIX_AXIS NO_INPUT_QUANTITY NO_COMPU_METHOD 16 0 15 BYTE_ORDER MSB_LAST FIX_AXIS_PAR_DIST 0 1 16 /end AXIS_DESCR
 BYTE_ORDER MSB_LAST SYMBOL_LINK "xGsecCalData" 1040 /end CHARACTERISTIC
/begin CHARACTERISTIC THRCGND_GSEC "THRCGND Active Recovery for OBD Diagnosis - GSEC" CURVE 0xFCD572 Lookup1D_UBYTE 0 NO_COMPU_METHOD 0 255
 /begin AXIS_DESCR FIX_AXIS NO_INPUT_QUANTITY NO_COMPU_METHOD 16 0 15 BYTE_ORDER MSB_LAST FIX_AXIS_PAR_DIST 0 1 16 /end AXIS_DESCR
 BYTE_ORDER MSB_LAST SYMBOL_LINK "xGsecCalData" 912 /end CHARACTERISTIC
/begin CHARACTERISTIC THRCVB_GSEC "FARCVB Active Recovery for OBD Diagnosis - GSEC" CURVE 0xFCD562 Lookup1D_UBYTE 0 NO_COMPU_METHOD 0 255
 /begin AXIS_DESCR FIX_AXIS NO_INPUT_QUANTITY NO_COMPU_METHOD 16 0 15 BYTE_ORDER MSB_LAST FIX_AXIS_PAR_DIST 0 1 16 /end AXIS_DESCR
 BYTE_ORDER MSB_LAST SYMBOL_LINK "xGsecCalData" 896 /end CHARACTERISTIC
/begin CHARACTERISTIC THRDR_GSEC "THRDR Active Recovery for OBD Diagnosis - GSEC" CURVE 0xFCD632 Lookup1D_UBYTE 0 NO_COMPU_METHOD 0 255
 /begin AXIS_DESCR FIX_AXIS NO_INPUT_QUANTITY NO_COMPU_METHOD 16 0 15 BYTE_ORDER MSB_LAST FIX_AXIS_PAR_DIST 0 1 16 /end AXIS_DESCR
 BYTE_ORDER MSB_LAST SYMBOL_LINK "xGsecCalData" 1104 /end CHARACTERISTIC
/begin CHARACTERISTIC THRST_GSEC "THRST Active Recovery for OBD Diagnosis - GSEC" CURVE 0xFCD612 Lookup1D_UBYTE 0 NO_COMPU_METHOD 0 255
 /begin AXIS_DESCR FIX_AXIS NO_INPUT_QUANTITY NO_COMPU_METHOD 16 0 15 BYTE_ORDER MSB_LAST FIX_AXIS_PAR_DIST 0 1 16 /end AXIS_DESCR
 BYTE_ORDER MSB_LAST SYMBOL_LINK "xGsecCalData" 1072 /end CHARACTERISTIC
/begin CHARACTERISTIC UDP_GSEC "UDP Active Recovery for OBD Diagnosis - GSEC" CURVE 0xFCD6D2 Lookup1D_UBYTE 0 NO_COMPU_METHOD 0 255
 /begin AXIS_DESCR FIX_AXIS NO_INPUT_QUANTITY NO_COMPU_METHOD 16 0 15 BYTE_ORDER MSB_LAST FIX_AXIS_PAR_DIST 0 1 16 /end AXIS_DESCR
 BYTE_ORDER MSB_LAST SYMBOL_LINK "xGsecCalData" 1264 /end CHARACTERISTIC
/begin CHARACTERISTIC UHR_GSEC "UHR Active Recovery for OBD Diagnosis - GSEC" CURVE 0xFCD6E2 Lookup1D_UBYTE 0 NO_COMPU_METHOD 0 255
 /begin AXIS_DESCR FIX_AXIS NO_INPUT_QUANTITY NO_COMPU_METHOD 16 0 15 BYTE_ORDER MSB_LAST FIX_AXIS_PAR_DIST 0 1 16 /end AXIS_DESCR
 BYTE_ORDER MSB_LAST SYMBOL_LINK "xGsecCalData" 1280 /end CHARACTERISTIC
/begin CHARACTERISTIC VBP_GSEC "VBP Active Recovery for OBD Diagnosis - GSEC" CURVE 0xFCD2B2 Lookup1D_UBYTE 0 NO_COMPU_METHOD 0 255
 /begin AXIS_DESCR FIX_AXIS NO_INPUT_QUANTITY NO_COMPU_METHOD 16 0 15 BYTE_ORDER MSB_LAST FIX_AXIS_PAR_DIST 0 1 16 /end AXIS_DESCR
 BYTE_ORDER MSB_LAST SYMBOL_LINK "xGsecCalData" 208 /end CHARACTERISTIC
/begin CHARACTERISTIC VS1_GSEC "VS1 Active Recovery for OBD Diagnosis - GSEC" CURVE 0xFCD4D2 Lookup1D_UBYTE 0 NO_COMPU_METHOD 0 255
 /begin AXIS_DESCR FIX_AXIS NO_INPUT_QUANTITY NO_COMPU_METHOD 16 0 15 BYTE_ORDER MSB_LAST FIX_AXIS_PAR_DIST 0 1 16 /end AXIS_DESCR
 BYTE_ORDER MSB_LAST SYMBOL_LINK "xGsecCalData" 752 /end CHARACTERISTIC
/begin CHARACTERISTIC VS2_GSEC "VS2 Active Recovery for OBD Diagnosis - GSEC" CURVE 0xFCD4E2 Lookup1D_UBYTE 0 NO_COMPU_METHOD 0 255
 /begin AXIS_DESCR FIX_AXIS NO_INPUT_QUANTITY NO_COMPU_METHOD 16 0 15 BYTE_ORDER MSB_LAST FIX_AXIS_PAR_DIST 0 1 16 /end AXIS_DESCR
 BYTE_ORDER MSB_LAST SYMBOL_LINK "xGsecCalData" 768 /end CHARACTERISTIC
/begin CHARACTERISTIC VS3_GSEC "VS3 Active Recovery for OBD Diagnosis - GSEC" CURVE 0xFCD4F2 Lookup1D_UBYTE 0 NO_COMPU_METHOD 0 255
 /begin AXIS_DESCR FIX_AXIS NO_INPUT_QUANTITY NO_COMPU_METHOD 16 0 15 BYTE_ORDER MSB_LAST FIX_AXIS_PAR_DIST 0 1 16 /end AXIS_DESCR
 BYTE_ORDER MSB_LAST SYMBOL_LINK "xGsecCalData" 784 /end CHARACTERISTIC
/begin CHARACTERISTIC VSS_GSEC "VSS Active Recovery for OBD Diagnosis - GSEC" CURVE 0xFCD9A2 Lookup1D_UBYTE 0 NO_COMPU_METHOD 0 255
 /begin AXIS_DESCR FIX_AXIS NO_INPUT_QUANTITY NO_COMPU_METHOD 16 0 15 BYTE_ORDER MSB_LAST FIX_AXIS_PAR_DIST 0 1 16 /end AXIS_DESCR
 BYTE_ORDER MSB_LAST SYMBOL_LINK "xGsecCalData" 1984 /end CHARACTERISTIC
/begin CHARACTERISTIC WGT_GSEC "WGT Active Recovery for OBD Diagnosis - GSEC" CURVE 0xFCD2C2 Lookup1D_UBYTE 0 NO_COMPU_METHOD 0 255
 /begin AXIS_DESCR FIX_AXIS NO_INPUT_QUANTITY NO_COMPU_METHOD 16 0 15 BYTE_ORDER MSB_LAST FIX_AXIS_PAR_DIST 0 1 16 /end AXIS_DESCR
 BYTE_ORDER MSB_LAST SYMBOL_LINK "xGsecCalData" 224 /end CHARACTERISTIC
/begin CHARACTERISTIC WRNL_GSEC "WRNL Active Recovery for OBD Diagnosis - GSEC" CURVE 0xFCD772 Lookup1D_UBYTE 0 NO_COMPU_METHOD 0 255
 /begin AXIS_DESCR FIX_AXIS NO_INPUT_QUANTITY NO_COMPU_METHOD 16 0 15 BYTE_ORDER MSB_LAST FIX_AXIS_PAR_DIST 0 1 16 /end AXIS_DESCR
 BYTE_ORDER MSB_LAST SYMBOL_LINK "xGsecCalData" 1424 /end CHARACTERISTIC
/begin MEASUREMENT xsCnt1secLstAc "Contatore di task 1 sec. a partire da precedente memorizzazione in classi della temperatura ECU" UWORD EcuTempUsageMap1s_CM_uint16_adm 0 0 0 65000 ECU_ADDRESS 0x40002A94 /end MEASUREMENT
/begin MEASUREMENT xsEVRel "CNG electrovalves relay command from the control" UBYTE Evrc4ms_CM_boolean_adm 0 0 0 1 ECU_ADDRESS 0x40002DE7 /end MEASUREMENT
/begin MEASUREMENT xsEcuTCnt1 "Numero di occorrenze nella prima classe di temperatura" ULONG Ecut1s_CM_uint32_adm 0 0 0 65000 ECU_ADDRESS 0x40002A58 /end MEASUREMENT
/begin MEASUREMENT xsEcuTCnt2 "Numero di occorrenze nella seconda classe di temperatura" ULONG Ecut1s_CM_uint32_adm 0 0 0 65000 ECU_ADDRESS 0x40002A54 /end MEASUREMENT
/begin MEASUREMENT xsEcuTCnt3 "Numero di occorrenze nella terza classe di temperatura" ULONG Ecut1s_CM_uint32_adm 0 0 0 65000 ECU_ADDRESS 0x40002A50 /end MEASUREMENT
/begin MEASUREMENT xsEcuTCnt4 "Numero di occorrenze nella quarta classe di temperatura" ULONG Ecut1s_CM_uint32_adm 0 0 0 65000 ECU_ADDRESS 0x40002A4C /end MEASUREMENT
/begin MEASUREMENT xsEcuTCnt5 "Numero di occorenze nella quinta classe di temperatura" ULONG Ecut1s_CM_uint32_adm 0 0 0 65000 ECU_ADDRESS 0x40002A48 /end MEASUREMENT
/begin MEASUREMENT xsEcuTCnt6 "Numero di occorrenze nella sesta classe di temperatura" ULONG Ecut1s_CM_uint32_adm 0 0 0 65000 ECU_ADDRESS 0x40002A44 /end MEASUREMENT
/begin MEASUREMENT xsEcuTCnt7 "Numero di occorrenze nella settima classe di temperatura" ULONG Ecut1s_CM_uint32_adm 0 0 0 65000 ECU_ADDRESS 0x40002A40 /end MEASUREMENT
/begin MEASUREMENT xsEcuTCnt8 "Numero di occorenze nella ottava classe di temperatura" ULONG Ecut1s_CM_uint32_adm 0 0 0 65000 ECU_ADDRESS 0x40002A3C /end MEASUREMENT
/begin CHARACTERISTIC xsNUM_1SEC_BTW_M "Numero di task 1 sec. che definiscono intervallo temporale fra una memorizzazione e la seguente della temperatura di ECU (10 equivale a 10 secondi)" VALUE 0xFC4CFE Scalar_UWORD 0 EcuTempUsageMap1s_CM_uint16_adm 2 36000 /end CHARACTERISTIC
/begin MEASUREMENT xsPRVCmd "CNG pressure reducing valve command from the control" UBYTE Prvc4ms_CM_boolean_adm 0 0 0 1 ECU_ADDRESS 0x40003FE2 /end MEASUREMENT
/begin CHARACTERISTIC xsSGL_ECUT1 "Soglia di temperatura che definisce la prima classe di temperature" VALUE 0xFC4CFC Scalar_UWORD 0 EcuTempUsageMap1s_CM_ufix16_Bn40_degC -40 150 /end CHARACTERISTIC
/begin CHARACTERISTIC xsSGL_ECUT2 "Soglia di temperatura che definisce la seconda classe di temperature" VALUE 0xFC4CFA Scalar_UWORD 0 EcuTempUsageMap1s_CM_ufix16_Bn40_degC -40 150 /end CHARACTERISTIC
/begin CHARACTERISTIC xsSGL_ECUT3 "Soglia di temperatura che definisce la terza classe di temperature" VALUE 0xFC4CF8 Scalar_UWORD 0 EcuTempUsageMap1s_CM_ufix16_Bn40_degC -40 150 /end CHARACTERISTIC
/begin CHARACTERISTIC xsSGL_ECUT4 "Soglia di temperatura che definisce la quarta classe di temperature" VALUE 0xFC4CF6 Scalar_UWORD 0 EcuTempUsageMap1s_CM_ufix16_Bn40_degC -40 150 /end CHARACTERISTIC
/begin CHARACTERISTIC xsSGL_ECUT5 "Soglia di temperatura che definisce la quinta classe di temperature" VALUE 0xFC4CF4 Scalar_UWORD 0 EcuTempUsageMap1s_CM_ufix16_Bn40_degC -40 150 /end CHARACTERISTIC
/begin CHARACTERISTIC xsSGL_ECUT6 "Soglia di temperatura che definisce la sesta classe di temperature" VALUE 0xFC4CF2 Scalar_UWORD 0 EcuTempUsageMap1s_CM_ufix16_Bn40_degC -40 150 /end CHARACTERISTIC
/begin CHARACTERISTIC xsSGL_ECUT7 "Soglia di temperatura che definisce la settima e la ottava classe di temperature" VALUE 0xFC4CF0 Scalar_UWORD 0 EcuTempUsageMap1s_CM_ufix16_Bn40_degC -40 150 /end CHARACTERISTIC
/begin CHARACTERISTIC yfCODE_LAMP_Enable "[FIX] Enable Fix for Code Lamp Status" VALUE 0xFC9C91 Scalar_UBYTE 0 ADIALampMgm100ms_CM_FixEnableT 171 218 /end CHARACTERISTIC
/begin CHARACTERISTIC yfCODE_LAMP_Value "[FIX] Fix for Code Lamp Status" VALUE 0xFC9C90 Scalar_UBYTE 0 ADIALampMgm100ms_CM_uint8_adm 0 3 /end CHARACTERISTIC
/begin CHARACTERISTIC yfHIGHRPM_LAMP_Enable "[FIX] Enable Fix for High Engine Speed" VALUE 0xFC9C8F Scalar_UBYTE 0 LampMgm100ms_CM_FixEnableT 171 218 /end CHARACTERISTIC
/begin CHARACTERISTIC yfHIGHRPM_LAMP_Value "[FIX] Fix for High Engine Speed" VALUE 0xFC9C8E Scalar_BOOLEAN 0 LampMgm100ms_CM_boolean_adm 0 1 /end CHARACTERISTIC
/begin CHARACTERISTIC yfIMMO_LAMP_Enable "[FIX] Enable Fix for Immobilizer Lamp Status" VALUE 0xFC9C8D Scalar_UBYTE 0 ADIALampMgm100ms_CM_FixEnableT 171 218 /end CHARACTERISTIC
/begin CHARACTERISTIC yfIMMO_LAMP_Value "[FIX] Fix for Immobilizer Lamp Status" VALUE 0xFC9C8C Scalar_UBYTE 0 ADIALampMgm100ms_CM_uint8_adm 0 3 /end CHARACTERISTIC
/begin CHARACTERISTIC yfLOW_BATT_Enable "[FIX] Enable for Low Battery Voltage" VALUE 0xFC9C8B Scalar_UBYTE 0 LampMgm100ms_CM_FixEnableT 171 218 /end CHARACTERISTIC
/begin CHARACTERISTIC yfLOW_BATT_Value "[FIX] Fix for Low Battery Voltage" VALUE 0xFC9C8A Scalar_BOOLEAN 0 LampMgm100ms_CM_boolean_adm 0 1 /end CHARACTERISTIC
/begin CHARACTERISTIC yfLOW_OIL_Enable "[FIX] Enable for Engine Oil Low Level" VALUE 0xFC9C89 Scalar_UBYTE 0 LampMgm100ms_CM_FixEnableT 171 218 /end CHARACTERISTIC
/begin CHARACTERISTIC yfLOW_OIL_Value "[FIX] Fix for Engine Oil Low Level" VALUE 0xFC9C88 Scalar_BOOLEAN 0 LampMgm100ms_CM_boolean_adm 0 1 /end CHARACTERISTIC
/begin CHARACTERISTIC yfMIL_LAMP_Enable "[FIX] Enable Fix for Mil Lamp Status" VALUE 0xFC9C87 Scalar_UBYTE 0 ADIALampMgm100ms_CM_FixEnableT 171 218 /end CHARACTERISTIC
/begin CHARACTERISTIC yfMIL_LAMP_Value "[FIX] Fix for MIL Lamp Status" VALUE 0xFC9C86 Scalar_UBYTE 0 ADIALampMgm100ms_CM_uint8_adm 0 3 /end CHARACTERISTIC
/begin CHARACTERISTIC yfRED_LAMP_Enable "[FIX] Enable Fix for Red Lamp Status" VALUE 0xFC9C85 Scalar_UBYTE 0 ADIALampMgm100ms_CM_FixEnableT 171 218 /end CHARACTERISTIC
/begin CHARACTERISTIC yfRED_LAMP_Value "[FIX] Fix for Red Lamp Status" VALUE 0xFC9C84 Scalar_UBYTE 0 ADIALampMgm100ms_CM_uint8_adm 0 3 /end CHARACTERISTIC
/begin CHARACTERISTIC yfTH2O_HIGH_Enable "[FIX] Enable for Engine Coolant High Temperature" VALUE 0xFC9C83 Scalar_UBYTE 0 LampMgm100ms_CM_FixEnableT 171 218 /end CHARACTERISTIC
/begin CHARACTERISTIC yfTH2O_HIGH_Value "[FIX] Fix for Engine Coolant High Temperature" VALUE 0xFC9C82 Scalar_BOOLEAN 0 LampMgm100ms_CM_boolean_adm 0 1 /end CHARACTERISTIC
/begin CHARACTERISTIC yfTH2O_LAMP_Enable "[FIX] Enable Fix for Th2o Lamp Status" VALUE 0xFC9C81 Scalar_UBYTE 0 ADIALampMgm100ms_CM_FixEnableT 171 218 /end CHARACTERISTIC
/begin CHARACTERISTIC yfTH2O_LAMP_Value "[FIX] Fix for TH2O Lamp Status" VALUE 0xFC9C80 Scalar_UBYTE 0 ADIALampMgm100ms_CM_uint8_adm 0 3 /end CHARACTERISTIC
/begin CHARACTERISTIC yfVERYHIGHRPM_LAMP_Enable "[FIX] Enable Fix for Very High Engine Speed" VALUE 0xFC9C7F Scalar_UBYTE 0 LampMgm100ms_CM_FixEnableT 171 218 /end CHARACTERISTIC
/begin CHARACTERISTIC yfVERYHIGHRPM_LAMP_Value "[FIX] Fix for Very High Engine Speed" VALUE 0xFC9C7E Scalar_BOOLEAN 0 LampMgm100ms_CM_boolean_adm 0 1 /end CHARACTERISTIC
/begin CHARACTERISTIC yfWRN_LAMP_Enable "[FIX] Enable Fix for Warning Lamp Status" VALUE 0xFC9C7D Scalar_UBYTE 0 ADIALampMgm100ms_CM_FixEnableT 171 218 /end CHARACTERISTIC
/begin CHARACTERISTIC yfWRN_LAMP_Value "[FIX] Fix for Warning Lamp Status" VALUE 0xFC9C7C Scalar_UBYTE 0 ADIALampMgm100ms_CM_uint8_adm 0 3 /end CHARACTERISTIC
/begin MEASUREMENT ysAllLampOn "Condition to enable lamp switch on at power on " UBYTE ADIALampMgm100ms_CM_boolean_adm 0 0 0 1 ECU_ADDRESS 0x40003772 /end MEASUREMENT
/begin MEASUREMENT ysCODELCmd "Code Lamp Command" UBYTE Lamp100ms_CM_boolean_adm 0 0 0 1 ECU_ADDRESS 0x40003762 /end MEASUREMENT
/begin MEASUREMENT ysHIGHRPMCmd "High Engine Speed Lamp Command" UBYTE J1939dl_Tx1s_CM_boolean_adm 0 0 0 1 ECU_ADDRESS 0x4000375E /end MEASUREMENT
/begin CHARACTERISTIC ysHIGH_ENG_SPEED "Upper rpm threshold to set ON the lamp indicator for High Engine Speed." VALUE 0xFC9C7A Scalar_UWORD 0 LampMgm100ms_CM_uint16_rpm 0 10000 /end CHARACTERISTIC
/begin CHARACTERISTIC ysHIGH_ENG_SPEED_TIME "Time to wait before to set ON the lamp indicator for High Engine Speed when threspassing the rpm threshold." VALUE 0xFC9C78 Scalar_UWORD 0 LampMgm100ms_CM_ufix16_Sp1_s 0 255 /end CHARACTERISTIC
/begin MEASUREMENT ysIMMOLCmd "Immobilizer Lamp command" UBYTE Lamp100ms_CM_boolean_adm 0 0 0 1 ECU_ADDRESS 0x40003763 /end MEASUREMENT
/begin CHARACTERISTIC ysLAMPON_PWON_TIMER "Timer to force the lamps to switch on at power on" VALUE 0xFC9C76 Scalar_UWORD 0 ADIALampMgm100ms_CM_ufix16_Sp1_s 0 255 /end CHARACTERISTIC
/begin MEASUREMENT ysLOWBATTCmd "Low Battery Voltage Lamp Command" UBYTE J1939dl_Tx1s_CM_boolean_adm 0 0 0 1 ECU_ADDRESS 0x4000375A /end MEASUREMENT
/begin MEASUREMENT ysLOWOILCmd "Low Level Engine Oil Lamp Command" UBYTE J1939dl_Tx1s_CM_boolean_adm 0 0 0 1 ECU_ADDRESS 0x4000375C /end MEASUREMENT
/begin CHARACTERISTIC ysLOW_BATT "Voltage threshold to set ON the lamp indicator for Low Battery Voltage." VALUE 0xFC9C74 Scalar_UWORD 0 LampMgm100ms_CM_ufix16_S50_mV 50 50000 /end CHARACTERISTIC
/begin CHARACTERISTIC ysLOW_BATT_TIME "Time to wait before to set ON the lamp indicator for Low Battery Voltage when threspassing the threshold." VALUE 0xFC9C72 Scalar_UWORD 0 LampMgm100ms_CM_ufix16_Sp1_s 0 255 /end CHARACTERISTIC
/begin CHARACTERISTIC ysLOW_OIL "Threshold to set ON the lamp indicator for Low Engine Oil Pressure." VALUE 0xFC9C70 Scalar_UWORD 0 LampMgm100ms_CM_uint16_mbar 250 6000 /end CHARACTERISTIC
/begin CHARACTERISTIC ysLOW_OIL_TIME "Time to wait before to set ON the lamp indicator for Low Engine Oil Pressure when threspassing the threshold." VALUE 0xFC9C6E Scalar_UWORD 0 LampMgm100ms_CM_ufix16_Sp1_s 0 255 /end CHARACTERISTIC
/begin MEASUREMENT ysMILCmd "MIL Command" UBYTE J1939dl_Tx1s_CM_boolean_adm 0 0 0 1 ECU_ADDRESS 0x40003765 /end MEASUREMENT
/begin MEASUREMENT ysREDLCmd "RED Lamp command" UBYTE J1939dl_Tx1s_CM_boolean_adm 0 0 0 1 ECU_ADDRESS 0x40003766 /end MEASUREMENT
/begin CHARACTERISTIC ysRPM_LAMP_THR "Soglia superiore di giri all avviamento per terminare il test delle lampade" VALUE 0xFC9C6C Scalar_UWORD 0 ADIALampMgm100ms_CM_uint16_rpm 0 10000 /end CHARACTERISTIC
/begin MEASUREMENT ysTH2OHIGHCmd "High Coolant Temperature Lamp Command" UBYTE J1939dl_Tx1s_CM_boolean_adm 0 0 0 1 ECU_ADDRESS 0x4000375B /end MEASUREMENT
/begin MEASUREMENT ysTH2OLCmd "Th2o Lamp Command" UBYTE J1939dl_Tx1s_CM_boolean_adm 0 0 0 1 ECU_ADDRESS 0x40003764 /end MEASUREMENT
/begin CHARACTERISTIC ysTH2O_HIGH "Threshold to set ON the lamp indicator for High Engine Coolant Temperature." VALUE 0xFC9C6A Scalar_UWORD 0 LampMgm100ms_CM_ufix16_Bn40_degC -40 140 /end CHARACTERISTIC
/begin CHARACTERISTIC ysTH2O_HIGH_TIME "Time to wait before to set ON the lamp indicator for High Engine Coolant temperature when threspassing the threshold." VALUE 0xFC9C68 Scalar_UWORD 0 LampMgm100ms_CM_ufix16_Sp1_s 0 255 /end CHARACTERISTIC
/begin MEASUREMENT ysVERYHIGHRPMCmd "High Engine Speed Lamp Command" UBYTE J1939dl_Tx1s_CM_boolean_adm 0 0 0 1 ECU_ADDRESS 0x4000375D /end MEASUREMENT
/begin CHARACTERISTIC ysVERY_HIGH_ENG_SPEED "Upper rpm threshold to set ON the lamp indicator for Very High Engine Speed." VALUE 0xFC9C66 Scalar_UWORD 0 LampMgm100ms_CM_uint16_rpm 0 10000 /end CHARACTERISTIC
/begin CHARACTERISTIC ysVERY_HIGH_ENG_SPEED_TIME "Time to wait before to set ON the lamp indicator for Very High Engine Speed when threspassing the rpm threshold." VALUE 0xFC9C64 Scalar_UWORD 0 LampMgm100ms_CM_ufix16_Sp1_s 0 255 /end CHARACTERISTIC
/begin MEASUREMENT ysWRNLCmd "Warning Lamp Command" UBYTE J1939dl_Tx1s_CM_boolean_adm 0 0 0 1 ECU_ADDRESS 0x40003767 /end MEASUREMENT
/begin CHARACTERISTIC zfABS_POT_THR "[FIX] Fix sulla posizione percentuale assoluta potenziometri farfalla" VALUE 0xFCB496 Scalar_UWORD 0 TE_TM_PotThrSens4ms_Symbol_CM_ufix8_Sp392__ 0 99.96 /end CHARACTERISTIC
/begin CHARACTERISTIC zfABS_POT_THR_EnFix "[FIX] Fix sulla posizione percentuale assoluta potenziometri farfalla" VALUE 0xFCB494 Scalar_UWORD 0 TE_TM_PotThrSens4ms_Symbol_CM_FixEnableT 171 218 /end CHARACTERISTIC
/begin CHARACTERISTIC zfAIR_CND_REQ "[FIX] Fix Air Cond Req (1 -> Request On, 0 -> Request Off)" VALUE 0xFC4CA2 Scalar_UWORD 0 DigInput4ms_Symbol_CM_boolean_adm 0 1 /end CHARACTERISTIC
/begin CHARACTERISTIC zfAIR_CND_REQ_EnFix "[FIX] Fix Air Cond Req (1 -> Request On, 0 -> Request Off)" VALUE 0xFC4CA0 Scalar_UWORD 0 DigInput4ms_Symbol_CM_FixEnableT 171 218 /end CHARACTERISTIC
/begin CHARACTERISTIC zfBRAKE_PED1_Enable "[FIX] Fix Brake Ped 1 (1 -> Request On, 0 -> Request Off)" VALUE 0xFC4C78 Scalar_UBYTE 0 TF_TE_DigInput4ms_CM_FixEnableT 171 218 /end CHARACTERISTIC
/begin CHARACTERISTIC zfBRAKE_PED1_Value "[FIX] Fix Brake Ped 1 (1 -> Request On, 0 -> Request Off)" VALUE 0xFC4C77 Scalar_BOOLEAN 0 TF_TE_DigInput4ms_CM_boolean_adm 0 1 /end CHARACTERISTIC
/begin CHARACTERISTIC zfBRAKE_PED2_Enable "[FIX] Fix Brake Ped 2 (1 -> Request On, 0 -> Request Off)" VALUE 0xFC4C76 Scalar_UBYTE 0 TF_TE_DigInput4ms_CM_FixEnableT 171 218 /end CHARACTERISTIC
/begin CHARACTERISTIC zfBRAKE_PED2_Value "[FIX] Fix Brake Ped 2 (1 -> Request On, 0 -> Request Off)" VALUE 0xFC4C75 Scalar_BOOLEAN 0 TF_TE_DigInput4ms_CM_boolean_adm 0 1 /end CHARACTERISTIC
/begin CHARACTERISTIC zfCLUTCH_Enable "[FIX] Fix Clutch switch (1 -> Press Clutch, 0 -> Release Clutch)" VALUE 0xFC4C74 Scalar_UBYTE 0 TF_TE_DigInput4ms_CM_FixEnableT 171 218 /end CHARACTERISTIC
/begin CHARACTERISTIC zfCLUTCH_Value "[FIX] Fix Clutch switch (1 -> Press Clutch, 0 -> Release Clutch)" VALUE 0xFC4C73 Scalar_BOOLEAN 0 TF_TE_DigInput4ms_CM_boolean_adm 0 1 /end CHARACTERISTIC
/begin CHARACTERISTIC zfDOORS_OPEN_Enable "[FIX] Fix Doors Open (1 -> Doors Open, 0 -> Doors Closed)" VALUE 0xFC4C72 Scalar_UBYTE 0 TF_TE_DigInput4ms_CM_FixEnableT 171 218 /end CHARACTERISTIC
/begin CHARACTERISTIC zfDOORS_OPEN_Value "[FIX] Fix Doors Open (1 -> Doors Open, 0 -> Doors Closed)" VALUE 0xFC4C71 Scalar_BOOLEAN 0 TF_TE_DigInput4ms_CM_boolean_adm 0 1 /end CHARACTERISTIC
/begin CHARACTERISTIC zfECU_TEMP_Enable "[FIX] Ecu temperature fix enable" VALUE 0xFC4CEE Scalar_UBYTE 0 EcuTempSensor1s_CM_FixEnableT 171 218 /end CHARACTERISTIC
/begin CHARACTERISTIC zfECU_TEMP_Value "[FIX] Ecu temperature fix value" VALUE 0xFC4CEC Scalar_UWORD 0 EcuTempSensor1s_CM_ufix16_Bn40_mbar -40 150 /end CHARACTERISTIC
/begin CHARACTERISTIC zfEGRP_Enable "[FIX] Exhaust manifold temperature fix enable" VALUE 0xFC4E28 Scalar_UBYTE 0 TE_EgrPos4ms_CM_FixEnableT 171 218 /end CHARACTERISTIC
/begin CHARACTERISTIC zfEGRP_Value "[FIX] EGR position fix value" VALUE 0xFC4E26 Scalar_UWORD 0 TE_EgrPos4ms_CM_ufix16_En10_V 0 5 /end CHARACTERISTIC
/begin CHARACTERISTIC zfENG_BRK_Enable "[FIX] Fix Engine Brake Request Command (1 -> Active, 0 -> Inactive)" VALUE 0xFC4C70 Scalar_UBYTE 0 TF_TE_DigInput4ms_CM_FixEnableT 171 218 /end CHARACTERISTIC
/begin CHARACTERISTIC zfENG_BRK_Value "[FIX] Fix Engine Brake Request Command (1 -> Active, 0 -> Inactive)" VALUE 0xFC4C6F Scalar_BOOLEAN 0 TF_TE_DigInput4ms_CM_boolean_adm 0 1 /end CHARACTERISTIC
/begin CHARACTERISTIC zfIDLE_ACC_Enable "[FIX] Fix Idle Acc (1 -> Active, 0 -> Inactive)" VALUE 0xFC4C6E Scalar_UBYTE 0 TF_TE_DigInput4ms_CM_FixEnableT 171 218 /end CHARACTERISTIC
/begin CHARACTERISTIC zfIDLE_ACC_Value "[FIX] Fix Idle Acc (1 -> Active, 0 -> Inactive)" VALUE 0xFC4C6D Scalar_BOOLEAN 0 TF_TE_DigInput4ms_CM_boolean_adm 0 1 /end CHARACTERISTIC
/begin CHARACTERISTIC zfIP_LAM_CONV_Enable "[FIX] [OUT] Conversion map between UEGO Ip to lambda" VALUE 0xFC9C60 Scalar_UBYTE 0 UegoSensor4ms_CM_FixEnableT 171 218 /end CHARACTERISTIC
/begin CHARACTERISTIC zfIP_LAM_CONV_Value "[FIX] [OUT] Conversion map between UEGO Ip to lambda" VALUE 0xFC9C5E Scalar_UWORD 0 UegoSensor4ms_CM_ufix16_En10 0 15 /end CHARACTERISTIC
/begin CHARACTERISTIC zfKEY "[FIX] Fix Key (1 -> Request On, 0 -> Request Off)" VALUE 0xFC4C9E Scalar_UWORD 0 DigInput4ms_Symbol_CM_boolean_adm 0 1 /end CHARACTERISTIC
/begin CHARACTERISTIC zfKEY_ENG_START_Enable "[FIX] Fix seconda posizione chiave (1 -> Request On, 0 -> Request Off)" VALUE 0xFC4C6C Scalar_UBYTE 0 TF_TE_DigInput4ms_CM_FixEnableT 171 218 /end CHARACTERISTIC
/begin CHARACTERISTIC zfKEY_ENG_START_Value "[FIX] Fix seconda posizione chiave (1 -> Request On, 0 -> Request Off)" VALUE 0xFC4C6B Scalar_BOOLEAN 0 TF_TE_DigInput4ms_CM_boolean_adm 0 1 /end CHARACTERISTIC
/begin CHARACTERISTIC zfKEY_EnFix "[FIX] Fix Key (1 -> Request On, 0 -> Request Off)" VALUE 0xFC4C9C Scalar_UWORD 0 DigInput4ms_Symbol_CM_FixEnableT 171 218 /end CHARACTERISTIC
/begin CHARACTERISTIC zfKICK_DOWN_Enable "[FIX] Fix Kick Down (1 -> Active, 0 -> Inactive)" VALUE 0xFC4C6A Scalar_UBYTE 0 TF_TE_DigInput4ms_CM_FixEnableT 171 218 /end CHARACTERISTIC
/begin CHARACTERISTIC zfKICK_DOWN_Value "[FIX] Fix Kick Down (1 -> Active, 0 -> Inactive)" VALUE 0xFC4C69 Scalar_BOOLEAN 0 TF_TE_DigInput4ms_CM_boolean_adm 0 1 /end CHARACTERISTIC
/begin CHARACTERISTIC zfLAMBDAPOSTF_Enable "[FIX] Fix sulla Sonda Lambda postcatalizzatore" VALUE 0xFC9C5C Scalar_UBYTE 0 LambdaPostSensor4ms_CM_FixEnableT 171 218 /end CHARACTERISTIC
/begin CHARACTERISTIC zfLAMBDAPOSTF_Value "[FIX] Fix sulla Sonda Lambda postcatalizzatore" VALUE 0xFC9C5A Scalar_UWORD 0 LambdaPostSensor4ms_CM_uint16_mV 0 1000 /end CHARACTERISTIC
/begin CHARACTERISTIC zfLAMBDAPOST_Enable "[FIX] Fix sulla Sonda Lambda postcatalizzatore" VALUE 0xFC9C58 Scalar_UBYTE 0 LambdaPostSensor4ms_CM_FixEnableT 171 218 /end CHARACTERISTIC
/begin CHARACTERISTIC zfLAMBDAPOST_Value "[FIX] Fix sulla Sonda Lambda postcatalizzatore" VALUE 0xFC9C56 Scalar_UWORD 0 LambdaPostSensor4ms_CM_uint16_mV 0 1000 /end CHARACTERISTIC
/begin CHARACTERISTIC zfLAMBDAPREF_Enable "[FIX] Fix sulla Sonda Lambda precatalizzatore filtrata" VALUE 0xFC9C54 Scalar_UBYTE 0 LambdaPreSensor4ms_CM_FixEnableT 171 218 /end CHARACTERISTIC
/begin CHARACTERISTIC zfLAMBDAPREF_Value "[FIX] Fix sulla Sonda Lambda precatalizzatore filtrata" VALUE 0xFC9C52 Scalar_UWORD 0 LambdaPreSensor4ms_CM_uint16_mV 0 1000 /end CHARACTERISTIC
/begin CHARACTERISTIC zfLAMBDAPRE_Enable "[FIX] Fix sulla Sonda Lambda precatalizzatore" VALUE 0xFC9C50 Scalar_UBYTE 0 LambdaPreSensor4ms_CM_FixEnableT 171 218 /end CHARACTERISTIC
/begin CHARACTERISTIC zfLAMBDAPRE_Value "[FIX] Fix sulla Sonda Lambda precatalizzatore" VALUE 0xFC9C4E Scalar_UWORD 0 LambdaPreSensor4ms_CM_uint16_mV 0 1000 /end CHARACTERISTIC
/begin CHARACTERISTIC zfLAMBDA_POST_TMP_Enable "[FIX] Caratteristica sensore Lambda post-catalizzatore" VALUE 0xFC9C4C Scalar_UBYTE 0 LambdaPostSensor4ms_CM_FixEnableT 171 218 /end CHARACTERISTIC
/begin CHARACTERISTIC zfLAMBDA_POST_TMP_Value "[FIX] Caratteristica sensore Lambda post-catalizzatore" VALUE 0xFC9C4A Scalar_UWORD 0 LambdaPostSensor4ms_CM_uint16_mV 0 1300 /end CHARACTERISTIC
/begin CHARACTERISTIC zfLAMBDA_PRE_TMP_Enable "[FIX] Caratteristica sensore Lambda pre-catalizzatore" VALUE 0xFC9C48 Scalar_UBYTE 0 LambdaPreSensor4ms_CM_FixEnableT 171 218 /end CHARACTERISTIC
/begin CHARACTERISTIC zfLAMBDA_PRE_TMP_Value "[FIX] Caratteristica sensore Lambda pre-catalizzatore" VALUE 0xFC9C46 Scalar_UWORD 0 LambdaPreSensor4ms_CM_uint16_mV 0 1300 /end CHARACTERISTIC
/begin CHARACTERISTIC zfLAST_WIN_DIS "[FIX] Fix sulla gestione LastWin (FIX = ON @ 0)" VALUE 0xFCAECE Scalar_UWORD 0 TE_PotenzAccSensor_4ms_Symbol_CM_boolean_adm 0 1 /end CHARACTERISTIC
/begin CHARACTERISTIC zfLAST_WIN_DIS_EnFix "[FIX] Fix sulla gestione LastWin (FIX = ON @ 0)" VALUE 0xFCAECC Scalar_UWORD 0 TE_PotenzAccSensor_4ms_Symbol_CM_FixEnableT 171 218 /end CHARACTERISTIC
/begin CHARACTERISTIC zfMAF_Enable "[FIX] Tabella di interpolazione di aria che attraversa il debimetro" VALUE 0xFC016A Scalar_UBYTE 0 DebimSensor4ms_CM_FixEnableT 171 218 /end CHARACTERISTIC
/begin CHARACTERISTIC zfMAF_Value "[FIX] Tabella di interpolazione di aria che attraversa il debimetro" VALUE 0xFC0168 Scalar_UWORD 0 DebimSensor4ms_CM_ufix16_En4_kg_h 0 4000 /end CHARACTERISTIC
/begin CHARACTERISTIC zfMAP "[FIX] Fix sulla Pressione nel collettore di aspirazione (assoluta)" VALUE 0xFCAA74 Scalar_UWORD 0 MapSensor4ms_Symbol_CM_uint16_mbar 150 2500 /end CHARACTERISTIC
/begin CHARACTERISTIC zfMAP_BAR "[FIX] Caratteristica del sensore di pressione assoluta nel collettore" VALUE 0xFCAA70 Scalar_UWORD 0 MapSensor4ms_Symbol_CM_uint16_mbar 1 2700 /end CHARACTERISTIC
/begin CHARACTERISTIC zfMAP_BAR_EnFix "[FIX] Caratteristica del sensore di pressione assoluta nel collettore" VALUE 0xFCAA6E Scalar_UWORD 0 MapSensor4ms_Symbol_CM_FixEnableT 171 218 /end CHARACTERISTIC
/begin CHARACTERISTIC zfMAP_EnFix "[FIX] Fix sulla Pressione nel collettore di aspirazione (assoluta)" VALUE 0xFCAA72 Scalar_UWORD 0 MapSensor4ms_Symbol_CM_FixEnableT 171 218 /end CHARACTERISTIC
/begin CHARACTERISTIC zfNIDLE_ACC_Enable "[FIX] Fix Not Idle Acc (1 -> Active, 0 -> Inactive)" VALUE 0xFC4C68 Scalar_UBYTE 0 TF_TE_DigInput4ms_CM_FixEnableT 171 218 /end CHARACTERISTIC
/begin CHARACTERISTIC zfNIDLE_ACC_Value "[FIX] Fix Not Idle Acc (1 -> Active, 0 -> Inactive)" VALUE 0xFC4C67 Scalar_BOOLEAN 0 TF_TE_DigInput4ms_CM_boolean_adm 0 1 /end CHARACTERISTIC
/begin CHARACTERISTIC zfNLP_THR "[FIX] Fix sul potenziometro farfalla motorizzata NLP in %" VALUE 0xFCB492 Scalar_UWORD 0 TE_TM_PotThrSens4ms_Symbol_CM_ufix16_En8__ 0 100 /end CHARACTERISTIC
/begin CHARACTERISTIC zfNLP_THR_EnFix "[FIX] Fix sul potenziometro farfalla motorizzata NLP in %" VALUE 0xFCB490 Scalar_UWORD 0 TE_TM_PotThrSens4ms_Symbol_CM_FixEnableT 171 218 /end CHARACTERISTIC
/begin CHARACTERISTIC zfOFF_Enable "[FIX] Fix PTO Off Request (1 -> Press Button, 0 -> Release Button)" VALUE 0xFC4C66 Scalar_UBYTE 0 TF_TE_DigInput4ms_CM_FixEnableT 171 218 /end CHARACTERISTIC
/begin CHARACTERISTIC zfOFF_Value "[FIX] Fix PTO Off Request (1 -> Press Button, 0 -> Release Button)" VALUE 0xFC4C65 Scalar_BOOLEAN 0 TF_TE_DigInput4ms_CM_boolean_adm 0 1 /end CHARACTERISTIC
/begin CHARACTERISTIC zfPARK_BRK_Enable "[FIX] Fix Park Brake (1 -> Parking Brk On, 0 -> Parking Brk Off)" VALUE 0xFC4C64 Scalar_UBYTE 0 TF_TE_DigInput4ms_CM_FixEnableT 171 218 /end CHARACTERISTIC
/begin CHARACTERISTIC zfPARK_BRK_Value "[FIX] Fix Park Brake (1 -> Parking Brk On, 0 -> Parking Brk Off)" VALUE 0xFC4C63 Scalar_BOOLEAN 0 TF_TE_DigInput4ms_CM_boolean_adm 0 1 /end CHARACTERISTIC
/begin CHARACTERISTIC zfPATM "[FIX] Fix sulla Pressione Atmosferica" VALUE 0xFC1F14 Scalar_UWORD 0 AtmophericPresSensor100ms_Symbol_CM_uint16_mbar 150 1150 /end CHARACTERISTIC
/begin CHARACTERISTIC zfPATM_EnFix "[FIX] Fix sulla Pressione Atmosferica" VALUE 0xFC1F12 Scalar_UWORD 0 AtmophericPresSensor100ms_Symbol_CM_FixEnableT 171 218 /end CHARACTERISTIC
/begin CHARACTERISTIC zfPBOOST "[FIX] Fix sulla pressione di sovralimentazione (assoluta)" VALUE 0xFC2BCC Scalar_UWORD 0 BoostPresSensor4ms_Symbol_CM_uint16_mbar 500 4000 /end CHARACTERISTIC
/begin CHARACTERISTIC zfPBOOST_EnFix "[FIX] Fix sulla pressione di sovralimentazione (assoluta)" VALUE 0xFC2BCA Scalar_UWORD 0 BoostPresSensor4ms_Symbol_CM_FixEnableT 171 218 /end CHARACTERISTIC
/begin CHARACTERISTIC zfPDL_SLOPE "[FIX] Contributo al passo di incremento del raccordo della posizione pedale funzione della velocità veicolo" VALUE 0xFCAECA Scalar_UWORD 0 TE_PotenzAccSensor_4ms_Symbol_CM_uint16_adm 0 1000 /end CHARACTERISTIC
/begin CHARACTERISTIC zfPDL_SLOPE_EnFix "[FIX] Contributo al passo di incremento del raccordo della posizione pedale funzione della velocità veicolo" VALUE 0xFCAEC8 Scalar_UWORD 0 TE_PotenzAccSensor_4ms_Symbol_CM_FixEnableT 171 218 /end CHARACTERISTIC
/begin CHARACTERISTIC zfPDL_STATUS "[FIX] Fix sullo stato pedale acceleratore" VALUE 0xFCAEC6 Scalar_UWORD 0 TE_PotenzAccSensor_4ms_Symbol_CM_uint8_adm 0 2 /end CHARACTERISTIC
/begin CHARACTERISTIC zfPDL_STATUS_EnFix "[FIX] Fix sullo stato pedale acceleratore" VALUE 0xFCAEC4 Scalar_UWORD 0 TE_PotenzAccSensor_4ms_Symbol_CM_FixEnableT 171 218 /end CHARACTERISTIC
/begin CHARACTERISTIC zfPOIL "[FIX] Fix sulla Pressione Olio" VALUE 0xFCAB58 Scalar_UWORD 0 OilPresSensor100ms_Symbol_CM_uint16_mbar 250 6000 /end CHARACTERISTIC
/begin CHARACTERISTIC zfPOIL_EnFix "[FIX] Fix sulla Pressione Olio" VALUE 0xFCAB56 Scalar_UWORD 0 OilPresSensor100ms_Symbol_CM_FixEnableT 171 218 /end CHARACTERISTIC
/begin CHARACTERISTIC zfPOTENZ_ACC "[FIX] Fix sul potenziometro principale del pedale acceleratore" VALUE 0xFCAEC2 Scalar_UWORD 0 TE_PotenzAccSensor_4ms_Symbol_CM_ufix16_En4__ 0 100 /end CHARACTERISTIC
/begin CHARACTERISTIC zfPOTENZ_ACC_EnFix "[FIX] Fix sul potenziometro principale del pedale acceleratore" VALUE 0xFCAEC0 Scalar_UWORD 0 TE_PotenzAccSensor_4ms_Symbol_CM_FixEnableT 171 218 /end CHARACTERISTIC
/begin CHARACTERISTIC zfPOTENZ_THR "[FIX] Fix sul potenziometro farfalla motorizzata in %" VALUE 0xFCB49A Scalar_SWORD 0 TE_TM_PotThrSens4ms_Symbol_CM_sfix16_En8__ -10 100 /end CHARACTERISTIC
/begin CHARACTERISTIC zfPOTENZ_THR_EnFix "[FIX] Fix sul potenziometro farfalla motorizzata in %" VALUE 0xFCB498 Scalar_SWORD 0 TE_TM_PotThrSens4ms_Symbol_CM_FixEnableT 171 218 /end CHARACTERISTIC
/begin CHARACTERISTIC zfPOT_ACC_PERC "[FIX] Caratteristica del potenziometro principale del pedale acceleratore" VALUE 0xFCAEBE Scalar_UWORD 0 TE_PotenzAccSensor_4ms_Symbol_CM_ufix16_En4__ 0 100 /end CHARACTERISTIC
/begin CHARACTERISTIC zfPOT_ACC_PERC_EnFix "[FIX] Caratteristica del potenziometro principale del pedale acceleratore" VALUE 0xFCAEBC Scalar_UWORD 0 TE_PotenzAccSensor_4ms_Symbol_CM_FixEnableT 171 218 /end CHARACTERISTIC
/begin CHARACTERISTIC zfPRAIL_BAR_Enable "[FIX] Caratteristica sensore pressione metano nel rail" VALUE 0xFCAF7C Scalar_UBYTE 0 RailPresSensor4ms_CM_FixEnableT 171 218 /end CHARACTERISTIC
/begin CHARACTERISTIC zfPRAIL_BAR_Value "[FIX] Caratteristica sensore pressione metano nel rail" VALUE 0xFCAF7A Scalar_UWORD 0 RailPresSensor4ms_CM_uint16_mbar 0 16000 /end CHARACTERISTIC
/begin CHARACTERISTIC zfPRAIL_Enable "[FIX] Fix sulla Pressione metano nel rail di bassa pressione (assoluta)" VALUE 0xFCAF78 Scalar_UBYTE 0 RailPresSensor4ms_CM_FixEnableT 171 218 /end CHARACTERISTIC
/begin CHARACTERISTIC zfPRAIL_Value "[FIX] Fix sulla Pressione metano nel rail di bassa pressione (assoluta)" VALUE 0xFCAF76 Scalar_UWORD 0 RailPresSensor4ms_CM_uint16_mbar 0 13793 /end CHARACTERISTIC
/begin CHARACTERISTIC zfPRESSIO_ATM "[FIX] Caratteristica del sensore pressione atmosferica" VALUE 0xFC1F10 Scalar_UWORD 0 AtmophericPresSensor100ms_Symbol_CM_uint16_mbar 150 1150 /end CHARACTERISTIC
/begin CHARACTERISTIC zfPRESSIO_ATM_EnFix "[FIX] Caratteristica del sensore pressione atmosferica" VALUE 0xFC1F0E Scalar_UWORD 0 AtmophericPresSensor100ms_Symbol_CM_FixEnableT 171 218 /end CHARACTERISTIC
/begin CHARACTERISTIC zfPRESSIO_OIL "[FIX] Caratteristica sensore pressione olio" VALUE 0xFCAB54 Scalar_UWORD 0 OilPresSensor100ms_Symbol_CM_uint16_mbar 225 6000 /end CHARACTERISTIC
/begin CHARACTERISTIC zfPRESSIO_OIL_EnFix "[FIX] Caratteristica sensore pressione olio" VALUE 0xFCAB52 Scalar_UWORD 0 OilPresSensor100ms_Symbol_CM_FixEnableT 171 218 /end CHARACTERISTIC
/begin CHARACTERISTIC zfPRESS_BOOST "[FIX] Caratteristica sensore pressione di sovralimentazione" VALUE 0xFC2BC8 Scalar_UWORD 0 BoostPresSensor4ms_Symbol_CM_uint16_mbar 50 4500 /end CHARACTERISTIC
/begin CHARACTERISTIC zfPRESS_BOOST_EnFix "[FIX] Caratteristica sensore pressione di sovralimentazione" VALUE 0xFC2BC6 Scalar_UWORD 0 BoostPresSensor4ms_Symbol_CM_FixEnableT 171 218 /end CHARACTERISTIC
/begin CHARACTERISTIC zfPRES_EGRDELTAP_Enable "[FIX] [OUT] Egr DeltaP sensor characteristic " VALUE 0xFC4E24 Scalar_UBYTE 0 EgrDeltaP4ms_CM_FixEnableT 171 218 /end CHARACTERISTIC
/begin CHARACTERISTIC zfPRES_EGRDELTAP_Value "[FIX] [OUT] Egr DeltaP sensor characteristic " VALUE 0xFC4E20 Scalar_LONG 0 EgrDeltaP4ms_CM_sfix32_En10_mbar -2850 2500 /end CHARACTERISTIC
/begin CHARACTERISTIC zfPRES_EGR_HP_Enable "[FIX] [OUT] Egr inlet valve pressure (high pressure EGR)  sensor characteristic " VALUE 0xFC4E1E Scalar_UBYTE 0 EgrHighPre4ms_CM_FixEnableT 171 218 /end CHARACTERISTIC
/begin CHARACTERISTIC zfPRES_EGR_HP_Value "[FIX] [OUT] Egr inlet valve pressure (high pressure EGR)  sensor characteristic " VALUE 0xFC4E1C Scalar_UWORD 0 EgrHighPre4ms_CM_uint16_mbar 0 5000 /end CHARACTERISTIC
/begin CHARACTERISTIC zfPTANK "[FIX] Fix sulla Pressione Metano Bombole (relativa)" VALUE 0xFCB68A Scalar_UWORD 0 TankPresSensor4ms_Symbol_CM_ufix16_E2_mbar 0 225000 /end CHARACTERISTIC
/begin CHARACTERISTIC zfPTANK_BAR "[FIX] Caratteristica sensore pressione metano nelle bombole" VALUE 0xFCB686 Scalar_UWORD 0 TankPresSensor4ms_Symbol_CM_ufix16_E2_mbar 0 250000 /end CHARACTERISTIC
/begin CHARACTERISTIC zfPTANK_BAR_EnFix "[FIX] Caratteristica sensore pressione metano nelle bombole" VALUE 0xFCB684 Scalar_UWORD 0 TankPresSensor4ms_Symbol_CM_FixEnableT 171 218 /end CHARACTERISTIC
/begin CHARACTERISTIC zfPTANK_EnFix "[FIX] Fix sulla Pressione Metano Bombole (relativa)" VALUE 0xFCB688 Scalar_UWORD 0 TankPresSensor4ms_Symbol_CM_FixEnableT 171 218 /end CHARACTERISTIC
/begin CHARACTERISTIC zfQAIRDEBIM_Enable "[FIX] Fix sulla Portata Aria aspirata da debimetro" VALUE 0xFC0166 Scalar_UBYTE 0 DebimSensor4ms_CM_FixEnableT 171 218 /end CHARACTERISTIC
/begin CHARACTERISTIC zfQAIRDEBIM_Value "[FIX] Fix sulla Portata Aria aspirata da debimetro" VALUE 0xFC0164 Scalar_UWORD 0 DebimSensor4ms_CM_ufix16_En4_kg_h 0 4000 /end CHARACTERISTIC
/begin CHARACTERISTIC zfRESUME_ON_Enable "[FIX] Fix Resume (1 -> Active, 0 -> Inactive)" VALUE 0xFC4C62 Scalar_UBYTE 0 TF_TE_DigInput4ms_CM_FixEnableT 171 218 /end CHARACTERISTIC
/begin CHARACTERISTIC zfRESUME_ON_Value "[FIX] Fix Resume (1 -> Active, 0 -> Inactive)" VALUE 0xFC4C61 Scalar_BOOLEAN 0 TF_TE_DigInput4ms_CM_boolean_adm 0 1 /end CHARACTERISTIC
/begin CHARACTERISTIC zfSET_MINUS_Enable "[FIX] Fix for decrease Pto or CC Obj Command (1 -> Active, 0 -> Inactive)" VALUE 0xFC4C60 Scalar_UBYTE 0 TF_TE_DigInput4ms_CM_FixEnableT 171 218 /end CHARACTERISTIC
/begin CHARACTERISTIC zfSET_MINUS_Value "[FIX] Fix for decrease Pto or CC Obj Command (1 -> Active, 0 -> Inactive)" VALUE 0xFC4C5F Scalar_BOOLEAN 0 TF_TE_DigInput4ms_CM_boolean_adm 0 1 /end CHARACTERISTIC
/begin CHARACTERISTIC zfSET_PLUS_Enable "[FIX] Fix for encrease Pto or CC Obj Command (1 -> Active, 0 -> Inactive)" VALUE 0xFC4C5E Scalar_UBYTE 0 TF_TE_DigInput4ms_CM_FixEnableT 171 218 /end CHARACTERISTIC
/begin CHARACTERISTIC zfSET_PLUS_Value "[FIX] Fix for encrease Pto or CC Obj Command (1 -> Active, 0 -> Inactive)" VALUE 0xFC4C5D Scalar_BOOLEAN 0 TF_TE_DigInput4ms_CM_boolean_adm 0 1 /end CHARACTERISTIC
/begin CHARACTERISTIC zfSPARE2 "[FIX] Fix Spare2 (1 -> Press Button, 0 -> Release Button)" VALUE 0xFC4C9A Scalar_UWORD 0 DigInput4ms_Symbol_CM_boolean_adm 0 1 /end CHARACTERISTIC
/begin CHARACTERISTIC zfSPARE2_EnFix "[FIX] Fix Spare2 (1 -> Press Button, 0 -> Release Button)" VALUE 0xFC4C98 Scalar_UWORD 0 DigInput4ms_Symbol_CM_FixEnableT 171 218 /end CHARACTERISTIC
/begin CHARACTERISTIC zfSPARE3 "[FIX] Fix spare3 (1 -> Request On, 0 -> Request Off)" VALUE 0xFC4C96 Scalar_UWORD 0 DigInput4ms_Symbol_CM_boolean_adm 0 1 /end CHARACTERISTIC
/begin CHARACTERISTIC zfSPARE3_EnFix "[FIX] Fix spare3 (1 -> Request On, 0 -> Request Off)" VALUE 0xFC4C94 Scalar_UWORD 0 DigInput4ms_Symbol_CM_FixEnableT 171 218 /end CHARACTERISTIC
/begin CHARACTERISTIC zfSTART_CBT "[FIX] Fix Start from Cabin Tilt (1 -> Press Button, 0 -> Release Button)" VALUE 0xFC4C92 Scalar_UWORD 0 DigInput4ms_Symbol_CM_boolean_adm 0 1 /end CHARACTERISTIC
/begin CHARACTERISTIC zfSTART_CBT_EnFix "[FIX] Fix Start from Cabin Tilt (1 -> Press Button, 0 -> Release Button)" VALUE 0xFC4C90 Scalar_UWORD 0 DigInput4ms_Symbol_CM_FixEnableT 171 218 /end CHARACTERISTIC
/begin CHARACTERISTIC zfSTOP_CBT "[FIX] Fix Start from Cabin Tilt (1 -> Press Button, 0 -> Release Button)" VALUE 0xFC4C8E Scalar_UWORD 0 DigInput4ms_Symbol_CM_boolean_adm 0 1 /end CHARACTERISTIC
/begin CHARACTERISTIC zfSTOP_CBT_EnFix "[FIX] Fix Start from Cabin Tilt (1 -> Press Button, 0 -> Release Button)" VALUE 0xFC4C8C Scalar_UWORD 0 DigInput4ms_Symbol_CM_FixEnableT 171 218 /end CHARACTERISTIC
/begin CHARACTERISTIC zfTAIR "[FIX] Fix sulla Temperatura Aria" VALUE 0xFC1EB2 Scalar_UWORD 0 TempAirSensor100ms_Symbol_CM_ufix16_Bn40_degC -40 130 /end CHARACTERISTIC
/begin CHARACTERISTIC zfTAIR_EnFix "[FIX] Fix sulla Temperatura Aria" VALUE 0xFC1EB0 Scalar_UWORD 0 TempAirSensor100ms_Symbol_CM_FixEnableT 171 218 /end CHARACTERISTIC
/begin CHARACTERISTIC zfTEMPER_AIR "[FIX] Tabella con caratteristica del sensore di temperatura aria nel collettore" VALUE 0xFC1EAE Scalar_UWORD 0 TempAirSensor100ms_Symbol_CM_ufix16_Bn40_degC -40 130 /end CHARACTERISTIC
/begin CHARACTERISTIC zfTEMPER_AIR_EnFix "[FIX] Tabella con caratteristica del sensore di temperatura aria nel collettore" VALUE 0xFC1EAC Scalar_UWORD 0 TempAirSensor100ms_Symbol_CM_FixEnableT 171 218 /end CHARACTERISTIC
/begin CHARACTERISTIC zfTEMPER_BOOST_Enable "[FIX] [OUT] Boost temperature sensor characteristic " VALUE 0xFCAFE2 Scalar_UBYTE 0 TurboTemp100ms_CM_FixEnableT 171 218 /end CHARACTERISTIC
/begin CHARACTERISTIC zfTEMPER_BOOST_Value "[FIX] [OUT] Boost temperature sensor characteristic " VALUE 0xFCAFE0 Scalar_UWORD 0 TurboTemp100ms_CM_ufix16_Bn40_degC -40 1000 /end CHARACTERISTIC
/begin CHARACTERISTIC zfTEMPER_ECU_Enable "[FIX] Ecu Temperature Sensor Characteristic" VALUE 0xFC4CEA Scalar_UBYTE 0 EcuTempSensor1s_CM_FixEnableT 171 218 /end CHARACTERISTIC
/begin CHARACTERISTIC zfTEMPER_ECU_Value "[FIX] Ecu Temperature Sensor Characteristic" VALUE 0xFC4CE8 Scalar_UWORD 0 EcuTempSensor1s_CM_ufix16_Bn40_degC -40 150 /end CHARACTERISTIC
/begin CHARACTERISTIC zfTEMPER_EGRCOOLER_Enable "[FIX] [OUT] Egr Cooler temperature sensor characteristic " VALUE 0xFC4E1A Scalar_UBYTE 0 EgrCoolerTemp4ms_CM_FixEnableT 171 218 /end CHARACTERISTIC
/begin CHARACTERISTIC zfTEMPER_EGRCOOLER_Value "[FIX] [OUT] Egr Cooler temperature sensor characteristic " VALUE 0xFC4E18 Scalar_UWORD 0 EgrCoolerTemp4ms_CM_ufix16_Bn40_degC -40 1000 /end CHARACTERISTIC
/begin CHARACTERISTIC zfTEMPER_EXH_Enable "[FIX] Exhaust Temperature Sensor Characteristic fix enable" VALUE 0xFC55CA Scalar_UBYTE 0 ExhaustGasTemp100ms_CM_FixEnableT 171 218 /end CHARACTERISTIC
/begin CHARACTERISTIC zfTEMPER_EXH_Value "[FIX] Exhaust Temperature Sensor Characteristic fix value" VALUE 0xFC55C8 Scalar_UWORD 0 ExhaustGasTemp100ms_CM_ufix16_Bn40_degC -40 1000 /end CHARACTERISTIC
/begin CHARACTERISTIC zfTEMPER_H2O "[FIX] Tabella con caratteristica del sensore di temperatura acqua motore" VALUE 0xFC2CAC Scalar_UWORD 0 TempH2OSensor100ms_Symbol_CM_ufix16_Bn40_degC -40 140 /end CHARACTERISTIC
/begin CHARACTERISTIC zfTEMPER_H2O_EnFix "[FIX] Tabella con caratteristica del sensore di temperatura acqua motore" VALUE 0xFC2CAA Scalar_UWORD 0 TempH2OSensor100ms_Symbol_CM_FixEnableT 171 218 /end CHARACTERISTIC
/begin CHARACTERISTIC zfTEMPER_KAT "[FIX] Tabella con caratteristica del sensore di temperatura valle catalizzatore" VALUE 0xFC2C40 Scalar_UWORD 0 TempKatSensor100ms_Symbol_CM_ufix16_Bn40_degC -40 1000 /end CHARACTERISTIC
/begin CHARACTERISTIC zfTEMPER_KAT_EnFix "[FIX] Tabella con caratteristica del sensore di temperatura valle catalizzatore" VALUE 0xFC2C3E Scalar_UWORD 0 TempKatSensor100ms_Symbol_CM_FixEnableT 171 218 /end CHARACTERISTIC
/begin CHARACTERISTIC zfTEMPER_MAF_Enable "[FIX] [OUT] MAF (Mass Air Flow) integrated temperature sensor characteristic " VALUE 0xFCAFDE Scalar_UBYTE 0 MAFTemp100ms_CM_FixEnableT 171 218 /end CHARACTERISTIC
/begin CHARACTERISTIC zfTEMPER_MAF_Value "[FIX] [OUT] MAF (Mass Air Flow) integrated temperature sensor characteristic " VALUE 0xFCAFDC Scalar_UWORD 0 MAFTemp100ms_CM_ufix16_Bn40_degC -40 1000 /end CHARACTERISTIC
/begin CHARACTERISTIC zfTEMPER_OIL_EMUL_Enable "[FIX] Tabella con caratteristica del sensore di pressione olio motore emulato" VALUE 0xFCAC00 Scalar_UBYTE 0 TempOilSensor100ms_CM_FixEnableT 171 218 /end CHARACTERISTIC
/begin CHARACTERISTIC zfTEMPER_OIL_EMUL_Value "[FIX] Tabella con caratteristica del sensore di pressione olio motore emulato" VALUE 0xFCABFE Scalar_UWORD 0 TempOilSensor100ms_CM_ufix16_Bn40_degC -40 130 /end CHARACTERISTIC
/begin CHARACTERISTIC zfTEMPER_OIL_Enable "[FIX] Tabella con caratteristica del sensore di pressione olio motore" VALUE 0xFCABFC Scalar_UBYTE 0 TempOilSensor100ms_CM_FixEnableT 171 218 /end CHARACTERISTIC
/begin CHARACTERISTIC zfTEMPER_OIL_Value "[FIX] Tabella con caratteristica del sensore di pressione olio motore" VALUE 0xFCABFA Scalar_UWORD 0 TempOilSensor100ms_CM_ufix16_Bn40_degC -40 130 /end CHARACTERISTIC
/begin CHARACTERISTIC zfTEMPER_RAIL "[FIX] Tabella con caratteristica del sensore di temperatura metano nel rail" VALUE 0xFC5A4C Scalar_UWORD 0 TempRailSensor100ms_Symbol_CM_ufix16_Bn40_degC -40 150 /end CHARACTERISTIC
/begin CHARACTERISTIC zfTEMPER_RAIL_EnFix "[FIX] Tabella con caratteristica del sensore di temperatura metano nel rail" VALUE 0xFC5A4A Scalar_UWORD 0 TempRailSensor100ms_Symbol_CM_FixEnableT 171 218 /end CHARACTERISTIC
/begin CHARACTERISTIC zfTEXH_Enable "[FIX] Exhaust manifold temperature fix enable" VALUE 0xFC55C6 Scalar_UBYTE 0 ExhaustGasTemp100ms_CM_FixEnableT 171 218 /end CHARACTERISTIC
/begin CHARACTERISTIC zfTEXH_Value "[FIX] Exhaust manifold temperature fix value" VALUE 0xFC55C4 Scalar_UWORD 0 ExhaustGasTemp100ms_CM_ufix16_Bn40_degC -40 1000 /end CHARACTERISTIC
/begin CHARACTERISTIC zfTH2O "[FIX] Fix sulla Temperatura Acqua" VALUE 0xFC2CA8 Scalar_UWORD 0 TempH2OSensor100ms_Symbol_CM_ufix16_Bn40_degC -40 140 /end CHARACTERISTIC
/begin CHARACTERISTIC zfTH2O_EnFix "[FIX] Fix sulla Temperatura Acqua" VALUE 0xFC2CA6 Scalar_UWORD 0 TempH2OSensor100ms_Symbol_CM_FixEnableT 171 218 /end CHARACTERISTIC
/begin CHARACTERISTIC zfTHROT_POS "[FIX] Fix sulla Posizione di apertura farfalla in gradi" VALUE 0xFCB48E Scalar_UWORD 0 TE_TM_PotThrSens4ms_Symbol_CM_ufix16_En3_degF 0 90 /end CHARACTERISTIC
/begin CHARACTERISTIC zfTHROT_POS_EnFix "[FIX] Fix sulla Posizione di apertura farfalla in gradi" VALUE 0xFCB48C Scalar_UWORD 0 TE_TM_PotThrSens4ms_Symbol_CM_FixEnableT 171 218 /end CHARACTERISTIC
/begin CHARACTERISTIC zfTKAT "[FIX] Fix sulla Temperatura Catalizzatore" VALUE 0xFC2C3C Scalar_UWORD 0 TempKatSensor100ms_Symbol_CM_ufix16_Bn40_degC -40 1000 /end CHARACTERISTIC
/begin CHARACTERISTIC zfTKAT_EnFix "[FIX] Fix sulla Temperatura Catalizzatore" VALUE 0xFC2C3A Scalar_UWORD 0 TempKatSensor100ms_Symbol_CM_FixEnableT 171 218 /end CHARACTERISTIC
/begin CHARACTERISTIC zfTOIL_Enable "[FIX] Fix sulla Temperatura Olio" VALUE 0xFCABF8 Scalar_UBYTE 0 TempOilSensor100ms_CM_FixEnableT 171 218 /end CHARACTERISTIC
/begin CHARACTERISTIC zfTOIL_Value "[FIX] Fix sulla Temperatura Olio" VALUE 0xFCABF6 Scalar_UWORD 0 TempOilSensor100ms_CM_ufix16_Bn40_degC -40 130 /end CHARACTERISTIC
/begin CHARACTERISTIC zfTRAIL "[FIX] Fix sulla Temperatura Metano nel Rail" VALUE 0xFC5A48 Scalar_UWORD 0 TempRailSensor100ms_Symbol_CM_ufix16_Bn40_degC -40 150 /end CHARACTERISTIC
/begin CHARACTERISTIC zfTRAIL_EnFix "[FIX] Fix sulla Temperatura Metano nel Rail" VALUE 0xFC5A46 Scalar_UWORD 0 TempRailSensor100ms_Symbol_CM_FixEnableT 171 218 /end CHARACTERISTIC
/begin CHARACTERISTIC zfUEGO_IPCURR_TO_O2CONC_Enable "[FIX] [OUT] Conversion map between UEGO heater resistance and UEGO temperature" VALUE 0xFC9C44 Scalar_UBYTE 0 UegoSensor4ms_CM_FixEnableT 171 218 /end CHARACTERISTIC
/begin CHARACTERISTIC zfUEGO_IPCURR_TO_O2CONC_Value "[FIX] [OUT] Conversion map between UEGO heater resistance and UEGO temperature" VALUE 0xFC9C42 Scalar_SWORD 0 UegoSensor4ms_CM_sfix16_En10_degC -30 30 /end CHARACTERISTIC
/begin CHARACTERISTIC zfVBATT "[FIX] Fix sulla Tensione Batteria" VALUE 0xFC203E Scalar_UWORD 0 VBattSensor4ms_Symbol_CM_ufix16_S50_mV 12000 36000 /end CHARACTERISTIC
/begin CHARACTERISTIC zfVBATTNOSAT "[FIX] Fix sulla Tensione Batteria Non Saturata" VALUE 0xFC203A Scalar_UWORD 0 VBattSensor4ms_Symbol_CM_ufix16_S50_mV 50 50000 /end CHARACTERISTIC
/begin CHARACTERISTIC zfVBATTNOSAT_EnFix "[FIX] Fix sulla Tensione Batteria Non Saturata" VALUE 0xFC2038 Scalar_UWORD 0 VBattSensor4ms_Symbol_CM_FixEnableT 171 218 /end CHARACTERISTIC
/begin CHARACTERISTIC zfVBATT_EnFix "[FIX] Fix sulla Tensione Batteria" VALUE 0xFC203C Scalar_UWORD 0 VBattSensor4ms_Symbol_CM_FixEnableT 171 218 /end CHARACTERISTIC
/begin CHARACTERISTIC zfVBATT_POST_PWR "[FIX] Conversione tensione batteria a valle relay carichi" VALUE 0xFCC63E Scalar_UWORD 0 VBattPower4ms_Symbol_CM_ufix16_S50_mV 50 50000 /end CHARACTERISTIC
/begin CHARACTERISTIC zfVBATT_POST_PWR_EnFix "[FIX] Conversione tensione batteria a valle relay carichi" VALUE 0xFCC63C Scalar_UWORD 0 VBattPower4ms_Symbol_CM_FixEnableT 171 218 /end CHARACTERISTIC
/begin CHARACTERISTIC zfVBATT_PRE_PWR "[FIX] Guadagno HW sensore VBatt" VALUE 0xFC2036 Scalar_UWORD 0 VBattSensor4ms_Symbol_CM_ufix16_S50_mV 0 50000 /end CHARACTERISTIC
/begin CHARACTERISTIC zfVBATT_PRE_PWR_EnFix "[FIX] Guadagno HW sensore VBatt" VALUE 0xFC2034 Scalar_UWORD 0 VBattSensor4ms_Symbol_CM_FixEnableT 171 218 /end CHARACTERISTIC
/begin CHARACTERISTIC zfVBPW "[FIX] Fix sulla Tensione lato caldo iniettore" VALUE 0xFCC63A Scalar_UWORD 0 VBattPower4ms_Symbol_CM_ufix16_S50_mV 12000 36000 /end CHARACTERISTIC
/begin CHARACTERISTIC zfVBPWNOSAT "[FIX] Fix sulla Tensione lato caldo iniettore Non Saturata" VALUE 0xFCC636 Scalar_UWORD 0 VBattPower4ms_Symbol_CM_ufix16_S50_mV 50 50000 /end CHARACTERISTIC
/begin CHARACTERISTIC zfVBPWNOSAT_EnFix "[FIX] Fix sulla Tensione lato caldo iniettore Non Saturata" VALUE 0xFCC634 Scalar_UWORD 0 VBattPower4ms_Symbol_CM_FixEnableT 171 218 /end CHARACTERISTIC
/begin CHARACTERISTIC zfVBPW_EnFix "[FIX] Fix sulla Tensione lato caldo iniettore" VALUE 0xFCC638 Scalar_UWORD 0 VBattPower4ms_Symbol_CM_FixEnableT 171 218 /end CHARACTERISTIC
/begin CHARACTERISTIC zfVEH_SPEED_LIM_Enable "[FIX] Fix Vehicle Speed Limitation Request (1 -> Press Button, 0 -> Release Button)" VALUE 0xFC4C5C Scalar_UBYTE 0 TF_TE_DigInput4ms_CM_FixEnableT 171 218 /end CHARACTERISTIC
/begin CHARACTERISTIC zfVEH_SPEED_LIM_Value "[FIX] Fix Vehicle Speed Limitation Request (1 -> Press Button, 0 -> Release Button)" VALUE 0xFC4C5B Scalar_BOOLEAN 0 TF_TE_DigInput4ms_CM_boolean_adm 0 1 /end CHARACTERISTIC
/begin AXIS_PTS zkACC_V "[XBK] Caratteristica del potenziometro principale del pedale acceleratore" 0xFCAF12 NO_INPUT_QUANTITY Lookup1D_X_UWORD 0 TE_PotenzAccSensor_4ms_Symbol_CM_ufix16_En10_V 16 0 5 /end AXIS_PTS
/begin AXIS_PTS zkEGRDELTAP_VOLT "[X_BKP] Egr Cooler temperature voltage value" 0xFC4E08 zsEgrDeltaPVolt Lookup1D_X_UWORD 0 EgrDeltaP4ms_CM_ufix16_En10_V 8 0 5 /end AXIS_PTS
/begin AXIS_PTS zkEGR_HP_VOLT "[X_BKP] Egr inlet valve pressure (high pressure EGR) voltage value" 0xFC4DF8 zsEgrHighPreVolt Lookup1D_X_UWORD 0 EgrHighPre4ms_CM_ufix16_En10_V 8 0 5 /end AXIS_PTS
/begin AXIS_PTS zkLAM_POST_VOLT_BKP "[XBK] Caratteristica sensore Lambda post-catalizzatore" 0xFC9C32 zsLambdaPostVolt Lookup1D_X_UWORD 0 LambdaPostSensor4ms_CM_ufix16_En10_V 8 0 5 /end AXIS_PTS
/begin AXIS_PTS zkLAM_PRE_VOLT_BKP "[XBK] Caratteristica sensore Lambda pre-catalizzatore" 0xFC9C22 zsLambdaPreVolt Lookup1D_X_UWORD 0 LambdaPreSensor4ms_CM_ufix16_En10_V 8 0 5 /end AXIS_PTS
/begin AXIS_PTS zkMAP_VOLT_BKP "[XBK] Caratteristica del sensore di pressione assoluta nel collettore" 0xFCAA86 NO_INPUT_QUANTITY Lookup1D_X_UWORD 0 MapSensor4ms_Symbol_CM_ufix16_En10_V 8 0 5 /end AXIS_PTS
/begin AXIS_PTS zkPATM_VOLT_BKP "[XBK] Caratteristica del sensore pressione atmosferica" 0xFC1F26 NO_INPUT_QUANTITY Lookup1D_X_UWORD 0 AtmophericPresSensor100ms_Symbol_CM_ufix16_En10_V 8 0 5 /end AXIS_PTS
/begin AXIS_PTS zkPBOOST_VOLT_BKP "[XBK] Caratteristica sensore pressione di sovralimentazione" 0xFC2BDE NO_INPUT_QUANTITY Lookup1D_X_UWORD 0 BoostPresSensor4ms_Symbol_CM_ufix16_En10_V 8 0 5 /end AXIS_PTS
/begin AXIS_PTS zkPOIL_VOLT_VBK "[XBK] Caratteristica sensore pressione olio" 0xFCAB6A NO_INPUT_QUANTITY Lookup1D_X_UWORD 0 OilPresSensor100ms_Symbol_CM_ufix16_En10_V 8 0 5 /end AXIS_PTS
/begin AXIS_PTS zkPRAIL_VOLT_BKP "[XBK] Caratteristica sensore pressione metano nel rail" 0xFCAF66 zsPRailVolt Lookup1D_X_UWORD 0 RailPresSensor4ms_CM_ufix16_En10_V 8 0 5 /end AXIS_PTS
/begin AXIS_PTS zkPTANK_VOLT_BKP "[XBK] Caratteristica sensore pressione metano nelle bombole" 0xFCB69C NO_INPUT_QUANTITY Lookup1D_X_UWORD 0 TankPresSensor4ms_Symbol_CM_ufix16_En10_V 8 0 5 /end AXIS_PTS
/begin AXIS_PTS zkTAIR_VOLT_BKP "[XBK] Tabella con caratteristica del sensore di temperatura aria nel collettore" 0xFC1EE0 NO_INPUT_QUANTITY Lookup1D_X_UWORD 0 TempAirSensor100ms_Symbol_CM_ufix16_En10_V 22 0 5 /end AXIS_PTS
/begin AXIS_PTS zkTBOOST_VOLT "[X_BKP] Boost temperature voltage value" 0xFCAFCC zsTBoostVolt Lookup1D_X_UWORD 0 TurboTemp100ms_CM_ufix16_En10_V 8 0 5 /end AXIS_PTS
/begin AXIS_PTS zkTECU_VOLT_BKP "[XBK] Ecu Temperature Sensor Characteristic " 0xFC4CC8 zsTECUVolt Lookup1D_X_UWORD 0 EcuTempSensor1s_CM_ufix16_En10_V 16 0 5 /end AXIS_PTS
/begin AXIS_PTS zkTEGRCOOLER_VOLT "[X_BKP] Egr Cooler temperature voltage value" 0xFC4DE8 zsTEgrCoolerVolt Lookup1D_X_UWORD 0 EgrCoolerTemp4ms_CM_ufix16_En10_V 8 0 5 /end AXIS_PTS
/begin AXIS_PTS zkTEXH_VOLT_BKP "[XBK] Exhaust manifold temperature sensor characteristic " 0xFC55B4 zsTExhVolt Lookup1D_X_UWORD 0 ExhaustGasTemp100ms_CM_ufix16_En10_V 8 0 5 /end AXIS_PTS
/begin AXIS_PTS zkTH2O_BKP "[XBK] Tabella con caratteristica del sensore di pressione olio motore emulata" 0xFCABE6 NO_INPUT_QUANTITY Lookup1D_X_UWORD 0 TempOilSensor100ms_CM_ufix16_Bn40_degC 8 -40 140 /end AXIS_PTS
/begin AXIS_PTS zkTH2O_VOLT_BKP "[XBK] Tabella con caratteristica del sensore di temperatura acqua motore" 0xFC2CDA NO_INPUT_QUANTITY Lookup1D_X_UWORD 0 TempH2OSensor100ms_Symbol_CM_ufix16_En10_V 22 0 5 /end AXIS_PTS
/begin AXIS_PTS zkTKAT_VOLT_BKP "[XBK] Tabella con caratteristica del sensore di temperatura valle catalizzatore" 0xFC2C52 NO_INPUT_QUANTITY Lookup1D_X_UWORD 0 TempKatSensor100ms_Symbol_CM_ufix16_En10_V 8 0 5 /end AXIS_PTS
/begin AXIS_PTS zkTMAF_VOLT "[X_BKP] MAF (Mass Air Flow) integrated temperature voltage value" 0xFCAFBC zsTMAFVolt Lookup1D_X_UWORD 0 MAFTemp100ms_CM_ufix16_En10_V 8 0 5 /end AXIS_PTS
/begin AXIS_PTS zkTOIL_VOLT_BKP "[XBK] Tabella con caratteristica del sensore di pressione olio motore" 0xFCABBA zsTOilVolt Lookup1D_X_UWORD 0 TempOilSensor100ms_CM_ufix16_En10_V 22 0 5 /end AXIS_PTS
/begin AXIS_PTS zkTRAIL_VOLT_BKP "[XBK] Tabella con caratteristica del sensore di temperatura metano nel rail" 0xFC5A7A NO_INPUT_QUANTITY Lookup1D_X_UWORD 0 TempRailSensor100ms_Symbol_CM_ufix16_En10_V 22 0 5 /end AXIS_PTS
/begin AXIS_PTS zkUEGO_IP_CURR1 "[X_BKP] UEGO Ip current" 0xFC9C0C NO_INPUT_QUANTITY Lookup1D_X_UWORD 0 UegoSensor4ms_CM_ufix16_Sp0001_Bn3_mA 11 -3 3 /end AXIS_PTS
/begin AXIS_PTS zkUEGO_IP_CURR2 "[X_BKP] UEGO Ip current" 0xFC9BE0 NO_INPUT_QUANTITY Lookup1D_X_UWORD 0 UegoSensor4ms_CM_ufix16_Sp0001_Bn3_mA 22 -3 3 /end AXIS_PTS
/begin AXIS_PTS zkVBATT_VOLT_BKP "[XBK] Guadagno HW sensore VBatt" 0xFC2050 NO_INPUT_QUANTITY Lookup1D_X_UWORD 0 VBattSensor4ms_Symbol_CM_ufix16_En10_V 8 0 5 /end AXIS_PTS
/begin AXIS_PTS zkVBPW_BKP "[XBK] Conversione tensione batteria a valle relay carichi" 0xFCC650 NO_INPUT_QUANTITY Lookup1D_X_UWORD 0 VBattPower4ms_Symbol_CM_ufix16_En10_V 8 0 5 /end AXIS_PTS
/begin AXIS_PTS zkVEHICLE_1 "[XBK] Contributo al passo di incremento del raccordo della posizione pedale funzione della velocità veicolo" 0xFCAF02 NO_INPUT_QUANTITY Lookup1D_X_UWORD 0 TE_PotenzAccSensor_4ms_Symbol_CM_uint16_km_h 8 0 250 /end AXIS_PTS
/begin AXIS_PTS zkVOLT_IN_DEB "[XBK] Tabella di interpolazione di aria che attraversa il debimetro" 0xFC0124 zsQAirDebVolt Lookup1D_X_UWORD 0 DebimSensor4ms_CM_ufix16_En10_V 32 0 5 /end AXIS_PTS
/begin CHARACTERISTIC zsAIR_COND_DEB_STEP "Step di debouncing per segnale bsAirCondReq" VALUE 0xFC4C8B Scalar_UBYTE 0 DigInput4ms_Symbol_CM_uint8_adm 0 254 /end CHARACTERISTIC
/begin CHARACTERISTIC zsAV_AIR_CND_REQ "Calib : Flag Digital Input Air Cond Req (1 -> DI Av, 0 -> DI Not Av)" VALUE 0xFC4C8A Scalar_BOOLEAN 0 DigInput4ms_Symbol_CM_boolean_adm 0 1 /end CHARACTERISTIC
/begin CHARACTERISTIC zsAV_BRAKE_PED1 "Calib : Flag Digital Input Brake Ped 1 (1 -> DI Av, 0 -> DI Not Av)" VALUE 0xFC4C5A Scalar_BOOLEAN 0 TF_TE_DigInput4ms_CM_boolean_adm 0 1 /end CHARACTERISTIC
/begin CHARACTERISTIC zsAV_BRAKE_PED2 "Calib : Flag Digital Input Brake Ped 2 (1 -> DI Av, 0 -> DI Not Av)" VALUE 0xFC4C59 Scalar_BOOLEAN 0 TF_TE_DigInput4ms_CM_boolean_adm 0 1 /end CHARACTERISTIC
/begin CHARACTERISTIC zsAV_CLUTCH "Calib : Flag Digital Input Clutch (1 -> DI Av, 0 -> DI Not Av)" VALUE 0xFC4C58 Scalar_BOOLEAN 0 TF_TE_DigInput4ms_CM_boolean_adm 0 1 /end CHARACTERISTIC
/begin CHARACTERISTIC zsAV_DOORS_OPEN "Calib : Flag Digital Input Doors Open (1 -> DI Av, 0 -> DI Not Av)" VALUE 0xFC4C57 Scalar_BOOLEAN 0 TF_TE_DigInput4ms_CM_boolean_adm 0 1 /end CHARACTERISTIC
/begin CHARACTERISTIC zsAV_ENG_BRK "Calib : Flag Digital Input Engine Brake Request Command (1 -> DI Av, 0 -> DI Not Av)" VALUE 0xFC4C56 Scalar_BOOLEAN 0 TF_TE_DigInput4ms_CM_boolean_adm 0 1 /end CHARACTERISTIC
/begin CHARACTERISTIC zsAV_IDLE_ACC "Calib : Flag Digital Idle Acc (1 -> DI Av, 0 -> DI Not Av)" VALUE 0xFC4C55 Scalar_BOOLEAN 0 TF_TE_DigInput4ms_CM_boolean_adm 0 1 /end CHARACTERISTIC
/begin CHARACTERISTIC zsAV_KEY "Calib : Flag Digital Input Key (1 -> DI Av, 0 -> DI Not Av)" VALUE 0xFC4C89 Scalar_BOOLEAN 0 DigInput4ms_Symbol_CM_boolean_adm 0 1 /end CHARACTERISTIC
/begin CHARACTERISTIC zsAV_KEY_ENG_START "Calib : Flag Digital Seconda posizione chiave (1 -> DI Av, 0 -> DI Not Av)" VALUE 0xFC4C54 Scalar_BOOLEAN 0 TF_TE_DigInput4ms_CM_boolean_adm 0 1 /end CHARACTERISTIC
/begin CHARACTERISTIC zsAV_KICK_DOWN "Calib : Flag Digital Input Kick Down (1 -> DI Av, 0 -> DI Not Av)" VALUE 0xFC4C53 Scalar_BOOLEAN 0 TF_TE_DigInput4ms_CM_boolean_adm 0 1 /end CHARACTERISTIC
/begin CHARACTERISTIC zsAV_NIDLE_ACC "Calib : Flag Digital Not Idle Acc (1 -> DI Av, 0 -> DI Not Av)" VALUE 0xFC4C52 Scalar_BOOLEAN 0 TF_TE_DigInput4ms_CM_boolean_adm 0 1 /end CHARACTERISTIC
/begin CHARACTERISTIC zsAV_OFF "Calib : Flag Digital Input Off PTO (1 -> DI Av, 0 -> DI Not Av)" VALUE 0xFC4C51 Scalar_BOOLEAN 0 TF_TE_DigInput4ms_CM_boolean_adm 0 1 /end CHARACTERISTIC
/begin CHARACTERISTIC zsAV_PARK_BRK "Calib : Flag Digital Input Park Brake (1 -> DI Av, 0 -> DI Not Av)" VALUE 0xFC4C50 Scalar_BOOLEAN 0 TF_TE_DigInput4ms_CM_boolean_adm 0 1 /end CHARACTERISTIC
/begin CHARACTERISTIC zsAV_RESUME "Calib : Flag Digital Input resume (1 -> DI Av, 0 -> DI Not Av)" VALUE 0xFC4C4F Scalar_BOOLEAN 0 TF_TE_DigInput4ms_CM_boolean_adm 0 1 /end CHARACTERISTIC
/begin CHARACTERISTIC zsAV_SET_MINUS "Calib : Flag Digital Input for decrease PTO or CC Obj (1 -> DI Av, 0 -> DI Not Av)" VALUE 0xFC4C4E Scalar_BOOLEAN 0 TF_TE_DigInput4ms_CM_boolean_adm 0 1 /end CHARACTERISTIC
/begin CHARACTERISTIC zsAV_SET_PLUS "Calib : Flag Digital Input for increase PTO or CC Obj (1 -> DI Av, 0 -> DI Not Av)" VALUE 0xFC4C4D Scalar_BOOLEAN 0 TF_TE_DigInput4ms_CM_boolean_adm 0 1 /end CHARACTERISTIC
/begin CHARACTERISTIC zsAV_SPARE2 "Calib : Flag Digital Input Spare2 (1 -> DI Av, 0 -> DI Not Av)" VALUE 0xFC4C88 Scalar_BOOLEAN 0 DigInput4ms_Symbol_CM_boolean_adm 0 1 /end CHARACTERISTIC
/begin CHARACTERISTIC zsAV_SPARE3 "Calib : Flag Digital Input Spare3 (1 -> DI Av, 0 -> DI Not Av)" VALUE 0xFC4C87 Scalar_BOOLEAN 0 DigInput4ms_Symbol_CM_boolean_adm 0 1 /end CHARACTERISTIC
/begin CHARACTERISTIC zsAV_START_CBT "Calib : Flag Digital Input Start from Cabin Tilt (1 -> DI Av, 0 -> DI Not Av)" VALUE 0xFC4C86 Scalar_BOOLEAN 0 DigInput4ms_Symbol_CM_boolean_adm 0 1 /end CHARACTERISTIC
/begin CHARACTERISTIC zsAV_STOP_CBT "Calib : Flag Digital Input Stop from Cabin Tilt (1 -> DI Av, 0 -> DI Not Av)" VALUE 0xFC4C85 Scalar_BOOLEAN 0 DigInput4ms_Symbol_CM_boolean_adm 0 1 /end CHARACTERISTIC
/begin CHARACTERISTIC zsAV_VEH_SPEED_LIM "Calib : Flag Digital Input Vehicle Speed Limitation (1 -> DI Av, 0 -> DI Not Av)" VALUE 0xFC4C4C Scalar_BOOLEAN 0 TF_TE_DigInput4ms_CM_boolean_adm 0 1 /end CHARACTERISTIC
/begin MEASUREMENT zsAbsPotThr "Valore assoluto in percentuale della posizione farfalla" UBYTE Thrp4ms_CM_ufix8_Sp392__ 0 0 0 99.96 ECU_ADDRESS 0x400040EC /end MEASUREMENT
/begin MEASUREMENT zsAirCondReq "From Digital Input Module : Air Cond Request" UBYTE Digin4ms_CM_boolean_adm 0 0 0 1 ECU_ADDRESS 0x40002993 /end MEASUREMENT
/begin MEASUREMENT zsAvAirCndReq "Variable : Flag Digital Input Air Cond Req (1 -> DI Av, 0 -> DI Not Av)" UBYTE Digin4ms_CM_boolean_adm 0 0 0 1 ECU_ADDRESS 0x40002992 /end MEASUREMENT
/begin MEASUREMENT zsAvBrakePed1 "Flag Digital Brake Ped 1 ((1 -> DI Av, 0 -> DI Not Av)" UBYTE Digin4ms_CM_boolean_adm 0 0 0 1 ECU_ADDRESS 0x400029AE /end MEASUREMENT
/begin MEASUREMENT zsAvBrakePed2 "Flag Digital Brake Ped 2 (1 -> DI Av, 0 -> DI Not Av)" UBYTE Digin4ms_CM_boolean_adm 0 0 0 1 ECU_ADDRESS 0x400029AD /end MEASUREMENT
/begin MEASUREMENT zsAvClutch "Flag Digital Clutch (1 -> DI Av, 0 -> DI Not Av)" UBYTE Digin4ms_CM_boolean_adm 0 0 0 1 ECU_ADDRESS 0x400029A8 /end MEASUREMENT
/begin MEASUREMENT zsAvDoorsOpen "Flag Digital Input Doors Open (1 -> DI Av, 0 -> DI Not Av)" UBYTE Digin4ms_CM_boolean_adm 0 0 0 1 ECU_ADDRESS 0x400029AF /end MEASUREMENT
/begin MEASUREMENT zsAvEngBrkReq "Flag Digital Engine Brake command request (1 -> DI Av, 0 -> DI Not Av)" UBYTE Digin4ms_CM_boolean_adm 0 0 0 1 ECU_ADDRESS 0x400029AB /end MEASUREMENT
/begin MEASUREMENT zsAvIdleAcc "Flag Digital Idle Acc (1 -> DI Av, 0 -> DI Not Av)" UBYTE Digin4ms_CM_boolean_adm 0 0 0 1 ECU_ADDRESS 0x400029AA /end MEASUREMENT
/begin MEASUREMENT zsAvKey "Disponibilità del segnale di chiave (posizione MAR)" UBYTE Digin4ms_CM_boolean_adm 0 0 0 1 ECU_ADDRESS 0x40002991 /end MEASUREMENT
/begin MEASUREMENT zsAvKeyEngStart "Disponibilità Segnale di chiave (posizione AVV)" UBYTE Digin4ms_CM_boolean_adm 0 0 0 1 ECU_ADDRESS 0x40002998 /end MEASUREMENT
/begin MEASUREMENT zsAvKickDown "Flag Digital Kick Down (1 -> DI Av, 0 -> DI Not Av)" UBYTE Digin4ms_CM_boolean_adm 0 0 0 1 ECU_ADDRESS 0x400029AC /end MEASUREMENT
/begin MEASUREMENT zsAvNIdleAcc "Flag Digital Not Idle Acc (1 -> DI Av, 0 -> DI Not Av)" UBYTE Digin4ms_CM_boolean_adm 0 0 0 1 ECU_ADDRESS 0x400029A0 /end MEASUREMENT
/begin MEASUREMENT zsAvOff "isponibilita Off PTO or CC" UBYTE Digin4ms_CM_boolean_adm 0 0 0 1 ECU_ADDRESS 0x400029A2 /end MEASUREMENT
/begin MEASUREMENT zsAvParkBrk "Flag Digital Input Park Brake (1 -> DI Av, 0 -> DI Not Av)" UBYTE Digin4ms_CM_boolean_adm 0 0 0 1 ECU_ADDRESS 0x400029A6 /end MEASUREMENT
/begin MEASUREMENT zsAvResumeOn "Flag Digital Resume On availability (1 -> DI Av, 0 -> DI Not Av)" UBYTE Digin4ms_CM_boolean_adm 0 0 0 1 ECU_ADDRESS 0x4000299A /end MEASUREMENT
/begin MEASUREMENT zsAvSetMinus "Flag Digital for decrease MFLV Obj (1 -> DI Av, 0 -> DI Not Av)" UBYTE Digin4ms_CM_boolean_adm 0 0 0 1 ECU_ADDRESS 0x4000299C /end MEASUREMENT
/begin MEASUREMENT zsAvSetPlus "Flag Digital for encrease MFLV Obj (1 -> DI Av, 0 -> DI Not Av)" UBYTE Digin4ms_CM_boolean_adm 0 0 0 1 ECU_ADDRESS 0x4000299E /end MEASUREMENT
/begin MEASUREMENT zsAvSpare2 "isponibilità del segnale Spare2" UBYTE Digin4ms_CM_boolean_adm 0 0 0 1 ECU_ADDRESS 0x4000298F /end MEASUREMENT
/begin MEASUREMENT zsAvSpare3 "isponibilità del segnale Spare3" UBYTE Digin4ms_CM_boolean_adm 0 0 0 1 ECU_ADDRESS 0x4000298D /end MEASUREMENT
/begin MEASUREMENT zsAvStartCbt "Variable : Flag Digital Input Start from Cabin Tilt (1 -> DI Av, 0 -> DI Not Av)" UBYTE Digin4ms_CM_boolean_adm 0 0 0 1 ECU_ADDRESS 0x40002995 /end MEASUREMENT
/begin MEASUREMENT zsAvStopCbt "Variable : Flag Digital Input Stop from Cabin Tilt (1 -> DI Av, 0 -> DI Not Av)" UBYTE Digin4ms_CM_boolean_adm 0 0 0 1 ECU_ADDRESS 0x40002994 /end MEASUREMENT
/begin MEASUREMENT zsAvVehSpeedLim "Disponibilità limitatore velocità veicolo" UBYTE Digin4ms_CM_boolean_adm 0 0 0 1 ECU_ADDRESS 0x400029A4 /end MEASUREMENT
/begin CHARACTERISTIC zsBRAKE_DELAY "Ritardo sulla abilitazione della gestione LastWin con il solo pedale freno (BRAKE)" VALUE 0xFCAEBA Scalar_UWORD 0 TE_PotenzAccSensor_4ms_Symbol_CM_ufix16_Sp1_s 0 10 /end CHARACTERISTIC
/begin CHARACTERISTIC zsBRKCH_DEB_STEP "Step di debouncing per coerenza tra Brake1 e Brake2" VALUE 0xFC4CA4 Scalar_UBYTE 0 FaultChkBRKCH_4ms_Symbol_CM_uint8_adm 0 254 /end CHARACTERISTIC
/begin CHARACTERISTIC zsBRK_PD1_DEB_STEP "Step di debouncing per segnale bsBrakePed1" VALUE 0xFC4C4B Scalar_UBYTE 0 TF_TE_DigInput4ms_CM_uint8_adm 0 254 /end CHARACTERISTIC
/begin CHARACTERISTIC zsBRK_PD2_DEB_STEP "Step di debouncing per segnale bsBrakePed2" VALUE 0xFC4C4A Scalar_UBYTE 0 TF_TE_DigInput4ms_CM_uint8_adm 0 254 /end CHARACTERISTIC
/begin MEASUREMENT zsBrakePed1 "zsBrakePed1 Signal" UBYTE Digin4ms_CM_boolean_adm 0 0 0 1 ECU_ADDRESS 0x400029B4 /end MEASUREMENT
/begin MEASUREMENT zsBrakePed2 "zsBrakePed2 Signal" UBYTE Digin4ms_CM_boolean_adm 0 0 0 1 ECU_ADDRESS 0x400029B3 /end MEASUREMENT
/begin MEASUREMENT zsBrakeTrans "Transizzione stato pedale freno in uscita da FSM LastWin" UBYTE TE_PotenzAccSensor_4ms_Symbol_CM_boolean_adm 0 0 0 1 ECU_ADDRESS 0x40003FBC /end MEASUREMENT
/begin CHARACTERISTIC zsCLUTCH_DEB_STEP "Step di debouncing per segnale bsClutch" VALUE 0xFC4C49 Scalar_UBYTE 0 TF_TE_DigInput4ms_CM_uint8_adm 0 254 /end CHARACTERISTIC
/begin MEASUREMENT zsClutch "KickDown Signal" UBYTE Digin4ms_CM_boolean_adm 0 0 0 1 ECU_ADDRESS 0x400029A9 /end MEASUREMENT
/begin CHARACTERISTIC zsDN_AIR_CND_REQ "Flag Digital Input Air Cond Req (0 -> Direct DI, 1 -> Neg DI)" VALUE 0xFC4C84 Scalar_BOOLEAN 0 DigInput4ms_Symbol_CM_boolean_adm 0 1 /end CHARACTERISTIC
/begin CHARACTERISTIC zsDN_BRAKE_PED1 "Flag Digital Input Brake Ped 1 (0 -> Direct DI, 1 -> Neg DI)" VALUE 0xFC4C48 Scalar_BOOLEAN 0 TF_TE_DigInput4ms_CM_boolean_adm 0 1 /end CHARACTERISTIC
/begin CHARACTERISTIC zsDN_BRAKE_PED2 "Flag Digital Input Brake Ped 2 (0 -> Direct DI, 1 -> Neg DI)" VALUE 0xFC4C47 Scalar_BOOLEAN 0 TF_TE_DigInput4ms_CM_boolean_adm 0 1 /end CHARACTERISTIC
/begin CHARACTERISTIC zsDN_CLUTCH "Flag Digital Input Clutch (0 -> Direct DI, 1 -> Neg DI)" VALUE 0xFC4C46 Scalar_BOOLEAN 0 TF_TE_DigInput4ms_CM_boolean_adm 0 1 /end CHARACTERISTIC
/begin CHARACTERISTIC zsDN_DOORS_OPEN "Flag Digital Input Doors Open (0 -> Direct DI, 1 -> Neg DI)" VALUE 0xFC4C45 Scalar_BOOLEAN 0 TF_TE_DigInput4ms_CM_boolean_adm 0 1 /end CHARACTERISTIC
/begin CHARACTERISTIC zsDN_ENG_BRK "Flag Digital Input Engine Brake Request Command (0 -> Direct DI, 1 -> Neg DI)" VALUE 0xFC4C44 Scalar_BOOLEAN 0 TF_TE_DigInput4ms_CM_boolean_adm 0 1 /end CHARACTERISTIC
/begin CHARACTERISTIC zsDN_IDLE_ACC "Flag Digital Idle Acc (0 -> Direct DI, 1 -> Neg DI)" VALUE 0xFC4C43 Scalar_BOOLEAN 0 TF_TE_DigInput4ms_CM_boolean_adm 0 1 /end CHARACTERISTIC
/begin CHARACTERISTIC zsDN_KEY "Flag Digital Input zsKey (0 -> Direct DI, 1 -> Neg DI)" VALUE 0xFC4C83 Scalar_BOOLEAN 0 DigInput4ms_Symbol_CM_boolean_adm 0 1 /end CHARACTERISTIC
/begin CHARACTERISTIC zsDN_KEY_ENG_START "Flag Digital Input Seconda posizione chiave (0 -> Direct DI, 1 -> Neg DI)" VALUE 0xFC4C42 Scalar_BOOLEAN 0 TF_TE_DigInput4ms_CM_boolean_adm 0 1 /end CHARACTERISTIC
/begin CHARACTERISTIC zsDN_KICK_DOWN "Flag Digital Input Kick Down (0 -> Direct DI, 1 -> Neg DI)" VALUE 0xFC4C41 Scalar_BOOLEAN 0 TF_TE_DigInput4ms_CM_boolean_adm 0 1 /end CHARACTERISTIC
/begin CHARACTERISTIC zsDN_NIDLE_ACC "Flag Digital Not Idle Acc (0 -> Direct DI, 1 -> Neg DI)" VALUE 0xFC4C40 Scalar_BOOLEAN 0 TF_TE_DigInput4ms_CM_boolean_adm 0 1 /end CHARACTERISTIC
/begin CHARACTERISTIC zsDN_OFF "Flag Digital Input Off PTO or CC (0 -> Direct DI, 1 -> Neg DI)" VALUE 0xFC4C3F Scalar_BOOLEAN 0 TF_TE_DigInput4ms_CM_boolean_adm 0 1 /end CHARACTERISTIC
/begin CHARACTERISTIC zsDN_PARK_BRK "Flag Digital Input Park Brake (0 -> Direct DI, 1 -> Neg DI)" VALUE 0xFC4C3E Scalar_BOOLEAN 0 TF_TE_DigInput4ms_CM_boolean_adm 0 1 /end CHARACTERISTIC
/begin CHARACTERISTIC zsDN_RESUME "Flag Digital Input resume (0 -> Direct DI, 1 -> Neg DI)" VALUE 0xFC4C3D Scalar_BOOLEAN 0 TF_TE_DigInput4ms_CM_boolean_adm 0 1 /end CHARACTERISTIC
/begin CHARACTERISTIC zsDN_SET_MINUS "Flag Digital Input for decrease PTO or CC Obj Command (0 -> Direct DI, 1 -> Neg DI)" VALUE 0xFC4C3C Scalar_BOOLEAN 0 TF_TE_DigInput4ms_CM_boolean_adm 0 1 /end CHARACTERISTIC
/begin CHARACTERISTIC zsDN_SET_PLUS "Flag Digital Input for increase PTO or CC Obj Command (0 -> Direct DI, 1 -> Neg DI)" VALUE 0xFC4C3B Scalar_BOOLEAN 0 TF_TE_DigInput4ms_CM_boolean_adm 0 1 /end CHARACTERISTIC
/begin CHARACTERISTIC zsDN_SPARE2 "Flag Digital Input Spare2 (0 -> Direct DI, 1 -> Neg DI)" VALUE 0xFC4C82 Scalar_BOOLEAN 0 DigInput4ms_Symbol_CM_boolean_adm 0 1 /end CHARACTERISTIC
/begin CHARACTERISTIC zsDN_SPARE3 "Flag Digital Input Spare3 (0 -> Direct DI, 1 -> Neg DI)" VALUE 0xFC4C81 Scalar_BOOLEAN 0 DigInput4ms_Symbol_CM_boolean_adm 0 1 /end CHARACTERISTIC
/begin CHARACTERISTIC zsDN_START_CBT "Flag Digital Input Start from Cabin Tilt (0 -> Direct DI, 1 -> Neg DI)" VALUE 0xFC4C80 Scalar_BOOLEAN 0 DigInput4ms_Symbol_CM_boolean_adm 0 1 /end CHARACTERISTIC
/begin CHARACTERISTIC zsDN_STOP_CBT "Flag Digital Input Stop from Cabin Tilt (0 -> Direct DI, 1 -> Neg DI)" VALUE 0xFC4C7F Scalar_BOOLEAN 0 DigInput4ms_Symbol_CM_boolean_adm 0 1 /end CHARACTERISTIC
/begin CHARACTERISTIC zsDN_VEH_SPEED_LIM "Flag Digital Input Vehicle Speed Limitation (0 -> Direct DI, 1 -> Neg DI)" VALUE 0xFC4C3A Scalar_BOOLEAN 0 TF_TE_DigInput4ms_CM_boolean_adm 0 1 /end CHARACTERISTIC
/begin CHARACTERISTIC zsDOORS_OP_DEB_STEP "Step di debouncing per segnale bsDoorsOpen" VALUE 0xFC4C39 Scalar_UBYTE 0 TF_TE_DigInput4ms_CM_uint8_adm 0 254 /end CHARACTERISTIC
/begin MEASUREMENT zsDegNlp "Testpoint gradi assoluti NLP Potenziometro Farfalla" UWORD TE_TM_PotThrSens4ms_Symbol_CM_ufix16_En9_deg 0 0 0 105 ECU_ADDRESS 0x40004178 /end MEASUREMENT
/begin MEASUREMENT zsDegUea "Testpoint gradi assoluti UEA Potenziometro Farfalla" UWORD TE_TM_PotThrSens4ms_Symbol_CM_ufix16_En9_deg 0 0 0 105 ECU_ADDRESS 0x40004176 /end MEASUREMENT
/begin MEASUREMENT zsDeltaThrotPos "Posizione di apertura farfalla" SWORD Thrp4ms_CM_sfix16_En3_degF 0 0 0 90 ECU_ADDRESS 0x400040F8 /end MEASUREMENT
/begin MEASUREMENT zsDigInSpare2 "egnale Spare2" UBYTE Digin4ms_CM_boolean_adm 0 0 0 1 ECU_ADDRESS 0x40002990 /end MEASUREMENT
/begin MEASUREMENT zsDigInSpare3 "egnale Spare3" UBYTE Digin4ms_CM_boolean_adm 0 0 0 1 ECU_ADDRESS 0x4000298E /end MEASUREMENT
/begin MEASUREMENT zsDoorsOpen "Segnale di indicazione porte aperte" UBYTE Digin4ms_CM_boolean_adm 0 0 0 1 ECU_ADDRESS 0x400029B5 /end MEASUREMENT
/begin MEASUREMENT zsECUTemp "Ecu Temperature" UWORD Ecut1s_CM_ufix16_Bn40_degC 0 0 -40 150 ECU_ADDRESS 0x40002A34 /end MEASUREMENT
/begin MEASUREMENT zsECUTempToD "Recovery GSEC - Ecu Temperature" UWORD Ecut1s_CM_ufix16_Bn40_degC 0 0 -40 150 ECU_ADDRESS 0x40002A32 /end MEASUREMENT
/begin CHARACTERISTIC zsENG_BRK_DEB_STEP "Debouncing Step for singal bsEngBrake (bsDoorsOpen)" VALUE 0xFC4C38 Scalar_UBYTE 0 TF_TE_DigInput4ms_CM_uint8_adm 0 254 /end CHARACTERISTIC
/begin CHARACTERISTIC zsEN_NEG_UMA "Flag selezione valori UMA negativi (1 -> Inf = -10deg; 0 -> Inf = 0deg)" VALUE 0xFCB483 Scalar_BOOLEAN 0 TE_TM_PotThrSens4ms_Symbol_CM_boolean_adm 0 1 /end CHARACTERISTIC
/begin MEASUREMENT zsEgrDeltaP "Egr Delta Pressure acquired by analog input" SLONG EgrMgm4ms_CM_sfix32_En10_mbar 0 0 -2850 2500 ECU_ADDRESS 0x40002B0C /end MEASUREMENT
/begin MEASUREMENT zsEgrDeltaPTmp "[OUT] Egr Delta pressure sensor characteristic " SLONG EgrDeltaP4ms_CM_sfix32_En10_mbar 0 0 -2850 2500 ECU_ADDRESS 0x40002B30 /end MEASUREMENT
/begin MEASUREMENT zsEgrDeltaPVolt "Egr Delta pressure voltage value" UWORD EgrDeltaP4ms_CM_ufix16_En10_V 0 0 0 5 ECU_ADDRESS 0x40002B2C /end MEASUREMENT
/begin MEASUREMENT zsEgrHighPre "Pressure at the inlet of EGR valve (High Pressure EGR)" UWORD EgrMgm4ms_CM_uint16_mbar 0 0 0 5000 ECU_ADDRESS 0x40002B08 /end MEASUREMENT
/begin MEASUREMENT zsEgrHighPreTmp "[OUT] Egr inlet valve pressure (high pressure EGR)  sensor characteristic " UWORD EgrHighPre4ms_CM_uint16_mbar 0 0 0 5000 ECU_ADDRESS 0x40002B56 /end MEASUREMENT
/begin MEASUREMENT zsEgrHighPreVolt "Egr inlet valve pressure (high pressure EGR) voltage value" UWORD EgrHighPre4ms_CM_ufix16_En10_V 0 0 0 5 ECU_ADDRESS 0x40002B54 /end MEASUREMENT
/begin MEASUREMENT zsEgrPos "EGR position" UWORD EgrMgm4ms_CM_ufix16_En10_V 0 0 0 5 ECU_ADDRESS 0x40002B00 /end MEASUREMENT
/begin MEASUREMENT zsEgrPosToD "Recovery GSEC - EGR position" UWORD EgrMgm4ms_CM_ufix16_En10_V 0 0 0 5 ECU_ADDRESS 0x40002AFE /end MEASUREMENT
/begin MEASUREMENT zsEngBrkReq "Digital Input after dobounce / deny - Engine Brake command request" UBYTE Digin4ms_CM_boolean_adm 0 0 0 1 ECU_ADDRESS 0x400029B1 /end MEASUREMENT
/begin CHARACTERISTIC zsHW_GAIN_BAT "Battery Hardware Gain (partitore stadio Power Supply Voltage)" VALUE 0xFC2026 Scalar_UWORD 0 FaultChkBAT4ms_CM_ufix16_En10_adm 0 2 /end CHARACTERISTIC
/begin CHARACTERISTIC zsHW_GAIN_VBPW "Power Relay Hardware Gain (partitore stadio Power Supply Voltage)" VALUE 0xFCC626 Scalar_UWORD 0 FaultChkVBP4ms_CM_ufix16_En10_adm 0 2 /end CHARACTERISTIC
/begin CHARACTERISTIC zsIDLE_DEB_STEP "Step di debouncing per segnale bsIdleAcc" VALUE 0xFC4C37 Scalar_UBYTE 0 TF_TE_DigInput4ms_CM_uint8_adm 0 254 /end CHARACTERISTIC
/begin MEASUREMENT zsIdleAcc "zsIdleAcc Signal" UBYTE Digin4ms_CM_boolean_adm 0 0 0 1 ECU_ADDRESS 0x400029B0 /end MEASUREMENT
/begin MEASUREMENT zsIdleAccR "zsIdleAcc Signal after recovery" UBYTE Pacc4ms_CM_uint8_adm 0 0 0 3 ECU_ADDRESS 0x40003F64 /end MEASUREMENT
/begin MEASUREMENT zsIpLamConv "[OUT] Conversion map between UEGO Ip to lambda" UWORD UegoSensor4ms_CM_ufix16_En10 0 0 0 15 ECU_ADDRESS 0x4000374C /end MEASUREMENT
/begin CHARACTERISTIC zsKEY_DEB_STEP "Step di debouncing per segnale chiave" VALUE 0xFC4C7E Scalar_UBYTE 0 DigInput4ms_Symbol_CM_uint8_adm 0 254 /end CHARACTERISTIC
/begin CHARACTERISTIC zsKEY_START_DEB_STEP "Step di debouncing per segnale bsKeyEngStart" VALUE 0xFC4C36 Scalar_UBYTE 0 TF_TE_DigInput4ms_CM_uint8_adm 0 254 /end CHARACTERISTIC
/begin CHARACTERISTIC zsKFHW_BATTV "Costante del filtro PassaBasso sulla Tensione Bbatteria nel modo motore Crank" VALUE 0xFC2032 Scalar_UWORD 0 VBattSensor4ms_Symbol_CM_ufix16_En10_adm 0 1 /end CHARACTERISTIC
/begin CHARACTERISTIC zsKFHW_CRK_BATTV "Costante del filtro PassaBasso sulla Tensione Batteria nel funzionamento normale" VALUE 0xFC2030 Scalar_UWORD 0 VBattSensor4ms_Symbol_CM_ufix16_En10_adm 0 1 /end CHARACTERISTIC
/begin CHARACTERISTIC zsKFHW_CRK_VBPW "Costante del filtro PassaBasso sulla tensione batteria da Releÿ carichi nel funzionamento normale" VALUE 0xFCC632 Scalar_UWORD 0 VBattPower4ms_Symbol_CM_ufix16_En10_adm 0 1 /end CHARACTERISTIC
/begin CHARACTERISTIC zsKFHW_EGRDELTAP "EGR deltaP low pass filter constant" VALUE 0xFC4DE6 Scalar_UWORD 0 EgrDeltaP4ms_CM_ufix16_En10_adm 0 1 /end CHARACTERISTIC
/begin CHARACTERISTIC zsKFHW_EGROBJ "EGR target position low pass filter constant" VALUE 0xFC4DE4 Scalar_UWORD 0 TE_HBEgrValveCtrl4ms_CM_ufix16_En10_adm 0 1 /end CHARACTERISTIC
/begin CHARACTERISTIC zsKFHW_EGRP "EGR position low pass filter constant" VALUE 0xFC4DE2 Scalar_UWORD 0 TE_EgrPos4ms_CM_ufix16_En10_adm 0 1 /end CHARACTERISTIC
/begin CHARACTERISTIC zsKFHW_EGR_FR "EGR measured flow rate low pass filter constant" VALUE 0xFC4DE0 Scalar_UWORD 0 EgrFlowRateMeas4ms_CM_ufix16_En10_adm 0 1 /end CHARACTERISTIC
/begin CHARACTERISTIC zsKFHW_EGR_HP "EGR inlet valve pressure (High Pressure EGR)  low pass filter constant" VALUE 0xFC4DDE Scalar_UWORD 0 EgrHighPre4ms_CM_ufix16_En10_adm 0 1 /end CHARACTERISTIC
/begin CHARACTERISTIC zsKFHW_LAM_POST "Costante del filtro PassaBasso sulla tensione letta dalla seconda Sonda Lambda" VALUE 0xFC9BDE Scalar_UWORD 0 LambdaPostSensor4ms_CM_ufix16_En10_adm 0 1 /end CHARACTERISTIC
/begin CHARACTERISTIC zsKFHW_LAM_PRE "Costante del filtro PassaBasso sulla tensione letta dalla Sonda Lambda" VALUE 0xFC9BDC Scalar_UWORD 0 LambdaPreSensor4ms_CM_ufix16_En10_adm 0 1 /end CHARACTERISTIC
/begin CHARACTERISTIC zsKFHW_MAP "Costante del filtro PassaBasso sulla Pressione Collettore" VALUE 0xFCAA6C Scalar_UWORD 0 MapSensor4ms_Symbol_CM_ufix16_En10_adm 0 1 /end CHARACTERISTIC
/begin CHARACTERISTIC zsKFHW_PATM "Costante del filtro PassaBasso sulla Pressione Atmosferica" VALUE 0xFC1F0C Scalar_UWORD 0 AtmophericPresSensor100ms_Symbol_CM_ufix16_En10_adm 0 1 /end CHARACTERISTIC
/begin CHARACTERISTIC zsKFHW_PBOOST "Costante del filtro PassaBasso sulla Pressione di sovralimentazione" VALUE 0xFC2BC4 Scalar_UWORD 0 BoostPresSensor4ms_Symbol_CM_ufix16_En10_adm 0 1 /end CHARACTERISTIC
/begin CHARACTERISTIC zsKFHW_POIL "Costante del filtro PassaBasso sulla Pressione Olio" VALUE 0xFCAB50 Scalar_UWORD 0 OilPresSensor100ms_Symbol_CM_ufix16_En10_adm 0 1 /end CHARACTERISTIC
/begin CHARACTERISTIC zsKFHW_POT_ACC "Costante del filtro PassaBasso sul potenziometro  principale del pedale acceleratore" VALUE 0xFCAEB8 Scalar_UWORD 0 TE_PotenzAccSensor_4ms_Symbol_CM_ufix16_En10_adm 0 1 /end CHARACTERISTIC
/begin CHARACTERISTIC zsKFHW_POT_THR "Costante del filtro PassaBasso sui potenziometri della farfalla" VALUE 0xFCB48A Scalar_UWORD 0 TE_TM_PotThrSens4ms_Symbol_CM_ufix16_En10_adm 0 1 /end CHARACTERISTIC
/begin CHARACTERISTIC zsKFHW_PRAIL "Low Pass Filter constant for Rail pressure sensor" VALUE 0xFCAF64 Scalar_UWORD 0 RailPresSensor4ms_CM_ufix16_En10_adm 0 1 /end CHARACTERISTIC
/begin CHARACTERISTIC zsKFHW_PTANK "Costante del filtro PassaBasso sulla Pressione Bombole" VALUE 0xFCB682 Scalar_UWORD 0 TankPresSensor4ms_Symbol_CM_ufix16_En10_adm 0 1 /end CHARACTERISTIC
/begin CHARACTERISTIC zsKFHW_QDEB "Costante del filtro sulla portata aria letta da Debimetro" VALUE 0xFC0122 Scalar_UWORD 0 DebimSensor4ms_CM_ufix16_En10_adm 0 1 /end CHARACTERISTIC
/begin CHARACTERISTIC zsKFHW_TAIR "Costante del filtro PassaBasso sulla Temperatura Aria Collettore" VALUE 0xFC1EAA Scalar_UWORD 0 TempAirSensor100ms_Symbol_CM_ufix16_En10_adm 0 1 /end CHARACTERISTIC
/begin CHARACTERISTIC zsKFHW_TBOOST "Boost temperature low pass filter constant" VALUE 0xFCAFBA Scalar_UWORD 0 TurboTemp100ms_CM_ufix16_En10_adm 0 1 /end CHARACTERISTIC
/begin CHARACTERISTIC zsKFHW_TECU "Costante del filtro PassaBasso sulla Pressione Atmosferica\r\n      Ecu temperature low pass filter constant" VALUE 0xFC4CC6 Scalar_UWORD 0 EcuTempSensor1s_CM_ufix16_En10_adm 0 1 /end CHARACTERISTIC
/begin CHARACTERISTIC zsKFHW_TEGRCOOLER "Egr Cooler temperature low pass filter constant" VALUE 0xFC4DDC Scalar_UWORD 0 EgrCoolerTemp4ms_CM_ufix16_En10_adm 0 1 /end CHARACTERISTIC
/begin CHARACTERISTIC zsKFHW_TEXH "Exhaust manifold temperature low pass filter constant" VALUE 0xFC55B2 Scalar_UWORD 0 ExhaustGasTemp100ms_CM_ufix16_En10_adm 0 1 /end CHARACTERISTIC
/begin CHARACTERISTIC zsKFHW_TH2O "Costante del filtro PassaBasso sulla Temperatura acqua motore" VALUE 0xFC2CA4 Scalar_UWORD 0 TempH2OSensor100ms_Symbol_CM_ufix16_En10_adm 0 1 /end CHARACTERISTIC
/begin CHARACTERISTIC zsKFHW_TKAT "Costante del filtro PassaBasso sulla Temperatura valle catalizzatore" VALUE 0xFC2C38 Scalar_UWORD 0 TempKatSensor100ms_Symbol_CM_ufix16_En10_adm 0 1 /end CHARACTERISTIC
/begin CHARACTERISTIC zsKFHW_TMAF "MAF (Mass Air Flow) integrated temperature low pass filter constant" VALUE 0xFCAFB8 Scalar_UWORD 0 MAFTemp100ms_CM_ufix16_En10_adm 0 1 /end CHARACTERISTIC
/begin CHARACTERISTIC zsKFHW_TOIL "Costante del filtro PassaBasso sulla Temperatura Olio motore" VALUE 0xFCABB8 Scalar_UWORD 0 TempOilSensor100ms_CM_ufix16_En10_adm 0 1 /end CHARACTERISTIC
/begin CHARACTERISTIC zsKFHW_TRAIL "Costante del filtro PassaBasso sulla Temperatura Metano nel rail" VALUE 0xFC5A44 Scalar_UWORD 0 TempRailSensor100ms_Symbol_CM_ufix16_En10_adm 0 1 /end CHARACTERISTIC
/begin CHARACTERISTIC zsKFHW_UEGO_IP "Filtering constatn for the LowPass filter on the UEGO Current Ip" VALUE 0xFC9BDA Scalar_UWORD 0 UegoSensor4ms_CM_ufix16_En10_adm 0 1 /end CHARACTERISTIC
/begin CHARACTERISTIC zsKFHW_VBPW "Costante del filtro PassaBasso sulla tensione batteria da Releÿ carichi nel modo motore Crank" VALUE 0xFCC630 Scalar_UWORD 0 VBattPower4ms_Symbol_CM_ufix16_En10_adm 0 1 /end CHARACTERISTIC
/begin CHARACTERISTIC zsKICK_DOWN_DEB_STEP "Step di debouncing per segnale bsKickDown" VALUE 0xFC4C35 Scalar_UBYTE 0 TF_TE_DigInput4ms_CM_uint8_adm 0 254 /end CHARACTERISTIC
/begin CHARACTERISTIC zsKICK_DOWN_THR "Soglia di riconoscimento SoftWare del KickDown" VALUE 0xFCAEB6 Scalar_UWORD 0 TE_PotenzAccSensor_4ms_Symbol_CM_ufix16_En10_V 0 5 /end CHARACTERISTIC
/begin MEASUREMENT zsKey "Segnale di chiave (posizione MAR)" UBYTE Airt100ms_CM_tKeyState_adm 0 0 0 1 ECU_ADDRESS 0x4000298B /end MEASUREMENT
/begin MEASUREMENT zsKeyEngStart "Segnale di chiave (posizione AVV)" UBYTE Crkc4ms_CM_boolean_adm 0 0 0 1 ECU_ADDRESS 0x40002999 /end MEASUREMENT
/begin MEASUREMENT zsKickDown "KickDown Signal: Ricostruito" UBYTE Digin4ms_CM_boolean_adm 0 0 0 1 ECU_ADDRESS 0x400029B2 /end MEASUREMENT
/begin MEASUREMENT zsKickDownR "KickDown Signal: Ricostruito" UBYTE Pacc4ms_CM_boolean_adm 0 0 0 1 ECU_ADDRESS 0x40003F5D /end MEASUREMENT
/begin MEASUREMENT zsLambdaPost "Valore in mVolt della Sonda Lambda post-catalizzatore" UWORD Ctit_LambdaCtrlTDC_CM_uint16_mV 0 0 0 1000 ECU_ADDRESS 0x40003700 /end MEASUREMENT
/begin MEASUREMENT zsLambdaPostF "Valore in mVolt filtrato della Sonda Lambda post-catalizzatore" UWORD Dcat_Diagnosis100ms_CM_uint16_mV 0 0 0 1000 ECU_ADDRESS 0x400036FE /end MEASUREMENT
/begin MEASUREMENT zsLambdaPostTmp "[OUT] Caratteristica sensore Lambda post-catalizzatore" UWORD LambdaPostSensor4ms_CM_uint16_mV 0 0 0 1300 ECU_ADDRESS 0x4000371C /end MEASUREMENT
/begin MEASUREMENT zsLambdaPostV "Valore di recovery istantanea della sonda lambda post-catalizzatore" UWORD LambdaPostSensor4ms_CM_ufix16_En10_V 0 0 0 5 ECU_ADDRESS 0x4000371A /end MEASUREMENT
/begin MEASUREMENT zsLambdaPostVolt "Lambda post-catalyst sensor voltage value" UWORD LambdaPostSensor4ms_CM_ufix16_En10_V 0 0 0 5 ECU_ADDRESS 0x40003718 /end MEASUREMENT
/begin MEASUREMENT zsLambdaPre "Valore in mVolt della Sonda Lambda pre-catalizzatore" UWORD Ctit_LambdaCtrlTDC_CM_uint16_mV 0 0 0 1000 ECU_ADDRESS 0x400036FC /end MEASUREMENT
/begin MEASUREMENT zsLambdaPreF "Valore in mVolt filtrato della Sonda Lambda pre-catalizzatore" UWORD Dcat_Diagnosis100ms_CM_uint16_mV 0 0 0 1000 ECU_ADDRESS 0x400036FA /end MEASUREMENT
/begin MEASUREMENT zsLambdaPreRes "Value of the pre-kat probe in mV (HEGO or UEGO depends on fsUEGO_EMULATION status)" UWORD Ctit_LambdaCtrlTDC_CM_uint16_mV 0 0 0 1000 ECU_ADDRESS 0x400023E2 /end MEASUREMENT
/begin MEASUREMENT zsLambdaPreTmp "[OUT] Caratteristica sensore Lambda pre-catalizzatore" UWORD LambdaPreSensor4ms_CM_uint16_mV 0 0 0 1300 ECU_ADDRESS 0x40003738 /end MEASUREMENT
/begin MEASUREMENT zsLambdaPreV "Valore di recovery istantanea della sonda lambda pre-catalizzatore" UWORD LambdaPreSensor4ms_CM_ufix16_En10_V 0 0 0 5 ECU_ADDRESS 0x40003736 /end MEASUREMENT
/begin MEASUREMENT zsLambdaPreVolt "Lambda pre-cat sensor voltage value" UWORD LambdaPreSensor4ms_CM_ufix16_En10_V 0 0 0 5 ECU_ADDRESS 0x40003734 /end MEASUREMENT
/begin MEASUREMENT zsLastWinSPP "Variabile di stato in uscita da FSM LastWin" UBYTE TE_PotenzAccSensor_4ms_Symbol_CM_uint8_adm 0 0 1 3 ECU_ADDRESS 0x40003FBB /end MEASUREMENT
/begin CHARACTERISTIC zsMINUS_DEB_STEP "Step di debouncing per segnale bsSetMinus" VALUE 0xFC4C34 Scalar_UBYTE 0 TF_TE_DigInput4ms_CM_uint8_adm 0 254 /end CHARACTERISTIC
/begin MEASUREMENT zsMaf "[OUT] Tabella di interpolazione di aria che attraversa il debimetro" UWORD DebimSensor4ms_CM_ufix16_En4_kg_h 0 0 0 4000 ECU_ADDRESS 0x40001E02 /end MEASUREMENT
/begin MEASUREMENT zsMafSup "Massimo valore di portata aria misurabile dal debimetro" UWORD Airq4ms_CM_ufix16_En4_kg_h 0 0 0 4000 ECU_ADDRESS 0x40001DE8 /end MEASUREMENT
/begin MEASUREMENT zsMap "Pressione nel collettore di aspirazione (assoluta)" UWORD Airq4ms_CM_uint16_mbar 0 0 150 2500 ECU_ADDRESS 0x40003EDA /end MEASUREMENT
/begin MEASUREMENT zsMapBar "[OUT] Caratteristica del sensore di pressione assoluta nel collettore" UWORD MapSensor4ms_Symbol_CM_uint16_mbar 0 0 1 2700 ECU_ADDRESS 0x40003EEE /end MEASUREMENT
/begin MEASUREMENT zsMapToD "Recovery GSEC - Pressione nel collettore di aspirazione (assoluta)" UWORD Mpre4ms_CM_uint16_mbar 0 0 150 2500 ECU_ADDRESS 0x40003ED8 /end MEASUREMENT
/begin MEASUREMENT zsMapVolt "Map sensor voltage value" UWORD MapSensor4ms_Symbol_CM_ufix16_En10_V 0 0 0 5 ECU_ADDRESS 0x40003EEC /end MEASUREMENT
/begin CHARACTERISTIC zsNIDLE_DEB_STEP "Step di debouncing per segnale bsNIdleAcc" VALUE 0xFC4C33 Scalar_UBYTE 0 TF_TE_DigInput4ms_CM_uint8_adm 0 254 /end CHARACTERISTIC
/begin MEASUREMENT zsNIdleAcc "zsIdleAcc inverted Signal" UBYTE Digin4ms_CM_boolean_adm 0 0 0 1 ECU_ADDRESS 0x400029A1 /end MEASUREMENT
/begin MEASUREMENT zsNLPThr "Potenziometro della farfalla motorizzata NLP" UWORD Airq_CtrlMgmtTDC_CM_ufix16_En8__ 0 0 0 100 ECU_ADDRESS 0x4000410A /end MEASUREMENT
/begin CHARACTERISTIC zsOFFSET_UEA "Offset in tensione al valore di UMA" VALUE 0xFCB488 Scalar_UWORD 0 TE_TM_PotThrSens4ms_Symbol_CM_ufix16_En10_V 0 1 /end CHARACTERISTIC
/begin CHARACTERISTIC zsOFF_DEB_STEP "Step di debouncing per segnale bsOff" VALUE 0xFC4C32 Scalar_UBYTE 0 TF_TE_DigInput4ms_CM_uint8_adm 0 254 /end CHARACTERISTIC
/begin MEASUREMENT zsOff "Richiesta off PTO or CC" UBYTE Digin4ms_CM_boolean_adm 0 0 0 1 ECU_ADDRESS 0x400029A3 /end MEASUREMENT
/begin MEASUREMENT zsPAtm "Pressione atmosferica (assoluta)" UWORD Airq_CtrlMgmtTDC_CM_uint16_mbar 0 0 150 1150 ECU_ADDRESS 0x40002072 /end MEASUREMENT
/begin MEASUREMENT zsPAtmToD "Recovery GSEC - Pressione Atmosferica (assoluta)" UWORD Apre100ms_CM_uint16_mbar 0 0 150 1150 ECU_ADDRESS 0x40002070 /end MEASUREMENT
/begin MEASUREMENT zsPAtmVolt "Atmospheric pressure voltage value" UWORD AtmophericPresSensor100ms_Symbol_CM_ufix16_En10_V 0 0 0 5 ECU_ADDRESS 0x4000207E /end MEASUREMENT
/begin MEASUREMENT zsPBoost "Pressione di sovralimentazione (assoluta)" UWORD Airq4ms_CM_uint16_mbar 0 0 500 4000 ECU_ADDRESS 0x400022A4 /end MEASUREMENT
/begin MEASUREMENT zsPBoostVolt "Pression Boost voltage" UWORD BoostPresSensor4ms_Symbol_CM_ufix16_En10_V 0 0 0 5 ECU_ADDRESS 0x400022B2 /end MEASUREMENT
/begin CHARACTERISTIC zsPLUS_DEB_STEP "Step di debouncing per segnale bsSetPlus" VALUE 0xFC4C31 Scalar_UBYTE 0 TF_TE_DigInput4ms_CM_uint8_adm 0 254 /end CHARACTERISTIC
/begin CHARACTERISTIC zsPOT_GRAD "Gradiente del potenziometro farfalla motorizzata" VALUE 0xFCB486 Scalar_UWORD 0 TE_TM_PotThrSens4ms_Symbol_CM_ufix16_En8___deg 0.25 1.99609375 /end CHARACTERISTIC
/begin CHARACTERISTIC zsPOT_PRESSED "Soglia di riconoscimento pedale acceleratore premuto" VALUE 0xFCAEB4 Scalar_UWORD 0 TE_PotenzAccSensor_4ms_Symbol_CM_ufix16_En10_V 0 5 /end CHARACTERISTIC
/begin MEASUREMENT zsPOil "Pressione olio (assoluta)" UWORD J1939dl_Tx100ms_CM_uint16_mbar 0 0 250 6000 ECU_ADDRESS 0x40003F04 /end MEASUREMENT
/begin MEASUREMENT zsPOilToD "Recovery GSEC - pressione olio (assoluta)" UWORD Oilp100ms_CM_uint16_mbar 0 0 250 6000 ECU_ADDRESS 0x40003F02 /end MEASUREMENT
/begin MEASUREMENT zsPOilVolt "Oil pressure voltage value" UWORD OilPresSensor100ms_Symbol_CM_ufix16_En10_V 0 0 0 5 ECU_ADDRESS 0x40003F1E /end MEASUREMENT
/begin CHARACTERISTIC zsPRK_BRK_DEB_STEP "Step di debouncing per segnale bsParkBrk" VALUE 0xFC4C30 Scalar_UBYTE 0 TF_TE_DigInput4ms_CM_uint8_adm 0 254 /end CHARACTERISTIC
/begin MEASUREMENT zsPRail "Pressione metano nel rail (assoluta)" UWORD AutoTDC_CM_uint16_mbar 0 0 0 13793 ECU_ADDRESS 0x40004058 /end MEASUREMENT
/begin MEASUREMENT zsPRailBar "[OUT] Caratteristica sensore pressione metano nel rail" UWORD RailPresSensor4ms_CM_uint16_mbar 0 0 0 16000 ECU_ADDRESS 0x4000406E /end MEASUREMENT
/begin MEASUREMENT zsPRailToD "Recovery GSEC - Pressione metano nel rail (assoluta)" UWORD Rpre4ms_CM_uint16_mbar 0 0 0 13793 ECU_ADDRESS 0x40004056 /end MEASUREMENT
/begin MEASUREMENT zsPRailVolt "Pression rail sensor voltage value" UWORD RailPresSensor4ms_CM_ufix16_En10_V 0 0 0 5 ECU_ADDRESS 0x4000406C /end MEASUREMENT
/begin MEASUREMENT zsPTank "Pressione metano bombole (relativa)" UWORD J1939dl_Tx100ms_CM_ufix16_E2_mbar 0 0 0 250000 ECU_ADDRESS 0x4000420A /end MEASUREMENT
/begin MEASUREMENT zsPTankBar "[OUT] Caratteristica sensore pressione metano nelle bombole" UWORD TankPresSensor4ms_Symbol_CM_ufix16_E2_mbar 0 0 0 250000 ECU_ADDRESS 0x40004226 /end MEASUREMENT
/begin MEASUREMENT zsPTankToD "Recovery GSEC - Pressione metano bombole (relativa)" UWORD Tnkp4ms_CM_ufix16_E2_mbar 0 0 0 250000 ECU_ADDRESS 0x40004208 /end MEASUREMENT
/begin MEASUREMENT zsPTankVolt "Pression tank sensor voltage value" UWORD TankPresSensor4ms_Symbol_CM_ufix16_En10_V 0 0 0 5 ECU_ADDRESS 0x40004224 /end MEASUREMENT
/begin MEASUREMENT zsParkBrk "Parking brake switch" UBYTE Digin4ms_CM_boolean_adm 0 0 0 1 ECU_ADDRESS 0x400029A7 /end MEASUREMENT
/begin MEASUREMENT zsPdlSlope "[OUT] Contributo al passo di incremento del raccordo della posizione pedale funzione della velocità veicolo" UWORD TE_PotenzAccSensor_4ms_Symbol_CM_uint16_adm 0 0 0 1000 ECU_ADDRESS 0x40003FC6 /end MEASUREMENT
/begin MEASUREMENT zsPdlStatus "Stato del pedale acceleratore (0 -> Rilasciato 1 -> Premuto 2 -> LastWin con BRAKE)" UBYTE Pacc4ms_CM_uint8_adm 0 0 0 2 ECU_ADDRESS 0x40003F63 /end MEASUREMENT
/begin MEASUREMENT zsPdlStatusTmp "Stato del pedale acceleratore in uscita da FSM LastWin" UBYTE TE_PotenzAccSensor_4ms_Symbol_CM_uint8_adm 0 0 0 2 ECU_ADDRESS 0x40003FBA /end MEASUREMENT
/begin MEASUREMENT zsPotAccPerc "[OUT] Caratteristica del potenziometro principale del pedale acceleratore" UWORD TE_PotenzAccSensor_4ms_Symbol_CM_ufix16_En4__ 0 0 0 100 ECU_ADDRESS 0x40003FC4 /end MEASUREMENT
/begin MEASUREMENT zsPotenzAcc "Potenziometro acceleratore" UWORD Crkc4ms_CM_ufix16_En4__ 0 0 0 100 ECU_ADDRESS 0x40003F66 /end MEASUREMENT
/begin MEASUREMENT zsPotenzAccV2 "Valore corrente del blocco di raccordo in Volt del pedale acceleratore" UWORD TE_PotenzAccSensor_4ms_Symbol_CM_ufix16_En10_V 0 0 0 5 ECU_ADDRESS 0x40003FC2 /end MEASUREMENT
/begin MEASUREMENT zsPotenzAccV3 "Richiesta in Volt del driver raccordata" UWORD TE_PotenzAccSensor_4ms_Symbol_CM_ufix16_En10_V 0 0 0 5 ECU_ADDRESS 0x40003FC0 /end MEASUREMENT
/begin MEASUREMENT zsPotenzAccVLast "Ultimo valore in Volt del pedale acceleratore prima del raccordo lineare" UWORD TE_PotenzAccSensor_4ms_Symbol_CM_ufix16_En10_V 0 0 0 5 ECU_ADDRESS 0x40003FBE /end MEASUREMENT
/begin MEASUREMENT zsPotenzThr "Potenziometro della farfalla motorizzata" SWORD Airq_CtrlMgmtTDC_CM_sfix16_En8__ 0 0 -10 100 ECU_ADDRESS 0x40004114 /end MEASUREMENT
/begin MEASUREMENT zsPressBoost "[OUT] Caratteristica sensore pressione di sovralimentazione" UWORD BoostPresSensor4ms_Symbol_CM_uint16_mbar 0 0 50 4500 ECU_ADDRESS 0x400022B0 /end MEASUREMENT
/begin MEASUREMENT zsPressioAtm "[OUT] Caratteristica del sensore pressione atmosferica" UWORD AtmophericPresSensor100ms_Symbol_CM_uint16_mbar 0 0 150 1150 ECU_ADDRESS 0x4000207C /end MEASUREMENT
/begin MEASUREMENT zsPressioOil "[OUT] Caratteristica sensore pressione olio" UWORD OilPresSensor100ms_Symbol_CM_uint16_mbar 0 0 225 6000 ECU_ADDRESS 0x40003F1C /end MEASUREMENT
/begin MEASUREMENT zsQAirDebVolt "Debimeter sensor voltage value" UWORD DebimSensor4ms_CM_ufix16_En10_V 0 0 0 5 ECU_ADDRESS 0x40001E00 /end MEASUREMENT
/begin MEASUREMENT zsQAirDebim "Portata aria aspirata da debimetro" UWORD Airq4ms_CM_ufix16_En4_kg_h 0 0 0 4000 ECU_ADDRESS 0x40001DEC /end MEASUREMENT
/begin MEASUREMENT zsQAirDebimToD "Recovery GSEC - Portata aria aspirata da debimetro" UWORD Airq4ms_CM_ufix16_En4_kg_h 0 0 0 4000 ECU_ADDRESS 0x40001DEA /end MEASUREMENT
/begin CHARACTERISTIC zsRANGE_CONSTR "Range di mobilità piattello farfalla tre UMA ed OMA" VALUE 0xFCB484 Scalar_UWORD 0 TE_TM_PotThrSens4ms_Symbol_CM_ufix16_En9_deg 60 90 /end CHARACTERISTIC
/begin CHARACTERISTIC zsRESUME_DEB_STEP "Step di debouncing per segnale bsResume" VALUE 0xFC4C2F Scalar_UBYTE 0 TF_TE_DigInput4ms_CM_uint8_adm 0 254 /end CHARACTERISTIC
/begin MEASUREMENT zsRangeConstr "Range effettivo ammesso meccanicamente di escursione piattello farfalla" UWORD Thrp4ms_CM_ufix16_En9_deg 0 0 60 90 ECU_ADDRESS 0x4000410C /end MEASUREMENT
/begin MEASUREMENT zsResumeOn "Flag Digital Resume On" UBYTE Digin4ms_CM_boolean_adm 0 0 0 1 ECU_ADDRESS 0x4000299B /end MEASUREMENT
/begin CHARACTERISTIC zsSPARE2_DEB_STEP "Step di debouncing per segnale spare2" VALUE 0xFC4C7D Scalar_UBYTE 0 DigInput4ms_Symbol_CM_uint8_adm 0 254 /end CHARACTERISTIC
/begin CHARACTERISTIC zsSPARE3_DEB_STEP "Step di debouncing per spare3" VALUE 0xFC4C7C Scalar_UBYTE 0 DigInput4ms_Symbol_CM_uint8_adm 0 254 /end CHARACTERISTIC
/begin CHARACTERISTIC zsSPEED_LIM_DEB_STEP "Step di debouncing per segnale bsVehSpeedLim" VALUE 0xFC4C2E Scalar_UBYTE 0 TF_TE_DigInput4ms_CM_uint8_adm 0 254 /end CHARACTERISTIC
/begin CHARACTERISTIC zsSTART_CBT_DEB_STEP "Step di debouncing per segnale bsStartAccDecCbt" VALUE 0xFC4C7B Scalar_UBYTE 0 DigInput4ms_Symbol_CM_uint8_adm 0 254 /end CHARACTERISTIC
/begin CHARACTERISTIC zsSTOP_CBT_DEB_STEP "Step di debouncing per segnale bsStopCbt" VALUE 0xFC4C7A Scalar_UBYTE 0 DigInput4ms_Symbol_CM_uint8_adm 0 254 /end CHARACTERISTIC
/begin MEASUREMENT zsSetMinus "Flag Digital for decrease MFLV Obj" UBYTE Digin4ms_CM_boolean_adm 0 0 0 1 ECU_ADDRESS 0x4000299D /end MEASUREMENT
/begin MEASUREMENT zsSetPlus "Flag Digital for encrease MFLV Obj" UBYTE Digin4ms_CM_boolean_adm 0 0 0 1 ECU_ADDRESS 0x4000299F /end MEASUREMENT
/begin MEASUREMENT zsStartAccDecCbt "From Digital Input Module : Cabin tilt start and Acc/Dec button" UBYTE Crkc4ms_CM_boolean_adm 0 0 0 1 ECU_ADDRESS 0x40002997 /end MEASUREMENT
/begin MEASUREMENT zsStopCbt "From Digital Input Module : Cabin tilt stop engine button" UBYTE Crkc4ms_CM_boolean_adm 0 0 0 1 ECU_ADDRESS 0x40002996 /end MEASUREMENT
/begin MEASUREMENT zsTAir "Temperatura aria" UWORD Airq_CtrlMgmtTDC_CM_ufix16_Bn40_degC 0 0 -40 130 ECU_ADDRESS 0x40002034 /end MEASUREMENT
/begin MEASUREMENT zsTAirToD "Recovery GSEC - Temperatura aria" UWORD Airt100ms_CM_ufix16_Bn40_degC 0 0 -40 130 ECU_ADDRESS 0x40002032 /end MEASUREMENT
/begin MEASUREMENT zsTAirVolt "Air temperature voltage value" UWORD TempAirSensor100ms_Symbol_CM_ufix16_En10_V 0 0 0 5 ECU_ADDRESS 0x40002066 /end MEASUREMENT
/begin MEASUREMENT zsTBoost "Boost temperature" UWORD Spare100ms_CM_ufix16_Bn40_degC 0 0 -40 1000 ECU_ADDRESS 0x40004088 /end MEASUREMENT
/begin MEASUREMENT zsTBoostVolt "Boost temperature voltage value" UWORD TurboTemp100ms_CM_ufix16_En10_V 0 0 0 5 ECU_ADDRESS 0x400040AA /end MEASUREMENT
/begin MEASUREMENT zsTECUPDiag "Ecu Temperature Sensor Characteristic Post Diagnosis" UWORD EcuTempSensor1s_CM_ufix16_Bn40_degC 0 0 -40 150 ECU_ADDRESS 0x40002A6C /end MEASUREMENT
/begin MEASUREMENT zsTECUVolt "ECU temperature voltage value" UWORD EcuTempSensor1s_CM_ufix16_En10_V 0 0 0 5 ECU_ADDRESS 0x40002A6A /end MEASUREMENT
/begin MEASUREMENT zsTEgrCooler "Egr Cooler temperature" UWORD EgrMgm4ms_CM_ufix16_Bn40_degC 0 0 -40 1000 ECU_ADDRESS 0x40002AFA /end MEASUREMENT
/begin MEASUREMENT zsTEgrCoolerVolt "Egr Cooler temperature voltage value" UWORD EgrCoolerTemp4ms_CM_ufix16_En10_V 0 0 0 5 ECU_ADDRESS 0x40002B1E /end MEASUREMENT
/begin MEASUREMENT zsTExh "Exhaust manifold temperature" UWORD Egt100ms_CM_ufix16_Bn40_degC 0 0 -40 1000 ECU_ADDRESS 0x40002C12 /end MEASUREMENT
/begin MEASUREMENT zsTExhToD "Recovery GSEC - Exhaust manifold temperature" UWORD Egt100ms_CM_ufix16_Bn40_degC 0 0 -40 1000 ECU_ADDRESS 0x40002C10 /end MEASUREMENT
/begin MEASUREMENT zsTExhVolt "Exhaust manifold temperature voltage value" UWORD ExhaustGasTemp100ms_CM_ufix16_En10_V 0 0 0 5 ECU_ADDRESS 0x40002C26 /end MEASUREMENT
/begin CHARACTERISTIC zsTHR_RPM_UPDATE "Valore di regime al di sotto del quale la posizione zsThrotPosLimit viene aggiornata in funzione dello stato motore" VALUE 0xFCB00E Scalar_UWORD 0 UpdateThrotPosLim4ms_CM_uint16_rpm 0 3000 /end CHARACTERISTIC
/begin MEASUREMENT zsTKat "Temperatura valle catalizzatore" UWORD Catt100ms_CM_ufix16_Bn40_degC 0 0 -40 1000 ECU_ADDRESS 0x400022F6 /end MEASUREMENT
/begin MEASUREMENT zsTKatToD "Recovery GSEC - Temperatura valle catalizzatore" UWORD Catt100ms_CM_ufix16_Bn40_degC 0 0 -40 1000 ECU_ADDRESS 0x400022F4 /end MEASUREMENT
/begin MEASUREMENT zsTKatVolt "Catalyst temperature voltage value" UWORD TempKatSensor100ms_Symbol_CM_ufix16_En10_V 0 0 0 5 ECU_ADDRESS 0x4000231A /end MEASUREMENT
/begin MEASUREMENT zsTMAF "MAF (Mass Air Flow) integrated temperature" UWORD Spare100ms_CM_ufix16_Bn40_degC 0 0 -40 1000 ECU_ADDRESS 0x4000408A /end MEASUREMENT
/begin MEASUREMENT zsTMAFVolt "MAF (Mass Air Flow) integrated temperature voltage value" UWORD MAFTemp100ms_CM_ufix16_En10_V 0 0 0 5 ECU_ADDRESS 0x4000409A /end MEASUREMENT
/begin MEASUREMENT zsTOil "Temperatura olio" UWORD DiagSym100ms_CM_ufix16_Bn40_degC 0 0 -40 130 ECU_ADDRESS 0x40003F2E /end MEASUREMENT
/begin MEASUREMENT zsTOilToD "Recovery GSEC - Temperatura olio" UWORD Coot100ms_CM_ufix16_Bn40_degC 0 0 -40 140 ECU_ADDRESS 0x40003F2C /end MEASUREMENT
/begin MEASUREMENT zsTOilVolt "Oil temperature voltage value" UWORD TempOilSensor100ms_CM_ufix16_En10_V 0 0 0 5 ECU_ADDRESS 0x40003F50 /end MEASUREMENT
/begin MEASUREMENT zsTRail "Temperatura metano nel rail" UWORD Airt100ms_CM_ufix16_Bn40_degC 0 0 -40 150 ECU_ADDRESS 0x40002F74 /end MEASUREMENT
/begin MEASUREMENT zsTRailToD "Recovery GSEC - Temperatura metano nel rail" UWORD Gast100ms_CM_ufix16_Bn40_degC 0 0 -40 150 ECU_ADDRESS 0x40002F72 /end MEASUREMENT
/begin MEASUREMENT zsTRailVolt "Rail temperature voltage value" UWORD TempRailSensor100ms_Symbol_CM_ufix16_En10_V 0 0 0 5 ECU_ADDRESS 0x40002F8E /end MEASUREMENT
/begin MEASUREMENT zsTemperAir "[OUT] Tabella con caratteristica del sensore di temperatura aria nel collettore" UWORD TempAirSensor100ms_Symbol_CM_ufix16_Bn40_degC 0 0 -40 130 ECU_ADDRESS 0x40002064 /end MEASUREMENT
/begin MEASUREMENT zsTemperBoost "[OUT] Boost temperature sensor characteristic " UWORD TurboTemp100ms_CM_ufix16_Bn40_degC 0 0 -40 1000 ECU_ADDRESS 0x400040A8 /end MEASUREMENT
/begin MEASUREMENT zsTemperECU "[OUT] Ecu Temperature Sensor Characteristic" UWORD EcuTempSensor1s_CM_ufix16_Bn40_degC 0 0 -40 150 ECU_ADDRESS 0x40002A68 /end MEASUREMENT
/begin MEASUREMENT zsTemperEgrCooler "[OUT] Egr Cooler temperature sensor characteristic " UWORD EgrCoolerTemp4ms_CM_ufix16_Bn40_degC 0 0 -40 1000 ECU_ADDRESS 0x40002B1C /end MEASUREMENT
/begin MEASUREMENT zsTemperExh "[OUT] Exhaust manifold temperature sensor characteristic " UWORD ExhaustGasTemp100ms_CM_ufix16_Bn40_degC 0 0 -40 1000 ECU_ADDRESS 0x40002C24 /end MEASUREMENT
/begin MEASUREMENT zsTemperH2o "[OUT] Tabella con caratteristica del sensore di temperatura acqua motore" UWORD TempH2OSensor100ms_Symbol_CM_ufix16_Bn40_degC 0 0 -40 140 ECU_ADDRESS 0x4000237E /end MEASUREMENT
/begin MEASUREMENT zsTemperKat "[OUT] Tabella con caratteristica del sensore di temperatura valle catalizzatore" UWORD TempKatSensor100ms_Symbol_CM_ufix16_Bn40_degC 0 0 -40 1000 ECU_ADDRESS 0x40002318 /end MEASUREMENT
/begin MEASUREMENT zsTemperMaf "[OUT] MAF (Mass Air Flow) integrated temperature sensor characteristic " UWORD MAFTemp100ms_CM_ufix16_Bn40_degC 0 0 -40 1000 ECU_ADDRESS 0x40004098 /end MEASUREMENT
/begin MEASUREMENT zsTemperOil "[OUT] Tabella con caratteristica del sensore di pressione olio motore" UWORD TempOilSensor100ms_CM_ufix16_Bn40_degC 0 0 -40 130 ECU_ADDRESS 0x40003F4E /end MEASUREMENT
/begin MEASUREMENT zsTemperOilEmul "[OUT] Tabella con caratteristica del sensore di pressione olio motore emulato" UWORD TempOilSensor100ms_CM_ufix16_Bn40_degC 0 0 -40 130 ECU_ADDRESS 0x40003F4C /end MEASUREMENT
/begin MEASUREMENT zsTemperRail "[OUT] Tabella con caratteristica del sensore di temperatura metano nel rail" UWORD TempRailSensor100ms_Symbol_CM_ufix16_Bn40_degC 0 0 -40 150 ECU_ADDRESS 0x40002F8C /end MEASUREMENT
/begin MEASUREMENT zsTh2o "Temperatura acqua motore" UWORD Airq_CtrlMgmtTDC_CM_ufix16_Bn40_degC 0 0 -40 140 ECU_ADDRESS 0x4000235E /end MEASUREMENT
/begin MEASUREMENT zsTh2oToD "Recovery GSEC - Temperatura acqua motore" UWORD Coot100ms_CM_ufix16_Bn40_degC 0 0 -40 140 ECU_ADDRESS 0x4000235C /end MEASUREMENT
/begin MEASUREMENT zsTh2oVolt "Water temperature voltage value" UWORD TempH2OSensor100ms_Symbol_CM_ufix16_En10_V 0 0 0 5 ECU_ADDRESS 0x4000237C /end MEASUREMENT
/begin MEASUREMENT zsThrotPos "Posizione di apertura farfalla" UWORD IgntTDC_CM_ufix16_En3_degF 0 0 0 90 ECU_ADDRESS 0x400040FA /end MEASUREMENT
/begin MEASUREMENT zsThrotPosCorr "Posizione corrente di apertura farfalla" UWORD Thrp4ms_CM_ufix16_En3_degF 0 0 0 90 ECU_ADDRESS 0x40004100 /end MEASUREMENT
/begin MEASUREMENT zsThrotPosLimit "Posizione limite di apertura farfalla" UWORD Thrp4ms_CM_ufix16_En3_degF 0 0 0 90 ECU_ADDRESS 0x400040FC /end MEASUREMENT
/begin MEASUREMENT zsThrotPosMin "Posizione apertura minima farfalla in gradi" UWORD Thrp4ms_CM_ufix16_En3_degree 0 0 0 90 ECU_ADDRESS 0x400041DE /end MEASUREMENT
/begin MEASUREMENT zsThrotPosOld "Posizione di apertura farfalla" UWORD Thrp4ms_CM_ufix16_En3_degF 0 0 0 90 ECU_ADDRESS 0x400040FE /end MEASUREMENT
/begin CHARACTERISTIC zsUEGO_IN_RUNNING_TIMER "Timer for UEGO driver in Running mode" VALUE 0xFC9BD8 Scalar_UWORD 0 UegoSensor4ms_CM_ufix16_Sp004_sec 0 10 /end CHARACTERISTIC
/begin CHARACTERISTIC zsUPPERLIM_QDEB "Upper limit of air quantity read by the debimeter" VALUE 0xFC0120 Scalar_UWORD 0 DebimSensor4ms_CM_ufix16_En4_kg_h 0 4000 /end CHARACTERISTIC
/begin MEASUREMENT zsUegoEmulation "Enable lambda pre signal emulation using UEGO sensor (1-enabled)" UBYTE Ctit_LambdaCtrlTDC_CM_boolean_adm 0 0 0 1 ECU_ADDRESS 0x400023CB /end MEASUREMENT
/begin MEASUREMENT zsUegoIp "Current Ip normalized read by cj135 on linear UEGO sensor (LSU 4.9)" UWORD UegoSensor4ms_CM_ufix16_Sp0001_Bn3_ma 0 0 -3 3 ECU_ADDRESS 0x4000374A /end MEASUREMENT
/begin MEASUREMENT zsUegoIpCurr "Current Ip normalized read by cj135 on linear UEGO sensor (LSU 4.9)" UWORD Ctit_LambdaCtrlTDC_CM_ufix16_Sp0001_Bn3_mA 0 0 -3 3 ECU_ADDRESS 0x400036F6 /end MEASUREMENT
/begin MEASUREMENT zsUegoIpcurrToO2conc "[OUT] Conversion map between UEGO heater resistance and UEGO temperature" SWORD UegoSensor4ms_CM_sfix16_En10_degC 0 0 -30 30 ECU_ADDRESS 0x40003748 /end MEASUREMENT
/begin MEASUREMENT zsUegoLambda "UEGO lambda value" UWORD Lamm4ms_CM_ufix16_En10_adm 0 0 0 15 ECU_ADDRESS 0x400036F8 /end MEASUREMENT
/begin MEASUREMENT zsUegoO2Conc "UEGO O2 concentration" SWORD Lamm4ms_CM_sfix16_En10__ 0 0 -30 30 ECU_ADDRESS 0x400036F4 /end MEASUREMENT
/begin MEASUREMENT zsVBPW "Tensione valle relay carichi utilizzata al posto della VBatt a tutela di eventuali inversioni di polarita o load dump" UWORD Ctit_LambdaHeater100ms_CM_ufix16_S50_mV 0 0 12000 36000 ECU_ADDRESS 0x4000456A /end MEASUREMENT
/begin MEASUREMENT zsVBPWNoSat "Tensione batteria lato caldo iniettori non saturata" UWORD J1939dl_Tx1s_CM_ufix16_S50_mV 0 0 50 50000 ECU_ADDRESS 0x40004568 /end MEASUREMENT
/begin MEASUREMENT zsVBPWVolt "Power Battery voltage value" UWORD VBattPower4ms_Symbol_CM_ufix16_En10_V 0 0 0 5 ECU_ADDRESS 0x40004582 /end MEASUREMENT
/begin MEASUREMENT zsVBatt "Tensione batteria" UWORD AutoTDC_CM_ufix16_S50_mV 0 0 12000 36000 ECU_ADDRESS 0x400021D2 /end MEASUREMENT
/begin MEASUREMENT zsVBattNoSat "Tensione batteria non saturata" UWORD Batt4ms_CM_ufix16_S50_mV 0 0 50 50000 ECU_ADDRESS 0x400021D0 /end MEASUREMENT
/begin MEASUREMENT zsVBattVolt "Battery voltage value" UWORD VBattSensor4ms_Symbol_CM_ufix16_En10_V 0 0 0 5 ECU_ADDRESS 0x400021EE /end MEASUREMENT
/begin CHARACTERISTIC zsV_SENS "Tensione di alimentazione dei sensori" VALUE 0xFCB482 Scalar_UBYTE 0 TE_TM_PotThrSens4ms_Symbol_CM_ufix8_Sp1_V 4 6 /end CHARACTERISTIC
/begin MEASUREMENT zsVbattPostPwr "[OUT] Conversione tensione batteria a valle relay carichi" UWORD VBattPower4ms_Symbol_CM_ufix16_S50_mV 0 0 50 50000 ECU_ADDRESS 0x40004580 /end MEASUREMENT
/begin MEASUREMENT zsVbattPrePwr "[OUT] Guadagno HW sensore VBatt" UWORD VBattSensor4ms_Symbol_CM_ufix16_S50_mV 0 0 0 50000 ECU_ADDRESS 0x400021EC /end MEASUREMENT
/begin MEASUREMENT zsVehSpeedLim "Richiesta limitazione velocità veicolo" UBYTE Digin4ms_CM_boolean_adm 0 0 0 1 ECU_ADDRESS 0x400029A5 /end MEASUREMENT
/begin CHARACTERISTIC zvIP_LAM_CONV "Conversion map between UEGO Ip to lambda" CURVE 0xFC9BAC Lookup1D_UWORD 0 UegoSensor4ms_CM_ufix16_En10 0 15
 /begin AXIS_DESCR COM_AXIS NO_INPUT_QUANTITY UegoSensor4ms_CM_ufix16_Sp0001_Bn3_mA 22 -3 3 AXIS_PTS_REF zkUEGO_IP_CURR2 /end AXIS_DESCR
/end CHARACTERISTIC
/begin CHARACTERISTIC zvLAMBDA_POST_TMP "Caratteristica sensore Lambda post-catalizzatore" CURVE 0xFC9B9C Lookup1D_UWORD 0 LambdaPostSensor4ms_CM_uint16_mV 0 1300
 /begin AXIS_DESCR COM_AXIS zsLambdaPostVolt LambdaPostSensor4ms_CM_ufix16_En10_V 8 0 5 AXIS_PTS_REF zkLAM_POST_VOLT_BKP /end AXIS_DESCR
/end CHARACTERISTIC
/begin CHARACTERISTIC zvLAMBDA_PRE_TMP "Caratteristica sensore Lambda pre-catalizzatore" CURVE 0xFC9B8C Lookup1D_UWORD 0 LambdaPreSensor4ms_CM_uint16_mV 0 1300
 /begin AXIS_DESCR COM_AXIS zsLambdaPreVolt LambdaPreSensor4ms_CM_ufix16_En10_V 8 0 5 AXIS_PTS_REF zkLAM_PRE_VOLT_BKP /end AXIS_DESCR
/end CHARACTERISTIC
/begin CHARACTERISTIC zvMAF "Tabella di interpolazione di aria che attraversa il debimetro" CURVE 0xFC00E0 Lookup1D_UWORD 0 DebimSensor4ms_CM_ufix16_En4_kg_h 0 4000
 /begin AXIS_DESCR COM_AXIS zsQAirDebVolt DebimSensor4ms_CM_ufix16_En10_V 32 0 5 AXIS_PTS_REF zkVOLT_IN_DEB /end AXIS_DESCR
/end CHARACTERISTIC
/begin CHARACTERISTIC zvMAP_BAR "Caratteristica del sensore di pressione assoluta nel collettore" CURVE 0xFCAA76 Lookup1D_UWORD 0 MapSensor4ms_Symbol_CM_uint16_mbar 1 2700
 /begin AXIS_DESCR COM_AXIS NO_INPUT_QUANTITY MapSensor4ms_Symbol_CM_ufix16_En10_V 8 0 5 AXIS_PTS_REF zkMAP_VOLT_BKP /end AXIS_DESCR
/end CHARACTERISTIC
/begin CHARACTERISTIC zvPDL_SLOPE "Contributo al passo di incremento del raccordo della posizione pedale funzione della velocità veicolo" CURVE 0xFCAEF2 Lookup1D_UWORD 0 TE_PotenzAccSensor_4ms_Symbol_CM_uint16_adm 0 1000
 /begin AXIS_DESCR COM_AXIS NO_INPUT_QUANTITY TE_PotenzAccSensor_4ms_Symbol_CM_uint16_km_h 8 0 250 AXIS_PTS_REF zkVEHICLE_1 /end AXIS_DESCR
/end CHARACTERISTIC
/begin CHARACTERISTIC zvPOT_ACC_PERC "Caratteristica del potenziometro principale del pedale acceleratore" CURVE 0xFCAED2 Lookup1D_UWORD 0 TE_PotenzAccSensor_4ms_Symbol_CM_ufix16_En4__ 0 100
 /begin AXIS_DESCR COM_AXIS NO_INPUT_QUANTITY TE_PotenzAccSensor_4ms_Symbol_CM_ufix16_En10_V 16 0 5 AXIS_PTS_REF zkACC_V /end AXIS_DESCR
/end CHARACTERISTIC
/begin CHARACTERISTIC zvPRAIL_BAR "Caratteristica sensore pressione metano nel rail" CURVE 0xFCAF54 Lookup1D_UWORD 0 RailPresSensor4ms_CM_uint16_mbar 0 16000
 /begin AXIS_DESCR COM_AXIS zsPRailVolt RailPresSensor4ms_CM_ufix16_En10_V 8 0 5 AXIS_PTS_REF zkPRAIL_VOLT_BKP /end AXIS_DESCR
/end CHARACTERISTIC
/begin CHARACTERISTIC zvPRESSIO_ATM "Caratteristica del sensore pressione atmosferica" CURVE 0xFC1F16 Lookup1D_UWORD 0 AtmophericPresSensor100ms_Symbol_CM_uint16_mbar 150 1150
 /begin AXIS_DESCR COM_AXIS NO_INPUT_QUANTITY AtmophericPresSensor100ms_Symbol_CM_ufix16_En10_V 8 0 5 AXIS_PTS_REF zkPATM_VOLT_BKP /end AXIS_DESCR
/end CHARACTERISTIC
/begin CHARACTERISTIC zvPRESSIO_OIL "Caratteristica sensore pressione olio" CURVE 0xFCAB5A Lookup1D_UWORD 0 OilPresSensor100ms_Symbol_CM_uint16_mbar 225 6000
 /begin AXIS_DESCR COM_AXIS NO_INPUT_QUANTITY OilPresSensor100ms_Symbol_CM_ufix16_En10_V 8 0 5 AXIS_PTS_REF zkPOIL_VOLT_VBK /end AXIS_DESCR
/end CHARACTERISTIC
/begin CHARACTERISTIC zvPRESS_BOOST "Caratteristica sensore pressione di sovralimentazione" CURVE 0xFC2BCE Lookup1D_UWORD 0 BoostPresSensor4ms_Symbol_CM_uint16_mbar 50 4500
 /begin AXIS_DESCR COM_AXIS NO_INPUT_QUANTITY BoostPresSensor4ms_Symbol_CM_ufix16_En10_V 8 0 5 AXIS_PTS_REF zkPBOOST_VOLT_BKP /end AXIS_DESCR
/end CHARACTERISTIC
/begin CHARACTERISTIC zvPRES_EGRDELTAP "Egr deltaP sensor characteristic " CURVE 0xFC4DBC Lookup1D_SLONG 0 EgrDeltaP4ms_CM_sfix32_En10_mbar -2850 2500
 /begin AXIS_DESCR COM_AXIS zsEgrDeltaPVolt EgrDeltaP4ms_CM_ufix16_En10_V 8 0 5 AXIS_PTS_REF zkEGRDELTAP_VOLT /end AXIS_DESCR
/end CHARACTERISTIC
/begin CHARACTERISTIC zvPRES_EGR_HP "Egr inlet valve pressure (high pressure EGR)  sensor characteristic " CURVE 0xFC4DAC Lookup1D_UWORD 0 EgrHighPre4ms_CM_uint16_mbar 0 5000
 /begin AXIS_DESCR COM_AXIS zsEgrHighPreVolt EgrHighPre4ms_CM_ufix16_En10_V 8 0 5 AXIS_PTS_REF zkEGR_HP_VOLT /end AXIS_DESCR
/end CHARACTERISTIC
/begin CHARACTERISTIC zvPTANK_BAR "Caratteristica sensore pressione metano nelle bombole" CURVE 0xFCB68C Lookup1D_UWORD 0 TankPresSensor4ms_Symbol_CM_ufix16_E2_mbar 0 250000
 /begin AXIS_DESCR COM_AXIS NO_INPUT_QUANTITY TankPresSensor4ms_Symbol_CM_ufix16_En10_V 8 0 5 AXIS_PTS_REF zkPTANK_VOLT_BKP /end AXIS_DESCR
/end CHARACTERISTIC
/begin CHARACTERISTIC zvTEMPER_AIR "Tabella con caratteristica del sensore di temperatura aria nel collettore" CURVE 0xFC1EB4 Lookup1D_UWORD 0 TempAirSensor100ms_Symbol_CM_ufix16_Bn40_degC -40 130
 /begin AXIS_DESCR COM_AXIS NO_INPUT_QUANTITY TempAirSensor100ms_Symbol_CM_ufix16_En10_V 22 0 5 AXIS_PTS_REF zkTAIR_VOLT_BKP /end AXIS_DESCR
/end CHARACTERISTIC
/begin CHARACTERISTIC zvTEMPER_BOOST "Boost temperature sensor characteristic " CURVE 0xFCAFA8 Lookup1D_UWORD 0 TurboTemp100ms_CM_ufix16_Bn40_degC -40 1000
 /begin AXIS_DESCR COM_AXIS zsTBoostVolt TurboTemp100ms_CM_ufix16_En10_V 8 0 5 AXIS_PTS_REF zkTBOOST_VOLT /end AXIS_DESCR
/end CHARACTERISTIC
/begin CHARACTERISTIC zvTEMPER_ECU "Ecu Temperature Sensor Characteristic" CURVE 0xFC4CA6 Lookup1D_UWORD 0 EcuTempSensor1s_CM_ufix16_Bn40_degC -40 150
 /begin AXIS_DESCR COM_AXIS zsTECUVolt EcuTempSensor1s_CM_ufix16_En10_V 16 0 5 AXIS_PTS_REF zkTECU_VOLT_BKP /end AXIS_DESCR
/end CHARACTERISTIC
/begin CHARACTERISTIC zvTEMPER_EGRCOOLER "Egr Cooler temperature sensor characteristic " CURVE 0xFC4D9C Lookup1D_UWORD 0 EgrCoolerTemp4ms_CM_ufix16_Bn40_degC -40 1000
 /begin AXIS_DESCR COM_AXIS zsTEgrCoolerVolt EgrCoolerTemp4ms_CM_ufix16_En10_V 8 0 5 AXIS_PTS_REF zkTEGRCOOLER_VOLT /end AXIS_DESCR
/end CHARACTERISTIC
/begin CHARACTERISTIC zvTEMPER_EXH "Exhaust manifold temperature sensor characteristic " CURVE 0xFC55A2 Lookup1D_UWORD 0 ExhaustGasTemp100ms_CM_ufix16_Bn40_degC -40 1000
 /begin AXIS_DESCR COM_AXIS zsTExhVolt ExhaustGasTemp100ms_CM_ufix16_En10_V 8 0 5 AXIS_PTS_REF zkTEXH_VOLT_BKP /end AXIS_DESCR
/end CHARACTERISTIC
/begin CHARACTERISTIC zvTEMPER_H2O "Tabella con caratteristica del sensore di temperatura acqua motore" CURVE 0xFC2CAE Lookup1D_UWORD 0 TempH2OSensor100ms_Symbol_CM_ufix16_Bn40_degC -40 140
 /begin AXIS_DESCR COM_AXIS NO_INPUT_QUANTITY TempH2OSensor100ms_Symbol_CM_ufix16_En10_V 22 0 5 AXIS_PTS_REF zkTH2O_VOLT_BKP /end AXIS_DESCR
/end CHARACTERISTIC
/begin CHARACTERISTIC zvTEMPER_KAT "Tabella con caratteristica del sensore di temperatura valle catalizzatore" CURVE 0xFC2C42 Lookup1D_UWORD 0 TempKatSensor100ms_Symbol_CM_ufix16_Bn40_degC -40 1000
 /begin AXIS_DESCR COM_AXIS NO_INPUT_QUANTITY TempKatSensor100ms_Symbol_CM_ufix16_En10_V 8 0 5 AXIS_PTS_REF zkTKAT_VOLT_BKP /end AXIS_DESCR
/end CHARACTERISTIC
/begin CHARACTERISTIC zvTEMPER_MAF "MAF (Mass Air Flow) integrated temperature sensor characteristic " CURVE 0xFCAF98 Lookup1D_UWORD 0 MAFTemp100ms_CM_ufix16_Bn40_degC -40 1000
 /begin AXIS_DESCR COM_AXIS zsTMAFVolt MAFTemp100ms_CM_ufix16_En10_V 8 0 5 AXIS_PTS_REF zkTMAF_VOLT /end AXIS_DESCR
/end CHARACTERISTIC
/begin CHARACTERISTIC zvTEMPER_OIL "Tabella con caratteristica del sensore di pressione olio motore" CURVE 0xFCAB8C Lookup1D_UWORD 0 TempOilSensor100ms_CM_ufix16_Bn40_degC -40 130
 /begin AXIS_DESCR COM_AXIS zsTOilVolt TempOilSensor100ms_CM_ufix16_En10_V 22 0 5 AXIS_PTS_REF zkTOIL_VOLT_BKP /end AXIS_DESCR
/end CHARACTERISTIC
/begin CHARACTERISTIC zvTEMPER_OIL_EMUL "Tabella con caratteristica del sensore di pressione olio motore emulata a partire dalla temperatura acqua" CURVE 0xFCAB7C Lookup1D_UWORD 0 TempOilSensor100ms_CM_ufix16_Bn40_degC -40 130
 /begin AXIS_DESCR COM_AXIS NO_INPUT_QUANTITY TempOilSensor100ms_CM_ufix16_Bn40_degC 8 -40 140 AXIS_PTS_REF zkTH2O_BKP /end AXIS_DESCR
/end CHARACTERISTIC
/begin CHARACTERISTIC zvTEMPER_RAIL "Tabella con caratteristica del sensore di temperatura metano nel rail" CURVE 0xFC5A4E Lookup1D_UWORD 0 TempRailSensor100ms_Symbol_CM_ufix16_Bn40_degC -40 150
 /begin AXIS_DESCR COM_AXIS NO_INPUT_QUANTITY TempRailSensor100ms_Symbol_CM_ufix16_En10_V 22 0 5 AXIS_PTS_REF zkTRAIL_VOLT_BKP /end AXIS_DESCR
/end CHARACTERISTIC
/begin CHARACTERISTIC zvUEGO_IPCURR_TO_O2CONC "Conversion map between UEGO heater resistance and UEGO temperature" CURVE 0xFC9B76 Lookup1D_WORD 0 UegoSensor4ms_CM_sfix16_En10_degC -30 30
 /begin AXIS_DESCR COM_AXIS NO_INPUT_QUANTITY UegoSensor4ms_CM_ufix16_Sp0001_Bn3_mA 11 -3 3 AXIS_PTS_REF zkUEGO_IP_CURR1 /end AXIS_DESCR
/end CHARACTERISTIC
/begin CHARACTERISTIC zvVBATT_POST_PWR "Conversione tensione batteria a valle relay carichi" CURVE 0xFCC640 Lookup1D_UWORD 0 VBattPower4ms_Symbol_CM_ufix16_S50_mV 50 50000
 /begin AXIS_DESCR COM_AXIS NO_INPUT_QUANTITY VBattPower4ms_Symbol_CM_ufix16_En10_V 8 0 5 AXIS_PTS_REF zkVBPW_BKP /end AXIS_DESCR
/end CHARACTERISTIC
/begin CHARACTERISTIC zvVBATT_PRE_PWR "Guadagno HW sensore VBatt" CURVE 0xFC2040 Lookup1D_UWORD 0 VBattSensor4ms_Symbol_CM_ufix16_S50_mV 0 50000
 /begin AXIS_DESCR COM_AXIS NO_INPUT_QUANTITY VBattSensor4ms_Symbol_CM_ufix16_En10_V 8 0 5 AXIS_PTS_REF zkVBATT_VOLT_BKP /end AXIS_DESCR
/end CHARACTERISTIC
/begin COMPU_METHOD ADIALampMgm100ms_CM_FixEnableT "Enumerated data type: FixEnableT" TAB_VERB "%0.6" "" COMPU_TAB_REF VTAB_FOR_ADIALampMgm100ms_CM_FixEnableT /end COMPU_METHOD
/begin COMPU_METHOD ADIALampMgm100ms_CM_boolean_adm "Q = V" RAT_FUNC "%1.0" "adm" COEFFS 0 1 0 0 0 1 /end COMPU_METHOD
/begin COMPU_METHOD ADIALampMgm100ms_CM_ufix16_Sp1_s "Q = V*10.000000" RAT_FUNC "%0.6" "s" COEFFS 0 10 0 0 0 1 /end COMPU_METHOD
/begin COMPU_METHOD ADIALampMgm100ms_CM_uint16_rpm "Q = V" RAT_FUNC "%5.0" "rpm" COEFFS 0 1 0 0 0 1 /end COMPU_METHOD
/begin COMPU_METHOD ADIALampMgm100ms_CM_uint8_adm "Q = V" RAT_FUNC "%3.0" "adm" COEFFS 0 1 0 0 0 1 /end COMPU_METHOD
/begin COMPU_METHOD Airq4ms_CM_ufix16_En4_kg_h "Q = V*16.000000" RAT_FUNC "%8.4" "kg/h" COEFFS 0 16 0 0 0 1 /end COMPU_METHOD
/begin COMPU_METHOD Airq4ms_CM_uint16_mbar "Q = V" RAT_FUNC "%5.0" "mbar" COEFFS 0 1 0 0 0 1 /end COMPU_METHOD
/begin COMPU_METHOD Airq_CtrlMgmtTDC_CM_sfix16_En8__ "Q = V*256.000000" RAT_FUNC "%11.8" "%" COEFFS 0 256 0 0 0 1 /end COMPU_METHOD
/begin COMPU_METHOD Airq_CtrlMgmtTDC_CM_ufix16_Bn40_degC "Q = (V+40.000000)/1.000000" RAT_FUNC "%0.6" "degC" COEFFS 0 1 40 0 0 1 /end COMPU_METHOD
/begin COMPU_METHOD Airq_CtrlMgmtTDC_CM_ufix16_En8__ "Q = V*256.000000" RAT_FUNC "%11.8" "%" COEFFS 0 256 0 0 0 1 /end COMPU_METHOD
/begin COMPU_METHOD Airq_CtrlMgmtTDC_CM_uint16_mbar "Q = V" RAT_FUNC "%5.0" "mbar" COEFFS 0 1 0 0 0 1 /end COMPU_METHOD
/begin COMPU_METHOD Airt100ms_CM_tKeyState_adm "Enumerated data type: tKeyState" TAB_VERB "%0.6" "adm" COMPU_TAB_REF VTAB_FOR_Airt100ms_CM_tKeyState_adm /end COMPU_METHOD
/begin COMPU_METHOD Airt100ms_CM_ufix16_Bn40_degC "Q = (V+40.000000)/1.000000" RAT_FUNC "%0.6" "degC" COEFFS 0 1 40 0 0 1 /end COMPU_METHOD
/begin COMPU_METHOD Apre100ms_CM_uint16_mbar "Q = V" RAT_FUNC "%5.0" "mbar" COEFFS 0 1 0 0 0 1 /end COMPU_METHOD
/begin COMPU_METHOD AtmophericPresSensor100ms_Symbol_CM_FixEnableT "Enumerated data type: FixEnableT" TAB_VERB "%0.6" "" COMPU_TAB_REF VTAB_FOR_AtmophericPresSensor100ms_Symbol_CM_FixEnableT /end COMPU_METHOD
/begin COMPU_METHOD AtmophericPresSensor100ms_Symbol_CM_ufix16_En10_V "Q = V*1024.000000" RAT_FUNC "%12.10" "V" COEFFS 0 1024 0 0 0 1 /end COMPU_METHOD
/begin COMPU_METHOD AtmophericPresSensor100ms_Symbol_CM_ufix16_En10_adm "Q = V*1024.000000" RAT_FUNC "%12.10" "adm" COEFFS 0 1024 0 0 0 1 /end COMPU_METHOD
/begin COMPU_METHOD AtmophericPresSensor100ms_Symbol_CM_uint16_mbar "Q = V" RAT_FUNC "%5.0" "mbar" COEFFS 0 1 0 0 0 1 /end COMPU_METHOD
/begin COMPU_METHOD AutoTDC_CM_ufix16_S50_mV "Q = V/50.000000" RAT_FUNC "%0.6" "mV" COEFFS 0 1 0 0 0 50 /end COMPU_METHOD
/begin COMPU_METHOD AutoTDC_CM_uint16_mbar "Q = V" RAT_FUNC "%5.0" "mbar" COEFFS 0 1 0 0 0 1 /end COMPU_METHOD
/begin COMPU_METHOD Batt4ms_CM_ufix16_S50_mV "Q = V/50.000000" RAT_FUNC "%0.6" "mV" COEFFS 0 1 0 0 0 50 /end COMPU_METHOD
/begin COMPU_METHOD BoostPresSensor4ms_Symbol_CM_FixEnableT "Enumerated data type: FixEnableT" TAB_VERB "%0.6" "" COMPU_TAB_REF VTAB_FOR_BoostPresSensor4ms_Symbol_CM_FixEnableT /end COMPU_METHOD
/begin COMPU_METHOD BoostPresSensor4ms_Symbol_CM_ufix16_En10_V "Q = V*1024.000000" RAT_FUNC "%12.10" "V" COEFFS 0 1024 0 0 0 1 /end COMPU_METHOD
/begin COMPU_METHOD BoostPresSensor4ms_Symbol_CM_ufix16_En10_adm "Q = V*1024.000000" RAT_FUNC "%12.10" "adm" COEFFS 0 1024 0 0 0 1 /end COMPU_METHOD
/begin COMPU_METHOD BoostPresSensor4ms_Symbol_CM_uint16_mbar "Q = V" RAT_FUNC "%5.0" "mbar" COEFFS 0 1 0 0 0 1 /end COMPU_METHOD
/begin COMPU_METHOD Catt100ms_CM_ufix16_Bn40_degC "Q = (V+40.000000)/1.000000" RAT_FUNC "%0.6" "degC" COEFFS 0 1 40 0 0 1 /end COMPU_METHOD
/begin COMPU_METHOD Coot100ms_CM_ufix16_Bn40_degC "Q = (V+40.000000)/1.000000" RAT_FUNC "%0.6" "degC" COEFFS 0 1 40 0 0 1 /end COMPU_METHOD
/begin COMPU_METHOD Crkc4ms_CM_boolean_adm "Q = V" RAT_FUNC "%1.0" "adm" COEFFS 0 1 0 0 0 1 /end COMPU_METHOD
/begin COMPU_METHOD Crkc4ms_CM_ufix16_En4__ "Q = V*16.000000" RAT_FUNC "%8.4" "%" COEFFS 0 16 0 0 0 1 /end COMPU_METHOD
/begin COMPU_METHOD Ctit_LambdaCtrlTDC_CM_boolean_adm "Q = V" RAT_FUNC "%1.0" "adm" COEFFS 0 1 0 0 0 1 /end COMPU_METHOD
/begin COMPU_METHOD Ctit_LambdaCtrlTDC_CM_ufix16_Sp0001_Bn3_mA "Q = (V+3.000000)*10000.000000" RAT_FUNC "%0.6" "mA" COEFFS 0 10000 30000 0 0 1 /end COMPU_METHOD
/begin COMPU_METHOD Ctit_LambdaCtrlTDC_CM_uint16_mV "Q = V" RAT_FUNC "%5.0" "mV" COEFFS 0 1 0 0 0 1 /end COMPU_METHOD
/begin COMPU_METHOD Ctit_LambdaHeater100ms_CM_ufix16_S50_mV "Q = V/50.000000" RAT_FUNC "%0.6" "mV" COEFFS 0 1 0 0 0 50 /end COMPU_METHOD
/begin COMPU_METHOD Dcat_Diagnosis100ms_CM_uint16_mV "Q = V" RAT_FUNC "%5.0" "mV" COEFFS 0 1 0 0 0 1 /end COMPU_METHOD
/begin COMPU_METHOD DebimSensor4ms_CM_FixEnableT "Enumerated data type: FixEnableT" TAB_VERB "%0.6" "" COMPU_TAB_REF VTAB_FOR_DebimSensor4ms_CM_FixEnableT /end COMPU_METHOD
/begin COMPU_METHOD DebimSensor4ms_CM_ufix16_En10_V "Q = V*1024.000000" RAT_FUNC "%12.10" "V" COEFFS 0 1024 0 0 0 1 /end COMPU_METHOD
/begin COMPU_METHOD DebimSensor4ms_CM_ufix16_En10_adm "Q = V*1024.000000" RAT_FUNC "%12.10" "adm" COEFFS 0 1024 0 0 0 1 /end COMPU_METHOD
/begin COMPU_METHOD DebimSensor4ms_CM_ufix16_En4_kg_h "Q = V*16.000000" RAT_FUNC "%8.4" "kg/h" COEFFS 0 16 0 0 0 1 /end COMPU_METHOD
/begin COMPU_METHOD DiagSym100ms_CM_ufix16_Bn40_degC "Q = (V+40.000000)/1.000000" RAT_FUNC "%0.6" "degC" COEFFS 0 1 40 0 0 1 /end COMPU_METHOD
/begin COMPU_METHOD DigInput4ms_Symbol_CM_FixEnableT "Enumerated data type: FixEnableT" TAB_VERB "%0.6" "" COMPU_TAB_REF VTAB_FOR_DigInput4ms_Symbol_CM_FixEnableT /end COMPU_METHOD
/begin COMPU_METHOD DigInput4ms_Symbol_CM_boolean_adm "Q = V" RAT_FUNC "%1.0" "adm" COEFFS 0 1 0 0 0 1 /end COMPU_METHOD
/begin COMPU_METHOD DigInput4ms_Symbol_CM_uint8_adm "Q = V" RAT_FUNC "%3.0" "adm" COEFFS 0 1 0 0 0 1 /end COMPU_METHOD
/begin COMPU_METHOD Digin4ms_CM_boolean_adm "Q = V" RAT_FUNC "%1.0" "adm" COEFFS 0 1 0 0 0 1 /end COMPU_METHOD
/begin COMPU_METHOD EcuTempSensor1s_CM_FixEnableT "Enumerated data type: FixEnableT" TAB_VERB "%0.6" "" COMPU_TAB_REF VTAB_FOR_EcuTempSensor1s_CM_FixEnableT /end COMPU_METHOD
/begin COMPU_METHOD EcuTempSensor1s_CM_ufix16_Bn40_degC "Q = (V+40.000000)/1.000000" RAT_FUNC "%0.6" "degC" COEFFS 0 1 40 0 0 1 /end COMPU_METHOD
/begin COMPU_METHOD EcuTempSensor1s_CM_ufix16_Bn40_mbar "Q = (V+40.000000)/1.000000" RAT_FUNC "%0.6" "mbar" COEFFS 0 1 40 0 0 1 /end COMPU_METHOD
/begin COMPU_METHOD EcuTempSensor1s_CM_ufix16_En10_V "Q = V*1024.000000" RAT_FUNC "%12.10" "V" COEFFS 0 1024 0 0 0 1 /end COMPU_METHOD
/begin COMPU_METHOD EcuTempSensor1s_CM_ufix16_En10_adm "Q = V*1024.000000" RAT_FUNC "%12.10" "adm" COEFFS 0 1024 0 0 0 1 /end COMPU_METHOD
/begin COMPU_METHOD EcuTempUsageMap1s_CM_ufix16_Bn40_degC "Q = (V+40.000000)/1.000000" RAT_FUNC "%0.6" "degC" COEFFS 0 1 40 0 0 1 /end COMPU_METHOD
/begin COMPU_METHOD EcuTempUsageMap1s_CM_uint16_adm "Q = V" RAT_FUNC "%5.0" "adm" COEFFS 0 1 0 0 0 1 /end COMPU_METHOD
/begin COMPU_METHOD Ecut1s_CM_ufix16_Bn40_degC "Q = (V+40.000000)/1.000000" RAT_FUNC "%0.6" "degC" COEFFS 0 1 40 0 0 1 /end COMPU_METHOD
/begin COMPU_METHOD Ecut1s_CM_uint32_adm "Q = V" RAT_FUNC "%10.0" "adm" COEFFS 0 1 0 0 0 1 /end COMPU_METHOD
/begin COMPU_METHOD EgrCoolerTemp4ms_CM_FixEnableT "Enumerated data type: FixEnableT" TAB_VERB "%0.6" "" COMPU_TAB_REF VTAB_FOR_EgrCoolerTemp4ms_CM_FixEnableT /end COMPU_METHOD
/begin COMPU_METHOD EgrCoolerTemp4ms_CM_ufix16_Bn40_degC "Q = (V+40.000000)/1.000000" RAT_FUNC "%0.6" "degC" COEFFS 0 1 40 0 0 1 /end COMPU_METHOD
/begin COMPU_METHOD EgrCoolerTemp4ms_CM_ufix16_En10_V "Q = V*1024.000000" RAT_FUNC "%12.10" "V" COEFFS 0 1024 0 0 0 1 /end COMPU_METHOD
/begin COMPU_METHOD EgrCoolerTemp4ms_CM_ufix16_En10_adm "Q = V*1024.000000" RAT_FUNC "%12.10" "adm" COEFFS 0 1024 0 0 0 1 /end COMPU_METHOD
/begin COMPU_METHOD EgrDeltaP4ms_CM_FixEnableT "Enumerated data type: FixEnableT" TAB_VERB "%0.6" "" COMPU_TAB_REF VTAB_FOR_EgrDeltaP4ms_CM_FixEnableT /end COMPU_METHOD
/begin COMPU_METHOD EgrDeltaP4ms_CM_sfix32_En10_mbar "Q = V*1024.000000" RAT_FUNC "%17.10" "mbar" COEFFS 0 1024 0 0 0 1 /end COMPU_METHOD
/begin COMPU_METHOD EgrDeltaP4ms_CM_ufix16_En10_V "Q = V*1024.000000" RAT_FUNC "%12.10" "V" COEFFS 0 1024 0 0 0 1 /end COMPU_METHOD
/begin COMPU_METHOD EgrDeltaP4ms_CM_ufix16_En10_adm "Q = V*1024.000000" RAT_FUNC "%12.10" "adm" COEFFS 0 1024 0 0 0 1 /end COMPU_METHOD
/begin COMPU_METHOD EgrFlowRateMeas4ms_CM_ufix16_En10_adm "Q = V*1024.000000" RAT_FUNC "%12.10" "adm" COEFFS 0 1024 0 0 0 1 /end COMPU_METHOD
/begin COMPU_METHOD EgrHighPre4ms_CM_FixEnableT "Enumerated data type: FixEnableT" TAB_VERB "%0.6" "" COMPU_TAB_REF VTAB_FOR_EgrHighPre4ms_CM_FixEnableT /end COMPU_METHOD
/begin COMPU_METHOD EgrHighPre4ms_CM_ufix16_En10_V "Q = V*1024.000000" RAT_FUNC "%12.10" "V" COEFFS 0 1024 0 0 0 1 /end COMPU_METHOD
/begin COMPU_METHOD EgrHighPre4ms_CM_ufix16_En10_adm "Q = V*1024.000000" RAT_FUNC "%12.10" "adm" COEFFS 0 1024 0 0 0 1 /end COMPU_METHOD
/begin COMPU_METHOD EgrHighPre4ms_CM_uint16_mbar "Q = V" RAT_FUNC "%5.0" "mbar" COEFFS 0 1 0 0 0 1 /end COMPU_METHOD
/begin COMPU_METHOD EgrMgm4ms_CM_sfix32_En10_mbar "Q = V*1024.000000" RAT_FUNC "%17.10" "mbar" COEFFS 0 1024 0 0 0 1 /end COMPU_METHOD
/begin COMPU_METHOD EgrMgm4ms_CM_ufix16_Bn40_degC "Q = (V+40.000000)/1.000000" RAT_FUNC "%0.6" "degC" COEFFS 0 1 40 0 0 1 /end COMPU_METHOD
/begin COMPU_METHOD EgrMgm4ms_CM_ufix16_En10_V "Q = V*1024.000000" RAT_FUNC "%12.10" "V" COEFFS 0 1024 0 0 0 1 /end COMPU_METHOD
/begin COMPU_METHOD EgrMgm4ms_CM_uint16_mbar "Q = V" RAT_FUNC "%5.0" "mbar" COEFFS 0 1 0 0 0 1 /end COMPU_METHOD
/begin COMPU_METHOD Egt100ms_CM_ufix16_Bn40_degC "Q = (V+40.000000)/1.000000" RAT_FUNC "%0.6" "degC" COEFFS 0 1 40 0 0 1 /end COMPU_METHOD
/begin COMPU_METHOD Evrc4ms_CM_boolean_adm "Q = V" RAT_FUNC "%1.0" "adm" COEFFS 0 1 0 0 0 1 /end COMPU_METHOD
/begin COMPU_METHOD ExhaustGasTemp100ms_CM_FixEnableT "Enumerated data type: FixEnableT" TAB_VERB "%0.6" "" COMPU_TAB_REF VTAB_FOR_ExhaustGasTemp100ms_CM_FixEnableT /end COMPU_METHOD
/begin COMPU_METHOD ExhaustGasTemp100ms_CM_ufix16_Bn40_degC "Q = (V+40.000000)/1.000000" RAT_FUNC "%0.6" "degC" COEFFS 0 1 40 0 0 1 /end COMPU_METHOD
/begin COMPU_METHOD ExhaustGasTemp100ms_CM_ufix16_En10_V "Q = V*1024.000000" RAT_FUNC "%12.10" "V" COEFFS 0 1024 0 0 0 1 /end COMPU_METHOD
/begin COMPU_METHOD ExhaustGasTemp100ms_CM_ufix16_En10_adm "Q = V*1024.000000" RAT_FUNC "%12.10" "adm" COEFFS 0 1024 0 0 0 1 /end COMPU_METHOD
/begin COMPU_METHOD FaultChkBAT4ms_CM_ufix16_En10_adm "Q = V*1024.000000" RAT_FUNC "%12.10" "adm" COEFFS 0 1024 0 0 0 1 /end COMPU_METHOD
/begin COMPU_METHOD FaultChkBRKCH_4ms_Symbol_CM_uint8_adm "Q = V" RAT_FUNC "%3.0" "adm" COEFFS 0 1 0 0 0 1 /end COMPU_METHOD
/begin COMPU_METHOD FaultChkVBP4ms_CM_ufix16_En10_adm "Q = V*1024.000000" RAT_FUNC "%12.10" "adm" COEFFS 0 1024 0 0 0 1 /end COMPU_METHOD
/begin COMPU_METHOD Gast100ms_CM_ufix16_Bn40_degC "Q = (V+40.000000)/1.000000" RAT_FUNC "%0.6" "degC" COEFFS 0 1 40 0 0 1 /end COMPU_METHOD
/begin COMPU_METHOD IgntTDC_CM_ufix16_En3_degF "Q = V*8.000000" RAT_FUNC "%7.3" "degF" COEFFS 0 8 0 0 0 1 /end COMPU_METHOD
/begin COMPU_METHOD J1939dl_Tx100ms_CM_ufix16_E2_mbar "Q = V/4.000000" RAT_FUNC "%5.0" "mbar" COEFFS 0 1 0 0 0 4 /end COMPU_METHOD
/begin COMPU_METHOD J1939dl_Tx100ms_CM_uint16_mbar "Q = V" RAT_FUNC "%5.0" "mbar" COEFFS 0 1 0 0 0 1 /end COMPU_METHOD
/begin COMPU_METHOD J1939dl_Tx1s_CM_boolean_adm "Q = V" RAT_FUNC "%1.0" "adm" COEFFS 0 1 0 0 0 1 /end COMPU_METHOD
/begin COMPU_METHOD J1939dl_Tx1s_CM_ufix16_S50_mV "Q = V/50.000000" RAT_FUNC "%0.6" "mV" COEFFS 0 1 0 0 0 50 /end COMPU_METHOD
/begin COMPU_METHOD LambdaPostSensor4ms_CM_FixEnableT "Enumerated data type: FixEnableT" TAB_VERB "%0.6" "" COMPU_TAB_REF VTAB_FOR_LambdaPostSensor4ms_CM_FixEnableT /end COMPU_METHOD
/begin COMPU_METHOD LambdaPostSensor4ms_CM_ufix16_En10_V "Q = V*1024.000000" RAT_FUNC "%12.10" "V" COEFFS 0 1024 0 0 0 1 /end COMPU_METHOD
/begin COMPU_METHOD LambdaPostSensor4ms_CM_ufix16_En10_adm "Q = V*1024.000000" RAT_FUNC "%12.10" "adm" COEFFS 0 1024 0 0 0 1 /end COMPU_METHOD
/begin COMPU_METHOD LambdaPostSensor4ms_CM_uint16_mV "Q = V" RAT_FUNC "%5.0" "mV" COEFFS 0 1 0 0 0 1 /end COMPU_METHOD
/begin COMPU_METHOD LambdaPreSensor4ms_CM_FixEnableT "Enumerated data type: FixEnableT" TAB_VERB "%0.6" "" COMPU_TAB_REF VTAB_FOR_LambdaPreSensor4ms_CM_FixEnableT /end COMPU_METHOD
/begin COMPU_METHOD LambdaPreSensor4ms_CM_ufix16_En10_V "Q = V*1024.000000" RAT_FUNC "%12.10" "V" COEFFS 0 1024 0 0 0 1 /end COMPU_METHOD
/begin COMPU_METHOD LambdaPreSensor4ms_CM_ufix16_En10_adm "Q = V*1024.000000" RAT_FUNC "%12.10" "adm" COEFFS 0 1024 0 0 0 1 /end COMPU_METHOD
/begin COMPU_METHOD LambdaPreSensor4ms_CM_uint16_mV "Q = V" RAT_FUNC "%5.0" "mV" COEFFS 0 1 0 0 0 1 /end COMPU_METHOD
/begin COMPU_METHOD Lamm4ms_CM_sfix16_En10__ "Q = V*1024.000000" RAT_FUNC "%12.10" "%" COEFFS 0 1024 0 0 0 1 /end COMPU_METHOD
/begin COMPU_METHOD Lamm4ms_CM_ufix16_En10_adm "Q = V*1024.000000" RAT_FUNC "%12.10" "adm" COEFFS 0 1024 0 0 0 1 /end COMPU_METHOD
/begin COMPU_METHOD Lamp100ms_CM_boolean_adm "Q = V" RAT_FUNC "%1.0" "adm" COEFFS 0 1 0 0 0 1 /end COMPU_METHOD
/begin COMPU_METHOD LampMgm100ms_CM_FixEnableT "Enumerated data type: FixEnableT" TAB_VERB "%0.6" "" COMPU_TAB_REF VTAB_FOR_LampMgm100ms_CM_FixEnableT /end COMPU_METHOD
/begin COMPU_METHOD LampMgm100ms_CM_boolean_adm "Q = V" RAT_FUNC "%1.0" "adm" COEFFS 0 1 0 0 0 1 /end COMPU_METHOD
/begin COMPU_METHOD LampMgm100ms_CM_ufix16_Bn40_degC "Q = (V+40.000000)/1.000000" RAT_FUNC "%0.6" "degC" COEFFS 0 1 40 0 0 1 /end COMPU_METHOD
/begin COMPU_METHOD LampMgm100ms_CM_ufix16_S50_mV "Q = V/50.000000" RAT_FUNC "%0.6" "mV" COEFFS 0 1 0 0 0 50 /end COMPU_METHOD
/begin COMPU_METHOD LampMgm100ms_CM_ufix16_Sp1_s "Q = V*10.000000" RAT_FUNC "%0.6" "s" COEFFS 0 10 0 0 0 1 /end COMPU_METHOD
/begin COMPU_METHOD LampMgm100ms_CM_uint16_mbar "Q = V" RAT_FUNC "%5.0" "mbar" COEFFS 0 1 0 0 0 1 /end COMPU_METHOD
/begin COMPU_METHOD LampMgm100ms_CM_uint16_rpm "Q = V" RAT_FUNC "%5.0" "rpm" COEFFS 0 1 0 0 0 1 /end COMPU_METHOD
/begin COMPU_METHOD MAFTemp100ms_CM_FixEnableT "Enumerated data type: FixEnableT" TAB_VERB "%0.6" "" COMPU_TAB_REF VTAB_FOR_MAFTemp100ms_CM_FixEnableT /end COMPU_METHOD
/begin COMPU_METHOD MAFTemp100ms_CM_ufix16_Bn40_degC "Q = (V+40.000000)/1.000000" RAT_FUNC "%0.6" "degC" COEFFS 0 1 40 0 0 1 /end COMPU_METHOD
/begin COMPU_METHOD MAFTemp100ms_CM_ufix16_En10_V "Q = V*1024.000000" RAT_FUNC "%12.10" "V" COEFFS 0 1024 0 0 0 1 /end COMPU_METHOD
/begin COMPU_METHOD MAFTemp100ms_CM_ufix16_En10_adm "Q = V*1024.000000" RAT_FUNC "%12.10" "adm" COEFFS 0 1024 0 0 0 1 /end COMPU_METHOD
/begin COMPU_METHOD MapSensor4ms_Symbol_CM_FixEnableT "Enumerated data type: FixEnableT" TAB_VERB "%0.6" "" COMPU_TAB_REF VTAB_FOR_MapSensor4ms_Symbol_CM_FixEnableT /end COMPU_METHOD
/begin COMPU_METHOD MapSensor4ms_Symbol_CM_ufix16_En10_V "Q = V*1024.000000" RAT_FUNC "%12.10" "V" COEFFS 0 1024 0 0 0 1 /end COMPU_METHOD
/begin COMPU_METHOD MapSensor4ms_Symbol_CM_ufix16_En10_adm "Q = V*1024.000000" RAT_FUNC "%12.10" "adm" COEFFS 0 1024 0 0 0 1 /end COMPU_METHOD
/begin COMPU_METHOD MapSensor4ms_Symbol_CM_uint16_mbar "Q = V" RAT_FUNC "%5.0" "mbar" COEFFS 0 1 0 0 0 1 /end COMPU_METHOD
/begin COMPU_METHOD Mpre4ms_CM_uint16_mbar "Q = V" RAT_FUNC "%5.0" "mbar" COEFFS 0 1 0 0 0 1 /end COMPU_METHOD
/begin COMPU_METHOD OilPresSensor100ms_Symbol_CM_FixEnableT "Enumerated data type: FixEnableT" TAB_VERB "%0.6" "" COMPU_TAB_REF VTAB_FOR_OilPresSensor100ms_Symbol_CM_FixEnableT /end COMPU_METHOD
/begin COMPU_METHOD OilPresSensor100ms_Symbol_CM_ufix16_En10_V "Q = V*1024.000000" RAT_FUNC "%12.10" "V" COEFFS 0 1024 0 0 0 1 /end COMPU_METHOD
/begin COMPU_METHOD OilPresSensor100ms_Symbol_CM_ufix16_En10_adm "Q = V*1024.000000" RAT_FUNC "%12.10" "adm" COEFFS 0 1024 0 0 0 1 /end COMPU_METHOD
/begin COMPU_METHOD OilPresSensor100ms_Symbol_CM_uint16_mbar "Q = V" RAT_FUNC "%5.0" "mbar" COEFFS 0 1 0 0 0 1 /end COMPU_METHOD
/begin COMPU_METHOD Oilp100ms_CM_uint16_mbar "Q = V" RAT_FUNC "%5.0" "mbar" COEFFS 0 1 0 0 0 1 /end COMPU_METHOD
/begin COMPU_METHOD Pacc4ms_CM_boolean_adm "Q = V" RAT_FUNC "%1.0" "adm" COEFFS 0 1 0 0 0 1 /end COMPU_METHOD
/begin COMPU_METHOD Pacc4ms_CM_uint8_adm "Q = V" RAT_FUNC "%3.0" "adm" COEFFS 0 1 0 0 0 1 /end COMPU_METHOD
/begin COMPU_METHOD Prvc4ms_CM_boolean_adm "Q = V" RAT_FUNC "%1.0" "adm" COEFFS 0 1 0 0 0 1 /end COMPU_METHOD
/begin COMPU_METHOD RailPresSensor4ms_CM_FixEnableT "Enumerated data type: FixEnableT" TAB_VERB "%0.6" "" COMPU_TAB_REF VTAB_FOR_RailPresSensor4ms_CM_FixEnableT /end COMPU_METHOD
/begin COMPU_METHOD RailPresSensor4ms_CM_ufix16_En10_V "Q = V*1024.000000" RAT_FUNC "%12.10" "V" COEFFS 0 1024 0 0 0 1 /end COMPU_METHOD
/begin COMPU_METHOD RailPresSensor4ms_CM_ufix16_En10_adm "Q = V*1024.000000" RAT_FUNC "%12.10" "adm" COEFFS 0 1024 0 0 0 1 /end COMPU_METHOD
/begin COMPU_METHOD RailPresSensor4ms_CM_uint16_mbar "Q = V" RAT_FUNC "%5.0" "mbar" COEFFS 0 1 0 0 0 1 /end COMPU_METHOD
/begin COMPU_METHOD Rpre4ms_CM_uint16_mbar "Q = V" RAT_FUNC "%5.0" "mbar" COEFFS 0 1 0 0 0 1 /end COMPU_METHOD
/begin COMPU_METHOD Spare100ms_CM_ufix16_Bn40_degC "Q = (V+40.000000)/1.000000" RAT_FUNC "%0.6" "degC" COEFFS 0 1 40 0 0 1 /end COMPU_METHOD
/begin COMPU_METHOD TE_EgrPos4ms_CM_FixEnableT "Enumerated data type: FixEnableT" TAB_VERB "%0.6" "" COMPU_TAB_REF VTAB_FOR_TE_EgrPos4ms_CM_FixEnableT /end COMPU_METHOD
/begin COMPU_METHOD TE_EgrPos4ms_CM_ufix16_En10_V "Q = V*1024.000000" RAT_FUNC "%12.10" "V" COEFFS 0 1024 0 0 0 1 /end COMPU_METHOD
/begin COMPU_METHOD TE_EgrPos4ms_CM_ufix16_En10_adm "Q = V*1024.000000" RAT_FUNC "%12.10" "adm" COEFFS 0 1024 0 0 0 1 /end COMPU_METHOD
/begin COMPU_METHOD TE_HBEgrValveCtrl4ms_CM_ufix16_En10_adm "Q = V*1024.000000" RAT_FUNC "%12.10" "adm" COEFFS 0 1024 0 0 0 1 /end COMPU_METHOD
/begin COMPU_METHOD TE_PotenzAccSensor_4ms_Symbol_CM_FixEnableT "Enumerated data type: FixEnableT" TAB_VERB "%0.6" "" COMPU_TAB_REF VTAB_FOR_TE_PotenzAccSensor_4ms_Symbol_CM_FixEnableT /end COMPU_METHOD
/begin COMPU_METHOD TE_PotenzAccSensor_4ms_Symbol_CM_boolean_adm "Q = V" RAT_FUNC "%1.0" "adm" COEFFS 0 1 0 0 0 1 /end COMPU_METHOD
/begin COMPU_METHOD TE_PotenzAccSensor_4ms_Symbol_CM_ufix16_En10_V "Q = V*1024.000000" RAT_FUNC "%12.10" "V" COEFFS 0 1024 0 0 0 1 /end COMPU_METHOD
/begin COMPU_METHOD TE_PotenzAccSensor_4ms_Symbol_CM_ufix16_En10_adm "Q = V*1024.000000" RAT_FUNC "%12.10" "adm" COEFFS 0 1024 0 0 0 1 /end COMPU_METHOD
/begin COMPU_METHOD TE_PotenzAccSensor_4ms_Symbol_CM_ufix16_En4__ "Q = V*16.000000" RAT_FUNC "%8.4" "%" COEFFS 0 16 0 0 0 1 /end COMPU_METHOD
/begin COMPU_METHOD TE_PotenzAccSensor_4ms_Symbol_CM_ufix16_Sp1_s "Q = V*10.000000" RAT_FUNC "%0.6" "s" COEFFS 0 10 0 0 0 1 /end COMPU_METHOD
/begin COMPU_METHOD TE_PotenzAccSensor_4ms_Symbol_CM_uint16_adm "Q = V" RAT_FUNC "%5.0" "adm" COEFFS 0 1 0 0 0 1 /end COMPU_METHOD
/begin COMPU_METHOD TE_PotenzAccSensor_4ms_Symbol_CM_uint16_km_h "Q = V" RAT_FUNC "%5.0" "km/h" COEFFS 0 1 0 0 0 1 /end COMPU_METHOD
/begin COMPU_METHOD TE_PotenzAccSensor_4ms_Symbol_CM_uint8_adm "Q = V" RAT_FUNC "%3.0" "adm" COEFFS 0 1 0 0 0 1 /end COMPU_METHOD
/begin COMPU_METHOD TE_TM_PotThrSens4ms_Symbol_CM_FixEnableT "Enumerated data type: FixEnableT" TAB_VERB "%0.6" "" COMPU_TAB_REF VTAB_FOR_TE_TM_PotThrSens4ms_Symbol_CM_FixEnableT /end COMPU_METHOD
/begin COMPU_METHOD TE_TM_PotThrSens4ms_Symbol_CM_boolean_adm "Q = V" RAT_FUNC "%1.0" "adm" COEFFS 0 1 0 0 0 1 /end COMPU_METHOD
/begin COMPU_METHOD TE_TM_PotThrSens4ms_Symbol_CM_sfix16_En8__ "Q = V*256.000000" RAT_FUNC "%11.8" "%" COEFFS 0 256 0 0 0 1 /end COMPU_METHOD
/begin COMPU_METHOD TE_TM_PotThrSens4ms_Symbol_CM_ufix16_En10_V "Q = V*1024.000000" RAT_FUNC "%12.10" "V" COEFFS 0 1024 0 0 0 1 /end COMPU_METHOD
/begin COMPU_METHOD TE_TM_PotThrSens4ms_Symbol_CM_ufix16_En10_adm "Q = V*1024.000000" RAT_FUNC "%12.10" "adm" COEFFS 0 1024 0 0 0 1 /end COMPU_METHOD
/begin COMPU_METHOD TE_TM_PotThrSens4ms_Symbol_CM_ufix16_En3_degF "Q = V*8.000000" RAT_FUNC "%7.3" "degF" COEFFS 0 8 0 0 0 1 /end COMPU_METHOD
/begin COMPU_METHOD TE_TM_PotThrSens4ms_Symbol_CM_ufix16_En8__ "Q = V*256.000000" RAT_FUNC "%11.8" "%" COEFFS 0 256 0 0 0 1 /end COMPU_METHOD
/begin COMPU_METHOD TE_TM_PotThrSens4ms_Symbol_CM_ufix16_En8___deg "Q = V*256.000000" RAT_FUNC "%11.8" "%/deg" COEFFS 0 256 0 0 0 1 /end COMPU_METHOD
/begin COMPU_METHOD TE_TM_PotThrSens4ms_Symbol_CM_ufix16_En9_deg "Q = V*512.000000" RAT_FUNC "%12.9" "deg" COEFFS 0 512 0 0 0 1 /end COMPU_METHOD
/begin COMPU_METHOD TE_TM_PotThrSens4ms_Symbol_CM_ufix8_Sp1_V "Q = V*10.000000" RAT_FUNC "%0.6" "V" COEFFS 0 10 0 0 0 1 /end COMPU_METHOD
/begin COMPU_METHOD TE_TM_PotThrSens4ms_Symbol_CM_ufix8_Sp392__ "Q = V*2.551020" RAT_FUNC "%0.6" "%" COEFFS 0 2.55102 0 0 0 1 /end COMPU_METHOD
/begin COMPU_METHOD TF_TE_DigInput4ms_CM_FixEnableT "Enumerated data type: FixEnableT" TAB_VERB "%0.6" "" COMPU_TAB_REF VTAB_FOR_TF_TE_DigInput4ms_CM_FixEnableT /end COMPU_METHOD
/begin COMPU_METHOD TF_TE_DigInput4ms_CM_boolean_adm "Q = V" RAT_FUNC "%1.0" "adm" COEFFS 0 1 0 0 0 1 /end COMPU_METHOD
/begin COMPU_METHOD TF_TE_DigInput4ms_CM_uint8_adm "Q = V" RAT_FUNC "%3.0" "adm" COEFFS 0 1 0 0 0 1 /end COMPU_METHOD
/begin COMPU_METHOD TankPresSensor4ms_Symbol_CM_FixEnableT "Enumerated data type: FixEnableT" TAB_VERB "%0.6" "" COMPU_TAB_REF VTAB_FOR_TankPresSensor4ms_Symbol_CM_FixEnableT /end COMPU_METHOD
/begin COMPU_METHOD TankPresSensor4ms_Symbol_CM_ufix16_E2_mbar "Q = V/4.000000" RAT_FUNC "%5.0" "mbar" COEFFS 0 1 0 0 0 4 /end COMPU_METHOD
/begin COMPU_METHOD TankPresSensor4ms_Symbol_CM_ufix16_En10_V "Q = V*1024.000000" RAT_FUNC "%12.10" "V" COEFFS 0 1024 0 0 0 1 /end COMPU_METHOD
/begin COMPU_METHOD TankPresSensor4ms_Symbol_CM_ufix16_En10_adm "Q = V*1024.000000" RAT_FUNC "%12.10" "adm" COEFFS 0 1024 0 0 0 1 /end COMPU_METHOD
/begin COMPU_METHOD TempAirSensor100ms_Symbol_CM_FixEnableT "Enumerated data type: FixEnableT" TAB_VERB "%0.6" "" COMPU_TAB_REF VTAB_FOR_TempAirSensor100ms_Symbol_CM_FixEnableT /end COMPU_METHOD
/begin COMPU_METHOD TempAirSensor100ms_Symbol_CM_ufix16_Bn40_degC "Q = (V+40.000000)/1.000000" RAT_FUNC "%0.6" "degC" COEFFS 0 1 40 0 0 1 /end COMPU_METHOD
/begin COMPU_METHOD TempAirSensor100ms_Symbol_CM_ufix16_En10_V "Q = V*1024.000000" RAT_FUNC "%12.10" "V" COEFFS 0 1024 0 0 0 1 /end COMPU_METHOD
/begin COMPU_METHOD TempAirSensor100ms_Symbol_CM_ufix16_En10_adm "Q = V*1024.000000" RAT_FUNC "%12.10" "adm" COEFFS 0 1024 0 0 0 1 /end COMPU_METHOD
/begin COMPU_METHOD TempH2OSensor100ms_Symbol_CM_FixEnableT "Enumerated data type: FixEnableT" TAB_VERB "%0.6" "" COMPU_TAB_REF VTAB_FOR_TempH2OSensor100ms_Symbol_CM_FixEnableT /end COMPU_METHOD
/begin COMPU_METHOD TempH2OSensor100ms_Symbol_CM_ufix16_Bn40_degC "Q = (V+40.000000)/1.000000" RAT_FUNC "%0.6" "degC" COEFFS 0 1 40 0 0 1 /end COMPU_METHOD
/begin COMPU_METHOD TempH2OSensor100ms_Symbol_CM_ufix16_En10_V "Q = V*1024.000000" RAT_FUNC "%12.10" "V" COEFFS 0 1024 0 0 0 1 /end COMPU_METHOD
/begin COMPU_METHOD TempH2OSensor100ms_Symbol_CM_ufix16_En10_adm "Q = V*1024.000000" RAT_FUNC "%12.10" "adm" COEFFS 0 1024 0 0 0 1 /end COMPU_METHOD
/begin COMPU_METHOD TempKatSensor100ms_Symbol_CM_FixEnableT "Enumerated data type: FixEnableT" TAB_VERB "%0.6" "" COMPU_TAB_REF VTAB_FOR_TempKatSensor100ms_Symbol_CM_FixEnableT /end COMPU_METHOD
/begin COMPU_METHOD TempKatSensor100ms_Symbol_CM_ufix16_Bn40_degC "Q = (V+40.000000)/1.000000" RAT_FUNC "%0.6" "degC" COEFFS 0 1 40 0 0 1 /end COMPU_METHOD
/begin COMPU_METHOD TempKatSensor100ms_Symbol_CM_ufix16_En10_V "Q = V*1024.000000" RAT_FUNC "%12.10" "V" COEFFS 0 1024 0 0 0 1 /end COMPU_METHOD
/begin COMPU_METHOD TempKatSensor100ms_Symbol_CM_ufix16_En10_adm "Q = V*1024.000000" RAT_FUNC "%12.10" "adm" COEFFS 0 1024 0 0 0 1 /end COMPU_METHOD
/begin COMPU_METHOD TempOilSensor100ms_CM_FixEnableT "Enumerated data type: FixEnableT" TAB_VERB "%0.6" "" COMPU_TAB_REF VTAB_FOR_TempOilSensor100ms_CM_FixEnableT /end COMPU_METHOD
/begin COMPU_METHOD TempOilSensor100ms_CM_ufix16_Bn40_degC "Q = (V+40.000000)/1.000000" RAT_FUNC "%0.6" "degC" COEFFS 0 1 40 0 0 1 /end COMPU_METHOD
/begin COMPU_METHOD TempOilSensor100ms_CM_ufix16_En10_V "Q = V*1024.000000" RAT_FUNC "%12.10" "V" COEFFS 0 1024 0 0 0 1 /end COMPU_METHOD
/begin COMPU_METHOD TempOilSensor100ms_CM_ufix16_En10_adm "Q = V*1024.000000" RAT_FUNC "%12.10" "adm" COEFFS 0 1024 0 0 0 1 /end COMPU_METHOD
/begin COMPU_METHOD TempRailSensor100ms_Symbol_CM_FixEnableT "Enumerated data type: FixEnableT" TAB_VERB "%0.6" "" COMPU_TAB_REF VTAB_FOR_TempRailSensor100ms_Symbol_CM_FixEnableT /end COMPU_METHOD
/begin COMPU_METHOD TempRailSensor100ms_Symbol_CM_ufix16_Bn40_degC "Q = (V+40.000000)/1.000000" RAT_FUNC "%0.6" "degC" COEFFS 0 1 40 0 0 1 /end COMPU_METHOD
/begin COMPU_METHOD TempRailSensor100ms_Symbol_CM_ufix16_En10_V "Q = V*1024.000000" RAT_FUNC "%12.10" "V" COEFFS 0 1024 0 0 0 1 /end COMPU_METHOD
/begin COMPU_METHOD TempRailSensor100ms_Symbol_CM_ufix16_En10_adm "Q = V*1024.000000" RAT_FUNC "%12.10" "adm" COEFFS 0 1024 0 0 0 1 /end COMPU_METHOD
/begin COMPU_METHOD Thrp4ms_CM_sfix16_En3_degF "Q = V*8.000000" RAT_FUNC "%7.3" "degF" COEFFS 0 8 0 0 0 1 /end COMPU_METHOD
/begin COMPU_METHOD Thrp4ms_CM_ufix16_En3_degF "Q = V*8.000000" RAT_FUNC "%7.3" "degF" COEFFS 0 8 0 0 0 1 /end COMPU_METHOD
/begin COMPU_METHOD Thrp4ms_CM_ufix16_En3_degree "Q = V*8.000000" RAT_FUNC "%7.3" "degree" COEFFS 0 8 0 0 0 1 /end COMPU_METHOD
/begin COMPU_METHOD Thrp4ms_CM_ufix16_En9_deg "Q = V*512.000000" RAT_FUNC "%12.9" "deg" COEFFS 0 512 0 0 0 1 /end COMPU_METHOD
/begin COMPU_METHOD Thrp4ms_CM_ufix8_Sp392__ "Q = V*2.551020" RAT_FUNC "%0.6" "%" COEFFS 0 2.55102 0 0 0 1 /end COMPU_METHOD
/begin COMPU_METHOD Tnkp4ms_CM_ufix16_E2_mbar "Q = V/4.000000" RAT_FUNC "%5.0" "mbar" COEFFS 0 1 0 0 0 4 /end COMPU_METHOD
/begin COMPU_METHOD TurboTemp100ms_CM_FixEnableT "Enumerated data type: FixEnableT" TAB_VERB "%0.6" "" COMPU_TAB_REF VTAB_FOR_TurboTemp100ms_CM_FixEnableT /end COMPU_METHOD
/begin COMPU_METHOD TurboTemp100ms_CM_ufix16_Bn40_degC "Q = (V+40.000000)/1.000000" RAT_FUNC "%0.6" "degC" COEFFS 0 1 40 0 0 1 /end COMPU_METHOD
/begin COMPU_METHOD TurboTemp100ms_CM_ufix16_En10_V "Q = V*1024.000000" RAT_FUNC "%12.10" "V" COEFFS 0 1024 0 0 0 1 /end COMPU_METHOD
/begin COMPU_METHOD TurboTemp100ms_CM_ufix16_En10_adm "Q = V*1024.000000" RAT_FUNC "%12.10" "adm" COEFFS 0 1024 0 0 0 1 /end COMPU_METHOD
/begin COMPU_METHOD UegoSensor4ms_CM_FixEnableT "Enumerated data type: FixEnableT" TAB_VERB "%0.6" "" COMPU_TAB_REF VTAB_FOR_UegoSensor4ms_CM_FixEnableT /end COMPU_METHOD
/begin COMPU_METHOD UegoSensor4ms_CM_sfix16_En10_degC "Q = V*1024.000000" RAT_FUNC "%12.10" "degC" COEFFS 0 1024 0 0 0 1 /end COMPU_METHOD
/begin COMPU_METHOD UegoSensor4ms_CM_ufix16_En10 "Q = V*1024.000000" RAT_FUNC "%12.10" "" COEFFS 0 1024 0 0 0 1 /end COMPU_METHOD
/begin COMPU_METHOD UegoSensor4ms_CM_ufix16_En10_adm "Q = V*1024.000000" RAT_FUNC "%12.10" "adm" COEFFS 0 1024 0 0 0 1 /end COMPU_METHOD
/begin COMPU_METHOD UegoSensor4ms_CM_ufix16_Sp0001_Bn3_mA "Q = (V+3.000000)*10000.000000" RAT_FUNC "%0.6" "mA" COEFFS 0 10000 30000 0 0 1 /end COMPU_METHOD
/begin COMPU_METHOD UegoSensor4ms_CM_ufix16_Sp0001_Bn3_ma "Q = (V+3.000000)*10000.000000" RAT_FUNC "%0.6" "ma" COEFFS 0 10000 30000 0 0 1 /end COMPU_METHOD
/begin COMPU_METHOD UegoSensor4ms_CM_ufix16_Sp004_sec "Q = V*250.000000" RAT_FUNC "%0.6" "sec" COEFFS 0 250 0 0 0 1 /end COMPU_METHOD
/begin COMPU_METHOD UpdateThrotPosLim4ms_CM_uint16_rpm "Q = V" RAT_FUNC "%5.0" "rpm" COEFFS 0 1 0 0 0 1 /end COMPU_METHOD
/begin COMPU_METHOD VBattPower4ms_Symbol_CM_FixEnableT "Enumerated data type: FixEnableT" TAB_VERB "%0.6" "" COMPU_TAB_REF VTAB_FOR_VBattPower4ms_Symbol_CM_FixEnableT /end COMPU_METHOD
/begin COMPU_METHOD VBattPower4ms_Symbol_CM_ufix16_En10_V "Q = V*1024.000000" RAT_FUNC "%12.10" "V" COEFFS 0 1024 0 0 0 1 /end COMPU_METHOD
/begin COMPU_METHOD VBattPower4ms_Symbol_CM_ufix16_En10_adm "Q = V*1024.000000" RAT_FUNC "%12.10" "adm" COEFFS 0 1024 0 0 0 1 /end COMPU_METHOD
/begin COMPU_METHOD VBattPower4ms_Symbol_CM_ufix16_S50_mV "Q = V/50.000000" RAT_FUNC "%0.6" "mV" COEFFS 0 1 0 0 0 50 /end COMPU_METHOD
/begin COMPU_METHOD VBattSensor4ms_Symbol_CM_FixEnableT "Enumerated data type: FixEnableT" TAB_VERB "%0.6" "" COMPU_TAB_REF VTAB_FOR_VBattSensor4ms_Symbol_CM_FixEnableT /end COMPU_METHOD
/begin COMPU_METHOD VBattSensor4ms_Symbol_CM_ufix16_En10_V "Q = V*1024.000000" RAT_FUNC "%12.10" "V" COEFFS 0 1024 0 0 0 1 /end COMPU_METHOD
/begin COMPU_METHOD VBattSensor4ms_Symbol_CM_ufix16_En10_adm "Q = V*1024.000000" RAT_FUNC "%12.10" "adm" COEFFS 0 1024 0 0 0 1 /end COMPU_METHOD
/begin COMPU_METHOD VBattSensor4ms_Symbol_CM_ufix16_S50_mV "Q = V/50.000000" RAT_FUNC "%0.6" "mV" COEFFS 0 1 0 0 0 50 /end COMPU_METHOD
/begin COMPU_METHOD bsWRNLStatus.Conversion "" LINEAR "%.3" "adm" COEFFS_LINEAR 1 0 /end COMPU_METHOD
/begin COMPU_METHOD bsWorkedTime_GOBD.Conversion "" LINEAR "%.3" "min" COEFFS_LINEAR 1 0 /end COMPU_METHOD
/begin COMPU_METHOD eDiagStatus.Conversion "" TAB_VERB "%.0" "" COMPU_TAB_REF eDiagStatus.Conversion /end COMPU_METHOD
/begin COMPU_VTAB VTAB_FOR_ADIALampMgm100ms_CM_FixEnableT "Enumerated data type: FixEnableT" TAB_VERB 2 171 "Enable" 218 "Disable" /end COMPU_VTAB
/begin COMPU_VTAB VTAB_FOR_Airt100ms_CM_tKeyState_adm "Enumerated data type: tKeyState" TAB_VERB 2 0 "KEY_OFF" 1 "KEY_ON" /end COMPU_VTAB
/begin COMPU_VTAB VTAB_FOR_AtmophericPresSensor100ms_Symbol_CM_FixEnableT "Enumerated data type: FixEnableT" TAB_VERB 2 171 "Enable" 218 "Disable" /end COMPU_VTAB
/begin COMPU_VTAB VTAB_FOR_BoostPresSensor4ms_Symbol_CM_FixEnableT "Enumerated data type: FixEnableT" TAB_VERB 2 171 "Enable" 218 "Disable" /end COMPU_VTAB
/begin COMPU_VTAB VTAB_FOR_DebimSensor4ms_CM_FixEnableT "Enumerated data type: FixEnableT" TAB_VERB 2 171 "Enable" 218 "Disable" /end COMPU_VTAB
/begin COMPU_VTAB VTAB_FOR_DigInput4ms_Symbol_CM_FixEnableT "Enumerated data type: FixEnableT" TAB_VERB 2 171 "Enable" 218 "Disable" /end COMPU_VTAB
/begin COMPU_VTAB VTAB_FOR_EcuTempSensor1s_CM_FixEnableT "Enumerated data type: FixEnableT" TAB_VERB 2 171 "Enable" 218 "Disable" /end COMPU_VTAB
/begin COMPU_VTAB VTAB_FOR_EgrCoolerTemp4ms_CM_FixEnableT "Enumerated data type: FixEnableT" TAB_VERB 2 171 "Enable" 218 "Disable" /end COMPU_VTAB
/begin COMPU_VTAB VTAB_FOR_EgrDeltaP4ms_CM_FixEnableT "Enumerated data type: FixEnableT" TAB_VERB 2 171 "Enable" 218 "Disable" /end COMPU_VTAB
/begin COMPU_VTAB VTAB_FOR_EgrHighPre4ms_CM_FixEnableT "Enumerated data type: FixEnableT" TAB_VERB 2 171 "Enable" 218 "Disable" /end COMPU_VTAB
/begin COMPU_VTAB VTAB_FOR_ExhaustGasTemp100ms_CM_FixEnableT "Enumerated data type: FixEnableT" TAB_VERB 2 171 "Enable" 218 "Disable" /end COMPU_VTAB
/begin COMPU_VTAB VTAB_FOR_LambdaPostSensor4ms_CM_FixEnableT "Enumerated data type: FixEnableT" TAB_VERB 2 171 "Enable" 218 "Disable" /end COMPU_VTAB
/begin COMPU_VTAB VTAB_FOR_LambdaPreSensor4ms_CM_FixEnableT "Enumerated data type: FixEnableT" TAB_VERB 2 171 "Enable" 218 "Disable" /end COMPU_VTAB
/begin COMPU_VTAB VTAB_FOR_LampMgm100ms_CM_FixEnableT "Enumerated data type: FixEnableT" TAB_VERB 2 171 "Enable" 218 "Disable" /end COMPU_VTAB
/begin COMPU_VTAB VTAB_FOR_MAFTemp100ms_CM_FixEnableT "Enumerated data type: FixEnableT" TAB_VERB 2 171 "Enable" 218 "Disable" /end COMPU_VTAB
/begin COMPU_VTAB VTAB_FOR_MapSensor4ms_Symbol_CM_FixEnableT "Enumerated data type: FixEnableT" TAB_VERB 2 171 "Enable" 218 "Disable" /end COMPU_VTAB
/begin COMPU_VTAB VTAB_FOR_OilPresSensor100ms_Symbol_CM_FixEnableT "Enumerated data type: FixEnableT" TAB_VERB 2 171 "Enable" 218 "Disable" /end COMPU_VTAB
/begin COMPU_VTAB VTAB_FOR_RailPresSensor4ms_CM_FixEnableT "Enumerated data type: FixEnableT" TAB_VERB 2 171 "Enable" 218 "Disable" /end COMPU_VTAB
/begin COMPU_VTAB VTAB_FOR_TE_EgrPos4ms_CM_FixEnableT "Enumerated data type: FixEnableT" TAB_VERB 2 171 "Enable" 218 "Disable" /end COMPU_VTAB
/begin COMPU_VTAB VTAB_FOR_TE_PotenzAccSensor_4ms_Symbol_CM_FixEnableT "Enumerated data type: FixEnableT" TAB_VERB 2 171 "Enable" 218 "Disable" /end COMPU_VTAB
/begin COMPU_VTAB VTAB_FOR_TE_TM_PotThrSens4ms_Symbol_CM_FixEnableT "Enumerated data type: FixEnableT" TAB_VERB 2 171 "Enable" 218 "Disable" /end COMPU_VTAB
/begin COMPU_VTAB VTAB_FOR_TF_TE_DigInput4ms_CM_FixEnableT "Enumerated data type: FixEnableT" TAB_VERB 2 171 "Enable" 218 "Disable" /end COMPU_VTAB
/begin COMPU_VTAB VTAB_FOR_TankPresSensor4ms_Symbol_CM_FixEnableT "Enumerated data type: FixEnableT" TAB_VERB 2 171 "Enable" 218 "Disable" /end COMPU_VTAB
/begin COMPU_VTAB VTAB_FOR_TempAirSensor100ms_Symbol_CM_FixEnableT "Enumerated data type: FixEnableT" TAB_VERB 2 171 "Enable" 218 "Disable" /end COMPU_VTAB
/begin COMPU_VTAB VTAB_FOR_TempH2OSensor100ms_Symbol_CM_FixEnableT "Enumerated data type: FixEnableT" TAB_VERB 2 171 "Enable" 218 "Disable" /end COMPU_VTAB
/begin COMPU_VTAB VTAB_FOR_TempKatSensor100ms_Symbol_CM_FixEnableT "Enumerated data type: FixEnableT" TAB_VERB 2 171 "Enable" 218 "Disable" /end COMPU_VTAB
/begin COMPU_VTAB VTAB_FOR_TempOilSensor100ms_CM_FixEnableT "Enumerated data type: FixEnableT" TAB_VERB 2 171 "Enable" 218 "Disable" /end COMPU_VTAB
/begin COMPU_VTAB VTAB_FOR_TempRailSensor100ms_Symbol_CM_FixEnableT "Enumerated data type: FixEnableT" TAB_VERB 2 171 "Enable" 218 "Disable" /end COMPU_VTAB
/begin COMPU_VTAB VTAB_FOR_TurboTemp100ms_CM_FixEnableT "Enumerated data type: FixEnableT" TAB_VERB 2 171 "Enable" 218 "Disable" /end COMPU_VTAB
/begin COMPU_VTAB VTAB_FOR_UegoSensor4ms_CM_FixEnableT "Enumerated data type: FixEnableT" TAB_VERB 2 171 "Enable" 218 "Disable" /end COMPU_VTAB
/begin COMPU_VTAB VTAB_FOR_VBattPower4ms_Symbol_CM_FixEnableT "Enumerated data type: FixEnableT" TAB_VERB 2 171 "Enable" 218 "Disable" /end COMPU_VTAB
/begin COMPU_VTAB VTAB_FOR_VBattSensor4ms_Symbol_CM_FixEnableT "Enumerated data type: FixEnableT" TAB_VERB 2 171 "Enable" 218 "Disable" /end COMPU_VTAB
/begin COMPU_VTAB eDiagStatus.Conversion "" TAB_VERB 27 0 "DIAG_STATUS_OK" 1 "DIAG_GENERIC_FAULT" 2 "DIAG_SHORT_GND" 3 "DIAG_SHORT_VCC" 4 "DIAG_SHORT_OVER_LOAD" 5 "DIAG_SHORT_HS_VCC" 6 "DIAG_SHORT_LS_VCC" 7 "DIAG_SHORT_HS_GND" 8 "DIAG_SHORT_LS_GND" 9 "DIAG_SHORT_HS_LS" 10 "DIAG_SHORT_HS_LS_GND" 11 "DIAG_SHORT_HS_LS_VCC" 12 "DIAG_OPEN_LOAD" 13 "DIAG_SHORT_GND_OR_OPEN_LOAD" 14 "DIAG_SHORT_VCC_OR_OPEN_LOAD" 15 "DIAG_OPEN_SECONDARY" 16 "DIAG_OVER_LOAD" 17 "DIAG_OVER_LOAD_LS" 18 "DIAG_OVER_LOAD_HS" 19 "DIAG_OVER_CURRENT" 20 "DIAG_POWER_SUPPLY_FAIL" 21 "DIAG_TEMPERATURE_FAULT" 22 "DIAG_TEMPERATURE_WARNING" 23 "DIAG_CURRENT_LIMITATION" 24 "DIAG_UNDERVOLTAGE" 25 "DIAG_LOAD_ENABLE" 26 "DIAG_BUS_OFF" /end COMPU_VTAB
/begin RECORD_LAYOUT Lookup1D_BOOLEAN FNC_VALUES 1 UBYTE COLUMN_DIR DIRECT /end RECORD_LAYOUT
/begin RECORD_LAYOUT Lookup1D_BYTE FNC_VALUES 1 SBYTE COLUMN_DIR DIRECT /end RECORD_LAYOUT
/begin RECORD_LAYOUT Lookup1D_FLOAT32_IEEE FNC_VALUES 1 FLOAT32_IEEE COLUMN_DIR DIRECT /end RECORD_LAYOUT
/begin RECORD_LAYOUT Lookup1D_FLOAT64_IEEE FNC_VALUES 1 FLOAT64_IEEE COLUMN_DIR DIRECT /end RECORD_LAYOUT
/begin RECORD_LAYOUT Lookup1D_SLONG FNC_VALUES 1 SLONG COLUMN_DIR DIRECT /end RECORD_LAYOUT
/begin RECORD_LAYOUT Lookup1D_UBYTE FNC_VALUES 1 UBYTE COLUMN_DIR DIRECT /end RECORD_LAYOUT
/begin RECORD_LAYOUT Lookup1D_UWORD FNC_VALUES 1 UWORD COLUMN_DIR DIRECT /end RECORD_LAYOUT
/begin RECORD_LAYOUT Lookup1D_WORD FNC_VALUES 1 SWORD COLUMN_DIR DIRECT /end RECORD_LAYOUT
/begin RECORD_LAYOUT Lookup1D_X_BOOLEAN AXIS_PTS_X 1 UBYTE INDEX_INCR DIRECT /end RECORD_LAYOUT
/begin RECORD_LAYOUT Lookup1D_X_BYTE AXIS_PTS_X 1 SBYTE INDEX_INCR DIRECT /end RECORD_LAYOUT
/begin RECORD_LAYOUT Lookup1D_X_FLOAT32_IEEE AXIS_PTS_X 1 FLOAT32_IEEE INDEX_INCR DIRECT /end RECORD_LAYOUT
/begin RECORD_LAYOUT Lookup1D_X_FLOAT64_IEEE AXIS_PTS_X 1 FLOAT64_IEEE INDEX_INCR DIRECT /end RECORD_LAYOUT
/begin RECORD_LAYOUT Lookup1D_X_LONG AXIS_PTS_X 1 SLONG INDEX_INCR DIRECT /end RECORD_LAYOUT
/begin RECORD_LAYOUT Lookup1D_X_UBYTE AXIS_PTS_X 1 UBYTE INDEX_INCR DIRECT /end RECORD_LAYOUT
/begin RECORD_LAYOUT Lookup1D_X_ULONG AXIS_PTS_X 1 ULONG INDEX_INCR DIRECT /end RECORD_LAYOUT
/begin RECORD_LAYOUT Lookup1D_X_UWORD AXIS_PTS_X 1 UWORD INDEX_INCR DIRECT /end RECORD_LAYOUT
/begin RECORD_LAYOUT Lookup1D_X_WORD AXIS_PTS_X 1 SWORD INDEX_INCR DIRECT /end RECORD_LAYOUT
/begin RECORD_LAYOUT Lookup2DSF_BOOLEAN FNC_VALUES 1 UBYTE ROW_DIR DIRECT /end RECORD_LAYOUT
/begin RECORD_LAYOUT Lookup2DSF_BYTE FNC_VALUES 1 SBYTE ROW_DIR DIRECT /end RECORD_LAYOUT
/begin RECORD_LAYOUT Lookup2DSF_FLOAT32_IEEE FNC_VALUES 1 FLOAT32_IEEE ROW_DIR DIRECT /end RECORD_LAYOUT
/begin RECORD_LAYOUT Lookup2DSF_FLOAT64_IEEE FNC_VALUES 1 FLOAT64_IEEE ROW_DIR DIRECT /end RECORD_LAYOUT
/begin RECORD_LAYOUT Lookup2DSF_LONG FNC_VALUES 1 SLONG ROW_DIR DIRECT /end RECORD_LAYOUT
/begin RECORD_LAYOUT Lookup2DSF_UBYTE FNC_VALUES 1 UBYTE ROW_DIR DIRECT /end RECORD_LAYOUT
/begin RECORD_LAYOUT Lookup2DSF_ULONG FNC_VALUES 1 ULONG ROW_DIR DIRECT /end RECORD_LAYOUT
/begin RECORD_LAYOUT Lookup2D_BOOLEAN FNC_VALUES 1 UBYTE COLUMN_DIR DIRECT /end RECORD_LAYOUT
/begin RECORD_LAYOUT Lookup2D_BYTE FNC_VALUES 1 SBYTE COLUMN_DIR DIRECT /end RECORD_LAYOUT
/begin RECORD_LAYOUT Lookup2D_FLOAT64_IEEE FNC_VALUES 1 FLOAT64_IEEE COLUMN_DIR DIRECT /end RECORD_LAYOUT
/begin RECORD_LAYOUT Lookup2D_LONG FNC_VALUES 1 SLONG COLUMN_DIR DIRECT /end RECORD_LAYOUT
/begin RECORD_LAYOUT Lookup2D_RD_UBYTE FNC_VALUES 1 UBYTE ROW_DIR DIRECT /end RECORD_LAYOUT
/begin RECORD_LAYOUT Lookup2D_ULONG FNC_VALUES 1 ULONG COLUMN_DIR DIRECT /end RECORD_LAYOUT
/begin RECORD_LAYOUT Lookup2D_X_BOOLEAN AXIS_PTS_X 1 UBYTE INDEX_INCR DIRECT /end RECORD_LAYOUT
/begin RECORD_LAYOUT Lookup2D_X_BYTE AXIS_PTS_X 1 SBYTE INDEX_INCR DIRECT /end RECORD_LAYOUT
/begin RECORD_LAYOUT Lookup2D_X_FLOAT32_IEEE AXIS_PTS_X 1 FLOAT32_IEEE INDEX_INCR DIRECT /end RECORD_LAYOUT
/begin RECORD_LAYOUT Lookup2D_X_FLOAT64_IEEE AXIS_PTS_X 1 FLOAT64_IEEE INDEX_INCR DIRECT /end RECORD_LAYOUT
/begin RECORD_LAYOUT Lookup2D_X_LONG AXIS_PTS_X 1 SLONG INDEX_INCR DIRECT /end RECORD_LAYOUT
/begin RECORD_LAYOUT Lookup2D_X_UBYTE AXIS_PTS_X 1 UBYTE INDEX_INCR DIRECT /end RECORD_LAYOUT
/begin RECORD_LAYOUT Lookup2D_X_ULONG AXIS_PTS_X 1 ULONG INDEX_INCR DIRECT /end RECORD_LAYOUT
/begin RECORD_LAYOUT Scalar_BOOLEAN FNC_VALUES 1 UBYTE COLUMN_DIR DIRECT /end RECORD_LAYOUT
/begin RECORD_LAYOUT Scalar_FLOAT64_IEEE FNC_VALUES 1 FLOAT64_IEEE COLUMN_DIR DIRECT /end RECORD_LAYOUT
/begin RECORD_LAYOUT Scalar_LONG FNC_VALUES 1 SLONG COLUMN_DIR DIRECT /end RECORD_LAYOUT
/begin RECORD_LAYOUT Scalar_SWORD FNC_VALUES 1 SWORD COLUMN_DIR DIRECT /end RECORD_LAYOUT
/begin RECORD_LAYOUT Scalar_UBYTE FNC_VALUES 1 UBYTE COLUMN_DIR DIRECT /end RECORD_LAYOUT
/begin RECORD_LAYOUT Scalar_UWORD FNC_VALUES 1 UWORD COLUMN_DIR DIRECT /end RECORD_LAYOUT
/begin RECORD_LAYOUT __UBYTE_Z FNC_VALUES 1 UBYTE ROW_DIR DIRECT /end RECORD_LAYOUT
/begin RECORD_LAYOUT __UWORD_Z FNC_VALUES 1 UWORD ROW_DIR DIRECT /end RECORD_LAYOUT
/end MODULE
/end PROJECT
