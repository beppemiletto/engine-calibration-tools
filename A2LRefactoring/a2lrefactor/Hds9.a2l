ASAP2_VERSION 1 70
/begin PROJECT XCPonCANFD "Generated for ETAS and Vector "
/begin MODULE XCPonCANFD "Generated for ETAS and Vector "
/begin MOD_COMMON "XCPonCANFD" BYTE_ORDER MSB_FIRST ALIGNMENT_BYTE 1 ALIGNMENT_WORD 2 ALIGNMENT_LONG 4 ALIGNMENT_FLOAT32_IEEE 4 ALIGNMENT_FLOAT64_IEEE 8 ALIGNMENT_INT64 8 /end MOD_COMMON
/begin AXIS_PTS tkRPM11 "[XBK] Soglia Inf per Commutazione Modalità Controllo Closed/Open Loop" 0xFC294A NO_INPUT_QUANTITY Lookup1D_X_UWORD 0 BoostControl50ms_Symbol_CM_uint16_rpm 8 0 10000 /end AXIS_PTS
/begin AXIS_PTS tkRPM12 "[XBK] Soglia Sup per Commutazione Modalità Controllo Closed/Open Loop" 0xFC293A NO_INPUT_QUANTITY Lookup1D_X_UWORD 0 BoostControl50ms_Symbol_CM_uint16_rpm 8 0 10000 /end AXIS_PTS
/begin AXIS_PTS tkRPM16 "[XBK] Soglia superiore apertura WG" 0xFC28FA NO_INPUT_QUANTITY Lookup1D_X_UWORD 0 BoostControl50ms_Symbol_CM_uint16_rpm 8 0 10000 /end AXIS_PTS
/begin AXIS_PTS tkRPM17 "[XBK] Soglia inferiore apertura WG" 0xFC28EA NO_INPUT_QUANTITY Lookup1D_X_UWORD 0 BoostControl50ms_Symbol_CM_uint16_rpm 8 0 10000 /end AXIS_PTS
/begin CHARACTERISTIC tvSOGLIA_INF_CO "Soglia Inf per Commutazione Modalità Controllo Closed/Open Loop" CURVE 0xFC211E Lookup1D_UWORD 0 BoostControl50ms_Symbol_CM_ufix16_En10_adm 0 3
 /begin AXIS_DESCR COM_AXIS NO_INPUT_QUANTITY BoostControl50ms_Symbol_CM_uint16_rpm 8 0 10000 AXIS_PTS_REF tkRPM11 /end AXIS_DESCR
/end CHARACTERISTIC
/begin CHARACTERISTIC tvSOGLIA_INF_WG "Soglia inferiore apertura WG" CURVE 0xFC210E Lookup1D_UWORD 0 BoostControl50ms_Symbol_CM_ufix16_En3__ 0 100
 /begin AXIS_DESCR COM_AXIS NO_INPUT_QUANTITY BoostControl50ms_Symbol_CM_uint16_rpm 8 0 10000 AXIS_PTS_REF tkRPM17 /end AXIS_DESCR
/end CHARACTERISTIC
/begin CHARACTERISTIC tvSOGLIA_SUP_CO "Soglia Sup per Commutazione Modalità Controllo Closed/Open Loop" CURVE 0xFC20FE Lookup1D_UWORD 0 BoostControl50ms_Symbol_CM_ufix16_En10_adm 0 3
 /begin AXIS_DESCR COM_AXIS NO_INPUT_QUANTITY BoostControl50ms_Symbol_CM_uint16_rpm 8 0 10000 AXIS_PTS_REF tkRPM12 /end AXIS_DESCR
/end CHARACTERISTIC
/begin CHARACTERISTIC tvSOGLIA_SUP_WG "Soglia superiore apertura WG" CURVE 0xFC20EE Lookup1D_UWORD 0 BoostControl50ms_Symbol_CM_ufix16_En3__ 0 100
 /begin AXIS_DESCR COM_AXIS NO_INPUT_QUANTITY BoostControl50ms_Symbol_CM_uint16_rpm 8 0 10000 AXIS_PTS_REF tkRPM16 /end AXIS_DESCR
/end CHARACTERISTIC
/begin CHARACTERISTIC ufATTIVA_ADAT_AF_Enable "[FIX] Fix on usAttivaAdatAF signal" VALUE 0xFC200E Scalar_UBYTE 0 AutoUpdatingTDC_CM_FixEnableT 171 218 /end CHARACTERISTIC
/begin CHARACTERISTIC ufATTIVA_ADAT_AF_Value "[FIX] Fix on usAttivaAdatAF signal" VALUE 0xFC200D Scalar_BOOLEAN 0 AutoUpdatingTDC_CM_boolean_adm 0 1 /end CHARACTERISTIC
/begin CHARACTERISTIC ufCORR_ADAT_Enable "[FIX] Fix on the adaptivity correction value" VALUE 0xFC200C Scalar_UBYTE 0 AutoUpdatingTDC_CM_FixEnableT 171 218 /end CHARACTERISTIC
/begin CHARACTERISTIC ufCORR_ADAT_Value "[FIX] Fix on the adaptivity correction value " VALUE 0xFC200A Scalar_UWORD 0 AutoUpdatingTDC_CM_ufix16_En15_adm 0.75 1.25 /end CHARACTERISTIC
/begin CHARACTERISTIC ufENA_CTRL_TST_Enable "[FIX] Adaptativity Enable Condition " VALUE 0xFC2008 Scalar_UBYTE 0 AutoUpdatingTDC_CM_FixEnableT 171 218 /end CHARACTERISTIC
/begin CHARACTERISTIC ufENA_CTRL_TST_Value "[FIX] Adaptativity Enable Condition " VALUE 0xFC2007 Scalar_BOOLEAN 0 AutoUpdatingTDC_CM_boolean_adm 0 1 /end CHARACTERISTIC
/begin CHARACTERISTIC ufGSEC_R47_Enable "[FIX] Flag that indicates if the recovery R47 is active." VALUE 0xFC2006 Scalar_UBYTE 0 AutoUpdatingTDC_CM_FixEnableT 171 218 /end CHARACTERISTIC
/begin CHARACTERISTIC ufGSEC_R47_Value "[FIX] Flag that indicates if the recovery R47 is active." VALUE 0xFC2005 Scalar_BOOLEAN 0 AutoUpdatingTDC_CM_boolean_adm 0 1 /end CHARACTERISTIC
/begin CHARACTERISTIC ufKO2_MED_CORR_Enable "[FIX] Fix on usKO2MedCorr signal" VALUE 0xFC2004 Scalar_UBYTE 0 AutoUpdatingTDC_CM_FixEnableT 171 218 /end CHARACTERISTIC
/begin CHARACTERISTIC ufKO2_MED_CORR_Value "[FIX] Fix on usKO2MedCorr signal" VALUE 0xFC2002 Scalar_UWORD 0 AutoUpdatingTDC_CM_ufix16_En15_adm 0.75 1.25 /end CHARACTERISTIC
/begin CHARACTERISTIC ufNUM_COMM_LAM_Enable "[FIX] [OUT] Lambda commutation number for ko2 mean [ Res: 1 /lsb ]" VALUE 0xFC2000 Scalar_UBYTE 0 AutoUpdatingTDC_CM_FixEnableT 171 218 /end CHARACTERISTIC
/begin CHARACTERISTIC ufNUM_COMM_LAM_Value "[FIX] [OUT] Lambda commutation number for ko2 mean [ Res: 1 /lsb ]" VALUE 0xFC1FFE Scalar_UWORD 0 AutoUpdatingTDC_CM_uint16_adm 2 65535 /end CHARACTERISTIC
/begin CHARACTERISTIC ufNUM_PMS_STAZ_Enable "[FIX] [OUT] Pms number for constant engine point [ Res: 1 pms/lsb ]" VALUE 0xFC1FFC Scalar_UBYTE 0 AutoUpdatingTDC_CM_FixEnableT 171 218 /end CHARACTERISTIC
/begin CHARACTERISTIC ufNUM_PMS_STAZ_Value "[FIX] [OUT] Pms number for constant engine point [ Res: 1 pms/lsb ]" VALUE 0xFC1FF8 Scalar_ULONG 0 AutoUpdatingTDC_CM_uint32_pms 0 10000 /end CHARACTERISTIC
/begin CHARACTERISTIC ufREADY_NEW_ADAT_Enable "[FIX] Fix on usReadyNewAdat signal" VALUE 0xFC1FF4 Scalar_UBYTE 0 AutoUpdatingTDC_CM_FixEnableT 171 218 /end CHARACTERISTIC
/begin CHARACTERISTIC ufREADY_NEW_ADAT_Value "[FIX] Fix on usReadyNewAdat signal" VALUE 0xFC1FF3 Scalar_BOOLEAN 0 AutoUpdatingTDC_CM_boolean_adm 0 1 /end CHARACTERISTIC
/begin CHARACTERISTIC ufRIFORN_GEST_Enable "[FIX] Fix on usRifornGest signal" VALUE 0xFC1FF2 Scalar_UBYTE 0 AutoUpdatingTDC_CM_FixEnableT 171 218 /end CHARACTERISTIC
/begin CHARACTERISTIC ufRIFORN_GEST_Value "[FIX] Fix on usRifornGest signal" VALUE 0xFC1FF1 Scalar_BOOLEAN 0 AutoUpdatingTDC_CM_boolean_adm 0 1 /end CHARACTERISTIC
/begin CHARACTERISTIC ufRPM_Enable "[FIX] Fix on bsRPM only for Adaptivity strategy test." VALUE 0xFC1FF0 Scalar_UBYTE 0 AutoUpdatingTDC_CM_FixEnableT 171 218 /end CHARACTERISTIC
/begin CHARACTERISTIC ufRPM_Value "[FIX] Fix on bsRPM only for Adaptivity strategy test." VALUE 0xFC1FEE Scalar_UWORD 0 AutoUpdatingTDC_CM_uint16_rpm 0 10000 /end CHARACTERISTIC
/begin AXIS_PTS ukNUM_COMM_LAM "Breakpoint table pms number for constant engine point [ Res: 1 pms/lsb ]" 0xFC1FDE NO_INPUT_QUANTITY Lookup1D_X_UWORD 0 AutoUpdatingTDC_CM_uint16_rpm 8 0 65535 /end AXIS_PTS
/begin AXIS_PTS ukRPM_PMS_STAZ "[X_BKP] Velocitá di rotazione motore" 0xFC1FCE NO_INPUT_QUANTITY Lookup1D_X_UWORD 0 AutoUpdatingTDC_CM_uint16_rpm 8 0 10000 /end AXIS_PTS
/begin CHARACTERISTIC usADAPTIVITY_EN "Enable for the adaptivity system" VALUE 0xFC1FCD Scalar_BOOLEAN 0 AutoUpdatingTDC_CM_boolean_adm 0 1 /end CHARACTERISTIC
/begin CHARACTERISTIC usADAT_ORD_ONLY "Only Ordinary autoadaptive flag [ Res: T/F ]" VALUE 0xFC1FCC Scalar_BOOLEAN 0 AutoUpdatingTDC_CM_boolean_adm 0 1 /end CHARACTERISTIC
/begin MEASUREMENT usAdatCondEnable "Adaptativity Condition Enable Vector" UBYTE AutoUpdatingTDC_CM_uint8_adm 0 0 0 255 ECU_ADDRESS 0x4000217B /end MEASUREMENT
/begin MEASUREMENT usAttivaAdatAF "Flag attivazione correzione adattativa A/F stechiometrico" UBYTE AutoTDC_CM_boolean_adm 0 0 0 1 ECU_ADDRESS 0x40002063 /end MEASUREMENT
/begin MEASUREMENT usAutoClosedLoopTimer "Flag that indicates if the Closed-Loop lambda control is active at least for the time specified by the calibration usTIME_CLOPON" UBYTE AutoUpdatingTDC_CM_boolean_adm 0 0 0 1 ECU_ADDRESS 0x4000217A /end MEASUREMENT
/begin CHARACTERISTIC usBKP_ETASP_ADAT "Etasp Breakpoints for adaptivity [ Res: 2^-10/lsb ]" VAL_BLK 0xFC1FBC Scalar_UWORD 0 AutoUpdatingTDC_CM_ufix16_En10_adm 0 3 MATRIX_DIM 8 /end CHARACTERISTIC
/begin CHARACTERISTIC usBKP_RPM_ADAT "RPM Breakpoints for adaptivity [ Res: 1 rpm/lsb ]" VAL_BLK 0xFC1F9C Scalar_UWORD 0 AutoUpdatingTDC_CM_uint16_rpm 0 10000 MATRIX_DIM 16 /end CHARACTERISTIC
/begin MEASUREMENT usCntCommLam "Counter of valid fsKo2 value used to compute the adaptivity  correction value (FSM adaptivity state MEAN_KO2)" UWORD AutoUpdatingTDC_CM_uint16_adm 0 0 0 65535 ECU_ADDRESS 0x40002178 /end MEASUREMENT
/begin MEASUREMENT usCntPrimaAtt "Number of Adaptivity table points that present a number of occurrences equal or higher than usNumAdatAfSat" UWORD AutoUpdatingTDC_CM_uint16_adm 0 0 0 65535 ECU_ADDRESS 0x40002176 /end MEASUREMENT
/begin MEASUREMENT usCorrAdat "Correzione moltiplicativa adattativita" UWORD AutoTDC_CM_ufix16_En15_adm 0 0 0.75 1.25 ECU_ADDRESS 0x40002068 /end MEASUREMENT
/begin MEASUREMENT usCorrAdatTmp "Correzione moltiplicativa adattativita estrapolata per interpolazione dalla mappa delle correzioni e polarizzata." UWORD AutoUpdatingTDC_CM_ufix16_En15_adm 0 0 0.75 1.25 ECU_ADDRESS 0x40002174 /end MEASUREMENT
/begin CHARACTERISTIC usDEL_ETASP_STAZ "Delta Etasp for constant engine working point [ Res: 2^-10/lsb ]" VALUE 0xFC1F9A Scalar_UWORD 0 AutoUpdatingTDC_CM_ufix16_En10_adm 0 3 /end CHARACTERISTIC
/begin CHARACTERISTIC usDEL_RPM_STAZ "Delta rpm for constant engine working point [ Res: 1 rpm/lsb ]" VALUE 0xFC1F98 Scalar_UWORD 0 AutoUpdatingTDC_CM_uint16_rpm 0 10000 /end CHARACTERISTIC
/begin CHARACTERISTIC usETASP_MAX_ADAT "Max value of Etasp for the FILLUP adaptivity management" VALUE 0xFC1F96 Scalar_UWORD 0 AutoUpdatingTDC_CM_ufix16_En10_adm 0 3 /end CHARACTERISTIC
/begin CHARACTERISTIC usETASP_MIN_ADAT "Min value of Etasp for the FILLUP adaptivity management" VALUE 0xFC1F94 Scalar_UWORD 0 AutoUpdatingTDC_CM_ufix16_En10_adm 0 3 /end CHARACTERISTIC
/begin MEASUREMENT usEnaCtrlTst "Adaptivity control test flag" UBYTE AutoUpdatingTDC_CM_boolean_adm 0 0 0 1 ECU_ADDRESS 0x40002172 /end MEASUREMENT
/begin MEASUREMENT usEngineAdatOk "Flag that indicates if the actual working point is in range with respect to the RPM and Etasp limits defined during the FILLUP adaptivity management" UBYTE AutoUpdatingTDC_CM_boolean_adm 0 0 0 1 ECU_ADDRESS 0x40002171 /end MEASUREMENT
/begin MEASUREMENT usFSMState "Adaptivity FSM State" UBYTE AutoUpdatingTDC_CM_tAutoState_adm 0 0 0 7 ECU_ADDRESS 0x40002170 /end MEASUREMENT
/begin MEASUREMENT usFreqValue "Number of occurrences stored in the Adaptivity frequency map related to actual RPM and Etasp" UWORD AutoUpdatingTDC_CM_uint16_adm 0 0 0 65535 ECU_ADDRESS 0x4000216E /end MEASUREMENT
/begin MEASUREMENT usGsecR16 "Flag that indicates if the recovery R16 is active." UBYTE AutoUpdatingTDC_CM_boolean_adm 0 0 0 1 ECU_ADDRESS 0x4000216D /end MEASUREMENT
/begin MEASUREMENT usGsecR47 "Flag that indicates if the recovery R47 is active." UBYTE AutoUpdatingTDC_CM_boolean_adm 0 0 0 1 ECU_ADDRESS 0x4000216C /end MEASUREMENT
/begin MEASUREMENT usKO2MedCorr "KO2 medio per correzione A/F Stechiometrico" UWORD AutoTDC_CM_ufix16_En15_adm 0 0 0.75 1.25 ECU_ADDRESS 0x40002066 /end MEASUREMENT
/begin CHARACTERISTIC usKO2_MED_INF "Ko2 Mean Value Lower threshold for adaptivity correction map updating [ Res: 2^-15/lsb ]" VALUE 0xFC1F92 Scalar_UWORD 0 AutoUpdatingTDC_CM_ufix16_En15_adm 0.75 1.25 /end CHARACTERISTIC
/begin CHARACTERISTIC usKO2_MED_SUP "Ko2 Mean Value Upper threshold for adaptivity correction map updating [ Res: 2^-15/lsb ]" VALUE 0xFC1F90 Scalar_UWORD 0 AutoUpdatingTDC_CM_ufix16_En15_adm 0.75 1.25 /end CHARACTERISTIC
/begin MEASUREMENT usKo2 "Old fsKo2trans Air/Fuel Control Feedback for adaptive control (FSM adaptivity state MEAN_KO2)" UWORD AutoUpdatingTDC_CM_ufix16_En15_adm 0 0 0.75 1.25 ECU_ADDRESS 0x4000216A /end MEASUREMENT
/begin MEASUREMENT usKo2Med "Mean Value ok fsKo2 calculated as usKo2Sum/usNumCommLam (FSM adaptivity state MEAN_KO2)" UWORD AutoUpdatingTDC_CM_ufix16_En15_adm 0 0 0.75 1.25 ECU_ADDRESS 0x40002168 /end MEASUREMENT
/begin MEASUREMENT usKo2Sum "Accumulator for fsKo2trans Air/Fuel Control Feedback for adaptive control (FSM adaptivity state MEAN_KO2)" ULONG AutoUpdatingTDC_CM_ufix32_En15_adm 0 0 0 131071.999969 ECU_ADDRESS 0x40002164 /end MEASUREMENT
/begin MEASUREMENT usMapCorrValue "Adaptivity correction value computed to update Correction Map" SWORD AutoUpdatingTDC_CM_sfix16_En15_adm 0 0 -0.25 0.25 ECU_ADDRESS 0x40002162 /end MEASUREMENT
/begin CHARACTERISTIC usNUM_ADAT_AF "Saturation value for valid points during FILLUP management" VALUE 0xFC1F8E Scalar_UWORD 0 AutoUpdatingTDC_CM_uint16_adm 0 65535 /end CHARACTERISTIC
/begin CHARACTERISTIC usNUM_ADAT_AF_MEAN "Expected mean number of occurrences for each  adaptivity frequency map point" VALUE 0xFC1F8C Scalar_UWORD 0 AutoUpdatingTDC_CM_uint16_adm 0 65535 /end CHARACTERISTIC
/begin MEASUREMENT usNumAdatAfSat "Saturated necessary number of occurrences for each table point in order to proced with a normal FILLUP adaptivity management " UWORD AutoUpdatingTDC_CM_uint16_adm 0 0 0 65535 ECU_ADDRESS 0x40002160 /end MEASUREMENT
/begin MEASUREMENT usNumCommLam "Threshold number of different valid ko2trans values (FSM adaptivity state MEAN_KO2)" UWORD AutoUpdatingTDC_CM_uint16_adm 0 0 0 65535 ECU_ADDRESS 0x4000215E /end MEASUREMENT
/begin MEASUREMENT usNumCommSonda "[OUT] Lambda commutation number for ko2 mean [ Res: 1 /lsb ]" UWORD AutoUpdatingTDC_CM_uint16_adm 0 0 0 65535 ECU_ADDRESS 0x4000215C /end MEASUREMENT
/begin MEASUREMENT usNumPmsStaz "[OUT] Pms number for constant engine point [ Res: 1 pms/lsb ]" ULONG AutoUpdatingTDC_CM_uint32_pms 0 0 0 10000 ECU_ADDRESS 0x40002158 /end MEASUREMENT
/begin MEASUREMENT usNumPunOkAdatAF "Number of valid point of the Adaptivity frequency sub-table identified during the FILLUP management" UWORD AutoUpdatingTDC_CM_uint16_adm 0 0 0 65535 ECU_ADDRESS 0x40002154 /end MEASUREMENT
/begin CHARACTERISTIC usPESO_KO2_MED "Ko2 mean correction factor for self learning [ Res: 2^-10/lsb ]" VALUE 0xFC1F8A Scalar_UWORD 0 AutoUpdatingTDC_CM_ufix16_En10_adm 0 1 /end CHARACTERISTIC
/begin MEASUREMENT usPrimaAtt "Flag that indicates if the system is in the First activation after a refill" UBYTE AutoUpdatingTDC_CM_boolean_adm 0 0 0 1 ECU_ADDRESS 0x40002152 /end MEASUREMENT
/begin MEASUREMENT usPuntoOkAdatAf "Flag that indicates if the actual working point was update a sufficient number of times from the previous refuel." UBYTE AutoUpdatingTDC_CM_boolean_adm 0 0 0 1 ECU_ADDRESS 0x40002151 /end MEASUREMENT
/begin CHARACTERISTIC usRPM_MAX_ADAT "Max value of RPM for the FILLUP adaptivity management" VALUE 0xFC1F88 Scalar_UWORD 0 AutoUpdatingTDC_CM_uint16_adm 0 10000 /end CHARACTERISTIC
/begin CHARACTERISTIC usRPM_MIN_ADAT "Min value of RPM for the FILLUP adaptivity management" VALUE 0xFC1F86 Scalar_UWORD 0 AutoUpdatingTDC_CM_uint16_adm 0 10000 /end CHARACTERISTIC
/begin MEASUREMENT usReadyNewAdat "Flag Strategia Autoadattativa pronta per un nuovo calcolo" UBYTE AutoTDC_CM_boolean_adm 0 0 0 1 ECU_ADDRESS 0x40002064 /end MEASUREMENT
/begin MEASUREMENT usRifornGest "Flag per azzerare indicazione di avvenuto rifornimento" UBYTE AutoTDC_CM_boolean_adm 0 0 0 1 ECU_ADDRESS 0x40002062 /end MEASUREMENT
/begin CHARACTERISTIC usSOGL_INF_ADAT "Lower threshold for write new table correction value [ Res: 2^-15/lsb ]" VALUE 0xFC1F84 Scalar_SWORD 0 AutoUpdatingTDC_CM_sfix16_En15_adm -0.5 0.5 /end CHARACTERISTIC
/begin CHARACTERISTIC usSOGL_SUP_ADAT "Upper threshold for write new table correction value [ Res: 2^-15/lsb ]" VALUE 0xFC1F82 Scalar_SWORD 0 AutoUpdatingTDC_CM_sfix16_En15_adm -0.5 0.5 /end CHARACTERISTIC
/begin MEASUREMENT usSmallNumPunAdatAF "Flag that indicates if the number of valid point to activate the AF correction during the FILLUP adaptivity management is too small." UBYTE AutoUpdatingTDC_CM_boolean_adm 0 0 0 1 ECU_ADDRESS 0x40002150 /end MEASUREMENT
/begin MEASUREMENT usSumFreqAdatAF "Sum of values present in the Adaptivity frequency sub-table identified during the FILLUP management" ULONG AutoUpdatingTDC_CM_uint32_adm 0 0 0 8388480 ECU_ADDRESS 0x4000214C /end MEASUREMENT
/begin MEASUREMENT usSumPrimaAtt "Sum of correction values related to Adaptivity table points that present a number of occurrences equal or higher than usNumAdatAfSat" SWORD AutoUpdatingTDC_CM_sfix16_En15_adm 0 0 -1 0.999969482422 ECU_ADDRESS 0x40002148 /end MEASUREMENT
/begin CHARACTERISTIC usTHR_INF_PRAIL "Rail press lower threshold for enable adaptivity [ Res: 1 mBar/lsb ]" VALUE 0xFC1F80 Scalar_UWORD 0 AutoUpdatingTDC_CM_uint16_mbar 0 13793 /end CHARACTERISTIC
/begin CHARACTERISTIC usTHR_INF_TAIR "Air temp lower threshold for enable adaptivity [ Res: 1 degC/lsb ]" VALUE 0xFC1F7E Scalar_UWORD 0 AutoUpdatingTDC_CM_ufix16_Bn40_degC -40 130 /end CHARACTERISTIC
/begin CHARACTERISTIC usTHR_INF_TH2O " Engine temp lower threshold for enable adaptivity [ Res: 1 degC/lsb ]" VALUE 0xFC1F7C Scalar_UWORD 0 AutoUpdatingTDC_CM_ufix16_Bn40_degC -40 140 /end CHARACTERISTIC
/begin CHARACTERISTIC usTHR_INF_VBAT "Voltage battery lower threshold for enable adaptivity [ Res: 50 mV/lsb ]" VALUE 0xFC1F7A Scalar_UWORD 0 AutoUpdatingTDC_CM_ufix16_S50_mV 12000 36000 /end CHARACTERISTIC
/begin CHARACTERISTIC usTHR_SUP_PRAIL "Rail press higher threshold for enable adaptivity [ Res: 1 mBar/lsb ]" VALUE 0xFC1F78 Scalar_UWORD 0 AutoUpdatingTDC_CM_uint16_mbar 0 13793 /end CHARACTERISTIC
/begin CHARACTERISTIC usTHR_SUP_TAIR "Air temp higher threshold for enable adaptivity [ Res: 1 degC/lsb ]" VALUE 0xFC1F76 Scalar_UWORD 0 AutoUpdatingTDC_CM_ufix16_Bn40_degC -40 130 /end CHARACTERISTIC
/begin CHARACTERISTIC usTHR_SUP_TH2O "Engine temp higher threshold for enable adaptivity [ Res: 1 degC/lsb ]" VALUE 0xFC1F74 Scalar_UWORD 0 AutoUpdatingTDC_CM_ufix16_Bn40_degC -40 140 /end CHARACTERISTIC
/begin CHARACTERISTIC usTIME_CLOPON "Closed-loop timer for enable adaptivity" VALUE 0xFC1F70 Scalar_ULONG 0 AutoUpdatingTDC_CM_ufix32_Sp1_s 0 268435455 /end CHARACTERISTIC
/begin CHARACTERISTIC uvNUM_COMM_LAM "Lambda commutation number for ko2 mean [ Res: 1 /lsb ]" CURVE 0xFC1F60 Lookup1D_UWORD 0 AutoUpdatingTDC_CM_uint16_adm 2 65535
 /begin AXIS_DESCR COM_AXIS NO_INPUT_QUANTITY AutoUpdatingTDC_CM_uint16_rpm 8 0 65535 AXIS_PTS_REF ukNUM_COMM_LAM /end AXIS_DESCR
/end CHARACTERISTIC
/begin CHARACTERISTIC uvNUM_PMS_STAZ "Pms number for constant engine point [ Res: 1 pms/lsb ]" CURVE 0xFC1F40 Lookup1D_ULONG 0 AutoUpdatingTDC_CM_uint32_pms 0 65535
 /begin AXIS_DESCR COM_AXIS NO_INPUT_QUANTITY AutoUpdatingTDC_CM_uint16_rpm 8 0 10000 AXIS_PTS_REF ukRPM_PMS_STAZ /end AXIS_DESCR
/end CHARACTERISTIC
/begin CHARACTERISTIC vfACT_GEAR_NOT_ZERO "[FIX] Fix su Selected Gear not zero" VALUE 0xFCC726 Scalar_UWORD 0 Signal_Mgm_4ms_Symbol_CM_boolean_adm 0 1 /end CHARACTERISTIC
/begin CHARACTERISTIC vfACT_GEAR_NOT_ZERO_EnFix "[FIX] Fix su Selected Gear not zero" VALUE 0xFCC724 Scalar_UWORD 0 Signal_Mgm_4ms_Symbol_CM_FixEnableT 171 218 /end CHARACTERISTIC
/begin CHARACTERISTIC vfAV_CRUISE_ACT "[FIX] Disponibilità del comando Cruise Control" VALUE 0xFCC7D8 Scalar_UWORD 0 TE_CmuReqMgm4ms_Symbol_CM_boolean_adm 0 1 /end CHARACTERISTIC
/begin CHARACTERISTIC vfAV_CRUISE_ACT_EnFix "[FIX] Disponibilità del comando Cruise Control" VALUE 0xFCC7D6 Scalar_UWORD 0 TE_CmuReqMgm4ms_Symbol_CM_FixEnableT 171 218 /end CHARACTERISTIC
/begin CHARACTERISTIC vfAV_SPEED_SENS "[FIX] Fix su disponibilità velocità veicolo da sensore" VALUE 0xFCC722 Scalar_UWORD 0 Signal_Mgm_4ms_Symbol_CM_boolean_adm 0 1 /end CHARACTERISTIC
/begin CHARACTERISTIC vfAV_SPEED_SENS_EnFix "[FIX] Fix su disponibilità velocità veicolo da sensore" VALUE 0xFCC720 Scalar_UWORD 0 Signal_Mgm_4ms_Symbol_CM_FixEnableT 171 218 /end CHARACTERISTIC
/begin CHARACTERISTIC vfBRAKE "[FIX] Fix Brake Rep" VALUE 0xFCC71E Scalar_UWORD 0 Signal_Mgm_4ms_Symbol_CM_boolean_adm 0 1 /end CHARACTERISTIC
/begin CHARACTERISTIC vfBRAKE_EnFix "[FIX] Fix Brake Rep" VALUE 0xFCC71C Scalar_UWORD 0 Signal_Mgm_4ms_Symbol_CM_FixEnableT 171 218 /end CHARACTERISTIC
/begin CHARACTERISTIC vfCAM_RUN_EN_Enable "[FIX] Fix su Abilitazione della funzione diagnosi camma SFR" VALUE 0xFC2C8C Scalar_UBYTE 0 VcmFcnEnableInit_CM_FixEnableT 171 218 /end CHARACTERISTIC
/begin CHARACTERISTIC vfCAM_RUN_EN_Value "[FIX] Fix su Abilitazione della funzione diagnosi camma SFR" VALUE 0xFC2C8B Scalar_BOOLEAN 0 VcmFcnEnableInit_CM_boolean_adm 0 1 /end CHARACTERISTIC
/begin CHARACTERISTIC vfCC_ACTIVE_SPD_LIM "[FIX] Fix per disabilitare la limitazione velocità veicolo su CC" VALUE 0xFCC68E Scalar_UWORD 0 TE_VehicleSpeedLim100ms_Symbol_CM_boolean_adm 0 1 /end CHARACTERISTIC
/begin CHARACTERISTIC vfCC_ACTIVE_SPD_LIM_EnFix "[FIX] Fix per disabilitare la limitazione velocità veicolo su CC" VALUE 0xFCC68C Scalar_UWORD 0 TE_VehicleSpeedLim100ms_Symbol_CM_FixEnableT 171 218 /end CHARACTERISTIC
/begin CHARACTERISTIC vfCC_SET_MINUS_CAN "[FIX] Fix Set Minus CC da CAN" VALUE 0xFCC6EE Scalar_UWORD 0 PtoCCReq4ms_Symbol_CM_boolean_adm 0 1 /end CHARACTERISTIC
/begin CHARACTERISTIC vfCC_SET_MINUS_CAN_EnFix "[FIX] Fix Set Minus CC da CAN" VALUE 0xFCC6EC Scalar_UWORD 0 PtoCCReq4ms_Symbol_CM_FixEnableT 171 218 /end CHARACTERISTIC
/begin CHARACTERISTIC vfCC_SET_PLUS_CAN "[FIX] Fix Set Plus CC da CAN" VALUE 0xFCC6EA Scalar_UWORD 0 PtoCCReq4ms_Symbol_CM_boolean_adm 0 1 /end CHARACTERISTIC
/begin CHARACTERISTIC vfCC_SET_PLUS_CAN_EnFix "[FIX] Fix Set Plus CC da CAN" VALUE 0xFCC6E8 Scalar_UWORD 0 PtoCCReq4ms_Symbol_CM_FixEnableT 171 218 /end CHARACTERISTIC
/begin CHARACTERISTIC vfCLUTCH "[FIX] Fix sulla informazione clutche" VALUE 0xFCC71A Scalar_UWORD 0 Signal_Mgm_4ms_Symbol_CM_boolean_adm 0 1 /end CHARACTERISTIC
/begin CHARACTERISTIC vfCLUTCH_EnFix "[FIX] Fix sulla informazione clutche" VALUE 0xFCC718 Scalar_UWORD 0 Signal_Mgm_4ms_Symbol_CM_FixEnableT 171 218 /end CHARACTERISTIC
/begin CHARACTERISTIC vfCLUTCH_STBY "[FIX] Fix su Clutch per passare vehicle speed come CC Obj" VALUE 0xFCC8FA Scalar_UWORD 0 TE_PtoCc4ms_Symbol_CM_boolean_adm 0 1 /end CHARACTERISTIC
/begin CHARACTERISTIC vfCLUTCH_STBY_EnFix "[FIX] Fix su Clutch per passare vehicle speed come CC Obj" VALUE 0xFCC8F8 Scalar_UWORD 0 TE_PtoCc4ms_Symbol_CM_FixEnableT 171 218 /end CHARACTERISTIC
/begin CHARACTERISTIC vfCMU_MGM_EN_Enable "[FIX] Fix su Abilitazione della gestione CMU" VALUE 0xFC2C8A Scalar_UBYTE 0 VcmFcnEnableInit_CM_FixEnableT 171 218 /end CHARACTERISTIC
/begin CHARACTERISTIC vfCMU_MGM_EN_Value "[FIX] Fix su Abilitazione della gestione CMU" VALUE 0xFC2C89 Scalar_BOOLEAN 0 VcmFcnEnableInit_CM_boolean_adm 0 1 /end CHARACTERISTIC
/begin CHARACTERISTIC vfCNG_DENSITY_Enable "[FIX] Fuel Density for CNG computed trough VAN DER WALLS equation" VALUE 0xFCC988 Scalar_UBYTE 0 FuelConsTDC_CM_FixEnableT 171 218 /end CHARACTERISTIC
/begin CHARACTERISTIC vfCNG_DENSITY_Value "[FIX] Fuel Density for CNG computed trough VAN DER WALLS equation" VALUE 0xFCC984 Scalar_FLOAT32_IEEE 0 FuelConsTDC_CM_single_kg_l 0.003 1 /end CHARACTERISTIC
/begin CHARACTERISTIC vfCNG_MASS_Enable "[FIX] Fuel Mass for CNG computed trough VAN DER WALLS equation" VALUE 0xFCC980 Scalar_UBYTE 0 FuelConsTDC_CM_FixEnableT 171 218 /end CHARACTERISTIC
/begin CHARACTERISTIC vfCNG_MASS_Value "[FIX] Fuel Mass for CNG computed trough VAN DER WALLS equation" VALUE 0xFCC97C Scalar_FLOAT32_IEEE 0 FuelConsTDC_CM_single_kg -3.4E+38 3.4E+38 /end CHARACTERISTIC
/begin CHARACTERISTIC vfCNG_MOLAR_MASS_Enable "[FIX] Molar Mass for CNG mixture composition provided from fuel stations " VALUE 0xFCC978 Scalar_UBYTE 0 FuelConsTDC_CM_FixEnableT 171 218 /end CHARACTERISTIC
/begin CHARACTERISTIC vfCNG_MOLAR_MASS_Value "[FIX] Molar Mass for CNG mixture composition provided from fuel stations " VALUE 0xFCC974 Scalar_FLOAT32_IEEE 0 FuelConsTDC_CM_single_g_mol -3.4E+38 3.4E+38 /end CHARACTERISTIC
/begin CHARACTERISTIC vfCRUISE_ACT "[FIX] Flag di richiesta attivazione Cruise Control" VALUE 0xFCC7D4 Scalar_UWORD 0 TE_CmuReqMgm4ms_Symbol_CM_boolean_adm 0 1 /end CHARACTERISTIC
/begin CHARACTERISTIC vfCRUISE_ACT_EnFix "[FIX] Flag di richiesta attivazione Cruise Control" VALUE 0xFCC7D2 Scalar_UWORD 0 TE_CmuReqMgm4ms_Symbol_CM_FixEnableT 171 218 /end CHARACTERISTIC
/begin CHARACTERISTIC vfCRUISE_CONTROL_EN_Enable "[FIX] Fix su Abilitazione della gestione cruise control" VALUE 0xFC2C88 Scalar_UBYTE 0 VcmFcnEnableInit_CM_FixEnableT 171 218 /end CHARACTERISTIC
/begin CHARACTERISTIC vfCRUISE_CONTROL_EN_Value "[FIX] Fix su Abilitazione della gestione cruise control" VALUE 0xFC2C87 Scalar_BOOLEAN 0 VcmFcnEnableInit_CM_boolean_adm 0 1 /end CHARACTERISTIC
/begin CHARACTERISTIC vfDOORS_OPEN_EN_Enable "[FIX] Fix su Abilitazione della funzione doors open" VALUE 0xFC2C86 Scalar_UBYTE 0 VcmFcnEnableInit_CM_FixEnableT 171 218 /end CHARACTERISTIC
/begin CHARACTERISTIC vfDOORS_OPEN_EN_Value "[FIX] Fix su Abilitazione della funzione doors open" VALUE 0xFC2C85 Scalar_BOOLEAN 0 VcmFcnEnableInit_CM_boolean_adm 0 1 /end CHARACTERISTIC
/begin CHARACTERISTIC vfENG_REV_EN_Enable "[FIX] Fix su Abilitazione della funzione engine revolution" VALUE 0xFC2C84 Scalar_UBYTE 0 VcmFcnEnableInit_CM_FixEnableT 171 218 /end CHARACTERISTIC
/begin CHARACTERISTIC vfENG_REV_EN_Value "[FIX] Fix su Abilitazione della funzione engine revolution" VALUE 0xFC2C83 Scalar_BOOLEAN 0 VcmFcnEnableInit_CM_boolean_adm 0 1 /end CHARACTERISTIC
/begin CHARACTERISTIC vfEN_DOOROP_IDLESW_Enable "[FIX] Fix per disabilitare gestione Doors Open con switch idle del pedale acceleratore FIX=ON @ 0" VALUE 0xFCC665 Scalar_UBYTE 0 TE_DoorsOpen100ms_CM_FixEnableT 171 218 /end CHARACTERISTIC
/begin CHARACTERISTIC vfEN_DOOROP_IDLESW_Value "[FIX] Fix per disabilitare gestione Doors Open con switch idle del pedale acceleratore FIX=ON @ 0" VALUE 0xFCC664 Scalar_UBYTE 0 TE_DoorsOpen100ms_CM_uint8_adm 0 3 /end CHARACTERISTIC
/begin CHARACTERISTIC vfEPR_MSG_OK_Enable "[FIX] Fix for bypassing the validity of the CAN message received by EPR and enabling EPR control" VALUE 0xFC567E Scalar_UBYTE 0 EprMgm4ms_CM_FixEnableT 171 218 /end CHARACTERISTIC
/begin CHARACTERISTIC vfEPR_MSG_OK_Value "[FIX] Fix for bypassing the validity of the CAN message received by EPR and enabling EPR control" VALUE 0xFC567D Scalar_BOOLEAN 0 EprMgm4ms_CM_boolean_adm 0 1 /end CHARACTERISTIC
/begin CHARACTERISTIC vfFAN1_ACT_REQ_PWM_Enable "[FIX] DutyCycle for FAN1 computed in function of coolant temperature and engine speed" VALUE 0xFC59A0 Scalar_UBYTE 0 FanMgm100ms_CM_FixEnableT 171 218 /end CHARACTERISTIC
/begin CHARACTERISTIC vfFAN1_ACT_REQ_PWM_Value "[FIX] DutyCycle for FAN1 computed in function of coolant temperature and engine speed" VALUE 0xFC599E Scalar_UWORD 0 FanMgm100ms_CM_ufix16_En3__ 0 100 /end CHARACTERISTIC
/begin CHARACTERISTIC vfFAN1_PWM_Enable "[FIX] Fix on the PWM Command related to FAN 1 " VALUE 0xFC599C Scalar_UBYTE 0 FanMgm100ms_CM_FixEnableT 171 218 /end CHARACTERISTIC
/begin CHARACTERISTIC vfFAN1_PWM_Value "[FIX] Fix on the PWM Command related to FAN 1 " VALUE 0xFC599A Scalar_UWORD 0 FanMgm100ms_CM_ufix16_En3__ 0 100 /end CHARACTERISTIC
/begin CHARACTERISTIC vfFAN2_ACT_REQ_PWM_Enable "[FIX] DutyCycle for FAN2 computed in function of coolant temperature and engine speed" VALUE 0xFC5998 Scalar_UBYTE 0 FanMgm100ms_CM_FixEnableT 171 218 /end CHARACTERISTIC
/begin CHARACTERISTIC vfFAN2_ACT_REQ_PWM_Value "[FIX] DutyCycle for FAN2 computed in function of coolant temperature and engine speed" VALUE 0xFC5996 Scalar_UWORD 0 FanMgm100ms_CM_ufix16_En3__ 0 100 /end CHARACTERISTIC
/begin CHARACTERISTIC vfFAN2_CMD_Enable "[FIX] Fix on the ON/OFF Command related to FAN 2 " VALUE 0xFC5994 Scalar_UBYTE 0 FanMgm100ms_CM_FixEnableT 171 218 /end CHARACTERISTIC
/begin CHARACTERISTIC vfFAN2_CMD_Value "[FIX] Fix on the ON/OFF Command related to FAN 2 " VALUE 0xFC5993 Scalar_BOOLEAN 0 FanMgm100ms_CM_boolean_adm 0 1 /end CHARACTERISTIC
/begin CHARACTERISTIC vfFAN_COOL_EN_Enable "[FIX] Fix su Abilitazione della funzione fan cool" VALUE 0xFC2C82 Scalar_UBYTE 0 VcmFcnEnableInit_CM_FixEnableT 171 218 /end CHARACTERISTIC
/begin CHARACTERISTIC vfFAN_COOL_EN_Value "[FIX] Fix su Abilitazione della funzione fan cool" VALUE 0xFC2C81 Scalar_BOOLEAN 0 VcmFcnEnableInit_CM_boolean_adm 0 1 /end CHARACTERISTIC
/begin CHARACTERISTIC vfFAN_SPEED_TARGET_Enable "[FIX] FAN1 target Speed computed in function of coolant temperature and engine speed" VALUE 0xFC5992 Scalar_UBYTE 0 FanMgm100ms_CM_FixEnableT 171 218 /end CHARACTERISTIC
/begin CHARACTERISTIC vfFAN_SPEED_TARGET_Value "[FIX] FAN1 target Speed computed in function of coolant temperature and engine speed" VALUE 0xFC5990 Scalar_UWORD 0 FanMgm100ms_CM_uint16_rpm 0 10000 /end CHARACTERISTIC
/begin CHARACTERISTIC vfFIRST4MS_FLAG "[FIX] Fix su abilitazione della gestione abilitazioni delle funzioni TE" VALUE 0xFCC6B0 Scalar_UWORD 0 EnableFcnEn4ms_Symbol_CM_boolean_adm 0 1 /end CHARACTERISTIC
/begin CHARACTERISTIC vfFIRST4MS_FLAG_EnFix "[FIX] Fix su abilitazione della gestione abilitazioni delle funzioni TE" VALUE 0xFCC6AE Scalar_UWORD 0 EnableFcnEn4ms_Symbol_CM_FixEnableT 171 218 /end CHARACTERISTIC
/begin CHARACTERISTIC vfFUEL_CONS_EN_Enable "[FIX] Fix su Abilitazione della funzione fuel consumption" VALUE 0xFC2C80 Scalar_UBYTE 0 VcmFcnEnableInit_CM_FixEnableT 171 218 /end CHARACTERISTIC
/begin CHARACTERISTIC vfFUEL_CONS_EN_Value "[FIX] Fix su Abilitazione della funzione fuel consumption" VALUE 0xFC2C7F Scalar_BOOLEAN 0 VcmFcnEnableInit_CM_boolean_adm 0 1 /end CHARACTERISTIC
/begin CHARACTERISTIC vfFUEL_IST_Enable "[FIX] urrent Fuel economy at current vehicle speed (SAE 5.2.5.67)" VALUE 0xFCC970 Scalar_UBYTE 0 FuelConsTDC_CM_FixEnableT 171 218 /end CHARACTERISTIC
/begin CHARACTERISTIC vfFUEL_IST_Value "[FIX] urrent Fuel economy at current vehicle speed (SAE 5.2.5.67)" VALUE 0xFCC96E Scalar_UWORD 0 FuelConsTDC_CM_ufix16_En9_km_l 0 125.5 /end CHARACTERISTIC
/begin CHARACTERISTIC vfFUEL_LEVEL_EN_Enable "[FIX] Fix su Abilitazione della funzione Fuel level" VALUE 0xFC2C7E Scalar_UBYTE 0 VcmFcnEnableInit_CM_FixEnableT 171 218 /end CHARACTERISTIC
/begin CHARACTERISTIC vfFUEL_LEVEL_EN_Value "[FIX] Fix su Abilitazione della funzione Fuel level" VALUE 0xFC2C7D Scalar_BOOLEAN 0 VcmFcnEnableInit_CM_boolean_adm 0 1 /end CHARACTERISTIC
/begin CHARACTERISTIC vfFUEL_LEV_Enable "[FIX] Fix on fuel level percentage" VALUE 0xFCC6A5 Scalar_UBYTE 0 TE_FuelLevel1s_CM_FixEnableT 171 218 /end CHARACTERISTIC
/begin CHARACTERISTIC vfFUEL_LEV_IND_DC_Enable "[FIX] Fix on fuel level indicator duty cycle " VALUE 0xFCC6A4 Scalar_UBYTE 0 TE_FuelLevel1s_CM_FixEnableT 171 218 /end CHARACTERISTIC
/begin CHARACTERISTIC vfFUEL_LEV_IND_DC_Value "[FIX] Fix on fuel level indicator duty cycle " VALUE 0xFCC6A2 Scalar_UWORD 0 TE_FuelLevel1s_CM_ufix16_En4__ 0 100 /end CHARACTERISTIC
/begin CHARACTERISTIC vfFUEL_LEV_LAMP_Enable "[FIX] Fix on fuel level lamp" VALUE 0xFCC6A0 Scalar_UBYTE 0 TE_FuelLevel1s_CM_FixEnableT 171 218 /end CHARACTERISTIC
/begin CHARACTERISTIC vfFUEL_LEV_LAMP_Value "[FIX] Fix on fuel level lamp" VALUE 0xFCC69F Scalar_BOOLEAN 0 TE_FuelLevel1s_CM_boolean 0 1 /end CHARACTERISTIC
/begin CHARACTERISTIC vfFUEL_LEV_Value "[FIX] Fix on fuel level percentage" VALUE 0xFCC69E Scalar_UBYTE 0 TE_FuelLevel1s_CM_ufix8_Sp4__ 0 100 /end CHARACTERISTIC
/begin CHARACTERISTIC vfFUEL_MASS_FLOW_Enable "[FIX] Fuel Mass Flow testpoint" VALUE 0xFCC96C Scalar_UBYTE 0 FuelConsTDC_CM_FixEnableT 171 218 /end CHARACTERISTIC
/begin CHARACTERISTIC vfFUEL_MASS_FLOW_Value "[FIX] Fuel Mass Flow testpoint" VALUE 0xFCC96A Scalar_UWORD 0 FuelConsTDC_CM_ufix16_Sp05_kg_h 0 3212.75 /end CHARACTERISTIC
/begin CHARACTERISTIC vfFUEL_RATE_Enable "[FIX] Fuel Rate testpoint" VALUE 0xFCC968 Scalar_UBYTE 0 FuelConsTDC_CM_FixEnableT 171 218 /end CHARACTERISTIC
/begin CHARACTERISTIC vfFUEL_RATE_Value "[FIX] Fuel Rate testpoint" VALUE 0xFCC966 Scalar_UWORD 0 FuelConsTDC_CM_ufix16_Sp05_l_h 0 3212.75 /end CHARACTERISTIC
/begin CHARACTERISTIC vfFUEL_TOT_CONS_Enable "[FIX] Accumulated amount of fuel used during vehicle operation (SAE 5.2.5.66)" VALUE 0xFCC964 Scalar_UBYTE 0 FuelConsTDC_CM_FixEnableT 171 218 /end CHARACTERISTIC
/begin CHARACTERISTIC vfFUEL_TOT_CONS_Value "[FIX] Accumulated amount of fuel used during vehicle operation (SAE 5.2.5.66)" VALUE 0xFCC960 Scalar_ULONG 0 FuelConsTDC_CM_ufix32_Sp05_l 0 210554060.75 /end CHARACTERISTIC
/begin CHARACTERISTIC vfFUEL_TRIP_Enable "[FIX] uel consumed during all or part of a trip (SAE 5.2.5.64)" VALUE 0xFCC95C Scalar_UBYTE 0 FuelConsTDC_CM_FixEnableT 171 218 /end CHARACTERISTIC
/begin CHARACTERISTIC vfFUEL_TRIP_Value "[FIX] uel consumed during all or part of a trip (SAE 5.2.5.64)" VALUE 0xFCC958 Scalar_ULONG 0 FuelConsTDC_CM_ufix32_Sp05_l 0 210554060.75 /end CHARACTERISTIC
/begin CHARACTERISTIC vfGEAR_COUP "[FIX] Fix su gear coupled per condizioni shutOff CC" VALUE 0xFCC8F6 Scalar_UWORD 0 TE_PtoCc4ms_Symbol_CM_boolean_adm 0 1 /end CHARACTERISTIC
/begin CHARACTERISTIC vfGEAR_COUPLED "[FIX] Fix sulla informazione cambio accoppiato" VALUE 0xFCC716 Scalar_UWORD 0 Signal_Mgm_4ms_Symbol_CM_boolean_adm 0 1 /end CHARACTERISTIC
/begin CHARACTERISTIC vfGEAR_COUPLED_EnFix "[FIX] Fix sulla informazione cambio accoppiato" VALUE 0xFCC714 Scalar_UWORD 0 Signal_Mgm_4ms_Symbol_CM_FixEnableT 171 218 /end CHARACTERISTIC
/begin CHARACTERISTIC vfGEAR_COUP_EnFix "[FIX] Fix su gear coupled per condizioni shutOff CC" VALUE 0xFCC8F4 Scalar_UWORD 0 TE_PtoCc4ms_Symbol_CM_FixEnableT 171 218 /end CHARACTERISTIC
/begin CHARACTERISTIC vfIDLE_ACC_Enable "[FIX] Fix IdleAcc" VALUE 0xFCC663 Scalar_UBYTE 0 TE_DigOutput100ms_CM_FixEnableT 171 218 /end CHARACTERISTIC
/begin CHARACTERISTIC vfIDLE_ACC_Value "[FIX] Fix IdleAcc" VALUE 0xFCC662 Scalar_UBYTE 0 TE_DigOutput100ms_CM_uint8_adm 0 3 /end CHARACTERISTIC
/begin CHARACTERISTIC vfIDN_SPM_NOFAULT_Enable "[FIX] Fix for bypassing the error on diag line IDN_SPM for enabling EPR control" VALUE 0xFC567C Scalar_UBYTE 0 EprMgm4ms_CM_FixEnableT 171 218 /end CHARACTERISTIC
/begin CHARACTERISTIC vfIDN_SPM_NOFAULT_Value "[FIX] Fix for bypassing the error on diag line IDN_SPM for enabling EPR control" VALUE 0xFC567B Scalar_BOOLEAN 0 EprMgm4ms_CM_boolean_adm 0 1 /end CHARACTERISTIC
/begin CHARACTERISTIC vfKICK_DOWN_Enable "[FIX] Output Kick down Rep" VALUE 0xFCC661 Scalar_UBYTE 0 TE_DigOutput100ms_CM_FixEnableT 171 218 /end CHARACTERISTIC
/begin CHARACTERISTIC vfKICK_DOWN_Value "[FIX] Output Kick down Rep" VALUE 0xFCC660 Scalar_BOOLEAN 0 TE_DigOutput100ms_CM_boolean_adm 0 1 /end CHARACTERISTIC
/begin CHARACTERISTIC vfLF_APPL_EN_Enable "[FIX] Fix su abilitazione della gestione LF" VALUE 0xFC2C7C Scalar_UBYTE 0 VcmFcnEnableInit_CM_FixEnableT 171 218 /end CHARACTERISTIC
/begin CHARACTERISTIC vfLF_APPL_EN_Value "[FIX] Fix su abilitazione della gestione LF" VALUE 0xFC2C7B Scalar_BOOLEAN 0 VcmFcnEnableInit_CM_boolean_adm 0 1 /end CHARACTERISTIC
/begin CHARACTERISTIC vfLIM_CC_OBJ_INF "[FIX] Fix su Limite inferiore Obiettivo giri motore CC" VALUE 0xFCC8F2 Scalar_UWORD 0 TE_PtoCc4ms_Symbol_CM_uint16_Km_h 0 250 /end CHARACTERISTIC
/begin CHARACTERISTIC vfLIM_CC_OBJ_INF_EnFix "[FIX] Fix su Limite inferiore Obiettivo giri motore CC" VALUE 0xFCC8F0 Scalar_UWORD 0 TE_PtoCc4ms_Symbol_CM_FixEnableT 171 218 /end CHARACTERISTIC
/begin CHARACTERISTIC vfLIM_CC_OBJ_SUP "[FIX] Fix su Limite superiore Obiettivo giri motore CC" VALUE 0xFCC8EE Scalar_UWORD 0 TE_PtoCc4ms_Symbol_CM_uint16_Km_h 0 250 /end CHARACTERISTIC
/begin CHARACTERISTIC vfLIM_CC_OBJ_SUP_EnFix "[FIX] Fix su Limite superiore Obiettivo giri motore CC" VALUE 0xFCC8EC Scalar_UWORD 0 TE_PtoCc4ms_Symbol_CM_FixEnableT 171 218 /end CHARACTERISTIC
/begin CHARACTERISTIC vfLIM_PTO_OBJ_INF "[FIX] Fix su Limite inferiore Obiettivo giri motore PTO" VALUE 0xFCC8EA Scalar_UWORD 0 TE_PtoCc4ms_Symbol_CM_uint16_rpm 0 10000 /end CHARACTERISTIC
/begin CHARACTERISTIC vfLIM_PTO_OBJ_INF_EnFix "[FIX] Fix su Limite inferiore Obiettivo giri motore PTO" VALUE 0xFCC8E8 Scalar_UWORD 0 TE_PtoCc4ms_Symbol_CM_FixEnableT 171 218 /end CHARACTERISTIC
/begin CHARACTERISTIC vfLIM_PTO_OBJ_SUP "[FIX] Fix su Limite superiore Obiettivo giri motore PTO" VALUE 0xFCC8E6 Scalar_UWORD 0 TE_PtoCc4ms_Symbol_CM_uint16_rpm 0 10000 /end CHARACTERISTIC
/begin CHARACTERISTIC vfLIM_PTO_OBJ_SUP_EnFix "[FIX] Fix su Limite superiore Obiettivo giri motore PTO" VALUE 0xFCC8E4 Scalar_UWORD 0 TE_PtoCc4ms_Symbol_CM_FixEnableT 171 218 /end CHARACTERISTIC
/begin CHARACTERISTIC vfLIM_START_OBJ_INF "[FIX] Fix su Limite inferiore Obiettivo giri motore da pulsante start" VALUE 0xFCC67A Scalar_UWORD 0 TE_StartStopRpmMgm100ms_Symbol_CM_uint16_rpm 0 2000 /end CHARACTERISTIC
/begin CHARACTERISTIC vfLIM_START_OBJ_INF_EnFix "[FIX] Fix su Limite inferiore Obiettivo giri motore da pulsante start" VALUE 0xFCC678 Scalar_UWORD 0 TE_StartStopRpmMgm100ms_Symbol_CM_FixEnableT 171 218 /end CHARACTERISTIC
/begin CHARACTERISTIC vfLIM_START_OBJ_SUP "[FIX] Fix su Limite superiore Obiettivo giri motore da pulsante start" VALUE 0xFCC676 Scalar_UWORD 0 TE_StartStopRpmMgm100ms_Symbol_CM_uint16_rpm 0 10000 /end CHARACTERISTIC
/begin CHARACTERISTIC vfLIM_START_OBJ_SUP_EnFix "[FIX] Fix su Limite superiore Obiettivo giri motore da pulsante start" VALUE 0xFCC674 Scalar_UWORD 0 TE_StartStopRpmMgm100ms_Symbol_CM_FixEnableT 171 218 /end CHARACTERISTIC
/begin CHARACTERISTIC vfMAIR_REQ_EN_Enable "[FIX] Fix su Abilitazione della funzione MairRequest" VALUE 0xFC2C7A Scalar_UBYTE 0 VcmFcnEnableInit_CM_FixEnableT 171 218 /end CHARACTERISTIC
/begin CHARACTERISTIC vfMAIR_REQ_EN_Value "[FIX] Fix su Abilitazione della funzione MairRequest" VALUE 0xFC2C79 Scalar_BOOLEAN 0 VcmFcnEnableInit_CM_boolean_adm 0 1 /end CHARACTERISTIC
/begin CHARACTERISTIC vfMECH_PTO_ENG "[FIX] Fix su mechanical PTO engaged" VALUE 0xFCC8E2 Scalar_UWORD 0 TE_PtoCc4ms_Symbol_CM_boolean_adm 0 1 /end CHARACTERISTIC
/begin CHARACTERISTIC vfMECH_PTO_ENG_EnFix "[FIX] Fix su mechanical PTO engaged" VALUE 0xFCC8E0 Scalar_UWORD 0 TE_PtoCc4ms_Symbol_CM_FixEnableT 171 218 /end CHARACTERISTIC
/begin CHARACTERISTIC vfMFLV_HOLD "[FIX] Fix Hold CC or PTO (1 -> Active, 0 -> Inactive)" VALUE 0xFCC6E6 Scalar_UWORD 0 PtoCCReq4ms_Symbol_CM_boolean_adm 0 1 /end CHARACTERISTIC
/begin CHARACTERISTIC vfMFLV_HOLD_EnFix "[FIX] Fix Hold CC or PTO (1 -> Active, 0 -> Inactive)" VALUE 0xFCC6E4 Scalar_UWORD 0 PtoCCReq4ms_Symbol_CM_FixEnableT 171 218 /end CHARACTERISTIC
/begin CHARACTERISTIC vfMFLV_OFF "[FIX] Fix Off CC or PTO (1 -> Active, 0 -> Inactive)" VALUE 0xFCC6E2 Scalar_UWORD 0 PtoCCReq4ms_Symbol_CM_boolean_adm 0 1 /end CHARACTERISTIC
/begin CHARACTERISTIC vfMFLV_OFF_EnFix "[FIX] Fix Off CC or PTO (1 -> Active, 0 -> Inactive)" VALUE 0xFCC6E0 Scalar_UWORD 0 PtoCCReq4ms_Symbol_CM_FixEnableT 171 218 /end CHARACTERISTIC
/begin CHARACTERISTIC vfMFLV_REQ "[FIX] Fix MFLV Request (1 -> Press Button, 0 -> Release Button)" VALUE 0xFCC6DE Scalar_UWORD 0 PtoCCReq4ms_Symbol_CM_boolean_adm 0 1 /end CHARACTERISTIC
/begin CHARACTERISTIC vfMFLV_REQ_EnFix "[FIX] Fix MFLV Request (1 -> Press Button, 0 -> Release Button)" VALUE 0xFCC6DC Scalar_UWORD 0 PtoCCReq4ms_Symbol_CM_FixEnableT 171 218 /end CHARACTERISTIC
/begin CHARACTERISTIC vfMFLV_RESUME "[FIX] Fix Resume CC or PTO (1 -> Active, 0 -> Inactive)" VALUE 0xFCC6DA Scalar_UWORD 0 PtoCCReq4ms_Symbol_CM_boolean_adm 0 1 /end CHARACTERISTIC
/begin CHARACTERISTIC vfMFLV_RESUME_EnFix "[FIX] Fix Resume CC or PTO (1 -> Active, 0 -> Inactive)" VALUE 0xFCC6D8 Scalar_UWORD 0 PtoCCReq4ms_Symbol_CM_FixEnableT 171 218 /end CHARACTERISTIC
/begin CHARACTERISTIC vfMFLV_SET_MINUS "[FIX] Fix for decrease CC or PTO Obj Command (1 -> Active, 0 -> Inactive)" VALUE 0xFCC6D6 Scalar_UWORD 0 PtoCCReq4ms_Symbol_CM_boolean_adm 0 1 /end CHARACTERISTIC
/begin CHARACTERISTIC vfMFLV_SET_MINUS_EnFix "[FIX] Fix for decrease CC or PTO Obj Command (1 -> Active, 0 -> Inactive)" VALUE 0xFCC6D4 Scalar_UWORD 0 PtoCCReq4ms_Symbol_CM_FixEnableT 171 218 /end CHARACTERISTIC
/begin CHARACTERISTIC vfMFLV_SET_PLUS "[FIX] Fix for encrease CC or PTO Obj Command (1 -> Active, 0 -> Inactive)" VALUE 0xFCC6D2 Scalar_UWORD 0 PtoCCReq4ms_Symbol_CM_boolean_adm 0 1 /end CHARACTERISTIC
/begin CHARACTERISTIC vfMFLV_SET_PLUS_EnFix "[FIX] Fix for encrease CC or PTO Obj Command (1 -> Active, 0 -> Inactive)" VALUE 0xFCC6D0 Scalar_UWORD 0 PtoCCReq4ms_Symbol_CM_FixEnableT 171 218 /end CHARACTERISTIC
/begin CHARACTERISTIC vfMFLV_SHUT_OFF "[FIX] Fix su shutoff PTO or CC" VALUE 0xFCC8DE Scalar_UWORD 0 TE_PtoCc4ms_Symbol_CM_boolean_adm 0 1 /end CHARACTERISTIC
/begin CHARACTERISTIC vfMFLV_SHUT_OFF_EnFix "[FIX] Fix su shutoff PTO or CC" VALUE 0xFCC8DC Scalar_UWORD 0 TE_PtoCc4ms_Symbol_CM_FixEnableT 171 218 /end CHARACTERISTIC
/begin CHARACTERISTIC vfNEUTRAL "[FIX] Fix sulla informazione neutral" VALUE 0xFCC712 Scalar_UWORD 0 Signal_Mgm_4ms_Symbol_CM_boolean_adm 0 1 /end CHARACTERISTIC
/begin CHARACTERISTIC vfNEUTRAL_EnFix "[FIX] Fix sulla informazione neutral" VALUE 0xFCC710 Scalar_UWORD 0 Signal_Mgm_4ms_Symbol_CM_FixEnableT 171 218 /end CHARACTERISTIC
/begin CHARACTERISTIC vfNO_EPR_DIAG_Enable "[FIX] Fix for bypassing EPR diagnosis for enabling EPR Control " VALUE 0xFC567A Scalar_UBYTE 0 EprMgm4ms_CM_FixEnableT 171 218 /end CHARACTERISTIC
/begin CHARACTERISTIC vfNO_EPR_DIAG_Value "[FIX] Fix for bypassing EPR diagnosis for enabling EPR Control " VALUE 0xFC5679 Scalar_BOOLEAN 0 EprMgm4ms_CM_boolean_adm 0 1 /end CHARACTERISTIC
/begin CHARACTERISTIC vfPARK_BRK "[FIX] Fix sulla informazione park barke" VALUE 0xFCC70E Scalar_UWORD 0 Signal_Mgm_4ms_Symbol_CM_boolean_adm 0 1 /end CHARACTERISTIC
/begin CHARACTERISTIC vfPARK_BRK_EnFix "[FIX] Fix sulla informazione park barke" VALUE 0xFCC70C Scalar_UWORD 0 Signal_Mgm_4ms_Symbol_CM_FixEnableT 171 218 /end CHARACTERISTIC
/begin CHARACTERISTIC vfPDL_BYPASS "[FIX] Fix su Abilitazione a bypass pedale per PTO" VALUE 0xFCC93A Scalar_UWORD 0 TE_TSC1Manager4ms_Symbol_CM_boolean_adm 0 1 /end CHARACTERISTIC
/begin CHARACTERISTIC vfPDL_BYPASS_EnFix "[FIX] Fix su Abilitazione a bypass pedale per PTO" VALUE 0xFCC938 Scalar_UWORD 0 TE_TSC1Manager4ms_Symbol_CM_FixEnableT 171 218 /end CHARACTERISTIC
/begin CHARACTERISTIC vfPDL_PERF_LIM4_VEL "[FIX] Fix sulla richiesta pedale limitata per velocità superiore al limite" VALUE 0xFCC7D0 Scalar_UWORD 0 TE_CmuReqMgm4ms_Symbol_CM_ufix16_En4__ 0 100 /end CHARACTERISTIC
/begin CHARACTERISTIC vfPDL_PERF_LIM4_VEL_EnFix "[FIX] Fix sulla richiesta pedale limitata per velocità superiore al limite" VALUE 0xFCC7CE Scalar_UWORD 0 TE_CmuReqMgm4ms_Symbol_CM_FixEnableT 171 218 /end CHARACTERISTIC
/begin CHARACTERISTIC vfPED_TORQ_REQ_LIM "[FIX] Limitazione della percentuale di coppia richiesta da pedale" VALUE 0xFCC7CC Scalar_UWORD 0 TE_CmuReqMgm4ms_Symbol_CM_ufix16_En4__ 0 100 /end CHARACTERISTIC
/begin CHARACTERISTIC vfPED_TORQ_REQ_LIM_EnFix "[FIX] Limitazione della percentuale di coppia richiesta da pedale" VALUE 0xFCC7CA Scalar_UWORD 0 TE_CmuReqMgm4ms_Symbol_CM_FixEnableT 171 218 /end CHARACTERISTIC
/begin CHARACTERISTIC vfPRAIL_TARGET_Enable "[FIX] [OUT] Rail target pressure table in function of engine working point" VALUE 0xFC5678 Scalar_UBYTE 0 EprMgm4ms_CM_FixEnableT 171 218 /end CHARACTERISTIC
/begin CHARACTERISTIC vfPRAIL_TARGET_Value "[FIX] [OUT] Rail target pressure table in function of engine working point" VALUE 0xFC5676 Scalar_UWORD 0 EprMgm4ms_CM_uint16_mbar 0 13793 /end CHARACTERISTIC
/begin CHARACTERISTIC vfPTO_SET_MINUS_CAN "[FIX] Fix Set Minus PTO da CAN" VALUE 0xFCC6CE Scalar_UWORD 0 PtoCCReq4ms_Symbol_CM_boolean_adm 0 1 /end CHARACTERISTIC
/begin CHARACTERISTIC vfPTO_SET_MINUS_CAN_EnFix "[FIX] Fix Set Minus PTO da CAN" VALUE 0xFCC6CC Scalar_UWORD 0 PtoCCReq4ms_Symbol_CM_FixEnableT 171 218 /end CHARACTERISTIC
/begin CHARACTERISTIC vfPTO_SET_PLUS_CAN "[FIX] Fix Set Plus PTO da CAN" VALUE 0xFCC6CA Scalar_UWORD 0 PtoCCReq4ms_Symbol_CM_boolean_adm 0 1 /end CHARACTERISTIC
/begin CHARACTERISTIC vfPTO_SET_PLUS_CAN_EnFix "[FIX] Fix Set Plus PTO da CAN" VALUE 0xFCC6C8 Scalar_UWORD 0 PtoCCReq4ms_Symbol_CM_FixEnableT 171 218 /end CHARACTERISTIC
/begin CHARACTERISTIC vfPTO_STATE "[FIX] Fix sullo stato PTO" VALUE 0xFCC70A Scalar_UWORD 0 Signal_Mgm_4ms_Symbol_CM_uint8_adm 0 31 /end CHARACTERISTIC
/begin CHARACTERISTIC vfPTO_STATE_EnFix "[FIX] Fix sullo stato PTO" VALUE 0xFCC708 Scalar_UWORD 0 Signal_Mgm_4ms_Symbol_CM_FixEnableT 171 218 /end CHARACTERISTIC
/begin CHARACTERISTIC vfRIFORNIMENTO "[FIX] Fix Rifornimento avvenuto" VALUE 0xFCC98E Scalar_UWORD 0 RefuelMgmTDC_Symbol_CM_boolean_adm 0 1 /end CHARACTERISTIC
/begin CHARACTERISTIC vfRIFORNIMENTO_EnFix "[FIX] Fix Rifornimento avvenuto" VALUE 0xFCC98C Scalar_UWORD 0 RefuelMgmTDC_Symbol_CM_FixEnableT 171 218 /end CHARACTERISTIC
/begin CHARACTERISTIC vfRIFORN_MGM_EN_Enable "[FIX] Fix su Abilitazione della funzione gestione rifornimento" VALUE 0xFC2C78 Scalar_UBYTE 0 VcmFcnEnableInit_CM_FixEnableT 171 218 /end CHARACTERISTIC
/begin CHARACTERISTIC vfRIFORN_MGM_EN_Value "[FIX] Fix su Abilitazione della funzione gestione rifornimento" VALUE 0xFC2C77 Scalar_BOOLEAN 0 VcmFcnEnableInit_CM_boolean_adm 0 1 /end CHARACTERISTIC
/begin CHARACTERISTIC vfSET1_CAN "[FIX] Fix su richiesta Set 1 Obj PTO da CAN" VALUE 0xFCC6C6 Scalar_UWORD 0 PtoCCReq4ms_Symbol_CM_boolean_adm 0 1 /end CHARACTERISTIC
/begin CHARACTERISTIC vfSET1_CAN_EnFix "[FIX] Fix su richiesta Set 1 Obj PTO da CAN" VALUE 0xFCC6C4 Scalar_UWORD 0 PtoCCReq4ms_Symbol_CM_FixEnableT 171 218 /end CHARACTERISTIC
/begin CHARACTERISTIC vfSET2_CAN "[FIX] Fix su richiesta Set 2 Obj PTO da CAN" VALUE 0xFCC6C2 Scalar_UWORD 0 PtoCCReq4ms_Symbol_CM_boolean_adm 0 1 /end CHARACTERISTIC
/begin CHARACTERISTIC vfSET2_CAN_EnFix "[FIX] Fix su richiesta Set 2 Obj PTO da CAN" VALUE 0xFCC6C0 Scalar_UWORD 0 PtoCCReq4ms_Symbol_CM_FixEnableT 171 218 /end CHARACTERISTIC
/begin CHARACTERISTIC vfSET3_CAN "[FIX] Fix su richiesta Set 3 Obj PTO da CAN" VALUE 0xFCC6BE Scalar_UWORD 0 PtoCCReq4ms_Symbol_CM_boolean_adm 0 1 /end CHARACTERISTIC
/begin CHARACTERISTIC vfSET3_CAN_EnFix "[FIX] Fix su richiesta Set 3 Obj PTO da CAN" VALUE 0xFCC6BC Scalar_UWORD 0 PtoCCReq4ms_Symbol_CM_FixEnableT 171 218 /end CHARACTERISTIC
/begin CHARACTERISTIC vfSET4_CAN "[FIX] Fix su richiesta Set 4 Obj PTO da CAN" VALUE 0xFCC6BA Scalar_UWORD 0 PtoCCReq4ms_Symbol_CM_boolean_adm 0 1 /end CHARACTERISTIC
/begin CHARACTERISTIC vfSET4_CAN_EnFix "[FIX] Fix su richiesta Set 4 Obj PTO da CAN" VALUE 0xFCC6B8 Scalar_UWORD 0 PtoCCReq4ms_Symbol_CM_FixEnableT 171 218 /end CHARACTERISTIC
/begin CHARACTERISTIC vfSPD_LTD_PRI_WIN "[FIX] Fix su priorità vincente nella limitazione di velocità" VALUE 0xFCC936 Scalar_UWORD 0 TE_TSC1Manager4ms_Symbol_CM_uint8_adm 1 8 /end CHARACTERISTIC
/begin CHARACTERISTIC vfSPD_LTD_PRI_WIN_EnFix "[FIX] Fix su priorità vincente nella limitazione di velocità" VALUE 0xFCC934 Scalar_UWORD 0 TE_TSC1Manager4ms_Symbol_CM_FixEnableT 171 218 /end CHARACTERISTIC
/begin CHARACTERISTIC vfSPD_REQ_PRI_WIN "[FIX] Fix su priorità vincente nella richiesta di velocità" VALUE 0xFCC932 Scalar_UWORD 0 TE_TSC1Manager4ms_Symbol_CM_uint8_adm 1 8 /end CHARACTERISTIC
/begin CHARACTERISTIC vfSPD_REQ_PRI_WIN_EnFix "[FIX] Fix su priorità vincente nella richiesta di velocità" VALUE 0xFCC930 Scalar_UWORD 0 TE_TSC1Manager4ms_Symbol_CM_FixEnableT 171 218 /end CHARACTERISTIC
/begin CHARACTERISTIC vfSPEED_LIM_EN_Enable "[FIX] Fix su Abilitazione della funzione Speed Limiter" VALUE 0xFC2C76 Scalar_UBYTE 0 VcmFcnEnableInit_CM_FixEnableT 171 218 /end CHARACTERISTIC
/begin CHARACTERISTIC vfSPEED_LIM_EN_Value "[FIX] Fix su Abilitazione della funzione Speed Limiter" VALUE 0xFC2C75 Scalar_BOOLEAN 0 VcmFcnEnableInit_CM_boolean_adm 0 1 /end CHARACTERISTIC
/begin CHARACTERISTIC vfSPEED_LIM_VCM "[FIX] Richiesta di limitazione giri motore" VALUE 0xFCC776 Scalar_UWORD 0 TB_VcmVariable4ms_Symbol_CM_uint16_rpm 0 10000 /end CHARACTERISTIC
/begin CHARACTERISTIC vfSPEED_LIM_VCM_EnFix "[FIX] Richiesta di limitazione giri motore" VALUE 0xFCC774 Scalar_UWORD 0 TB_VcmVariable4ms_Symbol_CM_FixEnableT 171 218 /end CHARACTERISTIC
/begin CHARACTERISTIC vfSPEED_LIM_VCM_R "[FIX] Richiesta di limitazione giri motore" VALUE 0xFCC7C8 Scalar_UWORD 0 TE_CmuReqMgm4ms_Symbol_CM_uint16_rpm 0 10000 /end CHARACTERISTIC
/begin CHARACTERISTIC vfSPEED_LIM_VCM_R_EnFix "[FIX] Richiesta di limitazione giri motore" VALUE 0xFCC7C6 Scalar_UWORD 0 TE_CmuReqMgm4ms_Symbol_CM_FixEnableT 171 218 /end CHARACTERISTIC
/begin CHARACTERISTIC vfSPEED_MGM_EN_Enable "[FIX] Fix su Abilitazione della gestione pto" VALUE 0xFC2C74 Scalar_UBYTE 0 VcmFcnEnableInit_CM_FixEnableT 171 218 /end CHARACTERISTIC
/begin CHARACTERISTIC vfSPEED_MGM_EN_Value "[FIX] Fix su Abilitazione della gestione pto" VALUE 0xFC2C73 Scalar_BOOLEAN 0 VcmFcnEnableInit_CM_boolean_adm 0 1 /end CHARACTERISTIC
/begin CHARACTERISTIC vfSPEED_REQ_VCM "[FIX] Fix su obiettivo giri motore PTO" VALUE 0xFCC772 Scalar_UWORD 0 TB_VcmVariable4ms_Symbol_CM_uint16_rpm 0 10000 /end CHARACTERISTIC
/begin CHARACTERISTIC vfSPEED_REQ_VCM2 "[FIX] Fix su obiettivo giri motore nel secondo messaggio TSC2" VALUE 0xFCC76E Scalar_UWORD 0 TB_VcmVariable4ms_Symbol_CM_uint16_rpm 0 10000 /end CHARACTERISTIC
/begin CHARACTERISTIC vfSPEED_REQ_VCM2_EnFix "[FIX] Fix su obiettivo giri motore nel secondo messaggio TSC2" VALUE 0xFCC76C Scalar_UWORD 0 TB_VcmVariable4ms_Symbol_CM_FixEnableT 171 218 /end CHARACTERISTIC
/begin CHARACTERISTIC vfSPEED_REQ_VCM2_R "[FIX] Fix su obiettivo giri motore nel secondo messaggio TSC2" VALUE 0xFCC7C4 Scalar_UWORD 0 TE_CmuReqMgm4ms_Symbol_CM_uint16_rpm 0 10000 /end CHARACTERISTIC
/begin CHARACTERISTIC vfSPEED_REQ_VCM2_R_EnFix "[FIX] Fix su obiettivo giri motore nel secondo messaggio TSC2" VALUE 0xFCC7C2 Scalar_UWORD 0 TE_CmuReqMgm4ms_Symbol_CM_FixEnableT 171 218 /end CHARACTERISTIC
/begin CHARACTERISTIC vfSPEED_REQ_VCM_EnFix "[FIX] Fix su obiettivo giri motore PTO" VALUE 0xFCC770 Scalar_UWORD 0 TB_VcmVariable4ms_Symbol_CM_FixEnableT 171 218 /end CHARACTERISTIC
/begin CHARACTERISTIC vfSPEED_REQ_VCM_R "[FIX] Fix su obiettivo giri motore PTO" VALUE 0xFCC7C0 Scalar_UWORD 0 TE_CmuReqMgm4ms_Symbol_CM_uint16_rpm 0 10000 /end CHARACTERISTIC
/begin CHARACTERISTIC vfSPEED_REQ_VCM_R_EnFix "[FIX] Fix su obiettivo giri motore PTO" VALUE 0xFCC7BE Scalar_UWORD 0 TE_CmuReqMgm4ms_Symbol_CM_FixEnableT 171 218 /end CHARACTERISTIC
/begin CHARACTERISTIC vfSPEED_REQ_WIN "[FIX] Fix su priorità vincente nella richiesta di velocità" VALUE 0xFCC92E Scalar_UWORD 0 TE_TSC1Manager4ms_Symbol_CM_uint8_adm 0 3 /end CHARACTERISTIC
/begin CHARACTERISTIC vfSPEED_REQ_WIN_EnFix "[FIX] Fix su priorità vincente nella richiesta di velocità" VALUE 0xFCC92C Scalar_UWORD 0 TE_TSC1Manager4ms_Symbol_CM_FixEnableT 171 218 /end CHARACTERISTIC
/begin CHARACTERISTIC vfSTART_OBJ_VAR "[FIX] Fix su obiettivo giri da pulsante di start" VALUE 0xFCC672 Scalar_SWORD 0 TE_StartStopRpmMgm100ms_Symbol_CM_uint16_rpm 0 10000 /end CHARACTERISTIC
/begin CHARACTERISTIC vfSTART_OBJ_VAR_DELTA "[FIX] Fix su delta obiettivo giri motore da pulsante start" VALUE 0xFCC680 Scalar_SWORD 0 TE_StartStopRpmMgm100ms_Symbol_CM_int16_rpm -1000 1000 /end CHARACTERISTIC
/begin CHARACTERISTIC vfSTART_OBJ_VAR_DELTA_EnFix "[FIX] Fix su delta obiettivo giri motore da pulsante start" VALUE 0xFCC67E Scalar_SWORD 0 TE_StartStopRpmMgm100ms_Symbol_CM_FixEnableT 171 218 /end CHARACTERISTIC
/begin CHARACTERISTIC vfSTART_OBJ_VAR_EnFix "[FIX] Fix su obiettivo giri da pulsante di start" VALUE 0xFCC670 Scalar_SWORD 0 TE_StartStopRpmMgm100ms_Symbol_CM_FixEnableT 171 218 /end CHARACTERISTIC
/begin CHARACTERISTIC vfSTART_SPEED_MGM_EN_Enable "[FIX] Fix su Abilitazione della gestione PTO da pulsante start" VALUE 0xFC2C72 Scalar_UBYTE 0 VcmFcnEnableInit_CM_FixEnableT 171 218 /end CHARACTERISTIC
/begin CHARACTERISTIC vfSTART_SPEED_MGM_EN_Value "[FIX] Fix su Abilitazione della gestione PTO da pulsante start" VALUE 0xFC2C71 Scalar_BOOLEAN 0 VcmFcnEnableInit_CM_boolean_adm 0 1 /end CHARACTERISTIC
/begin CHARACTERISTIC vfSTART_STOP_REQ_ACT "[FIX] Fix su funzione regolazione giri da pulsante di start attiva" VALUE 0xFCC66E Scalar_UWORD 0 TE_StartStopRpmMgm100ms_Symbol_CM_boolean_adm 0 1 /end CHARACTERISTIC
/begin CHARACTERISTIC vfSTART_STOP_REQ_ACT_EnFix "[FIX] Fix su funzione regolazione giri da pulsante di start attiva" VALUE 0xFCC66C Scalar_UWORD 0 TE_StartStopRpmMgm100ms_Symbol_CM_FixEnableT 171 218 /end CHARACTERISTIC
/begin CHARACTERISTIC vfSTR_APPL_EN_Enable "[FIX] Enable Starter Management Functionality " VALUE 0xFC2C70 Scalar_UBYTE 0 VcmFcnEnableInit_CM_FixEnableT 171 218 /end CHARACTERISTIC
/begin CHARACTERISTIC vfSTR_APPL_EN_Value "[FIX] Enable Starter Management Functionality " VALUE 0xFC2C6F Scalar_BOOLEAN 0 VcmFcnEnableInit_CM_boolean_adm 0 1 /end CHARACTERISTIC
/begin CHARACTERISTIC vfSW_TSC1_2 "[FIX] Flag per forzare (= 1 value) la struttura a 2 msg di controllo TSC1" VALUE 0xFCC76A Scalar_UWORD 0 TB_VcmVariable4ms_Symbol_CM_boolean_adm 0 1 /end CHARACTERISTIC
/begin CHARACTERISTIC vfSW_TSC1_2_EnFix "[FIX] Flag per forzare (= 1 value) la struttura a 2 msg di controllo TSC1" VALUE 0xFCC768 Scalar_UWORD 0 TB_VcmVariable4ms_Symbol_CM_FixEnableT 171 218 /end CHARACTERISTIC
/begin CHARACTERISTIC vfSW_TSC1_2_R "[FIX] Flag per forzare (= 1 value) la struttura a 2 msg di controllo TSC1" VALUE 0xFCC7BC Scalar_UWORD 0 TE_CmuReqMgm4ms_Symbol_CM_boolean_adm 0 1 /end CHARACTERISTIC
/begin CHARACTERISTIC vfSW_TSC1_2_R_EnFix "[FIX] Flag per forzare (= 1 value) la struttura a 2 msg di controllo TSC1" VALUE 0xFCC7BA Scalar_UWORD 0 TE_CmuReqMgm4ms_Symbol_CM_FixEnableT 171 218 /end CHARACTERISTIC
/begin CHARACTERISTIC vfTE_APPL_CAN_EN_Enable "[FIX] Fix su abilitazione della gestione CAN TE" VALUE 0xFC2C6E Scalar_UBYTE 0 VcmFcnEnableInit_CM_FixEnableT 171 218 /end CHARACTERISTIC
/begin CHARACTERISTIC vfTE_APPL_CAN_EN_Value "[FIX] Fix su abilitazione della gestione CAN TE" VALUE 0xFC2C6D Scalar_BOOLEAN 0 VcmFcnEnableInit_CM_boolean_adm 0 1 /end CHARACTERISTIC
/begin CHARACTERISTIC vfTE_APPL_EN_Enable "[FIX] Fix su abilitazione della gestione TE" VALUE 0xFC2C6C Scalar_UBYTE 0 VcmFcnEnableInit_CM_FixEnableT 171 218 /end CHARACTERISTIC
/begin CHARACTERISTIC vfTE_APPL_EN_Value "[FIX] Fix su abilitazione della gestione TE" VALUE 0xFC2C6B Scalar_BOOLEAN 0 VcmFcnEnableInit_CM_boolean_adm 0 1 /end CHARACTERISTIC
/begin CHARACTERISTIC vfTE_BRAKE_EN "[FIX] Fix sulla informazione freno per TE" VALUE 0xFCC706 Scalar_UWORD 0 Signal_Mgm_4ms_Symbol_CM_boolean_adm 0 1 /end CHARACTERISTIC
/begin CHARACTERISTIC vfTE_BRAKE_EN_EnFix "[FIX] Fix sulla informazione freno per TE" VALUE 0xFCC704 Scalar_UWORD 0 Signal_Mgm_4ms_Symbol_CM_FixEnableT 171 218 /end CHARACTERISTIC
/begin CHARACTERISTIC vfTE_CLUTCH_EN "[FIX] Fix sulla informazione clutche per TE" VALUE 0xFCC702 Scalar_UWORD 0 Signal_Mgm_4ms_Symbol_CM_boolean_adm 0 1 /end CHARACTERISTIC
/begin CHARACTERISTIC vfTE_CLUTCH_EN_EnFix "[FIX] Fix sulla informazione clutche per TE" VALUE 0xFCC700 Scalar_UWORD 0 Signal_Mgm_4ms_Symbol_CM_FixEnableT 171 218 /end CHARACTERISTIC
/begin CHARACTERISTIC vfTE_NEUTRAL_EN "[FIX] Fix sulla informazione neutral per TE" VALUE 0xFCC6FE Scalar_UWORD 0 Signal_Mgm_4ms_Symbol_CM_boolean_adm 0 1 /end CHARACTERISTIC
/begin CHARACTERISTIC vfTE_NEUTRAL_EN_EnFix "[FIX] Fix sulla informazione neutral per TE" VALUE 0xFCC6FC Scalar_UWORD 0 Signal_Mgm_4ms_Symbol_CM_FixEnableT 171 218 /end CHARACTERISTIC
/begin CHARACTERISTIC vfTE_PARK_BRK_EN "[FIX] Fix sulla informazione park barke per TE" VALUE 0xFCC6FA Scalar_UWORD 0 Signal_Mgm_4ms_Symbol_CM_boolean_adm 0 1 /end CHARACTERISTIC
/begin CHARACTERISTIC vfTE_PARK_BRK_EN_EnFix "[FIX] Fix sulla informazione park barke per TE" VALUE 0xFCC6F8 Scalar_UWORD 0 Signal_Mgm_4ms_Symbol_CM_FixEnableT 171 218 /end CHARACTERISTIC
/begin CHARACTERISTIC vfTE_PTO_STATE_EN "[FIX] Fix sullo stato PTO per TE" VALUE 0xFCC6F6 Scalar_UWORD 0 Signal_Mgm_4ms_Symbol_CM_boolean_adm 0 1 /end CHARACTERISTIC
/begin CHARACTERISTIC vfTE_PTO_STATE_EN_EnFix "[FIX] Fix sullo stato PTO per TE" VALUE 0xFCC6F4 Scalar_UWORD 0 Signal_Mgm_4ms_Symbol_CM_FixEnableT 171 218 /end CHARACTERISTIC
/begin CHARACTERISTIC vfTE_TSC1_2_ROUT_EN "[FIX] Fix su TeApplEn per gestire TSC1_2_ROUT come da TE" VALUE 0xFCC766 Scalar_UWORD 0 TB_VcmVariable4ms_Symbol_CM_boolean_adm 0 1 /end CHARACTERISTIC
/begin CHARACTERISTIC vfTE_TSC1_2_ROUT_EN_EnFix "[FIX] Fix su TeApplEn per gestire TSC1_2_ROUT come da TE" VALUE 0xFCC764 Scalar_UWORD 0 TB_VcmVariable4ms_Symbol_CM_FixEnableT 171 218 /end CHARACTERISTIC
/begin CHARACTERISTIC vfTE_TSC1_VE_CTRL2_EN "[FIX] Fix su TeApplEn per gestire TSC1_VE_CONTROL2 come da TE" VALUE 0xFCC762 Scalar_UWORD 0 TB_VcmVariable4ms_Symbol_CM_boolean_adm 0 1 /end CHARACTERISTIC
/begin CHARACTERISTIC vfTE_TSC1_VE_CTRL2_EN_EnFix "[FIX] Fix su TeApplEn per gestire TSC1_VE_CONTROL2 come da TE" VALUE 0xFCC760 Scalar_UWORD 0 TB_VcmVariable4ms_Symbol_CM_FixEnableT 171 218 /end CHARACTERISTIC
/begin CHARACTERISTIC vfTE_TSC1_VE_CTRL_EN "[FIX] Fix su TeApplEn per gestire TSC1_VE_CONTROL come da TE" VALUE 0xFCC75E Scalar_UWORD 0 TB_VcmVariable4ms_Symbol_CM_boolean_adm 0 1 /end CHARACTERISTIC
/begin CHARACTERISTIC vfTE_TSC1_VE_CTRL_EN_EnFix "[FIX] Fix su TeApplEn per gestire TSC1_VE_CONTROL come da TE" VALUE 0xFCC75C Scalar_UWORD 0 TB_VcmVariable4ms_Symbol_CM_FixEnableT 171 218 /end CHARACTERISTIC
/begin CHARACTERISTIC vfTE_TSC1_VE_LIMIT_EN "[FIX] Fix su TeApplEn per gestire TSC1_VE_LIMIT come da TE" VALUE 0xFCC75A Scalar_UWORD 0 TB_VcmVariable4ms_Symbol_CM_boolean_adm 0 1 /end CHARACTERISTIC
/begin CHARACTERISTIC vfTE_TSC1_VE_LIMIT_EN_EnFix "[FIX] Fix su TeApplEn per gestire TSC1_VE_LIMIT come da TE" VALUE 0xFCC758 Scalar_UWORD 0 TB_VcmVariable4ms_Symbol_CM_FixEnableT 171 218 /end CHARACTERISTIC
/begin CHARACTERISTIC vfTORQUE_LIM_VCM "[FIX] Fix sulla richiesta di limitazione di coppia (percentuale di Coppia Erogata)" VALUE 0xFCC756 Scalar_UWORD 0 TB_VcmVariable4ms_Symbol_CM_ufix16_En4__ 0 100 /end CHARACTERISTIC
/begin CHARACTERISTIC vfTORQUE_LIM_VCM_EnFix "[FIX] Fix sulla richiesta di limitazione di coppia (percentuale di Coppia Erogata)" VALUE 0xFCC754 Scalar_UWORD 0 TB_VcmVariable4ms_Symbol_CM_FixEnableT 171 218 /end CHARACTERISTIC
/begin CHARACTERISTIC vfTORQUE_LIM_VCM_R "[FIX] Fix sulla richiesta di limitazione di coppia (percentuale di Coppia Erogata)" VALUE 0xFCC7B8 Scalar_UWORD 0 TE_CmuReqMgm4ms_Symbol_CM_ufix16_En4__ 0 100 /end CHARACTERISTIC
/begin CHARACTERISTIC vfTORQUE_LIM_VCM_R_EnFix "[FIX] Fix sulla richiesta di limitazione di coppia (percentuale di Coppia Erogata)" VALUE 0xFCC7B6 Scalar_UWORD 0 TE_CmuReqMgm4ms_Symbol_CM_FixEnableT 171 218 /end CHARACTERISTIC
/begin CHARACTERISTIC vfTORQUE_REQ_VCM "[FIX] Fix sulla richiesta di coppia obiettivo (percentuale di Coppia Erogata)" VALUE 0xFCC752 Scalar_UWORD 0 TB_VcmVariable4ms_Symbol_CM_ufix16_En4__ 0 100 /end CHARACTERISTIC
/begin CHARACTERISTIC vfTORQUE_REQ_VCM2 "[FIX] Fix sulla richiesta di coppia obiettivo (target di Coppia)" VALUE 0xFCC74E Scalar_UWORD 0 TB_VcmVariable4ms_Symbol_CM_ufix16_En4__ 0 100 /end CHARACTERISTIC
/begin CHARACTERISTIC vfTORQUE_REQ_VCM2_EnFix "[FIX] Fix sulla richiesta di coppia obiettivo (target di Coppia)" VALUE 0xFCC74C Scalar_UWORD 0 TB_VcmVariable4ms_Symbol_CM_FixEnableT 171 218 /end CHARACTERISTIC
/begin CHARACTERISTIC vfTORQUE_REQ_VCM2_R "[FIX] Fix sulla richiesta di coppia obiettivo (target di Coppia)" VALUE 0xFCC7B4 Scalar_UWORD 0 TE_CmuReqMgm4ms_Symbol_CM_ufix16_En4__ 0 100 /end CHARACTERISTIC
/begin CHARACTERISTIC vfTORQUE_REQ_VCM2_R_EnFix "[FIX] Fix sulla richiesta di coppia obiettivo (target di Coppia)" VALUE 0xFCC7B2 Scalar_UWORD 0 TE_CmuReqMgm4ms_Symbol_CM_FixEnableT 171 218 /end CHARACTERISTIC
/begin CHARACTERISTIC vfTORQUE_REQ_VCM_EnFix "[FIX] Fix sulla richiesta di coppia obiettivo (percentuale di Coppia Erogata)" VALUE 0xFCC750 Scalar_UWORD 0 TB_VcmVariable4ms_Symbol_CM_FixEnableT 171 218 /end CHARACTERISTIC
/begin CHARACTERISTIC vfTORQUE_REQ_VCM_R "[FIX] Fix sulla richiesta di coppia obiettivo (percentuale di Coppia Erogata)" VALUE 0xFCC7B0 Scalar_UWORD 0 TE_CmuReqMgm4ms_Symbol_CM_ufix16_En4__ 0 100 /end CHARACTERISTIC
/begin CHARACTERISTIC vfTORQUE_REQ_VCM_R_EnFix "[FIX] Fix sulla richiesta di coppia obiettivo (percentuale di Coppia Erogata)" VALUE 0xFCC7AE Scalar_UWORD 0 TE_CmuReqMgm4ms_Symbol_CM_FixEnableT 171 218 /end CHARACTERISTIC
/begin CHARACTERISTIC vfTORQUE_REQ_WIN "[FIX] Fix su priorità vincente nella richiesta di coppia" VALUE 0xFCC92A Scalar_UWORD 0 TE_TSC1Manager4ms_Symbol_CM_uint8_adm 0 4 /end CHARACTERISTIC
/begin CHARACTERISTIC vfTORQUE_REQ_WIN_EnFix "[FIX] Fix su priorità vincente nella richiesta di coppia" VALUE 0xFCC928 Scalar_UWORD 0 TE_TSC1Manager4ms_Symbol_CM_FixEnableT 171 218 /end CHARACTERISTIC
/begin CHARACTERISTIC vfTRQ_LTD_PRI_WIN "[FIX] Fix su priorità vincente nella limitazione di coppia" VALUE 0xFCC926 Scalar_UWORD 0 TE_TSC1Manager4ms_Symbol_CM_uint8_adm 1 8 /end CHARACTERISTIC
/begin CHARACTERISTIC vfTRQ_LTD_PRI_WIN_EnFix "[FIX] Fix su priorità vincente nella limitazione di coppia" VALUE 0xFCC924 Scalar_UWORD 0 TE_TSC1Manager4ms_Symbol_CM_FixEnableT 171 218 /end CHARACTERISTIC
/begin CHARACTERISTIC vfTRQ_REQ_PRI_WIN "[FIX] Fix su priorità vincente nella richiesta di coppia" VALUE 0xFCC922 Scalar_UWORD 0 TE_TSC1Manager4ms_Symbol_CM_uint8_adm 1 9 /end CHARACTERISTIC
/begin CHARACTERISTIC vfTRQ_REQ_PRI_WIN_EnFix "[FIX] Fix su priorità vincente nella richiesta di coppia" VALUE 0xFCC920 Scalar_UWORD 0 TE_TSC1Manager4ms_Symbol_CM_FixEnableT 171 218 /end CHARACTERISTIC
/begin CHARACTERISTIC vfTSC1_MANAGER_EN_Enable "[FIX] Fix su Abilitazione della funzione manager TSC1" VALUE 0xFC2C6A Scalar_UBYTE 0 VcmFcnEnableInit_CM_FixEnableT 171 218 /end CHARACTERISTIC
/begin CHARACTERISTIC vfTSC1_MANAGER_EN_Value "[FIX] Fix su Abilitazione della funzione manager TSC1" VALUE 0xFC2C69 Scalar_BOOLEAN 0 VcmFcnEnableInit_CM_boolean_adm 0 1 /end CHARACTERISTIC
/begin CHARACTERISTIC vfTSC1_SPEED_LTD "[FIX] Fix su limitazione di giri" VALUE 0xFCC91E Scalar_UWORD 0 TE_TSC1Manager4ms_Symbol_CM_uint16_rpm 0 10000 /end CHARACTERISTIC
/begin CHARACTERISTIC vfTSC1_SPEED_LTD_EnFix "[FIX] Fix su limitazione di giri" VALUE 0xFCC91C Scalar_UWORD 0 TE_TSC1Manager4ms_Symbol_CM_FixEnableT 171 218 /end CHARACTERISTIC
/begin CHARACTERISTIC vfTSC1_SPEED_REQ "[FIX] Fix su richiesta di giri" VALUE 0xFCC91A Scalar_UWORD 0 TE_TSC1Manager4ms_Symbol_CM_uint16_rpm 0 10000 /end CHARACTERISTIC
/begin CHARACTERISTIC vfTSC1_SPEED_REQ_EnFix "[FIX] Fix su richiesta di giri" VALUE 0xFCC918 Scalar_UWORD 0 TE_TSC1Manager4ms_Symbol_CM_FixEnableT 171 218 /end CHARACTERISTIC
/begin CHARACTERISTIC vfTSC1_TORQUE_LTD "[FIX] Fix su limitazione di coppia" VALUE 0xFCC916 Scalar_UWORD 0 TE_TSC1Manager4ms_Symbol_CM_ufix16_En4__ 0 100 /end CHARACTERISTIC
/begin CHARACTERISTIC vfTSC1_TORQUE_LTD_EnFix "[FIX] Fix su limitazione di coppia" VALUE 0xFCC914 Scalar_UWORD 0 TE_TSC1Manager4ms_Symbol_CM_FixEnableT 171 218 /end CHARACTERISTIC
/begin CHARACTERISTIC vfTSC1_TORQUE_REQ "[FIX] Fix su richiesta di coppia" VALUE 0xFCC912 Scalar_UWORD 0 TE_TSC1Manager4ms_Symbol_CM_ufix16_En4__ 0 100 /end CHARACTERISTIC
/begin CHARACTERISTIC vfTSC1_TORQUE_REQ_EnFix "[FIX] Fix su richiesta di coppia" VALUE 0xFCC910 Scalar_UWORD 0 TE_TSC1Manager4ms_Symbol_CM_FixEnableT 171 218 /end CHARACTERISTIC
/begin CHARACTERISTIC vfVCM_C_TSC_COND "[FIX] Fix sulla modalità di richiesta di performance (TSC1_VE_CONTROL)" VALUE 0xFCC74A Scalar_UWORD 0 TB_VcmVariable4ms_Symbol_CM_uint8_adm 0 3 /end CHARACTERISTIC
/begin CHARACTERISTIC vfVCM_C_TSC_COND2 "[FIX] Fix sulla modalità di richiesta di performance (nel secondo TSC1_Ctrl2)" VALUE 0xFCC746 Scalar_UWORD 0 TB_VcmVariable4ms_Symbol_CM_uint8_adm 0 3 /end CHARACTERISTIC
/begin CHARACTERISTIC vfVCM_C_TSC_COND2_EnFix "[FIX] Fix sulla modalità di richiesta di performance (nel secondo TSC1_Ctrl2)" VALUE 0xFCC744 Scalar_UWORD 0 TB_VcmVariable4ms_Symbol_CM_FixEnableT 171 218 /end CHARACTERISTIC
/begin CHARACTERISTIC vfVCM_C_TSC_COND2_R "[FIX] Fix sulla modalità di richiesta di performance (nel secondo TSC1_Ctrl2)" VALUE 0xFCC7AC Scalar_UWORD 0 TE_CmuReqMgm4ms_Symbol_CM_uint8_adm 0 3 /end CHARACTERISTIC
/begin CHARACTERISTIC vfVCM_C_TSC_COND2_R_EnFix "[FIX] Fix sulla modalità di richiesta di performance (nel secondo TSC1_Ctrl2)" VALUE 0xFCC7AA Scalar_UWORD 0 TE_CmuReqMgm4ms_Symbol_CM_FixEnableT 171 218 /end CHARACTERISTIC
/begin CHARACTERISTIC vfVCM_C_TSC_COND_EnFix "[FIX] Fix sulla modalità di richiesta di performance (TSC1_VE_CONTROL)" VALUE 0xFCC748 Scalar_UWORD 0 TB_VcmVariable4ms_Symbol_CM_FixEnableT 171 218 /end CHARACTERISTIC
/begin CHARACTERISTIC vfVCM_C_TSC_COND_R "[FIX] Fix sulla modalità di richiesta di performance (TSC1_VE_CONTROL)" VALUE 0xFCC7A8 Scalar_UWORD 0 TE_CmuReqMgm4ms_Symbol_CM_uint8_adm 0 3 /end CHARACTERISTIC
/begin CHARACTERISTIC vfVCM_C_TSC_COND_R_EnFix "[FIX] Fix sulla modalità di richiesta di performance (TSC1_VE_CONTROL)" VALUE 0xFCC7A6 Scalar_UWORD 0 TE_CmuReqMgm4ms_Symbol_CM_FixEnableT 171 218 /end CHARACTERISTIC
/begin CHARACTERISTIC vfVCM_C_TSC_MODE "[FIX] Fix sulla modalità di richiesta obiettivo di performance (Coppia Erogata = 2 o giri = 1)" VALUE 0xFCC742 Scalar_UWORD 0 TB_VcmVariable4ms_Symbol_CM_uint8_adm 0 3 /end CHARACTERISTIC
/begin CHARACTERISTIC vfVCM_C_TSC_MODE2 "[FIX] Fix sulla modalità di richiesta (Controllo Coppia = 2 o Controllo giri = 1)" VALUE 0xFCC73E Scalar_UWORD 0 TB_VcmVariable4ms_Symbol_CM_uint8_adm 0 3 /end CHARACTERISTIC
/begin CHARACTERISTIC vfVCM_C_TSC_MODE2_EnFix "[FIX] Fix sulla modalità di richiesta (Controllo Coppia = 2 o Controllo giri = 1)" VALUE 0xFCC73C Scalar_UWORD 0 TB_VcmVariable4ms_Symbol_CM_FixEnableT 171 218 /end CHARACTERISTIC
/begin CHARACTERISTIC vfVCM_C_TSC_MODE2_R "[FIX] Fix sulla modalità di richiesta (Controllo Coppia = 2 o Controllo giri = 1)" VALUE 0xFCC7A4 Scalar_UWORD 0 TE_CmuReqMgm4ms_Symbol_CM_uint8_adm 0 3 /end CHARACTERISTIC
/begin CHARACTERISTIC vfVCM_C_TSC_MODE2_R_EnFix "[FIX] Fix sulla modalità di richiesta (Controllo Coppia = 2 o Controllo giri = 1)" VALUE 0xFCC7A2 Scalar_UWORD 0 TE_CmuReqMgm4ms_Symbol_CM_FixEnableT 171 218 /end CHARACTERISTIC
/begin CHARACTERISTIC vfVCM_C_TSC_MODE_EnFix "[FIX] Fix sulla modalità di richiesta obiettivo di performance (Coppia Erogata = 2 o giri = 1)" VALUE 0xFCC740 Scalar_UWORD 0 TB_VcmVariable4ms_Symbol_CM_FixEnableT 171 218 /end CHARACTERISTIC
/begin CHARACTERISTIC vfVCM_C_TSC_MODE_R "[FIX] Fix sulla modalità di richiesta obiettivo di performance (Coppia Erogata = 2 o giri = 1)" VALUE 0xFCC7A0 Scalar_UWORD 0 TE_CmuReqMgm4ms_Symbol_CM_uint8_adm 0 3 /end CHARACTERISTIC
/begin CHARACTERISTIC vfVCM_C_TSC_MODE_R_EnFix "[FIX] Fix sulla modalità di richiesta obiettivo di performance (Coppia Erogata = 2 o giri = 1)" VALUE 0xFCC79E Scalar_UWORD 0 TE_CmuReqMgm4ms_Symbol_CM_FixEnableT 171 218 /end CHARACTERISTIC
/begin CHARACTERISTIC vfVCM_C_TSC_PRI "[FIX] Fix sulla priorità degli obiettivi di performance (Coppia Erogata o giri) da VCM (Max(Pri)=0, Min(Pri)=3)" VALUE 0xFCC73A Scalar_UWORD 0 TB_VcmVariable4ms_Symbol_CM_uint8_adm 0 3 /end CHARACTERISTIC
/begin CHARACTERISTIC vfVCM_C_TSC_PRI2 "[FIX] Fix sulla priorità degli obiettivi di performance TSC2 (Coppia Erogata o giri) da VCM (Max(Pri)=0, Min(Pri)=3)" VALUE 0xFCC736 Scalar_UWORD 0 TB_VcmVariable4ms_Symbol_CM_uint8_adm 0 3 /end CHARACTERISTIC
/begin CHARACTERISTIC vfVCM_C_TSC_PRI2_EnFix "[FIX] Fix sulla priorità degli obiettivi di performance TSC2 (Coppia Erogata o giri) da VCM (Max(Pri)=0, Min(Pri)=3)" VALUE 0xFCC734 Scalar_UWORD 0 TB_VcmVariable4ms_Symbol_CM_FixEnableT 171 218 /end CHARACTERISTIC
/begin CHARACTERISTIC vfVCM_C_TSC_PRI2_R "[FIX] Fix sulla priorità degli obiettivi di performance TSC2 (Coppia Erogata o giri) da VCM (Max(Pri)=0, Min(Pri)=3)" VALUE 0xFCC79C Scalar_UWORD 0 TE_CmuReqMgm4ms_Symbol_CM_uint8_adm 0 3 /end CHARACTERISTIC
/begin CHARACTERISTIC vfVCM_C_TSC_PRI2_R_EnFix "[FIX] Fix sulla priorità degli obiettivi di performance TSC2 (Coppia Erogata o giri) da VCM (Max(Pri)=0, Min(Pri)=3)" VALUE 0xFCC79A Scalar_UWORD 0 TE_CmuReqMgm4ms_Symbol_CM_FixEnableT 171 218 /end CHARACTERISTIC
/begin CHARACTERISTIC vfVCM_C_TSC_PRI_EnFix "[FIX] Fix sulla priorità degli obiettivi di performance (Coppia Erogata o giri) da VCM (Max(Pri)=0, Min(Pri)=3)" VALUE 0xFCC738 Scalar_UWORD 0 TB_VcmVariable4ms_Symbol_CM_FixEnableT 171 218 /end CHARACTERISTIC
/begin CHARACTERISTIC vfVCM_C_TSC_PRI_R "[FIX] Fix sulla priorità degli obiettivi di performance (Coppia Erogata o giri) da VCM (Max(Pri)=0, Min(Pri)=3)" VALUE 0xFCC798 Scalar_UWORD 0 TE_CmuReqMgm4ms_Symbol_CM_uint8_adm 0 3 /end CHARACTERISTIC
/begin CHARACTERISTIC vfVCM_C_TSC_PRI_R_EnFix "[FIX] Fix sulla priorità degli obiettivi di performance (Coppia Erogata o giri) da VCM (Max(Pri)=0, Min(Pri)=3)" VALUE 0xFCC796 Scalar_UWORD 0 TE_CmuReqMgm4ms_Symbol_CM_FixEnableT 171 218 /end CHARACTERISTIC
/begin CHARACTERISTIC vfVCM_L_TSC_COND "[FIX] Fix sulla modalità di richiesta di performance (TSC1_VE_LIMIT)" VALUE 0xFCC732 Scalar_UWORD 0 TB_VcmVariable4ms_Symbol_CM_uint8_adm 0 3 /end CHARACTERISTIC
/begin CHARACTERISTIC vfVCM_L_TSC_COND_EnFix "[FIX] Fix sulla modalità di richiesta di performance (TSC1_VE_LIMIT)" VALUE 0xFCC730 Scalar_UWORD 0 TB_VcmVariable4ms_Symbol_CM_FixEnableT 171 218 /end CHARACTERISTIC
/begin CHARACTERISTIC vfVCM_L_TSC_COND_R "[FIX] Fix sulla modalità di richiesta di performance (TSC1_VE_LIMIT)" VALUE 0xFCC794 Scalar_UWORD 0 TE_CmuReqMgm4ms_Symbol_CM_uint8_adm 0 3 /end CHARACTERISTIC
/begin CHARACTERISTIC vfVCM_L_TSC_COND_R_EnFix "[FIX] Fix sulla modalità di richiesta di performance (TSC1_VE_LIMIT)" VALUE 0xFCC792 Scalar_UWORD 0 TE_CmuReqMgm4ms_Symbol_CM_FixEnableT 171 218 /end CHARACTERISTIC
/begin CHARACTERISTIC vfVCM_L_TSC_MODE "[FIX] Fix sulla modalità di richiesta limitazione di performance (Coppia Erogata o giri)" VALUE 0xFCC72E Scalar_UWORD 0 TB_VcmVariable4ms_Symbol_CM_uint8_adm 0 3 /end CHARACTERISTIC
/begin CHARACTERISTIC vfVCM_L_TSC_MODE_EnFix "[FIX] Fix sulla modalità di richiesta limitazione di performance (Coppia Erogata o giri)" VALUE 0xFCC72C Scalar_UWORD 0 TB_VcmVariable4ms_Symbol_CM_FixEnableT 171 218 /end CHARACTERISTIC
/begin CHARACTERISTIC vfVCM_L_TSC_MODE_R "[FIX] Fix sulla modalità di richiesta limitazione di performance (Coppia Erogata o giri)" VALUE 0xFCC790 Scalar_UWORD 0 TE_CmuReqMgm4ms_Symbol_CM_uint8_adm 0 3 /end CHARACTERISTIC
/begin CHARACTERISTIC vfVCM_L_TSC_MODE_R_EnFix "[FIX] Fix sulla modalità di richiesta limitazione di performance (Coppia Erogata o giri)" VALUE 0xFCC78E Scalar_UWORD 0 TE_CmuReqMgm4ms_Symbol_CM_FixEnableT 171 218 /end CHARACTERISTIC
/begin CHARACTERISTIC vfVCM_L_TSC_PRI "[FIX] Fix sulla priorità sulle limitazioni alle richieste di performance (Coppia Erogata o giri) da VCM (Max(Pri)=0, Min(Pri)=3)" VALUE 0xFCC72A Scalar_UWORD 0 TB_VcmVariable4ms_Symbol_CM_uint8_adm 0 3 /end CHARACTERISTIC
/begin CHARACTERISTIC vfVCM_L_TSC_PRI_EnFix "[FIX] Fix sulla priorità sulle limitazioni alle richieste di performance (Coppia Erogata o giri) da VCM (Max(Pri)=0, Min(Pri)=3)" VALUE 0xFCC728 Scalar_UWORD 0 TB_VcmVariable4ms_Symbol_CM_FixEnableT 171 218 /end CHARACTERISTIC
/begin CHARACTERISTIC vfVCM_L_TSC_PRI_R "[FIX] Fix sulla priorità sulle limitazioni alle richieste di performance (Coppia Erogata o giri) da VCM (Max(Pri)=0, Min(Pri)=3)" VALUE 0xFCC78C Scalar_UWORD 0 TE_CmuReqMgm4ms_Symbol_CM_uint8_adm 0 3 /end CHARACTERISTIC
/begin CHARACTERISTIC vfVCM_L_TSC_PRI_R_EnFix "[FIX] Fix sulla priorità sulle limitazioni alle richieste di performance (Coppia Erogata o giri) da VCM (Max(Pri)=0, Min(Pri)=3)" VALUE 0xFCC78A Scalar_UWORD 0 TE_CmuReqMgm4ms_Symbol_CM_FixEnableT 171 218 /end CHARACTERISTIC
/begin CHARACTERISTIC vfVEH_COND_4BRAKE_SHOFF "[FIX] Fix per condizione sulla velocità veicolo inferiore a CC Obj per Brake ShutOff" VALUE 0xFCC8DA Scalar_UWORD 0 TE_PtoCc4ms_Symbol_CM_boolean_adm 0 1 /end CHARACTERISTIC
/begin CHARACTERISTIC vfVEH_COND_4BRAKE_SHOFF_EnFix "[FIX] Fix per condizione sulla velocità veicolo inferiore a CC Obj per Brake ShutOff" VALUE 0xFCC8D8 Scalar_UWORD 0 TE_PtoCc4ms_Symbol_CM_FixEnableT 171 218 /end CHARACTERISTIC
/begin CHARACTERISTIC vfVEH_LTD_ACTIVE "[FIX] Flag di limitazione velocità attiva" VALUE 0xFCC788 Scalar_UWORD 0 TE_CmuReqMgm4ms_Symbol_CM_boolean_adm 0 1 /end CHARACTERISTIC
/begin CHARACTERISTIC vfVEH_LTD_ACTIVE_EnFix "[FIX] Flag di limitazione velocità attiva" VALUE 0xFCC786 Scalar_UWORD 0 TE_CmuReqMgm4ms_Symbol_CM_FixEnableT 171 218 /end CHARACTERISTIC
/begin CHARACTERISTIC vfVEH_SPEED_LIM "[FIX] Fix sulla limitazione velocità veicolo" VALUE 0xFCC68A Scalar_UWORD 0 TE_VehicleSpeedLim100ms_Symbol_CM_uint16_Km_h 1 250 /end CHARACTERISTIC
/begin CHARACTERISTIC vfVEH_SPEED_LIM_EN_Enable "[FIX] Fix su Abilitazione della funzione limitazione velocità veicolo" VALUE 0xFC2C68 Scalar_UBYTE 0 VcmFcnEnableInit_CM_FixEnableT 171 218 /end CHARACTERISTIC
/begin CHARACTERISTIC vfVEH_SPEED_LIM_EN_Value "[FIX] Fix su Abilitazione della funzione limitazione velocità veicolo" VALUE 0xFC2C67 Scalar_BOOLEAN 0 VcmFcnEnableInit_CM_boolean_adm 0 1 /end CHARACTERISTIC
/begin CHARACTERISTIC vfVEH_SPEED_LIM_EnFix "[FIX] Fix sulla limitazione velocità veicolo" VALUE 0xFCC688 Scalar_UWORD 0 TE_VehicleSpeedLim100ms_Symbol_CM_FixEnableT 171 218 /end CHARACTERISTIC
/begin CHARACTERISTIC vfVEH_VEL_SENS_DIAG_EN_Enable "[FIX] Fix su Abilitazione della funzione diagnosi sensore velocità veicolo" VALUE 0xFC2C66 Scalar_UBYTE 0 VcmFcnEnableInit_CM_FixEnableT 171 218 /end CHARACTERISTIC
/begin CHARACTERISTIC vfVEH_VEL_SENS_DIAG_EN_Value "[FIX] Fix su Abilitazione della funzione diagnosi sensore velocità veicolo" VALUE 0xFC2C65 Scalar_BOOLEAN 0 VcmFcnEnableInit_CM_boolean_adm 0 1 /end CHARACTERISTIC
/begin AXIS_PTS vkDELTA_VEL_BKP "[XBK] Limitazione della percentuale di coppia richiesta da pedale" 0xFCC86A NO_INPUT_QUANTITY Lookup2D_X_UWORD 0 TE_CmuReqMgm4ms_Symbol_CM_uint16_Km_h 8 0 250 /end AXIS_PTS
/begin AXIS_PTS vkETASP_EPR "[Y_BKP] Rendimento Volumetrico" 0xFC5666 NO_INPUT_QUANTITY Lookup2D_X_UWORD 0 EprMgm4ms_CM_ufix16_En10_adm 8 0 3 /end AXIS_PTS
/begin AXIS_PTS vkRPM_EPR "[X_BKP] Velocitá di rotazione motore" 0xFC5656 NO_INPUT_QUANTITY Lookup2D_X_UWORD 0 EprMgm4ms_CM_uint16_rpm 8 0 10000 /end AXIS_PTS
/begin AXIS_PTS vkRPM_FAN1_ACT "[YBK] DutyCycle for FAN2 computed in function of coolant temperature and engine speed" 0xFC5980 NO_INPUT_QUANTITY Lookup2D_X_UWORD 0 FanMgm100ms_CM_uint16_rpm 8 0 10000 /end AXIS_PTS
/begin AXIS_PTS vkRPM_FAN2_ACT "[YBK] DutyCycle for FAN2 computed in function of coolant temperature and engine speed" 0xFC5970 NO_INPUT_QUANTITY Lookup2D_X_UWORD 0 FanMgm100ms_CM_uint16_rpm 8 0 10000 /end AXIS_PTS
/begin AXIS_PTS vkTH2O_FAN1_ACT "[XBK] DutyCycle for FAN2 computed in function of coolant temperature and engine speed" 0xFC5960 NO_INPUT_QUANTITY Lookup2D_X_UWORD 0 FanMgm100ms_CM_ufix16_Bn40_degC 8 -40 140 /end AXIS_PTS
/begin AXIS_PTS vkTH2O_FAN2_ACT "[XBK] DutyCycle for FAN2 computed in function of coolant temperature and engine speed" 0xFC5950 NO_INPUT_QUANTITY Lookup2D_X_UWORD 0 FanMgm100ms_CM_ufix16_Bn40_degC 8 -40 140 /end AXIS_PTS
/begin AXIS_PTS vkVEL_LIM_BKP "[YBK] Limitazione della percentuale di coppia richiesta da pedale" 0xFCC85A NO_INPUT_QUANTITY Lookup2D_X_UWORD 0 TE_CmuReqMgm4ms_Symbol_CM_uint16_Km_h 8 0 250 /end AXIS_PTS
/begin CHARACTERISTIC vsAPPL_TYPE "Tipo di applicazione" VALUE 0xFC2C64 Scalar_UBYTE 0 VcmFcnEnableInit_CM_uint8_adm 0 255 /end CHARACTERISTIC
/begin MEASUREMENT vsActGear "Valore ricevuto via CAN sulla marcia effettiva innestata (solo per cambio automatico)" UBYTE Idle4ms_CM_ufix8_Bn125_gear 0 0 -125 125 ECU_ADDRESS 0x4000460A /end MEASUREMENT
/begin MEASUREMENT vsAvCruiseAct "Cruise control switch from CAN Module (1 -> Avaiable, 0 -> Not Avaiable)" UBYTE Vfnc4ms_CM_boolean_adm 0 0 0 1 ECU_ADDRESS 0x40004613 /end MEASUREMENT
/begin MEASUREMENT vsAvTOil "Oil temperature sensor available in the current engine configuration" UBYTE ConfInit_CM_boolean_adm 0 0 0 1 ECU_ADDRESS 0x400022FA /end MEASUREMENT
/begin MEASUREMENT vsAvVehicleSpeed "Variable : Flag Velocità veicolo acquisita da CAN disponibile (1 -> DI Av, 0 -> DI Not Av)" UBYTE Vfnc4ms_CM_boolean_adm 0 0 0 1 ECU_ADDRESS 0x40004617 /end MEASUREMENT
/begin MEASUREMENT vsBrake "Digital Output: zsBrakePed1 OR zsBrakePed2 OR zsClutch" UBYTE J1939dl_Tx100ms_CM_boolean_adm 0 0 0 1 ECU_ADDRESS 0x4000461C /end MEASUREMENT
/begin MEASUREMENT vsCCAccOverideCan "C via CAN Acc Override" UBYTE Vfnc4ms_CM_boolean_adm 0 0 0 1 ECU_ADDRESS 0x40004627 /end MEASUREMENT
/begin MEASUREMENT vsCCActive "ruise control active" UBYTE J1939dl_Tx100ms_CM_boolean_adm 0 0 0 1 ECU_ADDRESS 0x4000460B /end MEASUREMENT
/begin MEASUREMENT vsCCActiveWait "Sistema nello stato di vsCCActiveWait" UBYTE TE_PtoCc4ms_Symbol_CM_boolean_adm 0 0 0 1 ECU_ADDRESS 0x40004843 /end MEASUREMENT
/begin MEASUREMENT vsCCNotAvailCan "C via CAN not available" UBYTE Vfnc4ms_CM_boolean_adm 0 0 0 1 ECU_ADDRESS 0x40004626 /end MEASUREMENT
/begin MEASUREMENT vsCCObjFix "Componente fissa di CC Obj" UWORD TE_PtoCc4ms_Symbol_CM_uint16_Km_h 0 0 0 250 ECU_ADDRESS 0x40004846 /end MEASUREMENT
/begin MEASUREMENT vsCCSpdObjNoLim "CC Obj prima della limitazione di gradiente" UWORD J1939dl_Tx100ms_CM_uint16_Km_h 0 0 0 250 ECU_ADDRESS 0x4000465E /end MEASUREMENT
/begin MEASUREMENT vsCCSpeedObj "CC Obj" UWORD Vfnc100ms_CM_uint16_Km_h 0 0 0 250 ECU_ADDRESS 0x40004660 /end MEASUREMENT
/begin CHARACTERISTIC vsCC_DIG_EN "Abilitazione utilizzo ingressi digitali per CC" VALUE 0xFCC6B7 Scalar_BOOLEAN 0 PtoCCReq4ms_Symbol_CM_boolean_adm 0 1 /end CHARACTERISTIC
/begin CHARACTERISTIC vsCC_SHTOFF_IRREV_C "Calibrazione per condizioni ShutOff irreversibile per CC" VALUE 0xFCC8D6 Scalar_UWORD 0 TE_PtoCc4ms_Symbol_CM_uint16_adm 0 65535 /end CHARACTERISTIC
/begin CHARACTERISTIC vsCC_SHTOFF_REV_COND "Calibrazione per condizioni ShutOff reversibile per CC" VALUE 0xFCC8D4 Scalar_UWORD 0 TE_PtoCc4ms_Symbol_CM_uint16_adm 0 65535 /end CHARACTERISTIC
/begin CHARACTERISTIC vsCC_SPD_OBJ_GRAD "Limitazione di gradiente per obiettivo velocità CC" VALUE 0xFCC8D2 Scalar_UWORD 0 TE_PtoCc4ms_Symbol_CM_uint16__Km_h__s 0 250 /end CHARACTERISTIC
/begin CHARACTERISTIC vsCC_STDBY_MEM_REQ_C "Calibrazione per condizioni ShutOff Standby con memorizzazione per CC" VALUE 0xFCC8D0 Scalar_UWORD 0 TE_PtoCc4ms_Symbol_CM_uint16_adm 0 65535 /end CHARACTERISTIC
/begin CHARACTERISTIC vsCC_STDBY_REQ_COND "Calibrazione per condizioni ShutOff Standby per CC" VALUE 0xFCC8CE Scalar_UWORD 0 TE_PtoCc4ms_Symbol_CM_uint16_adm 0 65535 /end CHARACTERISTIC
/begin CHARACTERISTIC vsCLUTCH_MAX "Massimo tempo di attesa con clutch=1" VALUE 0xFCC8CC Scalar_UWORD 0 TE_PtoCc4ms_Symbol_CM_ufix16_Sp004_sec 0 240 /end CHARACTERISTIC
/begin MEASUREMENT vsCNGDensity "Fuel Density for CNG computed trough VAN DER WALLS equation" FLOAT32_IEEE FuelConsTDC_CM_single_kg_l 0 0 0.003 1 ECU_ADDRESS 0x40004B00 /end MEASUREMENT
/begin MEASUREMENT vsCNGMass "Fuel Mass for CNG computed trough VAN DER WALLS equation" FLOAT32_IEEE FuelConsTDC_CM_single_kg 0 0 -3.4E+38 3.4E+38 ECU_ADDRESS 0x40004AFC /end MEASUREMENT
/begin MEASUREMENT vsCNGMolarMass "Molar Mass for CNG mixture composition provided from fuel stations " FLOAT32_IEEE FuelConsTDC_CM_single_g_mol 0 0 -3.4E+38 3.4E+38 ECU_ADDRESS 0x40004AF8 /end MEASUREMENT
/begin MEASUREMENT vsCNGMolesN "Number of moles of methane in the tank" FLOAT32_IEEE FuelConsTDC_CM_single_g_mol 0 0 -3.4E+38 3.4E+38 ECU_ADDRESS 0x40004AF4 /end MEASUREMENT
/begin MEASUREMENT vsCamRunEn "Abilitazione alla diagnosi camma SFR" UBYTE ConfInit_CM_boolean_adm 0 0 0 1 ECU_ADDRESS 0x400022FE /end MEASUREMENT
/begin MEASUREMENT vsCcObj "Velocità obiettivo per CC" UWORD Vfnc4ms_CM_uint16_rpm 0 0 0 10000 ECU_ADDRESS 0x40004664 /end MEASUREMENT
/begin MEASUREMENT vsClutch "Clutch switch from CAN Module (1 -> Actuated, 0 -> Not Actuated) or digital input" UBYTE J1939dl_Tx100ms_CM_boolean_adm 0 0 0 1 ECU_ADDRESS 0x4000461B /end MEASUREMENT
/begin MEASUREMENT vsCmuReqMgmEn "Switch di abilitazione della funzione TE_CmuReqMgm4ms" UBYTE ConfInit_CM_boolean_adm 0 0 0 1 ECU_ADDRESS 0x400022FC /end MEASUREMENT
/begin MEASUREMENT vsCond0 "Condizione 0 per ShutOff PTO o CC" UBYTE TE_PtoCc4ms_Symbol_CM_boolean_adm 0 0 0 1 ECU_ADDRESS 0x40004842 /end MEASUREMENT
/begin MEASUREMENT vsCond1 "Condizione 1 per ShutOff PTO o CC" UBYTE TE_PtoCc4ms_Symbol_CM_boolean_adm 0 0 0 1 ECU_ADDRESS 0x40004841 /end MEASUREMENT
/begin MEASUREMENT vsCond10 "Condizione 10 per ShutOff PTO o CC" UBYTE TE_PtoCc4ms_Symbol_CM_boolean_adm 0 0 0 1 ECU_ADDRESS 0x40004840 /end MEASUREMENT
/begin MEASUREMENT vsCond11 "Condizione 11 per ShutOff PTO o CC" UBYTE TE_PtoCc4ms_Symbol_CM_boolean_adm 0 0 0 1 ECU_ADDRESS 0x4000483F /end MEASUREMENT
/begin MEASUREMENT vsCond12 "Condizione 12 per ShutOff PTO o CC" UBYTE TE_PtoCc4ms_Symbol_CM_boolean_adm 0 0 0 1 ECU_ADDRESS 0x4000483E /end MEASUREMENT
/begin MEASUREMENT vsCond13 "Condizione 13 per ShutOff PTO o CC" UBYTE TE_PtoCc4ms_Symbol_CM_boolean_adm 0 0 0 1 ECU_ADDRESS 0x4000483D /end MEASUREMENT
/begin MEASUREMENT vsCond14 "Condizione 14 per ShutOff PTO o CC" UBYTE TE_PtoCc4ms_Symbol_CM_boolean_adm 0 0 0 1 ECU_ADDRESS 0x4000483C /end MEASUREMENT
/begin MEASUREMENT vsCond15 "Condizione 15 per ShutOff PTO o CC" UBYTE TE_PtoCc4ms_Symbol_CM_boolean_adm 0 0 0 1 ECU_ADDRESS 0x4000483B /end MEASUREMENT
/begin MEASUREMENT vsCond2 "Condizione 2 per ShutOff PTO o CC" UBYTE TE_PtoCc4ms_Symbol_CM_boolean_adm 0 0 0 1 ECU_ADDRESS 0x4000483A /end MEASUREMENT
/begin MEASUREMENT vsCond3 "Condizione 3 per ShutOff PTO o CC" UBYTE TE_PtoCc4ms_Symbol_CM_boolean_adm 0 0 0 1 ECU_ADDRESS 0x40004839 /end MEASUREMENT
/begin MEASUREMENT vsCond4 "Condizione 4 per ShutOff PTO o CC" UBYTE TE_PtoCc4ms_Symbol_CM_boolean_adm 0 0 0 1 ECU_ADDRESS 0x40004838 /end MEASUREMENT
/begin MEASUREMENT vsCond5 "Condizione 5 per ShutOff PTO o CC" UBYTE TE_PtoCc4ms_Symbol_CM_boolean_adm 0 0 0 1 ECU_ADDRESS 0x40004837 /end MEASUREMENT
/begin MEASUREMENT vsCond6 "Condizione 6 per ShutOff PTO o CC" UBYTE TE_PtoCc4ms_Symbol_CM_boolean_adm 0 0 0 1 ECU_ADDRESS 0x40004836 /end MEASUREMENT
/begin MEASUREMENT vsCond7 "Condizione 7 per ShutOff PTO o CC" UBYTE TE_PtoCc4ms_Symbol_CM_boolean_adm 0 0 0 1 ECU_ADDRESS 0x40004835 /end MEASUREMENT
/begin MEASUREMENT vsCond8 "Condizione 8 per ShutOff PTO o CC" UBYTE TE_PtoCc4ms_Symbol_CM_boolean_adm 0 0 0 1 ECU_ADDRESS 0x40004834 /end MEASUREMENT
/begin MEASUREMENT vsCond9 "Condizione 9 per ShutOff PTO o CC" UBYTE TE_PtoCc4ms_Symbol_CM_boolean_adm 0 0 0 1 ECU_ADDRESS 0x40004833 /end MEASUREMENT
/begin MEASUREMENT vsCruiseAct "Cruise control switch from CAN Module (1 -> switched on, 0 -> switched off)" UBYTE Vfnc4ms_CM_boolean_adm 0 0 0 1 ECU_ADDRESS 0x40004614 /end MEASUREMENT
/begin MEASUREMENT vsCruiseControlEn "Switch di abilitazione della funzione TE_CruiseControl100ms" UBYTE ConfInit_CM_boolean_adm 0 0 0 1 ECU_ADDRESS 0x40002308 /end MEASUREMENT
/begin CHARACTERISTIC vsDELTA_LIM4_TORQ "Limitazione superiore sul delta di velocità sopra quella limite" VALUE 0xFCC784 Scalar_UWORD 0 TE_CmuReqMgm4ms_Symbol_CM_uint16_Km_h 0 250 /end CHARACTERISTIC
/begin CHARACTERISTIC vsDELTA_VEH_LIM "Delta sulla velocità limite per attivare la limitazione velocità veicolo" VALUE 0xFCC782 Scalar_UWORD 0 TE_CmuReqMgm4ms_Symbol_CM_uint16_Km_h 0 250 /end CHARACTERISTIC
/begin CHARACTERISTIC vsDELTA_VEH_SPEED4CC "Delta velocità per avere la minima velocità per CC" VALUE 0xFCC6B6 Scalar_UBYTE 0 PtoCCReq4ms_Symbol_CM_uint8_Km_h 0 250 /end CHARACTERISTIC
/begin CHARACTERISTIC vsDOOR_RACC_LIN_EN "Numero di passi per raccordo tra Limitazione pedale per Doors Open e pedale" VALUE 0xFCC77A Scalar_BOOLEAN 0 TE_CmuReqMgm4ms_Symbol_CM_boolean_adm 0 1 /end CHARACTERISTIC
/begin CHARACTERISTIC vsDOUBLE_PEDAL_AV "Double potentiometer accelerator pedal available" VALUE 0xFC2C63 Scalar_BOOLEAN 0 VcmFcnEnableInit_CM_boolean_adm 0 1 /end CHARACTERISTIC
/begin MEASUREMENT vsDPConfig "Double Accelerator Pedal Configuration (0 - Single pedal and 1/2 Digital, 1 - Double potentiometers pedal)" UBYTE ConfInit_CM_boolean_adm 0 0 0 1 ECU_ADDRESS 0x400022F9 /end MEASUREMENT
/begin MEASUREMENT vsDerContr "TestPoint on PID derivative contribute to the PWM command related to FAN1 during the CLOSED-LOOP PWM management" FLOAT32_IEEE FanMgm100ms_CM_single__ 0 0 -3.4E+38 3.4E+38 ECU_ADDRESS 0x40002E2C /end MEASUREMENT
/begin MEASUREMENT vsDer_VehSpd_100ms "derivata della velocità veicolo" SWORD Vfnc100ms_CM_sfix16_En8_m_sec_2 0 0 -125 125 ECU_ADDRESS 0x4000454E /end MEASUREMENT
/begin MEASUREMENT vsDoorsOpen "egnale di porte aperte" UBYTE Vfnc100ms_CM_boolean_adm 0 0 0 1 ECU_ADDRESS 0x4000454B /end MEASUREMENT
/begin MEASUREMENT vsDoorsOpenEn "Abilitazione alla funzione doors open" UBYTE ConfInit_CM_boolean_adm 0 0 0 1 ECU_ADDRESS 0x40002302 /end MEASUREMENT
/begin CHARACTERISTIC vsEPR_ENABLE "Enable for the EPR" VALUE 0xFC5654 Scalar_BOOLEAN 0 EprMgm4ms_CM_boolean_adm 0 1 /end CHARACTERISTIC
/begin MEASUREMENT vsEffInjVol "Effective volume of fuel injected" FLOAT32_IEEE FuelConsTDC_CM_single_ul_cc 0 0 -3.4E+38 3.4E+38 ECU_ADDRESS 0x40004AF0 /end MEASUREMENT
/begin MEASUREMENT vsEngRevEn "Abilitazione alla funzione Engine revolution" UBYTE ConfInit_CM_boolean_adm 0 0 0 1 ECU_ADDRESS 0x40002305 /end MEASUREMENT
/begin MEASUREMENT vsEprEnable "EPR Enabling signal" UBYTE Epr4ms_CM_boolean_adm 0 0 0 1 ECU_ADDRESS 0x40002BF0 /end MEASUREMENT
/begin MEASUREMENT vsEprMsgOk "[OUT] Validity of EPR CAN message for enabling EPR control" UBYTE EprMgm4ms_CM_boolean_adm 0 0 0 1 ECU_ADDRESS 0x40002C04 /end MEASUREMENT
/begin MEASUREMENT vsEraseFlg "Flag di cancellazione del valore memorizzato di PTO o CC" UBYTE TE_PtoCc4ms_Symbol_CM_boolean_adm 0 0 0 1 ECU_ADDRESS 0x40004832 /end MEASUREMENT
/begin MEASUREMENT vsErrCntLim "Contatore per lo smoothing tra pedale e pedale limitato" UWORD TE_CmuReqMgm4ms_Symbol_CM_ufix16_En10_adm 0 0 0 1 ECU_ADDRESS 0x400046B0 /end MEASUREMENT
/begin CHARACTERISTIC vsFAN1_FREQ "Frequency of PWM Command related to FAN 1 " VALUE 0xFC594E Scalar_UWORD 0 FanMgm100ms_CM_ufix16_S10_Hz 0 10000 /end CHARACTERISTIC
/begin CHARACTERISTIC vsFAN1_MGM_SEL "Selector for the management of the command related to FAN1 (1 = CAN, 2 = CLOSED-LOOP, 3 = OPEN-LOOP PWM, 4 = OPEN-LOOP ON/OFF)" VALUE 0xFC594C Scalar_UBYTE 0 FanMgm100ms_CM_uint8_adm 1 4 /end CHARACTERISTIC
/begin CHARACTERISTIC vsFAN1_OFF "Threshold to deactivate FAN1 in the OPEN-LOOP ON/OFF management" VALUE 0xFC594A Scalar_UWORD 0 FanMgm100ms_CM_ufix16_En3__ 0 100 /end CHARACTERISTIC
/begin CHARACTERISTIC vsFAN1_ON "Threshold to activate FAN1 in the OPEN-LOOP ON/OFF management" VALUE 0xFC5948 Scalar_UWORD 0 FanMgm100ms_CM_ufix16_En3__ 0 100 /end CHARACTERISTIC
/begin CHARACTERISTIC vsFAN1_REQ_MIN "Minimum value of PWM command related to FAN1" VALUE 0xFC5946 Scalar_UWORD 0 FanMgm100ms_CM_ufix16_En4__ 0 100 /end CHARACTERISTIC
/begin CHARACTERISTIC vsFAN2_OFF "Threshold to deactivate FAN2 in the ON/OFF configuration" VALUE 0xFC5944 Scalar_UWORD 0 FanMgm100ms_CM_ufix16_En3__ 0 100 /end CHARACTERISTIC
/begin CHARACTERISTIC vsFAN2_ON "Threshold to activate FAN2 in the ON/OFF configuration" VALUE 0xFC5942 Scalar_UWORD 0 FanMgm100ms_CM_ufix16_En3__ 0 100 /end CHARACTERISTIC
/begin CHARACTERISTIC vsFAN_ACT_CUTOFF "PWM command related to FAN1 in case of CUT-OFF" VALUE 0xFC5940 Scalar_UWORD 0 FanMgm100ms_CM_ufix16_En3__ 0 100 /end CHARACTERISTIC
/begin CHARACTERISTIC vsFAN_ECM_OFF "PWM command in case of failure of CAN bus during FAN1 CAN management" VALUE 0xFC593E Scalar_UWORD 0 FanMgm100ms_CM_ufix16_En3__ 0 100 /end CHARACTERISTIC
/begin CHARACTERISTIC vsFUEL_C02_PERC "Total percentage of Carbon Dioxide (CO2) in the fuel composition" VALUE 0xFCC954 Scalar_UWORD 0 FuelConsTDC_CM_ufix16_Sp0001__ 0 1 /end CHARACTERISTIC
/begin CHARACTERISTIC vsFUEL_C2H6_PERC "Total percentage of Ethane (C2H6) in the fuel composition" VALUE 0xFCC952 Scalar_UWORD 0 FuelConsTDC_CM_ufix16_Sp0001__ 0 1 /end CHARACTERISTIC
/begin CHARACTERISTIC vsFUEL_C3H8_PERC "Total percentage of Propane or other (C3H8) in the fuel composition" VALUE 0xFCC950 Scalar_UWORD 0 FuelConsTDC_CM_ufix16_Sp0001__ 0 1 /end CHARACTERISTIC
/begin CHARACTERISTIC vsFUEL_CH4_PERC "Total percentage of Methane (CH4) in the fuel composition" VALUE 0xFCC94E Scalar_UWORD 0 FuelConsTDC_CM_ufix16_Sp0001__ 0 1 /end CHARACTERISTIC
/begin CHARACTERISTIC vsFUEL_LEVEL_GAIN "Fuel Percentage Gain" VALUE 0xFCC69C Scalar_UWORD 0 TE_FuelLevel1s_CM_ufix16_En4_adm 0 100 /end CHARACTERISTIC
/begin CHARACTERISTIC vsFUEL_LEVEL_OFFSET " Fuel Percentage Offset " VALUE 0xFCC69A Scalar_SWORD 0 TE_FuelLevel1s_CM_sfix16_En4__ -100 100 /end CHARACTERISTIC
/begin CHARACTERISTIC vsFUEL_LEV_IND_FREQ "Fuel level frequency in Hz for analogue indicator pwm" VALUE 0xFCC698 Scalar_UWORD 0 TE_FuelLevel1s_CM_ufix16_S10_Hz 0 10000 /end CHARACTERISTIC
/begin CHARACTERISTIC vsFUEL_LEV_LOW_DELTA "Fuel Percentage delta to add to FUEL_LEV_LOW_THR for high hysteresis limit after which switch off the fuel low level lamp" VALUE 0xFCC696 Scalar_UWORD 0 TE_FuelLevel1s_CM_ufix16_En4_adm 0 100 /end CHARACTERISTIC
/begin CHARACTERISTIC vsFUEL_LEV_LOW_THR "Fuel Percentage threshold for low hysteresis limit under which switch on the fuel low level lamp" VALUE 0xFCC694 Scalar_UWORD 0 TE_FuelLevel1s_CM_ufix16_En4_adm 0 100 /end CHARACTERISTIC
/begin CHARACTERISTIC vsFUEL_LOW_RPM_INIT "Selector to enable to keep on the fuel low lamp until rpm is > 0." VALUE 0xFCC693 Scalar_BOOLEAN 0 TE_FuelLevel1s_CM_boolean_adm 0 1 /end CHARACTERISTIC
/begin CHARACTERISTIC vsFUEL_N2_PERC "Total percentage of Nitrogen (N2) in the fuel composition" VALUE 0xFCC94C Scalar_UWORD 0 FuelConsTDC_CM_ufix16_Sp0001__ 0 1 /end CHARACTERISTIC
/begin MEASUREMENT vsFan1ActReqPwm "[OUT] DutyCycle for FAN1 computed in function of coolant temperature and engine speed" UWORD FanMgm100ms_CM_ufix16_En3__ 0 0 0 100 ECU_ADDRESS 0x40002E2A /end MEASUREMENT
/begin MEASUREMENT vsFan1Duty "PWM command related to FAN1" UWORD FanCool100ms_CM_ufix16_En3__ 0 0 0 100 ECU_ADDRESS 0x40002DD0 /end MEASUREMENT
/begin MEASUREMENT vsFan1PwmReq "TestPoint on the requested PWM command related to FAN1" UWORD FanMgm100ms_CM_ufix16_En3__ 0 0 0 100 ECU_ADDRESS 0x40002E28 /end MEASUREMENT
/begin MEASUREMENT vsFan1Speed "FAN1 speed expressed in RPM" UWORD FanMgm100ms_CM_uint16_rpm 0 0 0 10000 ECU_ADDRESS 0x40002E26 /end MEASUREMENT
/begin MEASUREMENT vsFan2ActReqPwm "[OUT] DutyCycle for FAN2 computed in function of coolant temperature and engine speed" UWORD FanMgm100ms_CM_ufix16_En3__ 0 0 0 100 ECU_ADDRESS 0x40002E24 /end MEASUREMENT
/begin MEASUREMENT vsFan2Cmd "Digital ON/OFF command related to FAN2" UBYTE FanCool100ms_CM_boolean_adm 0 0 0 1 ECU_ADDRESS 0x40002DCE /end MEASUREMENT
/begin MEASUREMENT vsFanCoolEn "Primary cooling FAN control enable" UBYTE ConfInit_CM_boolean_adm 0 0 0 1 ECU_ADDRESS 0x40002303 /end MEASUREMENT
/begin MEASUREMENT vsFanSpeedError "FAN1 speed error computed as: (target speed - actual speed)" SWORD FanMgm100ms_CM_int16_rpm 0 0 -10000 10000 ECU_ADDRESS 0x40002E22 /end MEASUREMENT
/begin MEASUREMENT vsFanSpeedTarget "[OUT] FAN1 target Speed computed in function of coolant temperature and engine speed" UWORD FanMgm100ms_CM_uint16_rpm 0 0 0 10000 ECU_ADDRESS 0x40002E20 /end MEASUREMENT
/begin MEASUREMENT vsFanSpeedTargetFilt "Filtered target speed for FAN1 speed control" UWORD FanMgm100ms_CM_uint16_rpm 0 0 0 10000 ECU_ADDRESS 0x40002E1E /end MEASUREMENT
/begin MEASUREMENT vsFuelConsEn "Abilitazione alla funzione fuel consumption" UBYTE ConfInit_CM_boolean_adm 0 0 0 1 ECU_ADDRESS 0x40002300 /end MEASUREMENT
/begin MEASUREMENT vsFuelInstCons_HR "Instantaneus Fuel Consumption in High Resolution (ul)" FLOAT32_IEEE FuelConsTDC_CM_single_ul 0 0 -3.4E+38 3.4E+38 ECU_ADDRESS 0x40004AEC /end MEASUREMENT
/begin MEASUREMENT vsFuelIst "Current Fuel economy at current vehicle speed (SAE 5.2.5.67)" UWORD J1939dl_Tx100ms_CM_ufix16_En9_km_l 0 0 0 125.5 ECU_ADDRESS 0x40004AB4 /end MEASUREMENT
/begin MEASUREMENT vsFuelIstTmp "Current Fuel economy at current vehicle speed (SAE 5.2.5.67)" UWORD FuelConsTDC_CM_ufix16_En9_km_l 0 0 0 125.5 ECU_ADDRESS 0x40004AE8 /end MEASUREMENT
/begin MEASUREMENT vsFuelLev "Percentuale livello combustibile" UBYTE DiagSym100ms_CM_ufix8_Sp4__ 0 0 0 100 ECU_ADDRESS 0x40004572 /end MEASUREMENT
/begin MEASUREMENT vsFuelLevEn "Abilitazione alla funzione fuel level" UBYTE ConfInit_CM_boolean_adm 0 0 0 1 ECU_ADDRESS 0x40002304 /end MEASUREMENT
/begin MEASUREMENT vsFuelLevIndDC "Fuel level duty cycle for analogue indicator" UWORD Vfnc1s_CM_ufix16_En4__ 0 0 0 100 ECU_ADDRESS 0x40004576 /end MEASUREMENT
/begin MEASUREMENT vsFuelLevIndFreq "Fuel level frequence for analogue indicator" UWORD Vfnc1s_CM_ufix16_S10_Hz 0 0 0 10000 ECU_ADDRESS 0x40004574 /end MEASUREMENT
/begin MEASUREMENT vsFuelLevLowLamp "Fuel Low level lamp signal" UBYTE J1939dl_Tx1s_CM_boolean_adm 0 0 0 1 ECU_ADDRESS 0x40004573 /end MEASUREMENT
/begin MEASUREMENT vsFuelMassFlow "Fuel Mass Flow" UWORD VfncTDC_CM_ufix16_Sp05_kg_h 0 0 0 3212.75 ECU_ADDRESS 0x40004AB8 /end MEASUREMENT
/begin MEASUREMENT vsFuelMassFlowTmp "Fuel Mass Flow testpoint" UWORD FuelConsTDC_CM_ufix16_Sp05_kg_h 0 0 0 3212.75 ECU_ADDRESS 0x40004AE6 /end MEASUREMENT
/begin MEASUREMENT vsFuelRate "Amount of fuel consumed by the engine per unit of time (SAE 5.2.5.63)" UWORD J1939dl_Tx100ms_CM_ufix16_Sp05_l_h 0 0 0 3212.75 ECU_ADDRESS 0x40004AB6 /end MEASUREMENT
/begin MEASUREMENT vsFuelRateTmp "Fuel Rate testpoint" UWORD FuelConsTDC_CM_ufix16_Sp05_l_h 0 0 0 3212.75 ECU_ADDRESS 0x40004AE4 /end MEASUREMENT
/begin MEASUREMENT vsFuelTotCons "Accumulated amount of fuel used during vehicle operation (SAE 5.2.5.66)" ULONG J1939dl_Tx1s_CM_ufix32_Sp05_l 0 0 0 210554060.75 ECU_ADDRESS 0x40004AC0 /end MEASUREMENT
/begin MEASUREMENT vsFuelTotConsTmp "Accumulated amount of fuel used during vehicle operation (SAE 5.2.5.66)" ULONG FuelConsTDC_CM_ufix32_Sp05_l 0 0 0 210554060.75 ECU_ADDRESS 0x40004AE0 /end MEASUREMENT
/begin MEASUREMENT vsFuelTotCons_EE_HR "Total Fuel Consumption stored in EE in High Resolution (ul)" FLOAT32_IEEE FuelConsTDC_CM_single_ul 0 0 -3.4E+38 3.4E+38 ECU_ADDRESS 0x40004ADC /end MEASUREMENT
/begin MEASUREMENT vsFuelTotCons_HR "Total Fuel Consumption in High Resolution (ul)" FLOAT32_IEEE FuelConsTDC_CM_single_ul 0 0 -3.4E+38 3.4E+38 ECU_ADDRESS 0x40004AD8 /end MEASUREMENT
/begin MEASUREMENT vsFuelTrip "uel consumed during all or part of a trip (SAE 5.2.5.64)" ULONG J1939dl_Tx1s_CM_ufix32_Sp05_l 0 0 0 210554060.75 ECU_ADDRESS 0x40004ABC /end MEASUREMENT
/begin MEASUREMENT vsFuelTripTmp "uel consumed during all or part of a trip (SAE 5.2.5.64)" ULONG FuelConsTDC_CM_ufix32_Sp05_l 0 0 0 210554060.75 ECU_ADDRESS 0x40004AD4 /end MEASUREMENT
/begin MEASUREMENT vsGainBattFan1Dc "Test Point. Fattore che corregge il duty-cycles applicato alla Fan1 in funzione di Vbatt" UWORD FanMgm100ms_CM_ufix16_En14_adm 0 0 0 2 ECU_ADDRESS 0x40002E1C /end MEASUREMENT
/begin MEASUREMENT vsGearCoupled "Informazione di cambio accoppiato" UBYTE Crkc4ms_CM_boolean_adm 0 0 0 1 ECU_ADDRESS 0x4000461F /end MEASUREMENT
/begin MEASUREMENT vsIdleAcc "Digital Output: IdleAcc" UBYTE J1939dl_Tx50ms_CM_uint8_adm 0 0 0 3 ECU_ADDRESS 0x4000454D /end MEASUREMENT
/begin MEASUREMENT vsIdnSpmErrState "[OUT] Absence of fault on diag line IDN_SPM for enabling EPR control" UBYTE EprMgm4ms_CM_boolean_adm 0 0 0 1 ECU_ADDRESS 0x40002C03 /end MEASUREMENT
/begin MEASUREMENT vsInstQInj "Instantaneous fuel quantity injected" UWORD Epr4ms_CM_ufix16_En8_kg_hour 0 0 0 140 ECU_ADDRESS 0x40002BF2 /end MEASUREMENT
/begin MEASUREMENT vsIntContr "TestPoint on PID integrative contribute to the PWM command related to FAN1 during the CLOSED-LOOP PWM management" FLOAT32_IEEE FanMgm100ms_CM_single__ 0 0 -3.4E+38 3.4E+38 ECU_ADDRESS 0x40002E18 /end MEASUREMENT
/begin MEASUREMENT vsIrrevShutOffReq "ShutOff irreversibile in cui è cancellata la memorizzazione Obj PTO o CC" UBYTE TE_PtoCc4ms_Symbol_CM_boolean_adm 0 0 0 1 ECU_ADDRESS 0x40004831 /end MEASUREMENT
/begin CHARACTERISTIC vsKFHW_FUEL_IST "Instantaneous Fuel consumption low pass filter constant" VALUE 0xFCC94A Scalar_UWORD 0 FuelConsTDC_CM_ufix16_En10_adm 0 1 /end CHARACTERISTIC
/begin CHARACTERISTIC vsKFHW_FUEL_RATE "Fuel rate low pass filter constant" VALUE 0xFCC948 Scalar_UWORD 0 FuelConsTDC_CM_ufix16_En10_adm 0 1 /end CHARACTERISTIC
/begin MEASUREMENT vsKickDown "Output Kick down Rep" UBYTE J1939dl_Tx50ms_CM_boolean_adm 0 0 0 1 ECU_ADDRESS 0x4000454C /end MEASUREMENT
/begin CHARACTERISTIC vsLIM_PERF_PDL_DO "Limitazione richiesta pedale per doors open" VALUE 0xFCC780 Scalar_UWORD 0 TE_CmuReqMgm4ms_Symbol_CM_ufix16_En4__ 0 100 /end CHARACTERISTIC
/begin CHARACTERISTIC vsLIQUID_FUEL_DENS "Density of liquid fuel (kg/l)" VALUE 0xFCC944 Scalar_FLOAT32_IEEE 0 FuelConsTDC_CM_single_kg_l 0.003 1 /end CHARACTERISTIC
/begin CHARACTERISTIC vsLNG_FUEL_DENS_MODE "Density of liquid fuel (kg/l)" VALUE 0xFCC940 Scalar_BOOLEAN 0 FuelConsTDC_CM_boolean_kg_l 0 1 /end CHARACTERISTIC
/begin MEASUREMENT vsLfApplEn "Abilitazione funzioni LF" UBYTE ConfInit_CM_boolean_adm 0 0 0 1 ECU_ADDRESS 0x4000230C /end MEASUREMENT
/begin MEASUREMENT vsLongResume "vsLongResume" UBYTE TE_PtoCc4ms_Symbol_CM_boolean_adm 0 0 0 1 ECU_ADDRESS 0x40004830 /end MEASUREMENT
/begin CHARACTERISTIC vsMAX_4RPM_OUT_RANGE "Tempo massimo per giri motore fuori da range ammesso" VALUE 0xFCC8CA Scalar_UWORD 0 TE_PtoCc4ms_Symbol_CM_ufix16_En4_sec 0 240 /end CHARACTERISTIC
/begin CHARACTERISTIC vsMAX_CC_ERROR "Massima deviazione della velocità da obiettivo CC" VALUE 0xFCC8C8 Scalar_UWORD 0 TE_PtoCc4ms_Symbol_CM_ufix16_En8_Km_h 0 250 /end CHARACTERISTIC
/begin CHARACTERISTIC vsMAX_CMP_REQ "valore richiesta come criterio principale (1 si; 0 no)" VALUE 0xFCC906 Scalar_BOOLEAN 0 TE_TSC1Manager4ms_Symbol_CM_boolean_adm 0 1 /end CHARACTERISTIC
/begin CHARACTERISTIC vsMAX_DECEL "Massima decelerazione in velocità veicolo" VALUE 0xFCC8C6 Scalar_UWORD 0 TE_PtoCc4ms_Symbol_CM_ufix16_En8_Bn250_m_sec_2 -250 0 /end CHARACTERISTIC
/begin CHARACTERISTIC vsMAX_ON_REQ "Richiesta in corso come criterio principale (1 si; 0 no)" VALUE 0xFCC905 Scalar_BOOLEAN 0 TE_TSC1Manager4ms_Symbol_CM_boolean_adm 0 1 /end CHARACTERISTIC
/begin CHARACTERISTIC vsMAX_PRI_REQ "Priorità come criterio principale (1 si; 0 no)" VALUE 0xFCC904 Scalar_BOOLEAN 0 TE_TSC1Manager4ms_Symbol_CM_boolean_adm 0 1 /end CHARACTERISTIC
/begin CHARACTERISTIC vsMAX_PTO_ERROR "Massima deviazione dei giri da obiettivo PTO" VALUE 0xFCC8C4 Scalar_UWORD 0 TE_PtoCc4ms_Symbol_CM_uint16_rpm 0 10000 /end CHARACTERISTIC
/begin CHARACTERISTIC vsMAX_TIME_4ACC "Tempo massimo per aumento di coppia per eccesso di coppia esterna" VALUE 0xFCC8C2 Scalar_UWORD 0 TE_PtoCc4ms_Symbol_CM_uint16_sec 0 65535 /end CHARACTERISTIC
/begin CHARACTERISTIC vsMAX_TIME_4CC_ERR "Tempo massimo per errore di velocità in CC" VALUE 0xFCC8C0 Scalar_UWORD 0 TE_PtoCc4ms_Symbol_CM_uint16_sec 0 65535 /end CHARACTERISTIC
/begin CHARACTERISTIC vsMAX_TIME_4DEC "Tempo massimo per decremento di coppia per decremento di coppia esterna" VALUE 0xFCC8BE Scalar_UWORD 0 TE_PtoCc4ms_Symbol_CM_uint16_sec 0 65535 /end CHARACTERISTIC
/begin CHARACTERISTIC vsMAX_TIME_4PTO_ERR "Tempo massimo per errore di giri in PTO" VALUE 0xFCC8BC Scalar_UWORD 0 TE_PtoCc4ms_Symbol_CM_uint16_sec 0 65535 /end CHARACTERISTIC
/begin CHARACTERISTIC vsMAX_VEH_SPEED4CC "Massima velocità per CC" VALUE 0xFCC6B5 Scalar_UBYTE 0 PtoCCReq4ms_Symbol_CM_uint8_Km_h 0 250 /end CHARACTERISTIC
/begin CHARACTERISTIC vsMAX_VEH_SPEED4PTO "massima velocità per funzione PTO" VALUE 0xFCC6B4 Scalar_UBYTE 0 PtoCCReq4ms_Symbol_CM_uint8_Km_h 0 250 /end CHARACTERISTIC
/begin MEASUREMENT vsMAirReqEn "Flag di attivazione della strategia di richiesta apertura variabile delle valvole di aspirazione" UBYTE ConfInit_CM_boolean_adm 0 0 0 1 ECU_ADDRESS 0x4000230D /end MEASUREMENT
/begin MEASUREMENT vsMFLVHold "Flag Hold On for PTO or CC" UBYTE Vfnc4ms_CM_boolean_adm 0 0 0 1 ECU_ADDRESS 0x40004620 /end MEASUREMENT
/begin MEASUREMENT vsMFLVOff "Flag Off On for PTO or CC" UBYTE Vfnc4ms_CM_boolean_adm 0 0 0 1 ECU_ADDRESS 0x40004621 /end MEASUREMENT
/begin MEASUREMENT vsMFLVOnState "Stato MFLV attivo" UBYTE TE_PtoCc4ms_Symbol_CM_uint8_adm 0 0 0 2 ECU_ADDRESS 0x4000482F /end MEASUREMENT
/begin MEASUREMENT vsMFLVReq "Richiesta PTO or CC" UBYTE Vfnc4ms_CM_boolean_adm 0 0 0 1 ECU_ADDRESS 0x40004622 /end MEASUREMENT
/begin MEASUREMENT vsMFLVResume "Flag Resume On for PTO or CC" UBYTE Vfnc4ms_CM_boolean_adm 0 0 0 1 ECU_ADDRESS 0x40004623 /end MEASUREMENT
/begin MEASUREMENT vsMFLVSetMinus "Flag for decrease PTO or CC Obj" UBYTE Vfnc4ms_CM_boolean_adm 0 0 0 1 ECU_ADDRESS 0x40004624 /end MEASUREMENT
/begin MEASUREMENT vsMFLVSetPlus "Flag for encrease PTO or CC Obj" UBYTE Vfnc4ms_CM_boolean_adm 0 0 0 1 ECU_ADDRESS 0x40004625 /end MEASUREMENT
/begin MEASUREMENT vsMFLVShutOff "FLV ShutOff request" UBYTE Vfnc4ms_CM_boolean_adm 0 0 0 1 ECU_ADDRESS 0x4000460E /end MEASUREMENT
/begin MEASUREMENT vsMFLVSt "Stato MFLV" UBYTE TE_PtoCc4ms_Symbol_CM_uint8_adm 0 0 0 4 ECU_ADDRESS 0x4000482E /end MEASUREMENT
/begin MEASUREMENT vsMFLVState "Stato MFLV" UBYTE Vfnc4ms_CM_uint8_adm 0 0 0 4 ECU_ADDRESS 0x4000462F /end MEASUREMENT
/begin CHARACTERISTIC vsMINUS_START_STEP "Waiting time per decremento Rpm Obj da pulsante start" VALUE 0xFCC67C Scalar_SWORD 0 TE_StartStopRpmMgm100ms_Symbol_CM_int16_rpm -10000 0 /end CHARACTERISTIC
/begin CHARACTERISTIC vsMIN_VEH_SPEED4PTO "Minima velocità per PTO" VALUE 0xFCC6B3 Scalar_UBYTE 0 PtoCCReq4ms_Symbol_CM_uint8_Km_h 0 250 /end CHARACTERISTIC
/begin MEASUREMENT vsMaskMgmEn "Abilitazione per caricare i nuovi parametri della maschera di ShutOff per PTO o CC" UBYTE TE_PtoCc4ms_Symbol_CM_boolean_adm 0 0 0 1 ECU_ADDRESS 0x4000482D /end MEASUREMENT
/begin MEASUREMENT vsMaxVehSpeed4Pto "Massima velocità per funzione PTO" UBYTE Vfnc4ms_CM_uint8_Km_h 0 0 0 250 ECU_ADDRESS 0x40004644 /end MEASUREMENT
/begin MEASUREMENT vsMechPTOEng "echanical PTO Engaged" UBYTE Vfnc4ms_CM_boolean_adm 0 0 0 1 ECU_ADDRESS 0x4000460C /end MEASUREMENT
/begin MEASUREMENT vsMemoFlg "Flag di memorizzazione del valore di PTO o CC" UBYTE TE_PtoCc4ms_Symbol_CM_boolean_adm 0 0 0 1 ECU_ADDRESS 0x4000482C /end MEASUREMENT
/begin MEASUREMENT vsMemoReq "vsMemoReq" UBYTE TE_PtoCc4ms_Symbol_CM_boolean_adm 0 0 0 1 ECU_ADDRESS 0x4000482B /end MEASUREMENT
/begin MEASUREMENT vsMinusRamp "vsMinusRamp" UBYTE TE_PtoCc4ms_Symbol_CM_boolean_adm 0 0 0 1 ECU_ADDRESS 0x4000482A /end MEASUREMENT
/begin MEASUREMENT vsMinusStep "vsMinusStep" UBYTE TE_PtoCc4ms_Symbol_CM_boolean_adm 0 0 0 1 ECU_ADDRESS 0x40004829 /end MEASUREMENT
/begin MEASUREMENT vsMod1 "Control mode da  primo TSC1" UBYTE TE_TSC1Manager4ms_Symbol_CM_uint8_adm 0 0 0 3 ECU_ADDRESS 0x40004A81 /end MEASUREMENT
/begin MEASUREMENT vsMod2 "Control mode da  secondo TSC1" UBYTE TE_TSC1Manager4ms_Symbol_CM_uint8_adm 0 0 0 3 ECU_ADDRESS 0x40004A80 /end MEASUREMENT
/begin MEASUREMENT vsMod3 "Control mode da  terzo TSC1" UBYTE TE_TSC1Manager4ms_Symbol_CM_uint8_adm 0 0 0 3 ECU_ADDRESS 0x40004A7F /end MEASUREMENT
/begin MEASUREMENT vsNeutral "Stato del Neutral (folle inserita) da CAN o ingresso digitale" UBYTE Vfnc4ms_CM_boolean_adm 0 0 0 1 ECU_ADDRESS 0x4000461A /end MEASUREMENT
/begin MEASUREMENT vsNoEprDiag "[OUT] Absence of EPR diagnosis for enabling EPR Control " UBYTE EprMgm4ms_CM_boolean_adm 0 0 0 1 ECU_ADDRESS 0x40002C02 /end MEASUREMENT
/begin MEASUREMENT vsNumRifor "Numero di rifornimenti effettuati" UWORD VfncTDC_CM_uint16_adm 0 0 0 65000 ECU_ADDRESS 0x40004ABA /end MEASUREMENT
/begin CHARACTERISTIC vsOFFSET_CC_OBJ "Offset su obiettivo CC per Vehicle Speed Limiter" VALUE 0xFCC686 Scalar_UWORD 0 TE_VehicleSpeedLim100ms_Symbol_CM_uint16_Km_h 0 250 /end CHARACTERISTIC
/begin MEASUREMENT vsOff "vsOff" UBYTE TE_PtoCc4ms_Symbol_CM_boolean_adm 0 0 0 1 ECU_ADDRESS 0x40004828 /end MEASUREMENT
/begin CHARACTERISTIC vsPDL_REQ_PRI "Priorità della richiesta pedale" VALUE 0xFCC907 Scalar_BYTE 0 TE_TSC1Manager4ms_Symbol_CM_int8_adm -1 3 /end CHARACTERISTIC
/begin CHARACTERISTIC vsPID_ENABLE "[FIX] Enable for the Closed-Loop control on the FAN1 speed." VALUE 0xFC593C Scalar_BOOLEAN 0 FanMgm100ms_CM_boolean_adm 0 1 /end CHARACTERISTIC
/begin CHARACTERISTIC vsPID_KD "Derivative gain for PID control of FAN1 speed" VALUE 0xFC5938 Scalar_FLOAT32_IEEE 0 FanMgm100ms_CM_single__ 0 100 /end CHARACTERISTIC
/begin CHARACTERISTIC vsPID_KD_N "Derivative filter coefficient for PID control of FAN1 speed" VALUE 0xFC5934 Scalar_FLOAT32_IEEE 0 FanMgm100ms_CM_single__ 0 100 /end CHARACTERISTIC
/begin CHARACTERISTIC vsPID_KI "Integrative gain for PID control of FAN1 speed" VALUE 0xFC5930 Scalar_FLOAT32_IEEE 0 FanMgm100ms_CM_single__ 0 100 /end CHARACTERISTIC
/begin CHARACTERISTIC vsPID_KP "Proportional gain for PID control of FAN1 speed" VALUE 0xFC592C Scalar_FLOAT32_IEEE 0 FanMgm100ms_CM_single__ 0 100 /end CHARACTERISTIC
/begin CHARACTERISTIC vsPID_SAT_H "Maximum PID authority for the control of FAN1 speed" VALUE 0xFC5928 Scalar_FLOAT32_IEEE 0 FanMgm100ms_CM_single__ 0 100 /end CHARACTERISTIC
/begin CHARACTERISTIC vsPID_SAT_L "Minimum PID authority for the control of FAN1 speed" VALUE 0xFC5924 Scalar_FLOAT32_IEEE 0 FanMgm100ms_CM_single__ 0 100 /end CHARACTERISTIC
/begin CHARACTERISTIC vsPLUS_START_STEP "Waiting time per incremento Rpm Obj da pulsante start" VALUE 0xFCC66A Scalar_UWORD 0 TE_StartStopRpmMgm100ms_Symbol_CM_uint16_rpm 0 10000 /end CHARACTERISTIC
/begin MEASUREMENT vsPRailTarget "Rail target pressure (absolute)" UWORD Epr4ms_CM_uint16_mbar 0 0 0 13793 ECU_ADDRESS 0x40002BF4 /end MEASUREMENT
/begin CHARACTERISTIC vsPTANK_REF "Gas Pressure Reference" VALUE 0xFCC692 Scalar_UBYTE 0 TE_FuelLevel1s_CM_ufix8_S1000_mbar 1000 250000 /end CHARACTERISTIC
/begin CHARACTERISTIC vsPTANK_STEP_DW "Gas Pressure Reference" VALUE 0xFCC691 Scalar_UBYTE 0 TE_FuelLevel1s_CM_ufix8_S100_mbar 0 25000 /end CHARACTERISTIC
/begin CHARACTERISTIC vsPTANK_STEP_UP "Gas Pressure Reference" VALUE 0xFCC690 Scalar_UBYTE 0 TE_FuelLevel1s_CM_ufix8_S100_mbar 0 25000 /end CHARACTERISTIC
/begin MEASUREMENT vsPTOState "Stato della PTO" UBYTE Vfnc4ms_CM_uint8_adm 0 0 0 31 ECU_ADDRESS 0x40004643 /end MEASUREMENT
/begin CHARACTERISTIC vsPTO_DIG_EN "Abilitazione utilizzo ingressi digitali per PTO" VALUE 0xFCC6B2 Scalar_BOOLEAN 0 PtoCCReq4ms_Symbol_CM_boolean_adm 0 1 /end CHARACTERISTIC
/begin CHARACTERISTIC vsPTO_SHTOFF_IRREV_C "Calibrazione per condizioni ShutOff irreversibile per PTO" VALUE 0xFCC8BA Scalar_UWORD 0 TE_PtoCc4ms_Symbol_CM_uint16_adm 0 65535 /end CHARACTERISTIC
/begin CHARACTERISTIC vsPTO_SHTOFF_REV_COND "Calibrazione per condizioni ShutOff reversibile per PTO" VALUE 0xFCC8B8 Scalar_UWORD 0 TE_PtoCc4ms_Symbol_CM_uint16_adm 0 65535 /end CHARACTERISTIC
/begin CHARACTERISTIC vsPTO_SPD_OBJ_GRAD "Limitazione di gradiente per obiettivo giri PTO" VALUE 0xFCC8B6 Scalar_UWORD 0 TE_PtoCc4ms_Symbol_CM_uint16_rpm_s 0 10000 /end CHARACTERISTIC
/begin CHARACTERISTIC vsPTO_STDBY_MEM_REQ_C "Calibrazione per condizioni ShutOff Standby con memorizzazione per PTO" VALUE 0xFCC8B4 Scalar_UWORD 0 TE_PtoCc4ms_Symbol_CM_uint16_adm 0 65535 /end CHARACTERISTIC
/begin CHARACTERISTIC vsPTO_STDBY_REQ_COND "Calibrazione per condizioni ShutOff Standby per PTO" VALUE 0xFCC8B2 Scalar_UWORD 0 TE_PtoCc4ms_Symbol_CM_uint16_adm 0 65535 /end CHARACTERISTIC
/begin MEASUREMENT vsPTank "Pressione metano bombole (relativa) da salvare in EEProm" UWORD VfncTDC_CM_ufix16_E2_mbar 0 0 0 250000 ECU_ADDRESS 0x40004AB2 /end MEASUREMENT
/begin CHARACTERISTIC vsPULSE_FOR_ROTATION "Number of pulses for rotation" VALUE 0xFC5922 Scalar_UBYTE 0 FanMgm100ms_CM_uint8_adm 0 100 /end CHARACTERISTIC
/begin MEASUREMENT vsParkBrk "Parking Brake switch from CAN Module (1 -> Actuated, 0 -> Not Actuated) o digital signal" UBYTE Crkc4ms_CM_boolean_adm 0 0 0 1 ECU_ADDRESS 0x4000461D /end MEASUREMENT
/begin MEASUREMENT vsPedErrLimF "Errore sulla richiesta pedale rispetto alla richiesta pedale limitata" UWORD TE_CmuReqMgm4ms_Symbol_CM_ufix16_En4__ 0 0 0 100 ECU_ADDRESS 0x400046AE /end MEASUREMENT
/begin MEASUREMENT vsPedTorqReqLim "[OUT] Limitazione della percentuale di coppia richiesta da pedale" UWORD TE_CmuReqMgm4ms_Symbol_CM_ufix16_En4__ 0 0 0 100 ECU_ADDRESS 0x400046AC /end MEASUREMENT
/begin MEASUREMENT vsPlusRamp "vsPlusRamp" UBYTE TE_PtoCc4ms_Symbol_CM_boolean_adm 0 0 0 1 ECU_ADDRESS 0x40004827 /end MEASUREMENT
/begin MEASUREMENT vsPlusStep "vsPlusStep" UBYTE TE_PtoCc4ms_Symbol_CM_boolean_adm 0 0 0 1 ECU_ADDRESS 0x40004826 /end MEASUREMENT
/begin MEASUREMENT vsPrailTarget "[OUT] Rail target pressure table in function of engine working point" UWORD EprMgm4ms_CM_uint16_mbar 0 0 0 13793 ECU_ADDRESS 0x40002C00 /end MEASUREMENT
/begin MEASUREMENT vsPri1 "Priorità da  primo TSC1" UBYTE TE_TSC1Manager4ms_Symbol_CM_uint8_adm 0 0 0 3 ECU_ADDRESS 0x40004A7E /end MEASUREMENT
/begin MEASUREMENT vsPri2 "Priorità da  secondo TSC1" UBYTE TE_TSC1Manager4ms_Symbol_CM_uint8_adm 0 0 0 3 ECU_ADDRESS 0x40004A7D /end MEASUREMENT
/begin MEASUREMENT vsPri3 "Priorità da  terzo TSC1" UBYTE TE_TSC1Manager4ms_Symbol_CM_uint8_adm 0 0 0 3 ECU_ADDRESS 0x40004A7C /end MEASUREMENT
/begin MEASUREMENT vsPri_w1_Sr_PriOff "Flag priorità vincitrice primo TSC1 in richiesta di velocità con PriOff" UBYTE TE_TSC1Manager4ms_Symbol_CM_boolean_adm 0 0 0 1 ECU_ADDRESS 0x40004A7B /end MEASUREMENT
/begin MEASUREMENT vsPri_w1_Sr_PriOn "Flag priorità vincitrice primo TSC1 in richiesta di velocità con PriOn" UBYTE TE_TSC1Manager4ms_Symbol_CM_boolean_adm 0 0 0 1 ECU_ADDRESS 0x40004A7A /end MEASUREMENT
/begin MEASUREMENT vsPri_w1_Tr_PriOff "Flag priorità vincitrice primo TSC1 in richiesta di coppia con PriOff" UBYTE TE_TSC1Manager4ms_Symbol_CM_boolean_adm 0 0 0 1 ECU_ADDRESS 0x40004A79 /end MEASUREMENT
/begin MEASUREMENT vsPri_w1_Tr_PriOn "Flag priorità vincitrice primo TSC1 in richiesta di coppia con PriOn" UBYTE TE_TSC1Manager4ms_Symbol_CM_boolean_adm 0 0 0 1 ECU_ADDRESS 0x40004A78 /end MEASUREMENT
/begin MEASUREMENT vsPri_w2_Sr_PriOff "Flag priorità vincitrice secondo TSC1 in richiesta di velocità con PriOff" UBYTE TE_TSC1Manager4ms_Symbol_CM_boolean_adm 0 0 0 1 ECU_ADDRESS 0x40004A77 /end MEASUREMENT
/begin MEASUREMENT vsPri_w2_Sr_PriOn "Flag priorità vincitrice secondo TSC1 in richiesta di velocità con PriOn" UBYTE TE_TSC1Manager4ms_Symbol_CM_boolean_adm 0 0 0 1 ECU_ADDRESS 0x40004A76 /end MEASUREMENT
/begin MEASUREMENT vsPri_w2_Tr_PriOff "Flag priorità vincitrice secondo TSC1 in richiesta di coppia con PriOff" UBYTE TE_TSC1Manager4ms_Symbol_CM_boolean_adm 0 0 0 1 ECU_ADDRESS 0x40004A75 /end MEASUREMENT
/begin MEASUREMENT vsPri_w2_Tr_PriOn "Flag priorità vincitrice secondo TSC1 in richiesta di coppia con PriOn" UBYTE TE_TSC1Manager4ms_Symbol_CM_boolean_adm 0 0 0 1 ECU_ADDRESS 0x40004A74 /end MEASUREMENT
/begin MEASUREMENT vsPri_w3_Sr_PriOff "Flag priorità vincitrice terzo TSC1 in richiesta di velocità con PriOff" UBYTE TE_TSC1Manager4ms_Symbol_CM_boolean_adm 0 0 0 1 ECU_ADDRESS 0x40004A73 /end MEASUREMENT
/begin MEASUREMENT vsPri_w3_Sr_PriOn "Flag priorità vincitrice terzo TSC1 in richiesta di velocità con PriOn" UBYTE TE_TSC1Manager4ms_Symbol_CM_boolean_adm 0 0 0 1 ECU_ADDRESS 0x40004A72 /end MEASUREMENT
/begin MEASUREMENT vsPri_w3_Tr_PriOff "Flag priorità vincitrice terzo TSC1 in richiesta di coppia con PriOff" UBYTE TE_TSC1Manager4ms_Symbol_CM_boolean_adm 0 0 0 1 ECU_ADDRESS 0x40004A71 /end MEASUREMENT
/begin MEASUREMENT vsPri_w3_Tr_PriOn "Flag priorità vincitrice terzo TSC1 in richiesta di coppia con PriOn" UBYTE TE_TSC1Manager4ms_Symbol_CM_boolean_adm 0 0 0 1 ECU_ADDRESS 0x40004A70 /end MEASUREMENT
/begin MEASUREMENT vsPri_w4_Tr_PriOff "Flag priorità vincitrice richiesta di coppia pedale con PriOff" UBYTE TE_TSC1Manager4ms_Symbol_CM_boolean_adm 0 0 0 1 ECU_ADDRESS 0x40004A6F /end MEASUREMENT
/begin MEASUREMENT vsPri_w4_Tr_PriOn "Flag priorità vincitrice richiesta di coppia pedale con PriOn" UBYTE TE_TSC1Manager4ms_Symbol_CM_boolean_adm 0 0 0 1 ECU_ADDRESS 0x40004A6E /end MEASUREMENT
/begin MEASUREMENT vsPri_win_Sr_PriOff "Priorità vincitrice in richiesta di velocità con PriOff" UBYTE TE_TSC1Manager4ms_Symbol_CM_uint8_adm 0 0 0 4 ECU_ADDRESS 0x40004A6D /end MEASUREMENT
/begin MEASUREMENT vsPri_win_Sr_PriOn "Priorità vincitrice in richiesta di velocità con PriOn" UBYTE TE_TSC1Manager4ms_Symbol_CM_uint8_adm 0 0 0 4 ECU_ADDRESS 0x40004A6C /end MEASUREMENT
/begin MEASUREMENT vsPri_win_Tr_PriOff "Priorità vincitrice in richiesta di coppia con PriOff" UBYTE TE_TSC1Manager4ms_Symbol_CM_uint8_adm 0 0 0 4 ECU_ADDRESS 0x40004A6B /end MEASUREMENT
/begin MEASUREMENT vsPri_win_Tr_PriOn "Priorità vincitrice in richiesta di coppia con PriOn" UBYTE TE_TSC1Manager4ms_Symbol_CM_uint8_adm 0 0 0 4 ECU_ADDRESS 0x40004A6A /end MEASUREMENT
/begin MEASUREMENT vsPropContr "TestPoint on PID proportional contribute to the PWM command related to FAN1 during the CLOSED-LOOP PWM management" FLOAT32_IEEE FanMgm100ms_CM_single__ 0 0 -3.4E+38 3.4E+38 ECU_ADDRESS 0x40002E14 /end MEASUREMENT
/begin MEASUREMENT vsPtoActive "PTO attiva" UBYTE DiagSym100ms_CM_boolean_adm 0 0 0 1 ECU_ADDRESS 0x4000460D /end MEASUREMENT
/begin MEASUREMENT vsPtoActiveWait "Sistema nello stato di vsPtoActiveWait" UBYTE TE_PtoCc4ms_Symbol_CM_boolean_adm 0 0 0 1 ECU_ADDRESS 0x40004825 /end MEASUREMENT
/begin MEASUREMENT vsPtoCCReqEn "Switch di abilitazione della funzione PtoCCReq4ms" UBYTE ConfInit_CM_boolean_adm 0 0 0 1 ECU_ADDRESS 0x40002307 /end MEASUREMENT
/begin MEASUREMENT vsPtoNotAvailCan "TO via CAN not available" UBYTE Vfnc4ms_CM_boolean_adm 0 0 0 1 ECU_ADDRESS 0x40004628 /end MEASUREMENT
/begin MEASUREMENT vsPtoObj "Giri obiettivo per PTO" UWORD Vfnc4ms_CM_uint16_rpm 0 0 0 10000 ECU_ADDRESS 0x40004662 /end MEASUREMENT
/begin MEASUREMENT vsPtoObjFix "Componente fissa di PTO Obj" UWORD TE_PtoCc4ms_Symbol_CM_uint16_rpm 0 0 0 10000 ECU_ADDRESS 0x40004844 /end MEASUREMENT
/begin MEASUREMENT vsPtoObjNoLim "CC Obj No Lim" UWORD J1939dl_Tx100ms_CM_uint16_rpm 0 0 0 10000 ECU_ADDRESS 0x4000465C /end MEASUREMENT
/begin CHARACTERISTIC vsRAMP_MINUS_CC "Delta Km per ramp down CC (Km/sec)" VALUE 0xFCC902 Scalar_SWORD 0 TE_PtoCc4ms_Symbol_CM_int16__Km_h__s -250 0 /end CHARACTERISTIC
/begin CHARACTERISTIC vsRAMP_MINUS_PTO "Delta giri per ramp down PTO (RPM/sec)" VALUE 0xFCC900 Scalar_SWORD 0 TE_PtoCc4ms_Symbol_CM_int16_rpm_s -10000 0 /end CHARACTERISTIC
/begin CHARACTERISTIC vsRAMP_PLUS_CC "Delta Km per ramp up CC (Km/sec)" VALUE 0xFCC8B0 Scalar_UWORD 0 TE_PtoCc4ms_Symbol_CM_uint16__Km_h__s 0 250 /end CHARACTERISTIC
/begin CHARACTERISTIC vsRAMP_PLUS_PTO "Delta giri per ramp up PTO (RPM/sec)" VALUE 0xFCC8AE Scalar_UWORD 0 TE_PtoCc4ms_Symbol_CM_uint16_rpm_s 0 10000 /end CHARACTERISTIC
/begin CHARACTERISTIC vsRATIO_TOO_HIGH "Massimo rapporto velocità-giri" VALUE 0xFCC8AC Scalar_UWORD 0 TE_PtoCc4ms_Symbol_CM_ufix16_En10_Km__h_rpm_ 0 60 /end CHARACTERISTIC
/begin CHARACTERISTIC vsRATIO_TOO_LOW "Minimo rapporto velocità-giri" VALUE 0xFCC8AA Scalar_UWORD 0 TE_PtoCc4ms_Symbol_CM_ufix16_En10_Km__h_rpm_ 0 60 /end CHARACTERISTIC
/begin CHARACTERISTIC vsRPM_HIRES_EN "Abilitazione a utilizzo giri motore in alta risoluzione" VALUE 0xFCC779 Scalar_BOOLEAN 0 TE_CmuReqMgm4ms_Symbol_CM_boolean_adm 0 1 /end CHARACTERISTIC
/begin CHARACTERISTIC vsRPM_SET1_PTO "Obiettivo giri motore PTO per setpoint1" VALUE 0xFCC8A8 Scalar_UWORD 0 TE_PtoCc4ms_Symbol_CM_uint16_rpm 0 10000 /end CHARACTERISTIC
/begin CHARACTERISTIC vsRPM_SET2_PTO "Obiettivo giri motore PTO per setpoint2" VALUE 0xFCC8A6 Scalar_UWORD 0 TE_PtoCc4ms_Symbol_CM_uint16_rpm 0 10000 /end CHARACTERISTIC
/begin CHARACTERISTIC vsRPM_SET3_PTO "Obiettivo giri motore PTO per setpoint3" VALUE 0xFCC8A4 Scalar_UWORD 0 TE_PtoCc4ms_Symbol_CM_uint16_rpm 0 10000 /end CHARACTERISTIC
/begin CHARACTERISTIC vsRPM_SET4_PTO "Obiettivo giri motore PTO per setpoint4" VALUE 0xFCC8A2 Scalar_UWORD 0 TE_PtoCc4ms_Symbol_CM_uint16_rpm 0 10000 /end CHARACTERISTIC
/begin CHARACTERISTIC vsRPM_SHOFF_DOWN "Soglia inferiore giri per shutOff Pto" VALUE 0xFCC8A0 Scalar_UWORD 0 TE_PtoCc4ms_Symbol_CM_uint16_rpm 0 10000 /end CHARACTERISTIC
/begin CHARACTERISTIC vsRPM_SHOFF_UP "Soglia superiore giri per shutOff Pto" VALUE 0xFCC89E Scalar_UWORD 0 TE_PtoCc4ms_Symbol_CM_uint16_rpm 0 10000 /end CHARACTERISTIC
/begin MEASUREMENT vsRefuelState "Stato rifornimento" UBYTE RefuelMgmTDC_Symbol_CM_uint8_adm 0 0 0 2 ECU_ADDRESS 0x40004B10 /end MEASUREMENT
/begin MEASUREMENT vsResume "Resume" UBYTE TE_PtoCc4ms_Symbol_CM_boolean_adm 0 0 0 1 ECU_ADDRESS 0x40004824 /end MEASUREMENT
/begin MEASUREMENT vsRevShutOffReq "ShutOff momentaneo in cui è cancellata la memorizzazione Obj PTO o CC" UBYTE TE_PtoCc4ms_Symbol_CM_boolean_adm 0 0 0 1 ECU_ADDRESS 0x40004823 /end MEASUREMENT
/begin MEASUREMENT vsRifornMgmEn "lag di attivazione della strategia gestione rifornimento carburante" UBYTE ConfInit_CM_boolean_adm 0 0 0 1 ECU_ADDRESS 0x400022FF /end MEASUREMENT
/begin MEASUREMENT vsRifornimento "Flag di indicazione di avvenuto rifornimento" UBYTE AutoTDC_CM_boolean_adm 0 0 0 1 ECU_ADDRESS 0x40004AB0 /end MEASUREMENT
/begin CHARACTERISTIC vsSHAFT2WHEEL_SPD_GAIN "Fattore di conversione da Shaft Speed a Wheel Speed (Vehicle Speed)" VALUE 0xFCC6F2 Scalar_UWORD 0 Signal_Mgm_4ms_Symbol_CM_ufix16_En12_adm 0 1 /end CHARACTERISTIC
/begin CHARACTERISTIC vsSPEED_STEP_DOWN "Maximum decrement of speed target admitted at each cycle." VALUE 0xFC5920 Scalar_UWORD 0 FanMgm100ms_CM_uint16_rpm 0 10000 /end CHARACTERISTIC
/begin CHARACTERISTIC vsSPEED_STEP_UP "Maximum increment of speed target admitted at each cycle." VALUE 0xFC591E Scalar_UWORD 0 FanMgm100ms_CM_uint16_rpm 0 10000 /end CHARACTERISTIC
/begin CHARACTERISTIC vsSTART_RPM_THR "Soglia inferiore giri per permettere di settare obiettivo di giri da pulsante start" VALUE 0xFCC668 Scalar_UWORD 0 TE_StartStopRpmMgm100ms_Symbol_CM_uint16_rpm 0 10000 /end CHARACTERISTIC
/begin CHARACTERISTIC vsSTEP_MINUS_CC "Delta giri per tip down CC" VALUE 0xFCC8FE Scalar_SWORD 0 TE_PtoCc4ms_Symbol_CM_int16_Km_h -250 0 /end CHARACTERISTIC
/begin CHARACTERISTIC vsSTEP_MINUS_PTO "Delta giri per tip down PTO" VALUE 0xFCC8FC Scalar_SWORD 0 TE_PtoCc4ms_Symbol_CM_int16_rpm -10000 0 /end CHARACTERISTIC
/begin CHARACTERISTIC vsSTEP_PLUS_CC "Delta giri per tip up CC" VALUE 0xFCC89C Scalar_UWORD 0 TE_PtoCc4ms_Symbol_CM_uint16_Km_h 0 250 /end CHARACTERISTIC
/begin CHARACTERISTIC vsSTEP_PLUS_PTO "Delta giri per tip up PTO" VALUE 0xFCC89A Scalar_UWORD 0 TE_PtoCc4ms_Symbol_CM_uint16_rpm 0 10000 /end CHARACTERISTIC
/begin CHARACTERISTIC vsSTEP_RACC_DOOR_CL "Numero di passi per raccordo tra Limitazione pedale per Doors Open e pedale" VALUE 0xFCC77E Scalar_UWORD 0 TE_CmuReqMgm4ms_Symbol_CM_uint16_adm 1 10000 /end CHARACTERISTIC
/begin CHARACTERISTIC vsSTEP_RACC_DOOR_OP "Numero di passi per raccordo tra pedale e Limitazione pedale per Doors Open" VALUE 0xFCC77C Scalar_UWORD 0 TE_CmuReqMgm4ms_Symbol_CM_uint16_adm 1 10000 /end CHARACTERISTIC
/begin CHARACTERISTIC vsSW_SEL_CUR_GEAR "Flag per selezionare dal Cambio automatico la info del nr Gear da Selected (0) oppure da Current (1) in lettura da ETC2" VALUE 0xFCC6F1 Scalar_BOOLEAN 0 Signal_Mgm_4ms_Symbol_CM_boolean_adm 0 1 /end CHARACTERISTIC
/begin CHARACTERISTIC vsSW_VSPE_SENS_2_CAN "Multiple-Switch (old bsVSPE_CAN_CWTCH) da sensore velocità veicolo letto da sensore (0) a lettura dal CAN (1 => TCO1; 2 => CCVS; 3 => ETC1)" VALUE 0xFCC6F0 Scalar_UBYTE 0 Signal_Mgm_4ms_Symbol_CM_uint8_adm 0 3 /end CHARACTERISTIC
/begin MEASUREMENT vsSet1Can "ichiesta set1 PTO via CAN" UBYTE Vfnc4ms_CM_boolean_adm 0 0 0 1 ECU_ADDRESS 0x4000462C /end MEASUREMENT
/begin MEASUREMENT vsSet2Can "ichiesta set2 PTO via CAN" UBYTE Vfnc4ms_CM_boolean_adm 0 0 0 1 ECU_ADDRESS 0x4000462B /end MEASUREMENT
/begin MEASUREMENT vsSet3Can "ichiesta set3 PTO via CAN" UBYTE Vfnc4ms_CM_boolean_adm 0 0 0 1 ECU_ADDRESS 0x40004629 /end MEASUREMENT
/begin MEASUREMENT vsSet4Can "ichiesta set4 PTO via CAN" UBYTE Vfnc4ms_CM_boolean_adm 0 0 0 1 ECU_ADDRESS 0x4000462A /end MEASUREMENT
/begin MEASUREMENT vsSpdLtdPriWin "Priorità vincente nella limitazione di velocità" UBYTE TE_TSC1Manager4ms_Symbol_CM_uint8_adm 0 0 1 8 ECU_ADDRESS 0x40004A69 /end MEASUREMENT
/begin MEASUREMENT vsSpdReqPriWin "Priorità vincente nella richiesta di velocità" UBYTE TE_TSC1Manager4ms_Symbol_CM_uint8_adm 0 0 1 8 ECU_ADDRESS 0x40004A68 /end MEASUREMENT
/begin MEASUREMENT vsSpeedCCRange "Flag per definire ve velocità veicolo è nel range PTO (0) o nel range CC (1)" UBYTE Vfnc4ms_CM_uint8_adm 0 0 0 2 ECU_ADDRESS 0x40004645 /end MEASUREMENT
/begin MEASUREMENT vsSpeedLim2 "limitazione giri in caso di limitazione velocità veicolo (2)" UWORD TE_CmuReqMgm4ms_Symbol_CM_uint16_rpm 0 0 0 10000 ECU_ADDRESS 0x400046AA /end MEASUREMENT
/begin MEASUREMENT vsSpeedLimEn "Abilitazione alla funzione SpeedLim" UBYTE ConfInit_CM_boolean_adm 0 0 0 1 ECU_ADDRESS 0x4000230B /end MEASUREMENT
/begin MEASUREMENT vsSpeedLimState "Flag di limitazione velocità attiva" UBYTE TE_CmuReqMgm4ms_Symbol_CM_uint8_adm 0 0 1 3 ECU_ADDRESS 0x400046A6 /end MEASUREMENT
/begin MEASUREMENT vsSpeedLimVCM "Richiesta di limitazione giri da VCM" UWORD Trqm_CtrlMgmt4ms_CM_uint16_rpm 0 0 0 10000 ECU_ADDRESS 0x40004670 /end MEASUREMENT
/begin MEASUREMENT vsSpeedLimVCM_R "Richiesta di limitazione giri da VCM" UWORD Vfnc4ms_CM_uint16_rpm 0 0 0 10000 ECU_ADDRESS 0x4000466A /end MEASUREMENT
/begin MEASUREMENT vsSpeedObjMgmEn "Switch di abilitazione della funzione TE_PtoCc4ms" UBYTE ConfInit_CM_boolean_adm 0 0 0 1 ECU_ADDRESS 0x40002309 /end MEASUREMENT
/begin MEASUREMENT vsSpeedOn1 "Richiesta di velocità attiva da  primo TSC1" UBYTE TE_TSC1Manager4ms_Symbol_CM_boolean_adm 0 0 0 1 ECU_ADDRESS 0x40004A67 /end MEASUREMENT
/begin MEASUREMENT vsSpeedOn2 "Richiesta di velocità attiva da  secondo TSC1" UBYTE TE_TSC1Manager4ms_Symbol_CM_boolean_adm 0 0 0 1 ECU_ADDRESS 0x40004A66 /end MEASUREMENT
/begin MEASUREMENT vsSpeedOn3 "Richiesta di velocità attiva da  terzo TSC1" UBYTE TE_TSC1Manager4ms_Symbol_CM_boolean_adm 0 0 0 1 ECU_ADDRESS 0x40004A65 /end MEASUREMENT
/begin MEASUREMENT vsSpeedReqVCM "Richiesta di giri obiettivo da VCM" UWORD Idle4ms_CM_uint16_rpm 0 0 0 10000 ECU_ADDRESS 0x4000466E /end MEASUREMENT
/begin MEASUREMENT vsSpeedReqVCM2 "ichiesta di giri obiettivo da VCM nel msg TSC1_VE_CONTROL2" UWORD Vfnc4ms_CM_uint16_rpm 0 0 0 10000 ECU_ADDRESS 0x4000466C /end MEASUREMENT
/begin MEASUREMENT vsSpeedReqVCM2_R "ichiesta di giri obiettivo da VCM nel msg TSC1_VE_CONTROL2" UWORD Vfnc4ms_CM_uint16_rpm 0 0 0 10000 ECU_ADDRESS 0x40004666 /end MEASUREMENT
/begin MEASUREMENT vsSpeedReqVCM_R "Richiesta di giri obiettivo da VCM" UWORD Vfnc4ms_CM_uint16_rpm 0 0 0 10000 ECU_ADDRESS 0x40004668 /end MEASUREMENT
/begin MEASUREMENT vsSpeedReqWin "Priorità vincente nella richiesta di velocità" UBYTE TE_TSC1Manager4ms_Symbol_CM_uint8_adm 0 0 0 3 ECU_ADDRESS 0x40004A64 /end MEASUREMENT
/begin MEASUREMENT vsStandByMemReq "ShutOff momentaneo al cui ingresso è fatta la memorizzazione Obj PTO o CC corrente" UBYTE TE_PtoCc4ms_Symbol_CM_boolean_adm 0 0 0 1 ECU_ADDRESS 0x40004822 /end MEASUREMENT
/begin MEASUREMENT vsStandByReq "ShutOff momentaneo in cui non è cancellata la memorizzazione Obj PTO o CC" UBYTE TE_PtoCc4ms_Symbol_CM_boolean_adm 0 0 0 1 ECU_ADDRESS 0x40004821 /end MEASUREMENT
/begin MEASUREMENT vsStartObjVar "Richiesta di giri obiettivo da pulsante di start" UWORD Vfnc100ms_CM_uint16_rpm 0 0 0 10000 ECU_ADDRESS 0x40004552 /end MEASUREMENT
/begin MEASUREMENT vsStartStopMgmEn "Switch di abilitazione della funzione TE_StartStopRpmMgm100ms" UBYTE ConfInit_CM_boolean_adm 0 0 0 1 ECU_ADDRESS 0x400022FD /end MEASUREMENT
/begin MEASUREMENT vsStartStopReqActive "ontrollo di giri da pulsante di start attivo" UBYTE Vfnc100ms_CM_boolean_adm 0 0 0 1 ECU_ADDRESS 0x4000454A /end MEASUREMENT
/begin MEASUREMENT vsStrAppl "Enable Starter Management Functionality " UBYTE ConfInit_CM_boolean_adm 0 0 0 1 ECU_ADDRESS 0x400022F8 /end MEASUREMENT
/begin MEASUREMENT vsSwitchVspeSens2CAN "Multiple-Switch che indica da dove proviene la info su VehSpeed (0:sens;1:TCO1;2:ETC1:3:no info)" UBYTE Vfnc4ms_CM_uint8_adm 0 0 0 3 ECU_ADDRESS 0x40004642 /end MEASUREMENT
/begin MEASUREMENT vsSwitch_TSC1_2 "Switch ad architettura a due TSC1" UBYTE Vfnc4ms_CM_boolean_adm 0 0 0 1 ECU_ADDRESS 0x40004616 /end MEASUREMENT
/begin MEASUREMENT vsSwitch_TSC1_2_R "Switch ad architettura a due TSC1" UBYTE Vfnc4ms_CM_boolean_adm 0 0 0 1 ECU_ADDRESS 0x40004612 /end MEASUREMENT
/begin CHARACTERISTIC vsTHR_REFUEL "Soglia Rifornimento su pressione Bombole" VALUE 0xFCC98A Scalar_UWORD 0 RefuelMgmTDC_Symbol_CM_ufix16_E2_mbar 0 250000 /end CHARACTERISTIC
/begin CHARACTERISTIC vsTIME_DECEL "Tempo per calcolare decelerazione da incidente per ShutOff" VALUE 0xFCC898 Scalar_UWORD 0 TE_PtoCc4ms_Symbol_CM_ufix16_Sp004_sec 0 240 /end CHARACTERISTIC
/begin CHARACTERISTIC vsTIME_RATIO_WRONG "Tempo massimo per rapporto velocità veicolo - giri errato" VALUE 0xFCC896 Scalar_UWORD 0 TE_PtoCc4ms_Symbol_CM_ufix16_Sp004_sec 0 240 /end CHARACTERISTIC
/begin CHARACTERISTIC vsTOIL_AV "Temperature oil sensor available (Mounted in the current vehicle configuration)" VALUE 0xFC2C62 Scalar_BOOLEAN 0 VcmFcnEnableInit_CM_boolean_adm 0 1 /end CHARACTERISTIC
/begin CHARACTERISTIC vsTOT_TANK_VOLUME "Total volume for tanks on current application." VALUE 0xFCC93E Scalar_UWORD 0 FuelConsTDC_CM_uint16_l 0 60000 /end CHARACTERISTIC
/begin MEASUREMENT vsTSC1SpeedLtd "Limitazione di giri" UWORD Vfnc4ms_CM_uint16_rpm 0 0 0 10000 ECU_ADDRESS 0x4000465A /end MEASUREMENT
/begin MEASUREMENT vsTSC1SpeedReq "Richiesta di giri" UWORD Vfnc4ms_CM_uint16_rpm 0 0 0 10000 ECU_ADDRESS 0x40004658 /end MEASUREMENT
/begin MEASUREMENT vsTSC1TorqueLtd "Limitazione di coppia" UWORD Vfnc4ms_CM_ufix16_En4__ 0 0 0 100 ECU_ADDRESS 0x40004648 /end MEASUREMENT
/begin MEASUREMENT vsTSC1TorqueReq "Richiesta di coppia" UWORD Vfnc4ms_CM_ufix16_En4__ 0 0 0 100 ECU_ADDRESS 0x40004646 /end MEASUREMENT
/begin CHARACTERISTIC vsT_TANK_STUB "Stub per la temperatura bombole in attesa di riceverla da sensore" VALUE 0xFCC93C Scalar_SWORD 0 FuelConsTDC_CM_int16_degC -273 1500 /end CHARACTERISTIC
/begin MEASUREMENT vsTeApplCanEn "Abilitazione alle funzioni CAN TE" UBYTE ConfInit_CM_boolean_adm 0 0 0 1 ECU_ADDRESS 0x4000230E /end MEASUREMENT
/begin MEASUREMENT vsTeApplEn "OneBox Application" UBYTE ConfInit_CM_boolean_adm 0 0 0 1 ECU_ADDRESS 0x400022FB /end MEASUREMENT
/begin MEASUREMENT vsTeApplEn_pf "[PostFIX] TE application is running (Flag=1)" UBYTE VcmFcnEnableInit_CM_boolean_adm 0 0 0 1 ECU_ADDRESS 0x40002311 /end MEASUREMENT
/begin MEASUREMENT vsTeApplEn_prf "[PreFIX] TE application is running (Flag=1)" UBYTE VcmFcnEnableInit_CM_boolean_adm 0 0 0 1 ECU_ADDRESS 0x40002310 /end MEASUREMENT
/begin MEASUREMENT vsTmApplEn "Abilitazione alle funzioni TM" UBYTE ConfInit_CM_boolean_adm 0 0 0 1 ECU_ADDRESS 0x4000230F /end MEASUREMENT
/begin MEASUREMENT vsTorqueLimVCM "Richiesta di limitazione (percentuale di Coppia Erogata) di coppia da VCM" UWORD Trqm_CtrlMgmt4ms_CM_ufix16_En4__ 0 0 0 100 ECU_ADDRESS 0x40004654 /end MEASUREMENT
/begin MEASUREMENT vsTorqueLimVCM_R "Richiesta di limitazione (percentuale di Coppia Erogata) di coppia da VCM" UWORD Vfnc4ms_CM_ufix16_En4__ 0 0 0 100 ECU_ADDRESS 0x4000464C /end MEASUREMENT
/begin MEASUREMENT vsTorqueOn1 "Richiesta di coppia attiva da  primo TSC1" UBYTE TE_TSC1Manager4ms_Symbol_CM_boolean_adm 0 0 0 1 ECU_ADDRESS 0x40004A63 /end MEASUREMENT
/begin MEASUREMENT vsTorqueOn2 "Richiesta di coppia attiva da  secondo TSC1" UBYTE TE_TSC1Manager4ms_Symbol_CM_boolean_adm 0 0 0 1 ECU_ADDRESS 0x40004A62 /end MEASUREMENT
/begin MEASUREMENT vsTorqueOn3 "Richiesta di coppia attiva da  terzo TSC1" UBYTE TE_TSC1Manager4ms_Symbol_CM_boolean_adm 0 0 0 1 ECU_ADDRESS 0x40004A61 /end MEASUREMENT
/begin MEASUREMENT vsTorqueReqVCM "Richiesta di coppia obiettivo (percentuale di Coppia Erogata) da VCM" UWORD Trqm_CtrlMgmt4ms_CM_ufix16_En4__ 0 0 0 100 ECU_ADDRESS 0x40004650 /end MEASUREMENT
/begin MEASUREMENT vsTorqueReqVCM2 "ichiesta di coppia obiettivo (percentuale di Coppia Erogata) da VCM nel msg TSC1_VE_CONTROL2" UWORD Trqm_CtrlMgmt4ms_CM_ufix16_En4__ 0 0 0 100 ECU_ADDRESS 0x40004652 /end MEASUREMENT
/begin MEASUREMENT vsTorqueReqVCM2_R "Richiesta di coppia obiettivo (percentuale di Coppia Erogata) da VCM nel msg TSC1_VE_CONTROL2" UWORD Vfnc4ms_CM_ufix16_En4__ 0 0 0 100 ECU_ADDRESS 0x4000464A /end MEASUREMENT
/begin MEASUREMENT vsTorqueReqVCM_R "Richiesta di coppia obiettivo (percentuale di Coppia Erogata) da VCM" UWORD Vfnc4ms_CM_ufix16_En4__ 0 0 0 100 ECU_ADDRESS 0x4000464E /end MEASUREMENT
/begin MEASUREMENT vsTorqueReqWin "Priorità vincente nella richiesta di coppia" UBYTE TE_TSC1Manager4ms_Symbol_CM_uint8_adm 0 0 0 4 ECU_ADDRESS 0x40004A60 /end MEASUREMENT
/begin MEASUREMENT vsTotEngHours "accumulated time of operation of engine (SAE 5.2.5.61)" ULONG J1939dl_Tx100ms_CM_ufix32_Sp05_hour 0 0 0 210554060.75 ECU_ADDRESS 0x40004578 /end MEASUREMENT
/begin MEASUREMENT vsTotEngMinutes "Accumulated time (minutes) of operation of engine" ULONG Vfnc1s_CM_uint32_min 0 0 0 4294967295 ECU_ADDRESS 0x40004584 /end MEASUREMENT
/begin MEASUREMENT vsTotEngRevol "ccumulated number of revolutions of engine crankshaft during its operation (SAE 5.2.5.58)" ULONG J1939dl_Tx100ms_CM_ufix32_S1000_round 0 0 0 4.211081215E+12 ECU_ADDRESS 0x4000457C /end MEASUREMENT
/begin MEASUREMENT vsTotWorkedMinutes "Accumulated worked time (minutes) of ECU" ULONG DiagSym100ms_CM_uint32_min 0 0 0 4294967295 ECU_ADDRESS 0x40004580 /end MEASUREMENT
/begin MEASUREMENT vsTrqLtdPriWin "Priorità vincente nella limitazione di coppia" UBYTE TE_TSC1Manager4ms_Symbol_CM_uint8_adm 0 0 1 8 ECU_ADDRESS 0x40004A5F /end MEASUREMENT
/begin MEASUREMENT vsTrqReqPriWin "Priorità vincente nella richiesta di coppia" UBYTE TE_TSC1Manager4ms_Symbol_CM_uint8_adm 0 0 1 9 ECU_ADDRESS 0x40004A5E /end MEASUREMENT
/begin MEASUREMENT vsTsc1MgmEn "Abilitazione alla funzione gestione TSC1" UBYTE ConfInit_CM_boolean_adm 0 0 0 1 ECU_ADDRESS 0x4000230A /end MEASUREMENT
/begin CHARACTERISTIC vsVAL_SL_NEUTRAL "Valore neutro per Speed Limitation su messaggio TSC1" VALUE 0xFCC90E Scalar_UWORD 0 TE_TSC1Manager4ms_Symbol_CM_uint16_rpm 0 10000 /end CHARACTERISTIC
/begin CHARACTERISTIC vsVAL_SR_NEUTRAL "Valore neutro per Speed Request su messaggio TSC1" VALUE 0xFCC90C Scalar_UWORD 0 TE_TSC1Manager4ms_Symbol_CM_uint16_rpm 0 10000 /end CHARACTERISTIC
/begin CHARACTERISTIC vsVAL_TL_NEUTRAL "Valore neutro per Torque Limitation su messaggio TSC1" VALUE 0xFCC90A Scalar_UWORD 0 TE_TSC1Manager4ms_Symbol_CM_ufix16_En4__ 0 100 /end CHARACTERISTIC
/begin CHARACTERISTIC vsVAL_TR_NEUTRAL "Valore neutro per Torque Request su messaggio TSC1" VALUE 0xFCC908 Scalar_UWORD 0 TE_TSC1Manager4ms_Symbol_CM_ufix16_En4__ 0 100 /end CHARACTERISTIC
/begin CHARACTERISTIC vsVBPW_FAN1_REF "Reference value for Fan1 Duty-Cycle rescaling in function of zsVBPW" VALUE 0xFC591C Scalar_UWORD 0 FanMgm100ms_CM_ufix16_S50_mV 12000 36000 /end CHARACTERISTIC
/begin MEASUREMENT vsVCM_C_TSC_Cond "Requested speed control condition (Transient Drv_diseng, Drv_diseng, Drv_eng - Vehic_Drv, Drv_eng - PTO_Drv)" UBYTE Trqm_CtrlMgmt4ms_CM_uint8_adm 0 0 0 3 ECU_ADDRESS 0x4000463C /end MEASUREMENT
/begin MEASUREMENT vsVCM_C_TSC_Cond2 "Requested speed control condition (Transient Drv_diseng, Drv_diseng, Drv_eng - Vehic_Drv, Drv_eng - PTO_Drv) in TSC1_VE_CONTROL2" UBYTE Vfnc4ms_CM_uint8_adm 0 0 0 3 ECU_ADDRESS 0x4000463A /end MEASUREMENT
/begin MEASUREMENT vsVCM_C_TSC_Cond2_R "Requested speed control condition (Transient Drv_diseng, Drv_diseng, Drv_eng - Vehic_Drv, Drv_eng - PTO_Drv) in TSC1_VE_CONTROL2" UBYTE Vfnc4ms_CM_uint8_adm 0 0 0 3 ECU_ADDRESS 0x40004631 /end MEASUREMENT
/begin MEASUREMENT vsVCM_C_TSC_Cond_R "Requested speed control condition (Transient Drv_diseng, Drv_diseng, Drv_eng - Vehic_Drv, Drv_eng - PTO_Drv)" UBYTE Vfnc4ms_CM_uint8_adm 0 0 0 3 ECU_ADDRESS 0x40004633 /end MEASUREMENT
/begin MEASUREMENT vsVCM_C_TSC_Mode "Modalità di richiesta obiettivo di performance (Coppia Erogata = 2 o giri = 1) da VCM" UBYTE Trqm_CtrlMgmt4ms_CM_uint8_adm 0 0 0 3 ECU_ADDRESS 0x40004641 /end MEASUREMENT
/begin MEASUREMENT vsVCM_C_TSC_Mode2 "Modalità di richiesta obiettivo di performance (Coppia Erogata = 2 o giri = 1) da VCM nel msg TSC1_VE_CONTROL2" UBYTE Trqm_CtrlMgmt4ms_CM_uint8_adm 0 0 0 3 ECU_ADDRESS 0x4000463D /end MEASUREMENT
/begin MEASUREMENT vsVCM_C_TSC_Mode2_R "Modalità di richiesta obiettivo di performance (Coppia Erogata = 2 o giri = 1) da VCM nel msg TSC1_VE_CONTROL2" UBYTE Vfnc4ms_CM_uint8_adm 0 0 0 3 ECU_ADDRESS 0x40004634 /end MEASUREMENT
/begin MEASUREMENT vsVCM_C_TSC_Mode_R "Modalità di richiesta obiettivo di performance (Coppia Erogata = 2 o giri = 1) da VCM" UBYTE Vfnc4ms_CM_uint8_adm 0 0 0 3 ECU_ADDRESS 0x40004638 /end MEASUREMENT
/begin MEASUREMENT vsVCM_C_TSC_Pri "Priorità degli obiettivi di performance (Coppia Erogata o giri) da VCM (Max(Pri)=0, Min(Pri)=3)" UBYTE Vfnc4ms_CM_uint8_adm 0 0 0 3 ECU_ADDRESS 0x40004640 /end MEASUREMENT
/begin MEASUREMENT vsVCM_C_TSC_Pri2 "riorità degli obiettivi di performance (Coppia Erogata o giri) da VCM (Max(Pri)=0, Min(Pri)=3) nel msg TSC1_CTrl_2" UBYTE Vfnc4ms_CM_uint8_adm 0 0 0 3 ECU_ADDRESS 0x4000463B /end MEASUREMENT
/begin MEASUREMENT vsVCM_C_TSC_Pri2_R "riorità degli obiettivi di performance (Coppia Erogata o giri) da VCM (Max(Pri)=0, Min(Pri)=3) nel msg TSC1_CTrl_2" UBYTE Vfnc4ms_CM_uint8_adm 0 0 0 3 ECU_ADDRESS 0x40004632 /end MEASUREMENT
/begin MEASUREMENT vsVCM_C_TSC_Pri_R "Priorità degli obiettivi di performance (Coppia Erogata o giri) da VCM (Max(Pri)=0, Min(Pri)=3)" UBYTE Vfnc4ms_CM_uint8_adm 0 0 0 3 ECU_ADDRESS 0x40004637 /end MEASUREMENT
/begin MEASUREMENT vsVCM_L_TSC_Cond "Requested speed control condition (Transient Drv_diseng, Drv_diseng, Drv_eng - Vehic_Drv, Drv_eng - PTO_Drv)" UBYTE Vfnc4ms_CM_uint8_adm 0 0 0 3 ECU_ADDRESS 0x40004639 /end MEASUREMENT
/begin MEASUREMENT vsVCM_L_TSC_Cond_R "Requested speed control condition (Transient Drv_diseng, Drv_diseng, Drv_eng - Vehic_Drv, Drv_eng - PTO_Drv)" UBYTE Vfnc4ms_CM_uint8_adm 0 0 0 3 ECU_ADDRESS 0x40004630 /end MEASUREMENT
/begin MEASUREMENT vsVCM_L_TSC_Mode "Modalità di richiesta limitazione di performance (Coppia Erogata o giri)" UBYTE Trqm_CtrlMgmt4ms_CM_uint8_adm 0 0 0 3 ECU_ADDRESS 0x4000463E /end MEASUREMENT
/begin MEASUREMENT vsVCM_L_TSC_Mode_R "Modalità di richiesta limitazione di performance (Coppia Erogata o giri)" UBYTE Vfnc4ms_CM_uint8_adm 0 0 0 3 ECU_ADDRESS 0x40004635 /end MEASUREMENT
/begin MEASUREMENT vsVCM_L_TSC_Pri "Priorità sulle limitazioni alle richieste di performance (Coppia Erogata o giri) da VCM (Max(Pri)=0, Min(Pri)=3)" UBYTE Vfnc4ms_CM_uint8_adm 0 0 0 3 ECU_ADDRESS 0x4000463F /end MEASUREMENT
/begin MEASUREMENT vsVCM_L_TSC_Pri_R "Priorità sulle limitazioni alle richieste di performance (Coppia Erogata o giri) da VCM (Max(Pri)=0, Min(Pri)=3)" UBYTE Vfnc4ms_CM_uint8_adm 0 0 0 3 ECU_ADDRESS 0x40004636 /end MEASUREMENT
/begin CHARACTERISTIC vsVEH_OBJ_CC_OFF "Obiettivo PTO con CC non attiva" VALUE 0xFCC894 Scalar_UWORD 0 TE_PtoCc4ms_Symbol_CM_uint16_Km_h 0 250 /end CHARACTERISTIC
/begin CHARACTERISTIC vsVEH_OBJ_PTO_OFF "Obiettivo PTO con Pto non attiva" VALUE 0xFCC892 Scalar_UWORD 0 TE_PtoCc4ms_Symbol_CM_uint16_rpm 0 10000 /end CHARACTERISTIC
/begin CHARACTERISTIC vsVEH_SPEEDHR_EN "Abilitazione a utilizzo velocità veicolo in alta risoluzione" VALUE 0xFCC778 Scalar_BOOLEAN 0 TE_CmuReqMgm4ms_Symbol_CM_boolean_adm 0 1 /end CHARACTERISTIC
/begin CHARACTERISTIC vsVEH_SPEED_HIGH "Soglia di limitazione massima velocità veicolo" VALUE 0xFCC684 Scalar_UWORD 0 TE_VehicleSpeedLim100ms_Symbol_CM_uint16_Km_h 1 250 /end CHARACTERISTIC
/begin CHARACTERISTIC vsVEH_SPEED_LOW "Soglia di limitazione velocità veicolo da impostare tramite pulsante" VALUE 0xFCC682 Scalar_UWORD 0 TE_VehicleSpeedLim100ms_Symbol_CM_uint16_Km_h 1 250 /end CHARACTERISTIC
/begin MEASUREMENT vsValSL1 "Valore di limitazione di velocità da  primo TSC1" UWORD TE_TSC1Manager4ms_Symbol_CM_uint16_rpm 0 0 0 10000 ECU_ADDRESS 0x40004AAA /end MEASUREMENT
/begin MEASUREMENT vsValSL2 "Valore di limitazione di velocità da  secondo TSC1" UWORD TE_TSC1Manager4ms_Symbol_CM_uint16_rpm 0 0 0 10000 ECU_ADDRESS 0x40004AA8 /end MEASUREMENT
/begin MEASUREMENT vsValSL3 "Valore di limitazione di velocità da  terzo TSC1" UWORD TE_TSC1Manager4ms_Symbol_CM_uint16_rpm 0 0 0 10000 ECU_ADDRESS 0x40004AA6 /end MEASUREMENT
/begin MEASUREMENT vsValSR1 "Valore di richiesta di velocità da  primo TSC1" UWORD TE_TSC1Manager4ms_Symbol_CM_uint16_rpm 0 0 0 10000 ECU_ADDRESS 0x40004AA4 /end MEASUREMENT
/begin MEASUREMENT vsValSR2 "Valore di richiesta di velocità da  secondo TSC1" UWORD TE_TSC1Manager4ms_Symbol_CM_uint16_rpm 0 0 0 10000 ECU_ADDRESS 0x40004AA2 /end MEASUREMENT
/begin MEASUREMENT vsValSR3 "Valore di richiesta di velocità da  terzo TSC1" UWORD TE_TSC1Manager4ms_Symbol_CM_uint16_rpm 0 0 0 10000 ECU_ADDRESS 0x40004AA0 /end MEASUREMENT
/begin MEASUREMENT vsValSlNeutral "Valore neutro di limitazione di velocità" UWORD TE_TSC1Manager4ms_Symbol_CM_uint16_rpm 0 0 0 10000 ECU_ADDRESS 0x40004A9E /end MEASUREMENT
/begin MEASUREMENT vsValSrNeutral "Valore neutro di richiesta di velocità" UWORD TE_TSC1Manager4ms_Symbol_CM_uint16_rpm 0 0 0 10000 ECU_ADDRESS 0x40004A9C /end MEASUREMENT
/begin MEASUREMENT vsValTL1 "Valore di limitazione di coppia da  primo TSC1" UWORD TE_TSC1Manager4ms_Symbol_CM_ufix16_En4__ 0 0 0 100 ECU_ADDRESS 0x40004A9A /end MEASUREMENT
/begin MEASUREMENT vsValTL2 "Valore di limitazione di coppia da  secondo TSC1" UWORD TE_TSC1Manager4ms_Symbol_CM_ufix16_En4__ 0 0 0 100 ECU_ADDRESS 0x40004A98 /end MEASUREMENT
/begin MEASUREMENT vsValTL3 "Valore di limitazione di coppia da  terzo TSC1" UWORD TE_TSC1Manager4ms_Symbol_CM_ufix16_En4__ 0 0 0 100 ECU_ADDRESS 0x40004A96 /end MEASUREMENT
/begin MEASUREMENT vsValTR1 "Valore di richiesta di coppia da  primo TSC1" UWORD TE_TSC1Manager4ms_Symbol_CM_ufix16_En4__ 0 0 0 100 ECU_ADDRESS 0x40004A94 /end MEASUREMENT
/begin MEASUREMENT vsValTR2 "Valore di richiesta di coppia da  secondo TSC1" UWORD TE_TSC1Manager4ms_Symbol_CM_ufix16_En4__ 0 0 0 100 ECU_ADDRESS 0x40004A92 /end MEASUREMENT
/begin MEASUREMENT vsValTR3 "Valore di richiesta di coppia da  terzo TSC1" UWORD TE_TSC1Manager4ms_Symbol_CM_ufix16_En4__ 0 0 0 100 ECU_ADDRESS 0x40004A90 /end MEASUREMENT
/begin MEASUREMENT vsValTR4 "Valore di richiesta di coppia da pedale" UWORD TE_TSC1Manager4ms_Symbol_CM_ufix16_En4__ 0 0 0 100 ECU_ADDRESS 0x40004A8E /end MEASUREMENT
/begin MEASUREMENT vsValTlNeutral "Valore neutro di limitazione di coppia" UWORD TE_TSC1Manager4ms_Symbol_CM_ufix16_En4__ 0 0 0 100 ECU_ADDRESS 0x40004A8C /end MEASUREMENT
/begin MEASUREMENT vsValTrNeutral "Valore neutro di richiesta di coppia" UWORD TE_TSC1Manager4ms_Symbol_CM_ufix16_En4__ 0 0 0 100 ECU_ADDRESS 0x40004A8A /end MEASUREMENT
/begin MEASUREMENT vsVal_w1_Sr_PriOff "Flag valore vincitore  primo TSC1 in richiesta di velocità con PriOff" UBYTE TE_TSC1Manager4ms_Symbol_CM_boolean_adm 0 0 0 1 ECU_ADDRESS 0x40004A5D /end MEASUREMENT
/begin MEASUREMENT vsVal_w1_Sr_PriOn "Flag valore vincitore  primo TSC1 in richiesta di velocità con PriOn" UBYTE TE_TSC1Manager4ms_Symbol_CM_boolean_adm 0 0 0 1 ECU_ADDRESS 0x40004A5C /end MEASUREMENT
/begin MEASUREMENT vsVal_w1_Tr_PriOff "Flag valore vincitore  primo TSC1 in richiesta di coppia con PriOff" UBYTE TE_TSC1Manager4ms_Symbol_CM_boolean_adm 0 0 0 1 ECU_ADDRESS 0x40004A5B /end MEASUREMENT
/begin MEASUREMENT vsVal_w1_Tr_PriOn "Flag valore vincitore  primo TSC1 in richiesta di coppia con PriOn" UBYTE TE_TSC1Manager4ms_Symbol_CM_boolean_adm 0 0 0 1 ECU_ADDRESS 0x40004A5A /end MEASUREMENT
/begin MEASUREMENT vsVal_w2_Sr_PriOff "Flag valore vincitore  secondo TSC1 in richiesta di velocità con PriOff" UBYTE TE_TSC1Manager4ms_Symbol_CM_boolean_adm 0 0 0 1 ECU_ADDRESS 0x40004A59 /end MEASUREMENT
/begin MEASUREMENT vsVal_w2_Sr_PriOn "Flag valore vincitore  secondo TSC1 in richiesta di velocità con PriOn" UBYTE TE_TSC1Manager4ms_Symbol_CM_boolean_adm 0 0 0 1 ECU_ADDRESS 0x40004A58 /end MEASUREMENT
/begin MEASUREMENT vsVal_w2_Tr_PriOff "Flag valore vincitore  secondo TSC1 in richiesta di coppia con PriOff" UBYTE TE_TSC1Manager4ms_Symbol_CM_boolean_adm 0 0 0 1 ECU_ADDRESS 0x40004A57 /end MEASUREMENT
/begin MEASUREMENT vsVal_w2_Tr_PriOn "Flag valore vincitore  secondo TSC1 in richiesta di coppia con PriOn" UBYTE TE_TSC1Manager4ms_Symbol_CM_boolean_adm 0 0 0 1 ECU_ADDRESS 0x40004A56 /end MEASUREMENT
/begin MEASUREMENT vsVal_w3_Sr_PriOff "Flag valore vincitore  terzo TSC1 in richiesta di velocità con PriOff" UBYTE TE_TSC1Manager4ms_Symbol_CM_boolean_adm 0 0 0 1 ECU_ADDRESS 0x40004A55 /end MEASUREMENT
/begin MEASUREMENT vsVal_w3_Sr_PriOn "Flag valore vincitore  terzo TSC1 in richiesta di velocità con PriOn" UBYTE TE_TSC1Manager4ms_Symbol_CM_boolean_adm 0 0 0 1 ECU_ADDRESS 0x40004A54 /end MEASUREMENT
/begin MEASUREMENT vsVal_w3_Tr_PriOff "Flag valore vincitore  terzo TSC1 in richiesta di coppia con PriOff" UBYTE TE_TSC1Manager4ms_Symbol_CM_boolean_adm 0 0 0 1 ECU_ADDRESS 0x40004A53 /end MEASUREMENT
/begin MEASUREMENT vsVal_w3_Tr_PriOn "Flag valore vincitore  terzo TSC1 in richiesta di coppia con PriOn" UBYTE TE_TSC1Manager4ms_Symbol_CM_boolean_adm 0 0 0 1 ECU_ADDRESS 0x40004A52 /end MEASUREMENT
/begin MEASUREMENT vsVal_w4_Tr_PriOff "Flag valore vincitore  richiesta di coppia pedale con PriOff" UBYTE TE_TSC1Manager4ms_Symbol_CM_boolean_adm 0 0 0 1 ECU_ADDRESS 0x40004A51 /end MEASUREMENT
/begin MEASUREMENT vsVal_w4_Tr_PriOn "Flag valore vincitore richiesta di coppia pedale con PriOn" UBYTE TE_TSC1Manager4ms_Symbol_CM_boolean_adm 0 0 0 1 ECU_ADDRESS 0x40004A50 /end MEASUREMENT
/begin MEASUREMENT vsVal_win_Sr_PriOff "Valore vincitore in richiesta di velocità con PriOff" UWORD TE_TSC1Manager4ms_Symbol_CM_uint16_rpm 0 0 0 10000 ECU_ADDRESS 0x40004A88 /end MEASUREMENT
/begin MEASUREMENT vsVal_win_Sr_PriOn "Valore vincitore in richiesta di velocità con PriOn" UWORD TE_TSC1Manager4ms_Symbol_CM_uint16_rpm 0 0 0 10000 ECU_ADDRESS 0x40004A86 /end MEASUREMENT
/begin MEASUREMENT vsVal_win_Tr_PriOff "Valore vincitore in richiesta di coppia con PriOff" UWORD TE_TSC1Manager4ms_Symbol_CM_ufix16_En4__ 0 0 0 100 ECU_ADDRESS 0x40004A84 /end MEASUREMENT
/begin MEASUREMENT vsVal_win_Tr_PriOn "Valore vincitore in richiesta di coppia con PriOn" UWORD TE_TSC1Manager4ms_Symbol_CM_ufix16_En4__ 0 0 0 100 ECU_ADDRESS 0x40004A82 /end MEASUREMENT
/begin MEASUREMENT vsVehLtdActive "Limitazione velocità attiva" UBYTE J1939dl_Tx1s_CM_boolean_adm 0 0 0 1 ECU_ADDRESS 0x40004611 /end MEASUREMENT
/begin MEASUREMENT vsVehSpdFromShaft "Velocità veicolo derivata da Output Shaft Speed" UWORD Signal_Mgm_4ms_Symbol_CM_uint16_km_h 0 0 0 250 ECU_ADDRESS 0x40004680 /end MEASUREMENT
/begin MEASUREMENT vsVehSpeedLim "imite velocità veicolo imposta da pulsante esterno" UWORD J1939dl_Tx1s_CM_uint16_Km_h 0 0 1 250 ECU_ADDRESS 0x40004550 /end MEASUREMENT
/begin MEASUREMENT vsVehSpeedLimEn "Abilitazione alla funzione vehicle speed lim" UBYTE ConfInit_CM_boolean_adm 0 0 0 1 ECU_ADDRESS 0x40002301 /end MEASUREMENT
/begin MEASUREMENT vsVehVelSensDiagEn "Switch di abilitazione della diagnosi sensore velocità veicolo" UBYTE ConfInit_CM_boolean_adm 0 0 0 1 ECU_ADDRESS 0x40002306 /end MEASUREMENT
/begin MEASUREMENT vsVehicleSpeed "Velocità veicolo acquisita da CAN" UWORD DiagSym100ms_CM_uint16_km_h 0 0 0 250 ECU_ADDRESS 0x40004674 /end MEASUREMENT
/begin MEASUREMENT vsVehicleSpeedHR "Velocità veicolo acquisita da CAN con risoluzione SAE" UWORD Trqm_CtrlMgmt4ms_CM_ufix16_En8_km_h 0 0 0 250 ECU_ADDRESS 0x40004656 /end MEASUREMENT
/begin MEASUREMENT vsVehlErrPos "Errore tra velocità e limite" UWORD TE_CmuReqMgm4ms_Symbol_CM_uint16_Km_h 0 0 0 250 ECU_ADDRESS 0x400046A8 /end MEASUREMENT
/begin CHARACTERISTIC vsWAIT_PTO_MEMO_REQ "Tempo di attesa per riconoscere la richiesta di memo PTO" VALUE 0xFCC890 Scalar_UWORD 0 TE_PtoCc4ms_Symbol_CM_ufix16_Sp004_sec 0 240 /end CHARACTERISTIC
/begin CHARACTERISTIC vsWAIT_PTO_OFF "Tempo di attesa per riconoscere la richiesta di off PTO" VALUE 0xFCC88E Scalar_UWORD 0 TE_PtoCc4ms_Symbol_CM_ufix16_Sp004_sec 0 240 /end CHARACTERISTIC
/begin CHARACTERISTIC vsWAIT_PTO_RAMP_MINUS "Delta Tempo di attesa per riconoscere la richiesta di PTO ramp minus" VALUE 0xFCC88C Scalar_UWORD 0 TE_PtoCc4ms_Symbol_CM_ufix16_Sp004_sec 0 240 /end CHARACTERISTIC
/begin CHARACTERISTIC vsWAIT_PTO_RAMP_PLUS "Delta Tempo di attesa per riconoscere la richiesta di PTO ramp plus" VALUE 0xFCC88A Scalar_UWORD 0 TE_PtoCc4ms_Symbol_CM_ufix16_Sp004_sec 0 240 /end CHARACTERISTIC
/begin CHARACTERISTIC vsWAIT_PTO_REQ "Tempo di attesa per riconoscere la richiesta di PTO" VALUE 0xFCC888 Scalar_UWORD 0 TE_PtoCc4ms_Symbol_CM_ufix16_Sp004_sec 0 240 /end CHARACTERISTIC
/begin CHARACTERISTIC vsWAIT_PTO_RESUME "Tempo di attesa per riconoscere la richiesta di resume" VALUE 0xFCC886 Scalar_UWORD 0 TE_PtoCc4ms_Symbol_CM_ufix16_Sp004_sec 0 240 /end CHARACTERISTIC
/begin CHARACTERISTIC vsWAIT_PTO_SET_MINUS "Tempo di attesa per riconoscere la richiesta di PTO set minus" VALUE 0xFCC884 Scalar_UWORD 0 TE_PtoCc4ms_Symbol_CM_ufix16_Sp004_sec 0 240 /end CHARACTERISTIC
/begin CHARACTERISTIC vsWAIT_PTO_SET_PLUS "Tempo di attesa per riconoscere la richiesta di PTO set plus" VALUE 0xFCC882 Scalar_UWORD 0 TE_PtoCc4ms_Symbol_CM_ufix16_Sp004_sec 0 240 /end CHARACTERISTIC
/begin CHARACTERISTIC vs_CC_DELTA_OBJ "Massima deviazione della velocità da obiettivo CC" VALUE 0xFCC880 Scalar_UWORD 0 TE_PtoCc4ms_Symbol_CM_ufix16_En8_Bn100_Km_h -100 100 /end CHARACTERISTIC
/begin CHARACTERISTIC vtFAN1_ACT_REQ_PWM "DutyCycle for FAN1 computed in function of coolant temperature and engine speed" MAP 0xFC589C Lookup2D_UWORD 0 FanMgm100ms_CM_ufix16_En3__ 0 100
 /begin AXIS_DESCR COM_AXIS NO_INPUT_QUANTITY FanMgm100ms_CM_uint16_rpm 8 0 10000 AXIS_PTS_REF vkRPM_FAN1_ACT /end AXIS_DESCR
 /begin AXIS_DESCR COM_AXIS NO_INPUT_QUANTITY FanMgm100ms_CM_ufix16_Bn40_degC 8 -40 140 AXIS_PTS_REF vkTH2O_FAN1_ACT /end AXIS_DESCR
/end CHARACTERISTIC
/begin CHARACTERISTIC vtFAN2_ACT_REQ_PWM "DutyCycle for FAN2 computed in function of coolant temperature and engine speed" MAP 0xFC581C Lookup2D_UWORD 0 FanMgm100ms_CM_ufix16_En3__ 0 100
 /begin AXIS_DESCR COM_AXIS NO_INPUT_QUANTITY FanMgm100ms_CM_uint16_rpm 8 0 10000 AXIS_PTS_REF vkRPM_FAN2_ACT /end AXIS_DESCR
 /begin AXIS_DESCR COM_AXIS NO_INPUT_QUANTITY FanMgm100ms_CM_ufix16_Bn40_degC 8 -40 140 AXIS_PTS_REF vkTH2O_FAN2_ACT /end AXIS_DESCR
/end CHARACTERISTIC
/begin CHARACTERISTIC vtFAN_SPEED_TARGET "FAN1 target Speed computed in function of coolant temperature and engine speed" MAP 0xFC579C Lookup2D_UWORD 0 FanMgm100ms_CM_uint16_rpm 0 10000
 /begin AXIS_DESCR COM_AXIS NO_INPUT_QUANTITY FanMgm100ms_CM_uint16_rpm 8 0 10000 AXIS_PTS_REF vkRPM_FAN1_ACT /end AXIS_DESCR
 /begin AXIS_DESCR COM_AXIS NO_INPUT_QUANTITY FanMgm100ms_CM_ufix16_Bn40_degC 8 -40 140 AXIS_PTS_REF vkTH2O_FAN1_ACT /end AXIS_DESCR
/end CHARACTERISTIC
/begin CHARACTERISTIC vtPED_TORQ_REQ_LIM "Limitazione della percentuale di coppia richiesta da pedale" MAP 0xFCC7DA Lookup2DSF_UWORD 0 TE_CmuReqMgm4ms_Symbol_CM_ufix16_En4__ 0 100
 /begin AXIS_DESCR COM_AXIS NO_INPUT_QUANTITY TE_CmuReqMgm4ms_Symbol_CM_uint16_Km_h 8 0 250 AXIS_PTS_REF vkVEL_LIM_BKP /end AXIS_DESCR
 /begin AXIS_DESCR COM_AXIS NO_INPUT_QUANTITY TE_CmuReqMgm4ms_Symbol_CM_uint16_Km_h 8 0 250 AXIS_PTS_REF vkDELTA_VEL_BKP /end AXIS_DESCR
/end CHARACTERISTIC
/begin CHARACTERISTIC vtPRAIL_TARGET "Rail target pressure table in function of engine working point" MAP 0xFC55D4 Lookup2D_UWORD 0 EprMgm4ms_CM_uint16_mbar 0 13793
 /begin AXIS_DESCR COM_AXIS NO_INPUT_QUANTITY EprMgm4ms_CM_ufix16_En10_adm 8 0 3 AXIS_PTS_REF vkETASP_EPR /end AXIS_DESCR
 /begin AXIS_DESCR COM_AXIS NO_INPUT_QUANTITY EprMgm4ms_CM_uint16_rpm 8 0 10000 AXIS_PTS_REF vkRPM_EPR /end AXIS_DESCR
/end CHARACTERISTIC
/begin CHARACTERISTIC wfEGR_DELTA_P_TMP_Enable "[FIX] Egr Delta Pressure (Intake Manifold pressure [MAP] minus Exhaust Manifold pressure [Psca])" VALUE 0xFC5570 Scalar_UBYTE 0 TE_HBEgrValveCtrl4ms_CM_FixEnableT 171 218 /end CHARACTERISTIC
/begin CHARACTERISTIC wfEGR_DELTA_P_TMP_Value "[FIX] Egr Delta Pressure (Intake Manifold pressure [MAP] minus Exhaust Manifold pressure [Psca])" VALUE 0xFC556E Scalar_SWORD 0 TE_HBEgrValveCtrl4ms_CM_sfix16_En3_mbar -2850 2500 /end CHARACTERISTIC
/begin CHARACTERISTIC wfEGR_DUTY_Enable "[FIX] EGR Duty Cycle (for H-Bridge); sign represent the direction." VALUE 0xFC556C Scalar_UBYTE 0 TE_HBEgrValveCtrl4ms_CM_FixEnableT 171 218 /end CHARACTERISTIC
/begin CHARACTERISTIC wfEGR_DUTY_Value "[FIX] EGR Duty Cycle (for H-Bridge); sign represent the direction." VALUE 0xFC556A Scalar_SWORD 0 TE_HBEgrValveCtrl4ms_CM_sfix16_En3__ -100 100 /end CHARACTERISTIC
/begin CHARACTERISTIC wfEGR_K_D_Enable "[FIX] EGR Derivative Gain" VALUE 0xFC5568 Scalar_UBYTE 0 TE_HBEgrValveCtrl4ms_CM_FixEnableT 171 218 /end CHARACTERISTIC
/begin CHARACTERISTIC wfEGR_K_D_Value "[FIX] EGR Derivative Gain" VALUE 0xFC5564 Scalar_FLOAT32_IEEE 0 TE_HBEgrValveCtrl4ms_CM_single_adm 0 1000 /end CHARACTERISTIC
/begin CHARACTERISTIC wfEGR_K_I_Enable "[FIX] EGR Integrative Gain" VALUE 0xFC5560 Scalar_UBYTE 0 TE_HBEgrValveCtrl4ms_CM_FixEnableT 171 218 /end CHARACTERISTIC
/begin CHARACTERISTIC wfEGR_K_I_Value "[FIX] EGR Integrative Gain" VALUE 0xFC555C Scalar_FLOAT32_IEEE 0 TE_HBEgrValveCtrl4ms_CM_single_adm 0 1000 /end CHARACTERISTIC
/begin CHARACTERISTIC wfEGR_K_P_Enable "[FIX] EGR Proportional Gain" VALUE 0xFC5558 Scalar_UBYTE 0 TE_HBEgrValveCtrl4ms_CM_FixEnableT 171 218 /end CHARACTERISTIC
/begin CHARACTERISTIC wfEGR_K_P_Value "[FIX] EGR Proportional Gain" VALUE 0xFC5554 Scalar_FLOAT32_IEEE 0 TE_HBEgrValveCtrl4ms_CM_single_adm 0 1000 /end CHARACTERISTIC
/begin CHARACTERISTIC wfEGR_MASS_FLOW_EST_Enable "[FIX] EGR mass flow measured (using a calibrated septus and deltaP sensor beetwen the pipe orifice)." VALUE 0xFC5550 Scalar_UBYTE 0 EgrFlowRateMeas4ms_CM_FixEnableT 171 218 /end CHARACTERISTIC
/begin CHARACTERISTIC wfEGR_MASS_FLOW_EST_Value "[FIX] EGR mass flow measured (using a calibrated septus and deltaP sensor beetwen the pipe orifice)." VALUE 0xFC554E Scalar_UWORD 0 EgrFlowRateMeas4ms_CM_ufix16_En4_kg_h 0 4000 /end CHARACTERISTIC
/begin CHARACTERISTIC wfEGR_POS_OBJ_Enable "[FIX] [OUT] EGR target position voltage to obtain the Mass Flow Obj with the current EGR delta P (Intake - Exhaust pressure)" VALUE 0xFC554C Scalar_UBYTE 0 TE_HBEgrValveCtrl4ms_CM_FixEnableT 171 218 /end CHARACTERISTIC
/begin CHARACTERISTIC wfEGR_POS_OBJ_Value "[FIX] [OUT] EGR target position voltage to obtain the Mass Flow Obj with the current EGR delta P (Intake - Exhaust pressure)" VALUE 0xFC554A Scalar_UWORD 0 TE_HBEgrValveCtrl4ms_CM_ufix16_En10_V 0 5 /end CHARACTERISTIC
/begin CHARACTERISTIC wfEXH_P_MIX_Enable "[FIX] Molar mass of the exhaust gas mixture." VALUE 0xFC5548 Scalar_UBYTE 0 EgrFlowRateMeas4ms_CM_FixEnableT 171 218 /end CHARACTERISTIC
/begin CHARACTERISTIC wfEXH_P_MIX_Value "[FIX] Molar mass of the exhaust gas mixture." VALUE 0xFC5544 Scalar_FLOAT32_IEEE 0 EgrFlowRateMeas4ms_CM_single_kg_mol 0 500 /end CHARACTERISTIC
/begin CHARACTERISTIC wfPERC_EGR_OBJ_CO_Enable "[FIX] [OUT] EGR target percentage (with respect of Air Main mass flow) during cut-off" VALUE 0xFC5540 Scalar_UBYTE 0 TE_HBEgrValveCtrl4ms_CM_FixEnableT 171 218 /end CHARACTERISTIC
/begin CHARACTERISTIC wfPERC_EGR_OBJ_CO_Value "[FIX] [OUT] EGR target percentage (with respect of Air Main mass flow) during cut-off" VALUE 0xFC553E Scalar_UWORD 0 TE_HBEgrValveCtrl4ms_CM_ufix16_En3__ 0 100 /end CHARACTERISTIC
/begin CHARACTERISTIC wfPERC_EGR_OBJ_Enable "[FIX] [OUT] EGR target percentage (with respect of Air Main mass flow)" VALUE 0xFC553C Scalar_UBYTE 0 TE_HBEgrValveCtrl4ms_CM_FixEnableT 171 218 /end CHARACTERISTIC
/begin CHARACTERISTIC wfPERC_EGR_OBJ_Value "[FIX] [OUT] EGR target percentage (with respect of Air Main mass flow)" VALUE 0xFC553A Scalar_UWORD 0 TE_HBEgrValveCtrl4ms_CM_ufix16_En3__ 0 100 /end CHARACTERISTIC
/begin AXIS_PTS wkEGR_DELTA_P "[Y_BKP] Egr Delta Pressure (Intake Manifold pressure [MAP] minus Exhaust Manifold pressure [Psca])" 0xFC551A NO_INPUT_QUANTITY Lookup2D_X_WORD 0 TE_HBEgrValveCtrl4ms_CM_sfix16_En3_mbar 16 -2850 2500 /end AXIS_PTS
/begin AXIS_PTS wkMASS_FLOW_EGR_OBJ "[X_BKP] EGR mass flow target (as result of percentage of the Air Main)" 0xFC54BA NO_INPUT_QUANTITY Lookup2D_X_UWORD 0 TE_HBEgrValveCtrl4ms_CM_ufix16_En4_kg_h 16 0 4000 /end AXIS_PTS
/begin CHARACTERISTIC wsEGRC_ERROR_TIME "EGR control stability diagnosis time-out" VALUE 0xFC5478 Scalar_UWORD 0 FaultChkEGRC4ms_CM_ufix16_Sp004_s 0 250 /end CHARACTERISTIC
/begin CHARACTERISTIC wsEGRC_MAX_STAT_ERR "EGR maximum allowed error with respect to the target." VALUE 0xFC5476 Scalar_SWORD 0 FaultChkEGRC4ms_CM_sfix16_En10_V 0 5 /end CHARACTERISTIC
/begin CHARACTERISTIC wsEGR_CTRL_ENABLE "Enable EGR H-Bridge control strategy" VALUE 0xFC5474 Scalar_BOOLEAN 0 TE_HBEgrValveCtrl4ms_CM_boolean_adm 0 1 /end CHARACTERISTIC
/begin CHARACTERISTIC wsEGR_DISCHARGE_CD "Discharge coefficient through the constriction" VALUE 0xFC5472 Scalar_UWORD 0 EgrFlowRateMeas4ms_CM_ufix16_En14_adm 0 2 /end CHARACTERISTIC
/begin CHARACTERISTIC wsEGR_DPMEAS_IN_D "Diameter of the constrinction orifice of the calibrated septum pipe used for the estimation of the flow rate." VALUE 0xFC5470 Scalar_UWORD 0 EgrFlowRateMeas4ms_CM_ufix16_En7_mm 0 500 /end CHARACTERISTIC
/begin CHARACTERISTIC wsEGR_DPMEAS_OUT_D "Diameter of the pipe used for the estimation of the flow rate." VALUE 0xFC546E Scalar_UWORD 0 EgrFlowRateMeas4ms_CM_ufix16_En7_mm 0 500 /end CHARACTERISTIC
/begin CHARACTERISTIC wsEGR_DP_VIRTUAL "Select source for EGR Delta Pressure sensor (Upstream/Downstream valve sensor)." VALUE 0xFC546C Scalar_BOOLEAN 0 TE_HBEgrValveCtrl4ms_CM_boolean_adm 0 1 /end CHARACTERISTIC
/begin CHARACTERISTIC wsEGR_DUTY_SAT_H "EGR Duty Cycle (for H-Bridge) higher saturation; defines the control authority." VALUE 0xFC546A Scalar_SWORD 0 TE_HBEgrValveCtrl4ms_CM_sfix16_En3_adm 0 100 /end CHARACTERISTIC
/begin CHARACTERISTIC wsEGR_DUTY_SAT_L "EGR Duty Cycle (for H-Bridge) lower saturation; defines the control authority." VALUE 0xFC5468 Scalar_SWORD 0 TE_HBEgrValveCtrl4ms_CM_sfix16_En3_adm -100 0 /end CHARACTERISTIC
/begin CHARACTERISTIC wsEGR_FR_MEAS_ORIFICE_PIPE "Enable the calculation of the EGR flow rate using a calibrate septus pipe with a dedicated delta pressure sensor on the flow upstream and downstream of the orifice." VALUE 0xFC5466 Scalar_BOOLEAN 0 EgrFlowRateMeas4ms_CM_boolean_adm 0 1 /end CHARACTERISTIC
/begin CHARACTERISTIC wsEGR_HP_AV "Flag for the availability of the high pressure sensor (before EGR valve) to estimate the density of the exhaust gas mixture (1- Use HighP sensor zsEgrHigHPre; 0 - Use estimated pressure asPsca)" VALUE 0xFC5465 Scalar_BOOLEAN 0 EgrFlowRateMeas4ms_CM_boolean_adm 0 1 /end CHARACTERISTIC
/begin CHARACTERISTIC wsEGR_VALV_OPENING_DIR "Change standard opening direction of the EGR valve (depending by the physical component)." VALUE 0xFC5464 Scalar_BOOLEAN 0 TE_HBEgrValveCtrl4ms_CM_boolean_adm 0 1 /end CHARACTERISTIC
/begin CHARACTERISTIC wsEGR_WIN_NEG "Threshold value to identify the conditions of negative EGR position error beyond which normal parameters can be used (NEG_STRONG)" VALUE 0xFC5462 Scalar_SWORD 0 TE_HBEgrValveCtrl4ms_CM_sfix16_En10_V -5 0 /end CHARACTERISTIC
/begin CHARACTERISTIC wsEGR_WIN_POS "Threshold value to identify the conditions of positive EGR position error beyond which normal parameters can be used (POS_STRONG)" VALUE 0xFC5460 Scalar_SWORD 0 TE_HBEgrValveCtrl4ms_CM_sfix16_En10_V 0 5 /end CHARACTERISTIC
/begin CHARACTERISTIC wsEN_CUT_OFF_EGR "Enable Flag for change EGR taget percentage during CUT-OFF" VALUE 0xFC545E Scalar_BOOLEAN 0 TE_HBEgrValveCtrl4ms_CM_boolean_adm 0 1 /end CHARACTERISTIC
/begin MEASUREMENT wsEgrCmdEnable "Enable H-Bridge driver for Epr valve " UBYTE EgrMgm4ms_CM_boolean_adm 0 0 0 1 ECU_ADDRESS 0x40002AA9 /end MEASUREMENT
/begin MEASUREMENT wsEgrDeltaP "Egr Delta Pressure (between teh valve upstream and downstream) used to define the EGR valve target position." SWORD EgrMgm4ms_CM_sfix16_En3_mbar 0 0 -2850 2500 ECU_ADDRESS 0x40002AB2 /end MEASUREMENT
/begin MEASUREMENT wsEgrDeltaPTmp "Egr Delta Pressure (between teh valve upstream and downstream) before FIX" SWORD TE_HBEgrValveCtrl4ms_CM_sfix16_En3_mbar 0 0 -2850 2500 ECU_ADDRESS 0x40002B8C /end MEASUREMENT
/begin MEASUREMENT wsEgrDerCtrl "EGR Derivative contribute" FLOAT32_IEEE TE_HBEgrValveCtrl4ms_CM_single__ 0 0 -100 100 ECU_ADDRESS 0x40002B88 /end MEASUREMENT
/begin MEASUREMENT wsEgrDuty "EGR Duty Cycle (for H-Bridge); sign represent the direction." SWORD EgrMgm4ms_CM_sfix16_En3__ 0 0 -100 100 ECU_ADDRESS 0x40002AB0 /end MEASUREMENT
/begin MEASUREMENT wsEgrDutyPID "EGR PID contribute" FLOAT32_IEEE TE_HBEgrValveCtrl4ms_CM_single__ 0 0 -100 100 ECU_ADDRESS 0x40002B84 /end MEASUREMENT
/begin MEASUREMENT wsEgrDutyTmp "EGR Duty Cycle (for H-Bridge) before the FIX; sign represent the direction." SWORD TE_HBEgrValveCtrl4ms_CM_sfix16_En3__ 0 0 -100 100 ECU_ADDRESS 0x40002B80 /end MEASUREMENT
/begin MEASUREMENT wsEgrIntCtrl "EGR Integrative contribute" FLOAT32_IEEE TE_HBEgrValveCtrl4ms_CM_single__ 0 0 -100 100 ECU_ADDRESS 0x40002B7C /end MEASUREMENT
/begin MEASUREMENT wsEgrKD "EGR Derivative Gain" FLOAT32_IEEE TE_HBEgrValveCtrl4ms_CM_single_adm 0 0 0 1000 ECU_ADDRESS 0x40002B78 /end MEASUREMENT
/begin MEASUREMENT wsEgrKI "EGR Integrative Gain" FLOAT32_IEEE TE_HBEgrValveCtrl4ms_CM_single_adm 0 0 0 1000 ECU_ADDRESS 0x40002B74 /end MEASUREMENT
/begin MEASUREMENT wsEgrKP "EGR Proportional Gain" FLOAT32_IEEE TE_HBEgrValveCtrl4ms_CM_single_adm 0 0 0 1000 ECU_ADDRESS 0x40002B70 /end MEASUREMENT
/begin MEASUREMENT wsEgrPosErr "[OUT] EGR control error between the target position voltage to obtain the Mass Flow Obj and the feedback from EGR position sensor." SWORD EgrMgm4ms_CM_sfix16_En10_V 0 0 0 5 ECU_ADDRESS 0x40002AB4 /end MEASUREMENT
/begin MEASUREMENT wsEgrPosObj "EGR target position voltage to obtain the Mass Flow Obj with the current EGR delta P (Intake - Exhaust pressure)" UWORD EgrMgm4ms_CM_ufix16_En10_V 0 0 0 5 ECU_ADDRESS 0x40002ABC /end MEASUREMENT
/begin MEASUREMENT wsEgrPosObjTmp "[OUT] EGR target position voltage to obtain the Mass Flow Obj with the current EGR delta P (Intake - Exhaust pressure)" UWORD TE_HBEgrValveCtrl4ms_CM_ufix16_En10_V 0 0 0 5 ECU_ADDRESS 0x40002B6C /end MEASUREMENT
/begin MEASUREMENT wsEgrPropCtrl "EGR Proportional contribute" FLOAT32_IEEE TE_HBEgrValveCtrl4ms_CM_single__ 0 0 -100 100 ECU_ADDRESS 0x40002B68 /end MEASUREMENT
/begin MEASUREMENT wsExhPMix "Molar mass of the exhaust gas mixture (before FIX)." FLOAT32_IEEE EgrFlowRateMeas4ms_CM_single_kg_mol 0 0 0 500 ECU_ADDRESS 0x40002B04 /end MEASUREMENT
/begin CHARACTERISTIC wsHB_EGR_FREQ "H-Bridge EGR valve command frequency" VALUE 0xFC545C Scalar_UWORD 0 TE_HBEgrValveCtrl4ms_CM_ufix16_S10_Hz 0 10000 /end CHARACTERISTIC
/begin CHARACTERISTIC wsKD_NEG_STRONG "EGR Derivative Gain for normal negative error" VALUE 0xFC5458 Scalar_FLOAT32_IEEE 0 TE_HBEgrValveCtrl4ms_CM_single_adm 0 1000 /end CHARACTERISTIC
/begin CHARACTERISTIC wsKD_NEG_WEAK "EGR Derivative Gain for small negative error" VALUE 0xFC5454 Scalar_FLOAT32_IEEE 0 TE_HBEgrValveCtrl4ms_CM_single_adm 0 1000 /end CHARACTERISTIC
/begin CHARACTERISTIC wsKD_POS_STRONG "EGR Derivative Gain for normal positive error" VALUE 0xFC5450 Scalar_FLOAT32_IEEE 0 TE_HBEgrValveCtrl4ms_CM_single_adm 0 1000 /end CHARACTERISTIC
/begin CHARACTERISTIC wsKD_POS_WEAK "EGR Derivative Gain for small positive error" VALUE 0xFC544C Scalar_FLOAT32_IEEE 0 TE_HBEgrValveCtrl4ms_CM_single_adm 0 1000 /end CHARACTERISTIC
/begin CHARACTERISTIC wsKI_NEG_STRONG "EGR Integrative Gain for normal negative error" VALUE 0xFC5448 Scalar_FLOAT32_IEEE 0 TE_HBEgrValveCtrl4ms_CM_single_adm 0 1000 /end CHARACTERISTIC
/begin CHARACTERISTIC wsKI_NEG_WEAK "EGR Integrative Gain for small negative error" VALUE 0xFC5444 Scalar_FLOAT32_IEEE 0 TE_HBEgrValveCtrl4ms_CM_single_adm 0 1000 /end CHARACTERISTIC
/begin CHARACTERISTIC wsKI_POS_STRONG "EGR Integrative Gain for normal positive error" VALUE 0xFC5440 Scalar_FLOAT32_IEEE 0 TE_HBEgrValveCtrl4ms_CM_single_adm 0 1000 /end CHARACTERISTIC
/begin CHARACTERISTIC wsKI_POS_WEAK "EGR Integrative Gain for small positive error" VALUE 0xFC543C Scalar_FLOAT32_IEEE 0 TE_HBEgrValveCtrl4ms_CM_single_adm 0 1000 /end CHARACTERISTIC
/begin CHARACTERISTIC wsKP_NEG_STRONG "EGR Proportional Gain for normal negative error" VALUE 0xFC5438 Scalar_FLOAT32_IEEE 0 TE_HBEgrValveCtrl4ms_CM_single_adm 0 1000 /end CHARACTERISTIC
/begin CHARACTERISTIC wsKP_NEG_WEAK "EGR Proportional Gain for small negative error" VALUE 0xFC5434 Scalar_FLOAT32_IEEE 0 TE_HBEgrValveCtrl4ms_CM_single_adm 0 1000 /end CHARACTERISTIC
/begin CHARACTERISTIC wsKP_POS_STRONG "EGR Proportional Gain for normal positive error" VALUE 0xFC5430 Scalar_FLOAT32_IEEE 0 TE_HBEgrValveCtrl4ms_CM_single_adm 0 1000 /end CHARACTERISTIC
/begin CHARACTERISTIC wsKP_POS_WEAK "EGR Proportional Gain for small positive error" VALUE 0xFC542C Scalar_FLOAT32_IEEE 0 TE_HBEgrValveCtrl4ms_CM_single_adm 0 1000 /end CHARACTERISTIC
/begin MEASUREMENT wsMassFlowEGREst "EGR mass flow measured (using a calibrated septus and deltaP sensor beetwen the pipe orifice)." UWORD EgrMgm4ms_CM_ufix16_En4_kg_h 0 0 0 4000 ECU_ADDRESS 0x40002AB8 /end MEASUREMENT
/begin MEASUREMENT wsMassFlowEGREstTmp "EGR mass flow measured (using a calibrated septus and deltaP sensor beetwen the pipe orifice) before FIX and after filtering." UWORD EgrFlowRateMeas4ms_CM_ufix16_En4_kg_h 0 0 0 4000 ECU_ADDRESS 0x40002B00 /end MEASUREMENT
/begin MEASUREMENT wsMassFlowEGRInst "EGR instantaneous mass flow measured (using a calibrated septus and deltaP sensor beetwen the pipe orifice)." FLOAT32_IEEE EgrFlowRateMeas4ms_CM_single_kg_h 0 0 0 4000 ECU_ADDRESS 0x40002AFC /end MEASUREMENT
/begin MEASUREMENT wsMassFlowEGRMeasEn "Flag indicates that the measure of the EGR mass flow (using a calibrated septus and deltaP sensor beetwen the pipe orifice) is enabled." UBYTE EgrMgm4ms_CM_boolean_adm 0 0 0 1 ECU_ADDRESS 0x40002AAD /end MEASUREMENT
/begin MEASUREMENT wsMassFlowEGRObj "EGR mass flow target (as result of percentage of the Air Main)" UWORD Airq_CtrlMgmtTDC_CM_ufix16_En4_kg_h 0 0 0 4000 ECU_ADDRESS 0x40002AB6 /end MEASUREMENT
/begin MEASUREMENT wsMassFlowEGRObjTmp "EGR mass flow target (as result of percentage of the Air Main) before warm-up enable." UWORD TE_HBEgrValveCtrl4ms_CM_ufix16_En4_kg_h 0 0 0 4000 ECU_ADDRESS 0x40002B64 /end MEASUREMENT
/begin MEASUREMENT wsPercEGRObjFin "Target for EGR mass flow percentage" UWORD EgrMgm4ms_CM_ufix16_En3__ 0 0 0 100 ECU_ADDRESS 0x40002AAE /end MEASUREMENT
/begin MEASUREMENT wsPercEgrObj "[OUT] EGR target percentage (with respect of Air Main mass flow)" UWORD TE_HBEgrValveCtrl4ms_CM_ufix16_En3__ 0 0 0 100 ECU_ADDRESS 0x40002B62 /end MEASUREMENT
/begin MEASUREMENT wsPercEgrObjCo "[OUT] EGR target percentage (with respect of Air Main mass flow) during cut-off" UWORD TE_HBEgrValveCtrl4ms_CM_ufix16_En3__ 0 0 0 100 ECU_ADDRESS 0x40002B60 /end MEASUREMENT
/begin CHARACTERISTIC wsWARMUP_EGR_THR "Minimum Warm-up coolant temperature after which the EGR can be used." VALUE 0xFC542A Scalar_UWORD 0 TE_HBEgrValveCtrl4ms_CM_ufix16_Bn40_degC -40 140 /end CHARACTERISTIC
/begin CHARACTERISTIC wtEGR_POS_OBJ "EGR target position voltage to obtain the Mass Flow Obj with the current EGR delta P (Intake - Exhaust pressure)" MAP 0xFC522A Lookup2D_UWORD 0 TE_HBEgrValveCtrl4ms_CM_ufix16_En10_V 0 5
 /begin AXIS_DESCR COM_AXIS NO_INPUT_QUANTITY TE_HBEgrValveCtrl4ms_CM_sfix16_En3_mbar 16 -2850 2500 AXIS_PTS_REF wkEGR_DELTA_P /end AXIS_DESCR
 /begin AXIS_DESCR COM_AXIS NO_INPUT_QUANTITY TE_HBEgrValveCtrl4ms_CM_ufix16_En4_kg_h 16 0 4000 AXIS_PTS_REF wkMASS_FLOW_EGR_OBJ /end AXIS_DESCR
/end CHARACTERISTIC
/begin COMPU_METHOD Airq_CtrlMgmtTDC_CM_ufix16_En4_kg_h "Q = V*16.000000" RAT_FUNC "%8.4" "kg/h" COEFFS 0 16 0 0 0 1 /end COMPU_METHOD
/begin COMPU_METHOD AutoTDC_CM_boolean_adm "Q = V" RAT_FUNC "%1.0" "adm" COEFFS 0 1 0 0 0 1 /end COMPU_METHOD
/begin COMPU_METHOD AutoTDC_CM_ufix16_En15_adm "Q = V*32768.000000" RAT_FUNC "%16.15" "adm" COEFFS 0 32768 0 0 0 1 /end COMPU_METHOD
/begin COMPU_METHOD AutoUpdatingTDC_CM_FixEnableT "Enumerated data type: FixEnableT" TAB_VERB "%0.6" "" COMPU_TAB_REF VTAB_FOR_AutoUpdatingTDC_CM_FixEnableT /end COMPU_METHOD
/begin COMPU_METHOD AutoUpdatingTDC_CM_boolean_adm "Q = V" RAT_FUNC "%1.0" "adm" COEFFS 0 1 0 0 0 1 /end COMPU_METHOD
/begin COMPU_METHOD AutoUpdatingTDC_CM_sfix16_En15_adm "Q = V*32768.000000" RAT_FUNC "%16.15" "adm" COEFFS 0 32768 0 0 0 1 /end COMPU_METHOD
/begin COMPU_METHOD AutoUpdatingTDC_CM_tAutoState_adm "Enumerated data type: tAutoState" TAB_VERB "%0.6" "adm" COMPU_TAB_REF VTAB_FOR_AutoUpdatingTDC_CM_tAutoState_adm /end COMPU_METHOD
/begin COMPU_METHOD AutoUpdatingTDC_CM_ufix16_Bn40_degC "Q = (V+40.000000)/1.000000" RAT_FUNC "%0.6" "degC" COEFFS 0 1 40 0 0 1 /end COMPU_METHOD
/begin COMPU_METHOD AutoUpdatingTDC_CM_ufix16_En10_adm "Q = V*1024.000000" RAT_FUNC "%12.10" "adm" COEFFS 0 1024 0 0 0 1 /end COMPU_METHOD
/begin COMPU_METHOD AutoUpdatingTDC_CM_ufix16_En15_adm "Q = V*32768.000000" RAT_FUNC "%16.15" "adm" COEFFS 0 32768 0 0 0 1 /end COMPU_METHOD
/begin COMPU_METHOD AutoUpdatingTDC_CM_ufix16_S50_mV "Q = V/50.000000" RAT_FUNC "%0.6" "mV" COEFFS 0 1 0 0 0 50 /end COMPU_METHOD
/begin COMPU_METHOD AutoUpdatingTDC_CM_ufix32_En15_adm "Q = V*32768.000000" RAT_FUNC "%21.15" "adm" COEFFS 0 32768 0 0 0 1 /end COMPU_METHOD
/begin COMPU_METHOD AutoUpdatingTDC_CM_ufix32_Sp1_s "Q = V*10.000000" RAT_FUNC "%0.6" "s" COEFFS 0 10 0 0 0 1 /end COMPU_METHOD
/begin COMPU_METHOD AutoUpdatingTDC_CM_uint16_adm "Q = V" RAT_FUNC "%5.0" "adm" COEFFS 0 1 0 0 0 1 /end COMPU_METHOD
/begin COMPU_METHOD AutoUpdatingTDC_CM_uint16_mbar "Q = V" RAT_FUNC "%5.0" "mbar" COEFFS 0 1 0 0 0 1 /end COMPU_METHOD
/begin COMPU_METHOD AutoUpdatingTDC_CM_uint16_rpm "Q = V" RAT_FUNC "%5.0" "rpm" COEFFS 0 1 0 0 0 1 /end COMPU_METHOD
/begin COMPU_METHOD AutoUpdatingTDC_CM_uint32_adm "Q = V" RAT_FUNC "%10.0" "adm" COEFFS 0 1 0 0 0 1 /end COMPU_METHOD
/begin COMPU_METHOD AutoUpdatingTDC_CM_uint32_pms "Q = V" RAT_FUNC "%10.0" "pms" COEFFS 0 1 0 0 0 1 /end COMPU_METHOD
/begin COMPU_METHOD AutoUpdatingTDC_CM_uint8_adm "Q = V" RAT_FUNC "%3.0" "adm" COEFFS 0 1 0 0 0 1 /end COMPU_METHOD
/begin COMPU_METHOD BoostControl50ms_Symbol_CM_ufix16_En10_adm "Q = V*1024.000000" RAT_FUNC "%12.10" "adm" COEFFS 0 1024 0 0 0 1 /end COMPU_METHOD
/begin COMPU_METHOD BoostControl50ms_Symbol_CM_ufix16_En3__ "Q = V*8.000000" RAT_FUNC "%7.3" "%" COEFFS 0 8 0 0 0 1 /end COMPU_METHOD
/begin COMPU_METHOD BoostControl50ms_Symbol_CM_uint16_rpm "Q = V" RAT_FUNC "%5.0" "rpm" COEFFS 0 1 0 0 0 1 /end COMPU_METHOD
/begin COMPU_METHOD ConfInit_CM_boolean_adm "Q = V" RAT_FUNC "%1.0" "adm" COEFFS 0 1 0 0 0 1 /end COMPU_METHOD
/begin COMPU_METHOD Crkc4ms_CM_boolean_adm "Q = V" RAT_FUNC "%1.0" "adm" COEFFS 0 1 0 0 0 1 /end COMPU_METHOD
/begin COMPU_METHOD DiagSym100ms_CM_boolean_adm "Q = V" RAT_FUNC "%1.0" "adm" COEFFS 0 1 0 0 0 1 /end COMPU_METHOD
/begin COMPU_METHOD DiagSym100ms_CM_ufix8_Sp4__ "Q = V*2.500000" RAT_FUNC "%0.6" "%" COEFFS 0 2.5 0 0 0 1 /end COMPU_METHOD
/begin COMPU_METHOD DiagSym100ms_CM_uint16_km_h "Q = V" RAT_FUNC "%5.0" "km/h" COEFFS 0 1 0 0 0 1 /end COMPU_METHOD
/begin COMPU_METHOD DiagSym100ms_CM_uint32_min "Q = V" RAT_FUNC "%10.0" "min" COEFFS 0 1 0 0 0 1 /end COMPU_METHOD
/begin COMPU_METHOD EgrFlowRateMeas4ms_CM_FixEnableT "Enumerated data type: FixEnableT" TAB_VERB "%0.6" "" COMPU_TAB_REF VTAB_FOR_EgrFlowRateMeas4ms_CM_FixEnableT /end COMPU_METHOD
/begin COMPU_METHOD EgrFlowRateMeas4ms_CM_boolean_adm "Q = V" RAT_FUNC "%1.0" "adm" COEFFS 0 1 0 0 0 1 /end COMPU_METHOD
/begin COMPU_METHOD EgrFlowRateMeas4ms_CM_single_kg_h "Q = V" RAT_FUNC "%8.6" "kg/h" COEFFS 0 1 0 0 0 1 /end COMPU_METHOD
/begin COMPU_METHOD EgrFlowRateMeas4ms_CM_single_kg_mol "Q = V" RAT_FUNC "%8.6" "kg/mol" COEFFS 0 1 0 0 0 1 /end COMPU_METHOD
/begin COMPU_METHOD EgrFlowRateMeas4ms_CM_ufix16_En14_adm "Q = V*16384.000000" RAT_FUNC "%15.14" "adm" COEFFS 0 16384 0 0 0 1 /end COMPU_METHOD
/begin COMPU_METHOD EgrFlowRateMeas4ms_CM_ufix16_En4_kg_h "Q = V*16.000000" RAT_FUNC "%8.4" "kg/h" COEFFS 0 16 0 0 0 1 /end COMPU_METHOD
/begin COMPU_METHOD EgrFlowRateMeas4ms_CM_ufix16_En7_mm "Q = V*128.000000" RAT_FUNC "%10.7" "mm" COEFFS 0 128 0 0 0 1 /end COMPU_METHOD
/begin COMPU_METHOD EgrMgm4ms_CM_boolean_adm "Q = V" RAT_FUNC "%1.0" "adm" COEFFS 0 1 0 0 0 1 /end COMPU_METHOD
/begin COMPU_METHOD EgrMgm4ms_CM_sfix16_En10_V "Q = V*1024.000000" RAT_FUNC "%12.10" "V" COEFFS 0 1024 0 0 0 1 /end COMPU_METHOD
/begin COMPU_METHOD EgrMgm4ms_CM_sfix16_En3__ "Q = V*8.000000" RAT_FUNC "%7.3" "%" COEFFS 0 8 0 0 0 1 /end COMPU_METHOD
/begin COMPU_METHOD EgrMgm4ms_CM_sfix16_En3_mbar "Q = V*8.000000" RAT_FUNC "%7.3" "mbar" COEFFS 0 8 0 0 0 1 /end COMPU_METHOD
/begin COMPU_METHOD EgrMgm4ms_CM_ufix16_En10_V "Q = V*1024.000000" RAT_FUNC "%12.10" "V" COEFFS 0 1024 0 0 0 1 /end COMPU_METHOD
/begin COMPU_METHOD EgrMgm4ms_CM_ufix16_En3__ "Q = V*8.000000" RAT_FUNC "%7.3" "%" COEFFS 0 8 0 0 0 1 /end COMPU_METHOD
/begin COMPU_METHOD EgrMgm4ms_CM_ufix16_En4_kg_h "Q = V*16.000000" RAT_FUNC "%8.4" "kg/h" COEFFS 0 16 0 0 0 1 /end COMPU_METHOD
/begin COMPU_METHOD EnableFcnEn4ms_Symbol_CM_FixEnableT "Enumerated data type: FixEnableT" TAB_VERB "%0.6" "" COMPU_TAB_REF VTAB_FOR_EnableFcnEn4ms_Symbol_CM_FixEnableT /end COMPU_METHOD
/begin COMPU_METHOD EnableFcnEn4ms_Symbol_CM_boolean_adm "Q = V" RAT_FUNC "%1.0" "adm" COEFFS 0 1 0 0 0 1 /end COMPU_METHOD
/begin COMPU_METHOD Epr4ms_CM_boolean_adm "Q = V" RAT_FUNC "%1.0" "adm" COEFFS 0 1 0 0 0 1 /end COMPU_METHOD
/begin COMPU_METHOD Epr4ms_CM_ufix16_En8_kg_hour "Q = V*256.000000" RAT_FUNC "%11.8" "kg/hour" COEFFS 0 256 0 0 0 1 /end COMPU_METHOD
/begin COMPU_METHOD Epr4ms_CM_uint16_mbar "Q = V" RAT_FUNC "%5.0" "mbar" COEFFS 0 1 0 0 0 1 /end COMPU_METHOD
/begin COMPU_METHOD EprMgm4ms_CM_FixEnableT "Enumerated data type: FixEnableT" TAB_VERB "%0.6" "" COMPU_TAB_REF VTAB_FOR_EprMgm4ms_CM_FixEnableT /end COMPU_METHOD
/begin COMPU_METHOD EprMgm4ms_CM_boolean_adm "Q = V" RAT_FUNC "%1.0" "adm" COEFFS 0 1 0 0 0 1 /end COMPU_METHOD
/begin COMPU_METHOD EprMgm4ms_CM_ufix16_En10_adm "Q = V*1024.000000" RAT_FUNC "%12.10" "adm" COEFFS 0 1024 0 0 0 1 /end COMPU_METHOD
/begin COMPU_METHOD EprMgm4ms_CM_uint16_mbar "Q = V" RAT_FUNC "%5.0" "mbar" COEFFS 0 1 0 0 0 1 /end COMPU_METHOD
/begin COMPU_METHOD EprMgm4ms_CM_uint16_rpm "Q = V" RAT_FUNC "%5.0" "rpm" COEFFS 0 1 0 0 0 1 /end COMPU_METHOD
/begin COMPU_METHOD FanCool100ms_CM_boolean_adm "Q = V" RAT_FUNC "%1.0" "adm" COEFFS 0 1 0 0 0 1 /end COMPU_METHOD
/begin COMPU_METHOD FanCool100ms_CM_ufix16_En3__ "Q = V*8.000000" RAT_FUNC "%7.3" "%" COEFFS 0 8 0 0 0 1 /end COMPU_METHOD
/begin COMPU_METHOD FanMgm100ms_CM_FixEnableT "Enumerated data type: FixEnableT" TAB_VERB "%0.6" "" COMPU_TAB_REF VTAB_FOR_FanMgm100ms_CM_FixEnableT /end COMPU_METHOD
/begin COMPU_METHOD FanMgm100ms_CM_boolean_adm "Q = V" RAT_FUNC "%1.0" "adm" COEFFS 0 1 0 0 0 1 /end COMPU_METHOD
/begin COMPU_METHOD FanMgm100ms_CM_int16_rpm "Q = V" RAT_FUNC "%5.0" "rpm" COEFFS 0 1 0 0 0 1 /end COMPU_METHOD
/begin COMPU_METHOD FanMgm100ms_CM_single__ "Q = V" RAT_FUNC "%8.6" "%" COEFFS 0 1 0 0 0 1 /end COMPU_METHOD
/begin COMPU_METHOD FanMgm100ms_CM_ufix16_Bn40_degC "Q = (V+40.000000)/1.000000" RAT_FUNC "%0.6" "degC" COEFFS 0 1 40 0 0 1 /end COMPU_METHOD
/begin COMPU_METHOD FanMgm100ms_CM_ufix16_En14_adm "Q = V*16384.000000" RAT_FUNC "%15.14" "adm" COEFFS 0 16384 0 0 0 1 /end COMPU_METHOD
/begin COMPU_METHOD FanMgm100ms_CM_ufix16_En3__ "Q = V*8.000000" RAT_FUNC "%7.3" "%" COEFFS 0 8 0 0 0 1 /end COMPU_METHOD
/begin COMPU_METHOD FanMgm100ms_CM_ufix16_En4__ "Q = V*16.000000" RAT_FUNC "%8.4" "%" COEFFS 0 16 0 0 0 1 /end COMPU_METHOD
/begin COMPU_METHOD FanMgm100ms_CM_ufix16_S10_Hz "Q = V/10.000000" RAT_FUNC "%0.6" "Hz" COEFFS 0 1 0 0 0 10 /end COMPU_METHOD
/begin COMPU_METHOD FanMgm100ms_CM_ufix16_S50_mV "Q = V/50.000000" RAT_FUNC "%0.6" "mV" COEFFS 0 1 0 0 0 50 /end COMPU_METHOD
/begin COMPU_METHOD FanMgm100ms_CM_uint16_rpm "Q = V" RAT_FUNC "%5.0" "rpm" COEFFS 0 1 0 0 0 1 /end COMPU_METHOD
/begin COMPU_METHOD FanMgm100ms_CM_uint8_adm "Q = V" RAT_FUNC "%3.0" "adm" COEFFS 0 1 0 0 0 1 /end COMPU_METHOD
/begin COMPU_METHOD FaultChkEGRC4ms_CM_sfix16_En10_V "Q = V*1024.000000" RAT_FUNC "%12.10" "V" COEFFS 0 1024 0 0 0 1 /end COMPU_METHOD
/begin COMPU_METHOD FaultChkEGRC4ms_CM_ufix16_Sp004_s "Q = V*250.000000" RAT_FUNC "%0.6" "s" COEFFS 0 250 0 0 0 1 /end COMPU_METHOD
/begin COMPU_METHOD FuelConsTDC_CM_FixEnableT "Enumerated data type: FixEnableT" TAB_VERB "%0.6" "" COMPU_TAB_REF VTAB_FOR_FuelConsTDC_CM_FixEnableT /end COMPU_METHOD
/begin COMPU_METHOD FuelConsTDC_CM_boolean_kg_l "Q = V" RAT_FUNC "%1.0" "kg/l" COEFFS 0 1 0 0 0 1 /end COMPU_METHOD
/begin COMPU_METHOD FuelConsTDC_CM_int16_degC "Q = V" RAT_FUNC "%5.0" "degC" COEFFS 0 1 0 0 0 1 /end COMPU_METHOD
/begin COMPU_METHOD FuelConsTDC_CM_single_g_mol "Q = V" RAT_FUNC "%8.6" "g/mol" COEFFS 0 1 0 0 0 1 /end COMPU_METHOD
/begin COMPU_METHOD FuelConsTDC_CM_single_kg "Q = V" RAT_FUNC "%8.6" "kg" COEFFS 0 1 0 0 0 1 /end COMPU_METHOD
/begin COMPU_METHOD FuelConsTDC_CM_single_kg_l "Q = V" RAT_FUNC "%8.6" "kg/l" COEFFS 0 1 0 0 0 1 /end COMPU_METHOD
/begin COMPU_METHOD FuelConsTDC_CM_single_ul "Q = V" RAT_FUNC "%8.6" "ul" COEFFS 0 1 0 0 0 1 /end COMPU_METHOD
/begin COMPU_METHOD FuelConsTDC_CM_single_ul_cc "Q = V" RAT_FUNC "%8.6" "ul/cc" COEFFS 0 1 0 0 0 1 /end COMPU_METHOD
/begin COMPU_METHOD FuelConsTDC_CM_ufix16_En10_adm "Q = V*1024.000000" RAT_FUNC "%12.10" "adm" COEFFS 0 1024 0 0 0 1 /end COMPU_METHOD
/begin COMPU_METHOD FuelConsTDC_CM_ufix16_En9_km_l "Q = V*512.000000" RAT_FUNC "%12.9" "km/l" COEFFS 0 512 0 0 0 1 /end COMPU_METHOD
/begin COMPU_METHOD FuelConsTDC_CM_ufix16_Sp0001__ "Q = V*10000.000000" RAT_FUNC "%0.6" "%" COEFFS 0 10000 0 0 0 1 /end COMPU_METHOD
/begin COMPU_METHOD FuelConsTDC_CM_ufix16_Sp05_kg_h "Q = V*20.000000" RAT_FUNC "%0.6" "kg/h" COEFFS 0 20 0 0 0 1 /end COMPU_METHOD
/begin COMPU_METHOD FuelConsTDC_CM_ufix16_Sp05_l_h "Q = V*20.000000" RAT_FUNC "%0.6" "l/h" COEFFS 0 20 0 0 0 1 /end COMPU_METHOD
/begin COMPU_METHOD FuelConsTDC_CM_ufix32_Sp05_l "Q = V*20.000000" RAT_FUNC "%0.6" "l" COEFFS 0 20 0 0 0 1 /end COMPU_METHOD
/begin COMPU_METHOD FuelConsTDC_CM_uint16_l "Q = V" RAT_FUNC "%5.0" "l" COEFFS 0 1 0 0 0 1 /end COMPU_METHOD
/begin COMPU_METHOD Idle4ms_CM_ufix8_Bn125_gear "Q = (V+125.000000)/1.000000" RAT_FUNC "%0.6" "gear" COEFFS 0 1 125 0 0 1 /end COMPU_METHOD
/begin COMPU_METHOD Idle4ms_CM_uint16_rpm "Q = V" RAT_FUNC "%5.0" "rpm" COEFFS 0 1 0 0 0 1 /end COMPU_METHOD
/begin COMPU_METHOD J1939dl_Tx100ms_CM_boolean_adm "Q = V" RAT_FUNC "%1.0" "adm" COEFFS 0 1 0 0 0 1 /end COMPU_METHOD
/begin COMPU_METHOD J1939dl_Tx100ms_CM_ufix16_En9_km_l "Q = V*512.000000" RAT_FUNC "%12.9" "km/l" COEFFS 0 512 0 0 0 1 /end COMPU_METHOD
/begin COMPU_METHOD J1939dl_Tx100ms_CM_ufix16_Sp05_l_h "Q = V*20.000000" RAT_FUNC "%0.6" "l/h" COEFFS 0 20 0 0 0 1 /end COMPU_METHOD
/begin COMPU_METHOD J1939dl_Tx100ms_CM_ufix32_S1000_round "Q = V/1000.000000" RAT_FUNC "%0.6" "round" COEFFS 0 1 0 0 0 1000 /end COMPU_METHOD
/begin COMPU_METHOD J1939dl_Tx100ms_CM_ufix32_Sp05_hour "Q = V*20.000000" RAT_FUNC "%0.6" "hour" COEFFS 0 20 0 0 0 1 /end COMPU_METHOD
/begin COMPU_METHOD J1939dl_Tx100ms_CM_uint16_Km_h "Q = V" RAT_FUNC "%5.0" "Km/h" COEFFS 0 1 0 0 0 1 /end COMPU_METHOD
/begin COMPU_METHOD J1939dl_Tx100ms_CM_uint16_rpm "Q = V" RAT_FUNC "%5.0" "rpm" COEFFS 0 1 0 0 0 1 /end COMPU_METHOD
/begin COMPU_METHOD J1939dl_Tx1s_CM_boolean_adm "Q = V" RAT_FUNC "%1.0" "adm" COEFFS 0 1 0 0 0 1 /end COMPU_METHOD
/begin COMPU_METHOD J1939dl_Tx1s_CM_ufix32_Sp05_l "Q = V*20.000000" RAT_FUNC "%0.6" "l" COEFFS 0 20 0 0 0 1 /end COMPU_METHOD
/begin COMPU_METHOD J1939dl_Tx1s_CM_uint16_Km_h "Q = V" RAT_FUNC "%5.0" "Km/h" COEFFS 0 1 0 0 0 1 /end COMPU_METHOD
/begin COMPU_METHOD J1939dl_Tx50ms_CM_boolean_adm "Q = V" RAT_FUNC "%1.0" "adm" COEFFS 0 1 0 0 0 1 /end COMPU_METHOD
/begin COMPU_METHOD J1939dl_Tx50ms_CM_uint8_adm "Q = V" RAT_FUNC "%3.0" "adm" COEFFS 0 1 0 0 0 1 /end COMPU_METHOD
/begin COMPU_METHOD PtoCCReq4ms_Symbol_CM_FixEnableT "Enumerated data type: FixEnableT" TAB_VERB "%0.6" "" COMPU_TAB_REF VTAB_FOR_PtoCCReq4ms_Symbol_CM_FixEnableT /end COMPU_METHOD
/begin COMPU_METHOD PtoCCReq4ms_Symbol_CM_boolean_adm "Q = V" RAT_FUNC "%1.0" "adm" COEFFS 0 1 0 0 0 1 /end COMPU_METHOD
/begin COMPU_METHOD PtoCCReq4ms_Symbol_CM_uint8_Km_h "Q = V" RAT_FUNC "%3.0" "Km/h" COEFFS 0 1 0 0 0 1 /end COMPU_METHOD
/begin COMPU_METHOD RefuelMgmTDC_Symbol_CM_FixEnableT "Enumerated data type: FixEnableT" TAB_VERB "%0.6" "" COMPU_TAB_REF VTAB_FOR_RefuelMgmTDC_Symbol_CM_FixEnableT /end COMPU_METHOD
/begin COMPU_METHOD RefuelMgmTDC_Symbol_CM_boolean_adm "Q = V" RAT_FUNC "%1.0" "adm" COEFFS 0 1 0 0 0 1 /end COMPU_METHOD
/begin COMPU_METHOD RefuelMgmTDC_Symbol_CM_ufix16_E2_mbar "Q = V/4.000000" RAT_FUNC "%5.0" "mbar" COEFFS 0 1 0 0 0 4 /end COMPU_METHOD
/begin COMPU_METHOD RefuelMgmTDC_Symbol_CM_uint8_adm "Q = V" RAT_FUNC "%3.0" "adm" COEFFS 0 1 0 0 0 1 /end COMPU_METHOD
/begin COMPU_METHOD Signal_Mgm_4ms_Symbol_CM_FixEnableT "Enumerated data type: FixEnableT" TAB_VERB "%0.6" "" COMPU_TAB_REF VTAB_FOR_Signal_Mgm_4ms_Symbol_CM_FixEnableT /end COMPU_METHOD
/begin COMPU_METHOD Signal_Mgm_4ms_Symbol_CM_boolean_adm "Q = V" RAT_FUNC "%1.0" "adm" COEFFS 0 1 0 0 0 1 /end COMPU_METHOD
/begin COMPU_METHOD Signal_Mgm_4ms_Symbol_CM_ufix16_En12_adm "Q = V*4096.000000" RAT_FUNC "%14.12" "adm" COEFFS 0 4096 0 0 0 1 /end COMPU_METHOD
/begin COMPU_METHOD Signal_Mgm_4ms_Symbol_CM_uint16_km_h "Q = V" RAT_FUNC "%5.0" "km/h" COEFFS 0 1 0 0 0 1 /end COMPU_METHOD
/begin COMPU_METHOD Signal_Mgm_4ms_Symbol_CM_uint8_adm "Q = V" RAT_FUNC "%3.0" "adm" COEFFS 0 1 0 0 0 1 /end COMPU_METHOD
/begin COMPU_METHOD TB_VcmVariable4ms_Symbol_CM_FixEnableT "Enumerated data type: FixEnableT" TAB_VERB "%0.6" "" COMPU_TAB_REF VTAB_FOR_TB_VcmVariable4ms_Symbol_CM_FixEnableT /end COMPU_METHOD
/begin COMPU_METHOD TB_VcmVariable4ms_Symbol_CM_boolean_adm "Q = V" RAT_FUNC "%1.0" "adm" COEFFS 0 1 0 0 0 1 /end COMPU_METHOD
/begin COMPU_METHOD TB_VcmVariable4ms_Symbol_CM_ufix16_En4__ "Q = V*16.000000" RAT_FUNC "%8.4" "%" COEFFS 0 16 0 0 0 1 /end COMPU_METHOD
/begin COMPU_METHOD TB_VcmVariable4ms_Symbol_CM_uint16_rpm "Q = V" RAT_FUNC "%5.0" "rpm" COEFFS 0 1 0 0 0 1 /end COMPU_METHOD
/begin COMPU_METHOD TB_VcmVariable4ms_Symbol_CM_uint8_adm "Q = V" RAT_FUNC "%3.0" "adm" COEFFS 0 1 0 0 0 1 /end COMPU_METHOD
/begin COMPU_METHOD TE_CmuReqMgm4ms_Symbol_CM_FixEnableT "Enumerated data type: FixEnableT" TAB_VERB "%0.6" "" COMPU_TAB_REF VTAB_FOR_TE_CmuReqMgm4ms_Symbol_CM_FixEnableT /end COMPU_METHOD
/begin COMPU_METHOD TE_CmuReqMgm4ms_Symbol_CM_boolean_adm "Q = V" RAT_FUNC "%1.0" "adm" COEFFS 0 1 0 0 0 1 /end COMPU_METHOD
/begin COMPU_METHOD TE_CmuReqMgm4ms_Symbol_CM_ufix16_En10_adm "Q = V*1024.000000" RAT_FUNC "%12.10" "adm" COEFFS 0 1024 0 0 0 1 /end COMPU_METHOD
/begin COMPU_METHOD TE_CmuReqMgm4ms_Symbol_CM_ufix16_En4__ "Q = V*16.000000" RAT_FUNC "%8.4" "%" COEFFS 0 16 0 0 0 1 /end COMPU_METHOD
/begin COMPU_METHOD TE_CmuReqMgm4ms_Symbol_CM_uint16_Km_h "Q = V" RAT_FUNC "%5.0" "Km/h" COEFFS 0 1 0 0 0 1 /end COMPU_METHOD
/begin COMPU_METHOD TE_CmuReqMgm4ms_Symbol_CM_uint16_adm "Q = V" RAT_FUNC "%5.0" "adm" COEFFS 0 1 0 0 0 1 /end COMPU_METHOD
/begin COMPU_METHOD TE_CmuReqMgm4ms_Symbol_CM_uint16_rpm "Q = V" RAT_FUNC "%5.0" "rpm" COEFFS 0 1 0 0 0 1 /end COMPU_METHOD
/begin COMPU_METHOD TE_CmuReqMgm4ms_Symbol_CM_uint8_adm "Q = V" RAT_FUNC "%3.0" "adm" COEFFS 0 1 0 0 0 1 /end COMPU_METHOD
/begin COMPU_METHOD TE_DigOutput100ms_CM_FixEnableT "Enumerated data type: FixEnableT" TAB_VERB "%0.6" "" COMPU_TAB_REF VTAB_FOR_TE_DigOutput100ms_CM_FixEnableT /end COMPU_METHOD
/begin COMPU_METHOD TE_DigOutput100ms_CM_boolean_adm "Q = V" RAT_FUNC "%1.0" "adm" COEFFS 0 1 0 0 0 1 /end COMPU_METHOD
/begin COMPU_METHOD TE_DigOutput100ms_CM_uint8_adm "Q = V" RAT_FUNC "%3.0" "adm" COEFFS 0 1 0 0 0 1 /end COMPU_METHOD
/begin COMPU_METHOD TE_DoorsOpen100ms_CM_FixEnableT "Enumerated data type: FixEnableT" TAB_VERB "%0.6" "" COMPU_TAB_REF VTAB_FOR_TE_DoorsOpen100ms_CM_FixEnableT /end COMPU_METHOD
/begin COMPU_METHOD TE_DoorsOpen100ms_CM_uint8_adm "Q = V" RAT_FUNC "%3.0" "adm" COEFFS 0 1 0 0 0 1 /end COMPU_METHOD
/begin COMPU_METHOD TE_FuelLevel1s_CM_FixEnableT "Enumerated data type: FixEnableT" TAB_VERB "%0.6" "" COMPU_TAB_REF VTAB_FOR_TE_FuelLevel1s_CM_FixEnableT /end COMPU_METHOD
/begin COMPU_METHOD TE_FuelLevel1s_CM_boolean "Q = V" RAT_FUNC "%1.0" "" COEFFS 0 1 0 0 0 1 /end COMPU_METHOD
/begin COMPU_METHOD TE_FuelLevel1s_CM_boolean_adm "Q = V" RAT_FUNC "%1.0" "adm" COEFFS 0 1 0 0 0 1 /end COMPU_METHOD
/begin COMPU_METHOD TE_FuelLevel1s_CM_sfix16_En4__ "Q = V*16.000000" RAT_FUNC "%8.4" "%" COEFFS 0 16 0 0 0 1 /end COMPU_METHOD
/begin COMPU_METHOD TE_FuelLevel1s_CM_ufix16_En4__ "Q = V*16.000000" RAT_FUNC "%8.4" "%" COEFFS 0 16 0 0 0 1 /end COMPU_METHOD
/begin COMPU_METHOD TE_FuelLevel1s_CM_ufix16_En4_adm "Q = V*16.000000" RAT_FUNC "%8.4" "adm" COEFFS 0 16 0 0 0 1 /end COMPU_METHOD
/begin COMPU_METHOD TE_FuelLevel1s_CM_ufix16_S10_Hz "Q = V/10.000000" RAT_FUNC "%0.6" "Hz" COEFFS 0 1 0 0 0 10 /end COMPU_METHOD
/begin COMPU_METHOD TE_FuelLevel1s_CM_ufix8_S1000_mbar "Q = V/1000.000000" RAT_FUNC "%0.6" "mbar" COEFFS 0 1 0 0 0 1000 /end COMPU_METHOD
/begin COMPU_METHOD TE_FuelLevel1s_CM_ufix8_S100_mbar "Q = V/100.000000" RAT_FUNC "%0.6" "mbar" COEFFS 0 1 0 0 0 100 /end COMPU_METHOD
/begin COMPU_METHOD TE_FuelLevel1s_CM_ufix8_Sp4__ "Q = V*2.500000" RAT_FUNC "%0.6" "%" COEFFS 0 2.5 0 0 0 1 /end COMPU_METHOD
/begin COMPU_METHOD TE_HBEgrValveCtrl4ms_CM_FixEnableT "Enumerated data type: FixEnableT" TAB_VERB "%0.6" "" COMPU_TAB_REF VTAB_FOR_TE_HBEgrValveCtrl4ms_CM_FixEnableT /end COMPU_METHOD
/begin COMPU_METHOD TE_HBEgrValveCtrl4ms_CM_boolean_adm "Q = V" RAT_FUNC "%1.0" "adm" COEFFS 0 1 0 0 0 1 /end COMPU_METHOD
/begin COMPU_METHOD TE_HBEgrValveCtrl4ms_CM_sfix16_En10_V "Q = V*1024.000000" RAT_FUNC "%12.10" "V" COEFFS 0 1024 0 0 0 1 /end COMPU_METHOD
/begin COMPU_METHOD TE_HBEgrValveCtrl4ms_CM_sfix16_En3__ "Q = V*8.000000" RAT_FUNC "%7.3" "%" COEFFS 0 8 0 0 0 1 /end COMPU_METHOD
/begin COMPU_METHOD TE_HBEgrValveCtrl4ms_CM_sfix16_En3_adm "Q = V*8.000000" RAT_FUNC "%7.3" "adm" COEFFS 0 8 0 0 0 1 /end COMPU_METHOD
/begin COMPU_METHOD TE_HBEgrValveCtrl4ms_CM_sfix16_En3_mbar "Q = V*8.000000" RAT_FUNC "%7.3" "mbar" COEFFS 0 8 0 0 0 1 /end COMPU_METHOD
/begin COMPU_METHOD TE_HBEgrValveCtrl4ms_CM_single__ "Q = V" RAT_FUNC "%8.6" "%" COEFFS 0 1 0 0 0 1 /end COMPU_METHOD
/begin COMPU_METHOD TE_HBEgrValveCtrl4ms_CM_single_adm "Q = V" RAT_FUNC "%8.6" "adm" COEFFS 0 1 0 0 0 1 /end COMPU_METHOD
/begin COMPU_METHOD TE_HBEgrValveCtrl4ms_CM_ufix16_Bn40_degC "Q = (V+40.000000)/1.000000" RAT_FUNC "%0.6" "degC" COEFFS 0 1 40 0 0 1 /end COMPU_METHOD
/begin COMPU_METHOD TE_HBEgrValveCtrl4ms_CM_ufix16_En10_V "Q = V*1024.000000" RAT_FUNC "%12.10" "V" COEFFS 0 1024 0 0 0 1 /end COMPU_METHOD
/begin COMPU_METHOD TE_HBEgrValveCtrl4ms_CM_ufix16_En3__ "Q = V*8.000000" RAT_FUNC "%7.3" "%" COEFFS 0 8 0 0 0 1 /end COMPU_METHOD
/begin COMPU_METHOD TE_HBEgrValveCtrl4ms_CM_ufix16_En4_kg_h "Q = V*16.000000" RAT_FUNC "%8.4" "kg/h" COEFFS 0 16 0 0 0 1 /end COMPU_METHOD
/begin COMPU_METHOD TE_HBEgrValveCtrl4ms_CM_ufix16_S10_Hz "Q = V/10.000000" RAT_FUNC "%0.6" "Hz" COEFFS 0 1 0 0 0 10 /end COMPU_METHOD
/begin COMPU_METHOD TE_PtoCc4ms_Symbol_CM_FixEnableT "Enumerated data type: FixEnableT" TAB_VERB "%0.6" "" COMPU_TAB_REF VTAB_FOR_TE_PtoCc4ms_Symbol_CM_FixEnableT /end COMPU_METHOD
/begin COMPU_METHOD TE_PtoCc4ms_Symbol_CM_boolean_adm "Q = V" RAT_FUNC "%1.0" "adm" COEFFS 0 1 0 0 0 1 /end COMPU_METHOD
/begin COMPU_METHOD TE_PtoCc4ms_Symbol_CM_int16_Km_h "Q = V" RAT_FUNC "%5.0" "Km/h" COEFFS 0 1 0 0 0 1 /end COMPU_METHOD
/begin COMPU_METHOD TE_PtoCc4ms_Symbol_CM_int16__Km_h__s "Q = V" RAT_FUNC "%5.0" "(Km/h)/s" COEFFS 0 1 0 0 0 1 /end COMPU_METHOD
/begin COMPU_METHOD TE_PtoCc4ms_Symbol_CM_int16_rpm "Q = V" RAT_FUNC "%5.0" "rpm" COEFFS 0 1 0 0 0 1 /end COMPU_METHOD
/begin COMPU_METHOD TE_PtoCc4ms_Symbol_CM_int16_rpm_s "Q = V" RAT_FUNC "%5.0" "rpm/s" COEFFS 0 1 0 0 0 1 /end COMPU_METHOD
/begin COMPU_METHOD TE_PtoCc4ms_Symbol_CM_ufix16_En10_Km__h_rpm_ "Q = V*1024.000000" RAT_FUNC "%12.10" "Km/(h*rpm)" COEFFS 0 1024 0 0 0 1 /end COMPU_METHOD
/begin COMPU_METHOD TE_PtoCc4ms_Symbol_CM_ufix16_En4_sec "Q = V*16.000000" RAT_FUNC "%8.4" "sec" COEFFS 0 16 0 0 0 1 /end COMPU_METHOD
/begin COMPU_METHOD TE_PtoCc4ms_Symbol_CM_ufix16_En8_Bn100_Km_h "Q = (V+100.000000)*256.000000" RAT_FUNC "%0.6" "Km/h" COEFFS 0 256 25600 0 0 1 /end COMPU_METHOD
/begin COMPU_METHOD TE_PtoCc4ms_Symbol_CM_ufix16_En8_Bn250_m_sec_2 "Q = (V+250.000000)*256.000000" RAT_FUNC "%0.6" "m/sec^2" COEFFS 0 256 64000 0 0 1 /end COMPU_METHOD
/begin COMPU_METHOD TE_PtoCc4ms_Symbol_CM_ufix16_En8_Km_h "Q = V*256.000000" RAT_FUNC "%11.8" "Km/h" COEFFS 0 256 0 0 0 1 /end COMPU_METHOD
/begin COMPU_METHOD TE_PtoCc4ms_Symbol_CM_ufix16_Sp004_sec "Q = V*250.000000" RAT_FUNC "%0.6" "sec" COEFFS 0 250 0 0 0 1 /end COMPU_METHOD
/begin COMPU_METHOD TE_PtoCc4ms_Symbol_CM_uint16_Km_h "Q = V" RAT_FUNC "%5.0" "Km/h" COEFFS 0 1 0 0 0 1 /end COMPU_METHOD
/begin COMPU_METHOD TE_PtoCc4ms_Symbol_CM_uint16__Km_h__s "Q = V" RAT_FUNC "%5.0" "(Km/h)/s" COEFFS 0 1 0 0 0 1 /end COMPU_METHOD
/begin COMPU_METHOD TE_PtoCc4ms_Symbol_CM_uint16_adm "Q = V" RAT_FUNC "%5.0" "adm" COEFFS 0 1 0 0 0 1 /end COMPU_METHOD
/begin COMPU_METHOD TE_PtoCc4ms_Symbol_CM_uint16_rpm "Q = V" RAT_FUNC "%5.0" "rpm" COEFFS 0 1 0 0 0 1 /end COMPU_METHOD
/begin COMPU_METHOD TE_PtoCc4ms_Symbol_CM_uint16_rpm_s "Q = V" RAT_FUNC "%5.0" "rpm/s" COEFFS 0 1 0 0 0 1 /end COMPU_METHOD
/begin COMPU_METHOD TE_PtoCc4ms_Symbol_CM_uint16_sec "Q = V" RAT_FUNC "%5.0" "sec" COEFFS 0 1 0 0 0 1 /end COMPU_METHOD
/begin COMPU_METHOD TE_PtoCc4ms_Symbol_CM_uint8_adm "Q = V" RAT_FUNC "%3.0" "adm" COEFFS 0 1 0 0 0 1 /end COMPU_METHOD
/begin COMPU_METHOD TE_StartStopRpmMgm100ms_Symbol_CM_FixEnableT "Enumerated data type: FixEnableT" TAB_VERB "%0.6" "" COMPU_TAB_REF VTAB_FOR_TE_StartStopRpmMgm100ms_Symbol_CM_FixEnableT /end COMPU_METHOD
/begin COMPU_METHOD TE_StartStopRpmMgm100ms_Symbol_CM_boolean_adm "Q = V" RAT_FUNC "%1.0" "adm" COEFFS 0 1 0 0 0 1 /end COMPU_METHOD
/begin COMPU_METHOD TE_StartStopRpmMgm100ms_Symbol_CM_int16_rpm "Q = V" RAT_FUNC "%5.0" "rpm" COEFFS 0 1 0 0 0 1 /end COMPU_METHOD
/begin COMPU_METHOD TE_StartStopRpmMgm100ms_Symbol_CM_uint16_rpm "Q = V" RAT_FUNC "%5.0" "rpm" COEFFS 0 1 0 0 0 1 /end COMPU_METHOD
/begin COMPU_METHOD TE_TSC1Manager4ms_Symbol_CM_FixEnableT "Enumerated data type: FixEnableT" TAB_VERB "%0.6" "" COMPU_TAB_REF VTAB_FOR_TE_TSC1Manager4ms_Symbol_CM_FixEnableT /end COMPU_METHOD
/begin COMPU_METHOD TE_TSC1Manager4ms_Symbol_CM_boolean_adm "Q = V" RAT_FUNC "%1.0" "adm" COEFFS 0 1 0 0 0 1 /end COMPU_METHOD
/begin COMPU_METHOD TE_TSC1Manager4ms_Symbol_CM_int8_adm "Q = V" RAT_FUNC "%3.0" "adm" COEFFS 0 1 0 0 0 1 /end COMPU_METHOD
/begin COMPU_METHOD TE_TSC1Manager4ms_Symbol_CM_ufix16_En4__ "Q = V*16.000000" RAT_FUNC "%8.4" "%" COEFFS 0 16 0 0 0 1 /end COMPU_METHOD
/begin COMPU_METHOD TE_TSC1Manager4ms_Symbol_CM_uint16_rpm "Q = V" RAT_FUNC "%5.0" "rpm" COEFFS 0 1 0 0 0 1 /end COMPU_METHOD
/begin COMPU_METHOD TE_TSC1Manager4ms_Symbol_CM_uint8_adm "Q = V" RAT_FUNC "%3.0" "adm" COEFFS 0 1 0 0 0 1 /end COMPU_METHOD
/begin COMPU_METHOD TE_VehicleSpeedLim100ms_Symbol_CM_FixEnableT "Enumerated data type: FixEnableT" TAB_VERB "%0.6" "" COMPU_TAB_REF VTAB_FOR_TE_VehicleSpeedLim100ms_Symbol_CM_FixEnableT /end COMPU_METHOD
/begin COMPU_METHOD TE_VehicleSpeedLim100ms_Symbol_CM_boolean_adm "Q = V" RAT_FUNC "%1.0" "adm" COEFFS 0 1 0 0 0 1 /end COMPU_METHOD
/begin COMPU_METHOD TE_VehicleSpeedLim100ms_Symbol_CM_uint16_Km_h "Q = V" RAT_FUNC "%5.0" "Km/h" COEFFS 0 1 0 0 0 1 /end COMPU_METHOD
/begin COMPU_METHOD Trqm_CtrlMgmt4ms_CM_ufix16_En4__ "Q = V*16.000000" RAT_FUNC "%8.4" "%" COEFFS 0 16 0 0 0 1 /end COMPU_METHOD
/begin COMPU_METHOD Trqm_CtrlMgmt4ms_CM_ufix16_En8_km_h "Q = V*256.000000" RAT_FUNC "%11.8" "km/h" COEFFS 0 256 0 0 0 1 /end COMPU_METHOD
/begin COMPU_METHOD Trqm_CtrlMgmt4ms_CM_uint16_rpm "Q = V" RAT_FUNC "%5.0" "rpm" COEFFS 0 1 0 0 0 1 /end COMPU_METHOD
/begin COMPU_METHOD Trqm_CtrlMgmt4ms_CM_uint8_adm "Q = V" RAT_FUNC "%3.0" "adm" COEFFS 0 1 0 0 0 1 /end COMPU_METHOD
/begin COMPU_METHOD Vbpw4ms_CM_ufix16_S50_mV "Q = V/50.000000" RAT_FUNC "%0.6" "mV" COEFFS 0 1 0 0 0 50 /end COMPU_METHOD
/begin COMPU_METHOD VcmFcnEnableInit_CM_FixEnableT "Enumerated data type: FixEnableT" TAB_VERB "%0.6" "" COMPU_TAB_REF VTAB_FOR_VcmFcnEnableInit_CM_FixEnableT /end COMPU_METHOD
/begin COMPU_METHOD VcmFcnEnableInit_CM_boolean_adm "Q = V" RAT_FUNC "%1.0" "adm" COEFFS 0 1 0 0 0 1 /end COMPU_METHOD
/begin COMPU_METHOD VcmFcnEnableInit_CM_uint8_adm "Q = V" RAT_FUNC "%3.0" "adm" COEFFS 0 1 0 0 0 1 /end COMPU_METHOD
/begin COMPU_METHOD Vfnc100ms_CM_boolean_adm "Q = V" RAT_FUNC "%1.0" "adm" COEFFS 0 1 0 0 0 1 /end COMPU_METHOD
/begin COMPU_METHOD Vfnc100ms_CM_sfix16_En8_m_sec_2 "Q = V*256.000000" RAT_FUNC "%11.8" "m/sec^2" COEFFS 0 256 0 0 0 1 /end COMPU_METHOD
/begin COMPU_METHOD Vfnc100ms_CM_ufix16_En8_km_h "Q = V*256.000000" RAT_FUNC "%11.8" "km/h" COEFFS 0 256 0 0 0 1 /end COMPU_METHOD
/begin COMPU_METHOD Vfnc100ms_CM_uint16_Km_h "Q = V" RAT_FUNC "%5.0" "Km/h" COEFFS 0 1 0 0 0 1 /end COMPU_METHOD
/begin COMPU_METHOD Vfnc100ms_CM_uint16_rpm "Q = V" RAT_FUNC "%5.0" "rpm" COEFFS 0 1 0 0 0 1 /end COMPU_METHOD
/begin COMPU_METHOD Vfnc100ms_CM_uint8_adm "Q = V" RAT_FUNC "%3.0" "adm" COEFFS 0 1 0 0 0 1 /end COMPU_METHOD
/begin COMPU_METHOD Vfnc100ms_CM_uint8_km_h "Q = V" RAT_FUNC "%3.0" "km/h" COEFFS 0 1 0 0 0 1 /end COMPU_METHOD
/begin COMPU_METHOD Vfnc1s_CM_boolean_adm "Q = V" RAT_FUNC "%1.0" "adm" COEFFS 0 1 0 0 0 1 /end COMPU_METHOD
/begin COMPU_METHOD Vfnc1s_CM_ufix16_E2_mbar "Q = V/4.000000" RAT_FUNC "%5.0" "mbar" COEFFS 0 1 0 0 0 4 /end COMPU_METHOD
/begin COMPU_METHOD Vfnc1s_CM_ufix16_En4__ "Q = V*16.000000" RAT_FUNC "%8.4" "%" COEFFS 0 16 0 0 0 1 /end COMPU_METHOD
/begin COMPU_METHOD Vfnc1s_CM_ufix16_S10_Hz "Q = V/10.000000" RAT_FUNC "%0.6" "Hz" COEFFS 0 1 0 0 0 10 /end COMPU_METHOD
/begin COMPU_METHOD Vfnc1s_CM_ufix32_S1000_round "Q = V/1000.000000" RAT_FUNC "%0.6" "round" COEFFS 0 1 0 0 0 1000 /end COMPU_METHOD
/begin COMPU_METHOD Vfnc1s_CM_ufix32_Sp05_hour "Q = V*20.000000" RAT_FUNC "%0.6" "hour" COEFFS 0 20 0 0 0 1 /end COMPU_METHOD
/begin COMPU_METHOD Vfnc1s_CM_ufix8_Sp4__ "Q = V*2.500000" RAT_FUNC "%0.6" "%" COEFFS 0 2.5 0 0 0 1 /end COMPU_METHOD
/begin COMPU_METHOD Vfnc1s_CM_uint32_min "Q = V" RAT_FUNC "%10.0" "min" COEFFS 0 1 0 0 0 1 /end COMPU_METHOD
/begin COMPU_METHOD Vfnc4ms_CM_boolean_adm "Q = V" RAT_FUNC "%1.0" "adm" COEFFS 0 1 0 0 0 1 /end COMPU_METHOD
/begin COMPU_METHOD Vfnc4ms_CM_sfix16_En8_m_sec_2 "Q = V*256.000000" RAT_FUNC "%11.8" "m/sec^2" COEFFS 0 256 0 0 0 1 /end COMPU_METHOD
/begin COMPU_METHOD Vfnc4ms_CM_tKeyState_adm "Enumerated data type: tKeyState" TAB_VERB "%0.6" "adm" COMPU_TAB_REF VTAB_FOR_Vfnc4ms_CM_tKeyState_adm /end COMPU_METHOD
/begin COMPU_METHOD Vfnc4ms_CM_ufix16_En3_rpm "Q = V*8.000000" RAT_FUNC "%7.3" "rpm" COEFFS 0 8 0 0 0 1 /end COMPU_METHOD
/begin COMPU_METHOD Vfnc4ms_CM_ufix16_En4__ "Q = V*16.000000" RAT_FUNC "%8.4" "%" COEFFS 0 16 0 0 0 1 /end COMPU_METHOD
/begin COMPU_METHOD Vfnc4ms_CM_ufix16_En8_km_h "Q = V*256.000000" RAT_FUNC "%11.8" "km/h" COEFFS 0 256 0 0 0 1 /end COMPU_METHOD
/begin COMPU_METHOD Vfnc4ms_CM_ufix8_Bn125_gear "Q = (V+125.000000)/1.000000" RAT_FUNC "%0.6" "gear" COEFFS 0 1 125 0 0 1 /end COMPU_METHOD
/begin COMPU_METHOD Vfnc4ms_CM_uint16_Km_h "Q = V" RAT_FUNC "%5.0" "Km/h" COEFFS 0 1 0 0 0 1 /end COMPU_METHOD
/begin COMPU_METHOD Vfnc4ms_CM_uint16_km_h "Q = V" RAT_FUNC "%5.0" "km/h" COEFFS 0 1 0 0 0 1 /end COMPU_METHOD
/begin COMPU_METHOD Vfnc4ms_CM_uint16_rpm "Q = V" RAT_FUNC "%5.0" "rpm" COEFFS 0 1 0 0 0 1 /end COMPU_METHOD
/begin COMPU_METHOD Vfnc4ms_CM_uint8_Km_h "Q = V" RAT_FUNC "%3.0" "Km/h" COEFFS 0 1 0 0 0 1 /end COMPU_METHOD
/begin COMPU_METHOD Vfnc4ms_CM_uint8_adm "Q = V" RAT_FUNC "%3.0" "adm" COEFFS 0 1 0 0 0 1 /end COMPU_METHOD
/begin COMPU_METHOD VfncTDC_CM_boolean_adm "Q = V" RAT_FUNC "%1.0" "adm" COEFFS 0 1 0 0 0 1 /end COMPU_METHOD
/begin COMPU_METHOD VfncTDC_CM_ufix16_E2_mbar "Q = V/4.000000" RAT_FUNC "%5.0" "mbar" COEFFS 0 1 0 0 0 4 /end COMPU_METHOD
/begin COMPU_METHOD VfncTDC_CM_ufix16_E4_us "Q = V/16.000000" RAT_FUNC "%5.0" "us" COEFFS 0 1 0 0 0 16 /end COMPU_METHOD
/begin COMPU_METHOD VfncTDC_CM_ufix16_En7_mg_cc "Q = V*128.000000" RAT_FUNC "%10.7" "mg/cc" COEFFS 0 128 0 0 0 1 /end COMPU_METHOD
/begin COMPU_METHOD VfncTDC_CM_ufix16_En9_km_l "Q = V*512.000000" RAT_FUNC "%12.9" "km/l" COEFFS 0 512 0 0 0 1 /end COMPU_METHOD
/begin COMPU_METHOD VfncTDC_CM_ufix16_Sp05_kg_h "Q = V*20.000000" RAT_FUNC "%0.6" "kg/h" COEFFS 0 20 0 0 0 1 /end COMPU_METHOD
/begin COMPU_METHOD VfncTDC_CM_ufix16_Sp05_l_h "Q = V*20.000000" RAT_FUNC "%0.6" "l/h" COEFFS 0 20 0 0 0 1 /end COMPU_METHOD
/begin COMPU_METHOD VfncTDC_CM_ufix32_Sp05_l "Q = V*20.000000" RAT_FUNC "%0.6" "l" COEFFS 0 20 0 0 0 1 /end COMPU_METHOD
/begin COMPU_METHOD VfncTDC_CM_uint16_adm "Q = V" RAT_FUNC "%5.0" "adm" COEFFS 0 1 0 0 0 1 /end COMPU_METHOD
/begin COMPU_METHOD VfncTDC_CM_uint16_km_h "Q = V" RAT_FUNC "%5.0" "km/h" COEFFS 0 1 0 0 0 1 /end COMPU_METHOD
/begin COMPU_METHOD VfncTDC_CM_uint8_adm "Q = V" RAT_FUNC "%3.0" "adm" COEFFS 0 1 0 0 0 1 /end COMPU_METHOD
/begin COMPU_METHOD bs2LHDuty.Conversion "" LINEAR "%.3" "%" COEFFS_LINEAR 0.125 0 /end COMPU_METHOD
/begin COMPU_METHOD bsALTERNATE_FUEL_Tx_Enable.Conversion "" LINEAR "%.3" "adm" COEFFS_LINEAR 1 0 /end COMPU_METHOD
/begin COMPU_METHOD bsApplType.Conversion "" LINEAR "%.3" "adm" COEFFS_LINEAR 1 0 /end COMPU_METHOD
/begin COMPU_METHOD bsCCVS_Tx_Enable.Conversion "" LINEAR "%.3" "adm" COEFFS_LINEAR 1 0 /end COMPU_METHOD
/begin COMPU_METHOD bsCODELStatus.Conversion "" LINEAR "%.3" "adm" COEFFS_LINEAR 1 0 /end COMPU_METHOD
/begin COMPU_METHOD bsCrkPhase.Conversion "" TAB_VERB "%.0" "" COMPU_TAB_REF bsCrkPhase.Conversion /end COMPU_METHOD
/begin COMPU_METHOD bsDD1_Tx_Enable.Conversion "" LINEAR "%.3" "adm" COEFFS_LINEAR 1 0 /end COMPU_METHOD
/begin COMPU_METHOD bsDLCC1_Tx_Enable.Conversion "" LINEAR "%.3" "adm" COEFFS_LINEAR 1 0 /end COMPU_METHOD
/begin COMPU_METHOD bsDLCC2_Tx_Enable.Conversion "" LINEAR "%.3" "adm" COEFFS_LINEAR 1 0 /end COMPU_METHOD
/begin COMPU_METHOD bsECM2EPR_Tx_Enable.Conversion "" LINEAR "%.3" "adm" COEFFS_LINEAR 1 0 /end COMPU_METHOD
/begin COMPU_METHOD bsECU2TURBO_Tx_Enable.Conversion "" LINEAR "%.3" "adm" COEFFS_LINEAR 1 0 /end COMPU_METHOD
/begin COMPU_METHOD bsEDC2BC_Tx_Enable.Conversion "" LINEAR "%.3" "adm" COEFFS_LINEAR 1 0 /end COMPU_METHOD
/begin COMPU_METHOD bsEEC1_Tx_Enable.Conversion "" LINEAR "%.3" "adm" COEFFS_LINEAR 1 0 /end COMPU_METHOD
/begin COMPU_METHOD bsEEC2_Tx_Enable.Conversion "" LINEAR "%.3" "adm" COEFFS_LINEAR 1 0 /end COMPU_METHOD
/begin COMPU_METHOD bsEEC3_Tx_Enable.Conversion "" LINEAR "%.3" "adm" COEFFS_LINEAR 1 0 /end COMPU_METHOD
/begin COMPU_METHOD bsEFL_P2_Tx_Enable.Conversion "" LINEAR "%.3" "adm" COEFFS_LINEAR 1 0 /end COMPU_METHOD
/begin COMPU_METHOD bsEFL_Tx_Enable.Conversion "" LINEAR "%.3" "adm" COEFFS_LINEAR 1 0 /end COMPU_METHOD
/begin COMPU_METHOD bsENG_CONF_Tx_Enable.Conversion "" LINEAR "%.3" "adm" COEFFS_LINEAR 1 0 /end COMPU_METHOD
/begin COMPU_VTAB VTAB_FOR_AutoUpdatingTDC_CM_FixEnableT "Enumerated data type: FixEnableT" TAB_VERB 2 171 "Enable" 218 "Disable" /end COMPU_VTAB
/begin COMPU_VTAB VTAB_FOR_AutoUpdatingTDC_CM_tAutoState_adm "Enumerated data type: tAutoState" TAB_VERB 8 0 "MBSL_WAIT_ENABLE" 1 "MBSL_INIT_STABILIZE" 2 "MBSL_WAIT_MEAN_KO2" 3 "MBSL_INIT_MEAN_KO2" 4 "MBSL_MEAN_KO2" 5 "MBSL_ORDINARY_AUTOADAPTIVE" 6 "MBSL_FILLUP_AUTOADAPTIVE" 7 "MBSL_WAIT_NEW_AUTOADAPTIVE" /end COMPU_VTAB
/begin COMPU_VTAB VTAB_FOR_EgrFlowRateMeas4ms_CM_FixEnableT "Enumerated data type: FixEnableT" TAB_VERB 2 171 "Enable" 218 "Disable" /end COMPU_VTAB
/begin COMPU_VTAB VTAB_FOR_EnableFcnEn4ms_Symbol_CM_FixEnableT "Enumerated data type: FixEnableT" TAB_VERB 2 171 "Enable" 218 "Disable" /end COMPU_VTAB
/begin COMPU_VTAB VTAB_FOR_EprMgm4ms_CM_FixEnableT "Enumerated data type: FixEnableT" TAB_VERB 2 171 "Enable" 218 "Disable" /end COMPU_VTAB
/begin COMPU_VTAB VTAB_FOR_FanMgm100ms_CM_FixEnableT "Enumerated data type: FixEnableT" TAB_VERB 2 171 "Enable" 218 "Disable" /end COMPU_VTAB
/begin COMPU_VTAB VTAB_FOR_FuelConsTDC_CM_FixEnableT "Enumerated data type: FixEnableT" TAB_VERB 2 171 "Enable" 218 "Disable" /end COMPU_VTAB
/begin COMPU_VTAB VTAB_FOR_PtoCCReq4ms_Symbol_CM_FixEnableT "Enumerated data type: FixEnableT" TAB_VERB 2 171 "Enable" 218 "Disable" /end COMPU_VTAB
/begin COMPU_VTAB VTAB_FOR_RefuelMgmTDC_Symbol_CM_FixEnableT "Enumerated data type: FixEnableT" TAB_VERB 2 171 "Enable" 218 "Disable" /end COMPU_VTAB
/begin COMPU_VTAB VTAB_FOR_Signal_Mgm_4ms_Symbol_CM_FixEnableT "Enumerated data type: FixEnableT" TAB_VERB 2 171 "Enable" 218 "Disable" /end COMPU_VTAB
/begin COMPU_VTAB VTAB_FOR_TB_VcmVariable4ms_Symbol_CM_FixEnableT "Enumerated data type: FixEnableT" TAB_VERB 2 171 "Enable" 218 "Disable" /end COMPU_VTAB
/begin COMPU_VTAB VTAB_FOR_TE_CmuReqMgm4ms_Symbol_CM_FixEnableT "Enumerated data type: FixEnableT" TAB_VERB 2 171 "Enable" 218 "Disable" /end COMPU_VTAB
/begin COMPU_VTAB VTAB_FOR_TE_DigOutput100ms_CM_FixEnableT "Enumerated data type: FixEnableT" TAB_VERB 2 171 "Enable" 218 "Disable" /end COMPU_VTAB
/begin COMPU_VTAB VTAB_FOR_TE_DoorsOpen100ms_CM_FixEnableT "Enumerated data type: FixEnableT" TAB_VERB 2 171 "Enable" 218 "Disable" /end COMPU_VTAB
/begin COMPU_VTAB VTAB_FOR_TE_FuelLevel1s_CM_FixEnableT "Enumerated data type: FixEnableT" TAB_VERB 2 171 "Enable" 218 "Disable" /end COMPU_VTAB
/begin COMPU_VTAB VTAB_FOR_TE_HBEgrValveCtrl4ms_CM_FixEnableT "Enumerated data type: FixEnableT" TAB_VERB 2 171 "Enable" 218 "Disable" /end COMPU_VTAB
/begin COMPU_VTAB VTAB_FOR_TE_PtoCc4ms_Symbol_CM_FixEnableT "Enumerated data type: FixEnableT" TAB_VERB 2 171 "Enable" 218 "Disable" /end COMPU_VTAB
/begin COMPU_VTAB VTAB_FOR_TE_StartStopRpmMgm100ms_Symbol_CM_FixEnableT "Enumerated data type: FixEnableT" TAB_VERB 2 171 "Enable" 218 "Disable" /end COMPU_VTAB
/begin COMPU_VTAB VTAB_FOR_TE_TSC1Manager4ms_Symbol_CM_FixEnableT "Enumerated data type: FixEnableT" TAB_VERB 2 171 "Enable" 218 "Disable" /end COMPU_VTAB
/begin COMPU_VTAB VTAB_FOR_TE_VehicleSpeedLim100ms_Symbol_CM_FixEnableT "Enumerated data type: FixEnableT" TAB_VERB 2 171 "Enable" 218 "Disable" /end COMPU_VTAB
/begin COMPU_VTAB VTAB_FOR_VcmFcnEnableInit_CM_FixEnableT "Enumerated data type: FixEnableT" TAB_VERB 2 171 "Enable" 218 "Disable" /end COMPU_VTAB
/begin COMPU_VTAB VTAB_FOR_Vfnc4ms_CM_tKeyState_adm "Enumerated data type: tKeyState" TAB_VERB 2 0 "KEY_OFF" 1 "KEY_ON" /end COMPU_VTAB
/begin COMPU_VTAB bsCrkPhase.Conversion "" TAB_VERB 5 0 "PH_NULL" 1 "PHASE1" 2 "PHASE2" 3 "PHASE3" 4 "END_CRANK" /end COMPU_VTAB
/begin RECORD_LAYOUT Lookup1D_ULONG FNC_VALUES 1 ULONG COLUMN_DIR DIRECT /end RECORD_LAYOUT
/begin RECORD_LAYOUT Lookup1D_UWORD FNC_VALUES 1 UWORD COLUMN_DIR DIRECT /end RECORD_LAYOUT
/begin RECORD_LAYOUT Lookup1D_X_UWORD AXIS_PTS_X 1 UWORD INDEX_INCR DIRECT /end RECORD_LAYOUT
/begin RECORD_LAYOUT Lookup2DSF_UWORD FNC_VALUES 1 UWORD ROW_DIR DIRECT /end RECORD_LAYOUT
/begin RECORD_LAYOUT Lookup2D_UWORD FNC_VALUES 1 UWORD COLUMN_DIR DIRECT /end RECORD_LAYOUT
/begin RECORD_LAYOUT Lookup2D_X_UWORD AXIS_PTS_X 1 UWORD INDEX_INCR DIRECT /end RECORD_LAYOUT
/begin RECORD_LAYOUT Lookup2D_X_WORD AXIS_PTS_X 1 SWORD INDEX_INCR DIRECT /end RECORD_LAYOUT
/begin RECORD_LAYOUT Scalar_BOOLEAN FNC_VALUES 1 UBYTE COLUMN_DIR DIRECT /end RECORD_LAYOUT
/begin RECORD_LAYOUT Scalar_BYTE FNC_VALUES 1 SBYTE COLUMN_DIR DIRECT /end RECORD_LAYOUT
/begin RECORD_LAYOUT Scalar_FLOAT32_IEEE FNC_VALUES 1 FLOAT32_IEEE COLUMN_DIR DIRECT /end RECORD_LAYOUT
/begin RECORD_LAYOUT Scalar_SWORD FNC_VALUES 1 SWORD COLUMN_DIR DIRECT /end RECORD_LAYOUT
/begin RECORD_LAYOUT Scalar_UBYTE FNC_VALUES 1 UBYTE COLUMN_DIR DIRECT /end RECORD_LAYOUT
/begin RECORD_LAYOUT Scalar_ULONG FNC_VALUES 1 ULONG COLUMN_DIR DIRECT /end RECORD_LAYOUT
/begin RECORD_LAYOUT Scalar_UWORD FNC_VALUES 1 UWORD COLUMN_DIR DIRECT /end RECORD_LAYOUT
/end MODULE
/end PROJECT
