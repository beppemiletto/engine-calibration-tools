ASAP2_VERSION 1 70
/begin PROJECT XCPonCANFD "Generated for ETAS and Vector "
/begin MODULE XCPonCANFD "Generated for ETAS and Vector "
/begin MOD_COMMON "XCPonCANFD" BYTE_ORDER MSB_FIRST ALIGNMENT_BYTE 1 ALIGNMENT_WORD 2 ALIGNMENT_LONG 4 ALIGNMENT_FLOAT32_IEEE 4 ALIGNMENT_FLOAT64_IEEE 8 ALIGNMENT_INT64 8 /end MOD_COMMON
/begin CHARACTERISTIC efELECTRIC_LOAD_EnFix "[FIX] Richiesta di coppia per carichi elettrici" VALUE 0xFC5DC4 Scalar_UWORD 0 TE_TM_FFW4ms_Symbol_CM_FixEnableT 171 218 /end CHARACTERISTIC
/begin CHARACTERISTIC efENBRK_DC_Enable "[FIX] Engine Brake actuator command duty cycle" VALUE 0xFC4D22 Scalar_UBYTE 0 EngineBrakeMgm50ms_CM_FixEnableT 171 218 /end CHARACTERISTIC
/begin CHARACTERISTIC efENBRK_DC_Value "[FIX] Engine Brake actuator command duty cycle" VALUE 0xFC4D20 Scalar_UWORD 0 EngineBrakeMgm50ms_CM_ufix16_En4__ 0 100 /end CHARACTERISTIC
/begin CHARACTERISTIC efENG2CMF_N_IST "[FIX] Coppia Resistente dovuta al movimento organico" VALUE 0xFCBE98 Scalar_UWORD 0 TE_TM_TorqBasCtrl4ms_Symbol_CM_ufix16_En4_N_m 0 4095 /end CHARACTERISTIC
/begin CHARACTERISTIC efENG2CMF_N_IST_EnFix "[FIX] Coppia Resistente dovuta al movimento organico" VALUE 0xFCBE96 Scalar_UWORD 0 TE_TM_TorqBasCtrl4ms_Symbol_CM_FixEnableT 171 218 /end CHARACTERISTIC
/begin CHARACTERISTIC efENG2CMF_P_IST "[FIX] Coppia Resistente dovuta alla pressione del lubrificante" VALUE 0xFCBE94 Scalar_UWORD 0 TE_TM_TorqBasCtrl4ms_Symbol_CM_ufix16_En4_N_m 0 4095 /end CHARACTERISTIC
/begin CHARACTERISTIC efENG2CMF_P_IST_EnFix "[FIX] Coppia Resistente dovuta alla pressione del lubrificante" VALUE 0xFCBE92 Scalar_UWORD 0 TE_TM_TorqBasCtrl4ms_Symbol_CM_FixEnableT 171 218 /end CHARACTERISTIC
/begin CHARACTERISTIC efENG2CMF_T_IST "[FIX] Coppia Resistente dovuta alla viscosita del lubrificante" VALUE 0xFCBE90 Scalar_UWORD 0 TE_TM_TorqBasCtrl4ms_Symbol_CM_ufix16_En4_N_m 0 4095 /end CHARACTERISTIC
/begin CHARACTERISTIC efENG2CMF_T_IST_EnFix "[FIX] Coppia Resistente dovuta alla viscosita del lubrificante" VALUE 0xFCBE8E Scalar_UWORD 0 TE_TM_TorqBasCtrl4ms_Symbol_CM_FixEnableT 171 218 /end CHARACTERISTIC
/begin CHARACTERISTIC efENG_REQ_LIM_SUP_Enable "[FIX] Fix su Limitazione di coppia interna (MF3 engine+diagnosi)" VALUE 0xFCBA1E Scalar_UBYTE 0 TE_TM_TorqBas4ms_CM_FixEnableT 171 218 /end CHARACTERISTIC
/begin CHARACTERISTIC efENG_REQ_LIM_SUP_Value "[FIX] Fix su Limitazione di coppia interna (MF3 engine+diagnosi)" VALUE 0xFCBA1C Scalar_UWORD 0 TE_TM_TorqBas4ms_CM_ufix16_En4__ 0 100 /end CHARACTERISTIC
/begin CHARACTERISTIC efENG_TRQ_MODE "[FIX] Fix su Engine torque mode generato da MF3" VALUE 0xFCBE8C Scalar_UWORD 0 TE_TM_TorqBasCtrl4ms_Symbol_CM_uint8_adm 0 15 /end CHARACTERISTIC
/begin CHARACTERISTIC efENG_TRQ_MODE_EnFix "[FIX] Fix su Engine torque mode generato da MF3" VALUE 0xFCBE8A Scalar_UWORD 0 TE_TM_TorqBasCtrl4ms_Symbol_CM_FixEnableT 171 218 /end CHARACTERISTIC
/begin CHARACTERISTIC efEN_D_ADV_OBJ "[FIX] Fix su abilitazione contributo di Coppia Veloce anche in Low Idle" VALUE 0xFCBE88 Scalar_UWORD 0 TE_TM_TorqBasCtrl4ms_Symbol_CM_boolean_adm 0 1 /end CHARACTERISTIC
/begin CHARACTERISTIC efEN_D_ADV_OBJ_EnFix "[FIX] Fix su abilitazione contributo di Coppia Veloce anche in Low Idle" VALUE 0xFCBE86 Scalar_UWORD 0 TE_TM_TorqBasCtrl4ms_Symbol_CM_FixEnableT 171 218 /end CHARACTERISTIC
/begin CHARACTERISTIC efEN_G_ADV_OBJ "[FIX] Fix su abilitazione contributo di Coppia Veloce anche con Gear Coupled" VALUE 0xFCBE84 Scalar_UWORD 0 TE_TM_TorqBasCtrl4ms_Symbol_CM_boolean_adm 0 1 /end CHARACTERISTIC
/begin CHARACTERISTIC efEN_G_ADV_OBJ_EnFix "[FIX] Fix su abilitazione contributo di Coppia Veloce anche con Gear Coupled" VALUE 0xFCBE82 Scalar_UWORD 0 TE_TM_TorqBasCtrl4ms_Symbol_CM_FixEnableT 171 218 /end CHARACTERISTIC
/begin CHARACTERISTIC efEN_N_ADV_OBJ "[FIX] Fix su abilitazione contributo di Coppia Veloce quando si è in controllo di giri" VALUE 0xFCBE80 Scalar_UWORD 0 TE_TM_TorqBasCtrl4ms_Symbol_CM_boolean_adm 0 1 /end CHARACTERISTIC
/begin CHARACTERISTIC efEN_N_ADV_OBJ_EnFix "[FIX] Fix su abilitazione contributo di Coppia Veloce quando si è in controllo di giri" VALUE 0xFCBE7E Scalar_UWORD 0 TE_TM_TorqBasCtrl4ms_Symbol_CM_FixEnableT 171 218 /end CHARACTERISTIC
/begin CHARACTERISTIC efEN_SP_CTRL_PID "[FIX] Fix per forzare attivazione controllo di giri PTO" VALUE 0xFCBA98 Scalar_UWORD 0 TE_TM_SpeedCtrl_4ms_Symbol_CM_boolean_adm 0 1 /end CHARACTERISTIC
/begin CHARACTERISTIC efEN_SP_CTRL_PID_EnFix "[FIX] Fix per forzare attivazione controllo di giri PTO" VALUE 0xFCBA96 Scalar_UWORD 0 TE_TM_SpeedCtrl_4ms_Symbol_CM_FixEnableT 171 218 /end CHARACTERISTIC
/begin CHARACTERISTIC efEN_VVA_THROT_INF "[FIX] Fix on Lower Trhottle Limitation for Fi2 Activation" VALUE 0xFC9CE0 Scalar_UWORD 0 TE_MAirReqATDC_Symbol_CM_uint16__ 0 100 /end CHARACTERISTIC
/begin CHARACTERISTIC efEN_VVA_THROT_INF_EnFix "[FIX] Fix on Lower Trhottle Limitation for Fi2 Activation" VALUE 0xFC9CDE Scalar_UWORD 0 TE_MAirReqATDC_Symbol_CM_FixEnableT 171 218 /end CHARACTERISTIC
/begin CHARACTERISTIC efETA2DADV "[FIX] Curva (inversa della Curva Unica) che fornisce il delta anticipo sul ramo veloce della Coppia" VALUE 0xFCBE7C Scalar_UWORD 0 TE_TM_TorqBasCtrl4ms_Symbol_CM_ufix16_En4_degree 0 50 /end CHARACTERISTIC
/begin CHARACTERISTIC efETA2DADV_EnFix "[FIX] Curva (inversa della Curva Unica) che fornisce il delta anticipo sul ramo veloce della Coppia" VALUE 0xFCBE7A Scalar_UWORD 0 TE_TM_TorqBasCtrl4ms_Symbol_CM_FixEnableT 171 218 /end CHARACTERISTIC
/begin CHARACTERISTIC efETA_CYL_ON_OFF "[FIX] Fix su valore efficienza per spegnimento cilindri" VALUE 0xFCC5A4 Scalar_UWORD 0 TE_TM_TorqCalcTDC_Symbol_CM_ufix16_En8_adm 0 1 /end CHARACTERISTIC
/begin CHARACTERISTIC efETA_CYL_ON_OFF_EnFix "[FIX] Fix su valore efficienza per spegnimento cilindri" VALUE 0xFCC5A2 Scalar_UWORD 0 TE_TM_TorqCalcTDC_Symbol_CM_FixEnableT 171 218 /end CHARACTERISTIC
/begin CHARACTERISTIC efETA_D_ADV_ISTA "[FIX] Curva Unica della efficienza del Ciclo Otto (Coppia Utile) in funzione del delta anticipo" VALUE 0xFCC5A0 Scalar_UWORD 0 TE_TM_TorqCalcTDC_Symbol_CM_ufix16_En8_adm 0.00390625 1 /end CHARACTERISTIC
/begin CHARACTERISTIC efETA_D_ADV_ISTA_EnFix "[FIX] Curva Unica della efficienza del Ciclo Otto (Coppia Utile) in funzione del delta anticipo" VALUE 0xFCC59E Scalar_UWORD 0 TE_TM_TorqCalcTDC_Symbol_CM_FixEnableT 171 218 /end CHARACTERISTIC
/begin CHARACTERISTIC efETA_LAM_ISTA "[FIX] Efficienza della Coppia Utile in funzione di lambda" VALUE 0xFCC59C Scalar_UWORD 0 TE_TM_TorqCalcTDC_Symbol_CM_ufix16_En8_adm 0 1 /end CHARACTERISTIC
/begin CHARACTERISTIC efETA_LAM_ISTA_EnFix "[FIX] Efficienza della Coppia Utile in funzione di lambda" VALUE 0xFCC59A Scalar_UWORD 0 TE_TM_TorqCalcTDC_Symbol_CM_FixEnableT 171 218 /end CHARACTERISTIC
/begin CHARACTERISTIC efFI1_FI2_VVA "[FIX] Fix sul delta fase di aspirazione in funzionamento VVA" VALUE 0xFC9CDC Scalar_UWORD 0 TE_MAirReqATDC_Symbol_CM_uint16_degM 180 360 /end CHARACTERISTIC
/begin CHARACTERISTIC efFI1_FI2_VVA_EnFix "[FIX] Fix sul delta fase di aspirazione in funzionamento VVA" VALUE 0xFC9CDA Scalar_UWORD 0 TE_MAirReqATDC_Symbol_CM_FixEnableT 171 218 /end CHARACTERISTIC
/begin CHARACTERISTIC efFI2_TO_VCYL "[FIX] Single Cylinder Volume varying with Fi2 actuation" VALUE 0xFC9CD8 Scalar_UWORD 0 TE_MAirReqATDC_Symbol_CM_ufix16_En4_cc 0 4095 /end CHARACTERISTIC
/begin CHARACTERISTIC efFI2_TO_VCYL_EnFix "[FIX] Single Cylinder Volume varying with Fi2 actuation" VALUE 0xFC9CD6 Scalar_UWORD 0 TE_MAirReqATDC_Symbol_CM_FixEnableT 171 218 /end CHARACTERISTIC
/begin CHARACTERISTIC efFREEZE_KI_HI "[FIX] Fix per congelare (1) integrale del PID in High Idle" VALUE 0xFCBE78 Scalar_UWORD 0 TE_TM_TorqBasCtrl4ms_Symbol_CM_boolean_adm 0 1 /end CHARACTERISTIC
/begin CHARACTERISTIC efFREEZE_KI_HI_EnFix "[FIX] Fix per congelare (1) integrale del PID in High Idle" VALUE 0xFCBE76 Scalar_UWORD 0 TE_TM_TorqBasCtrl4ms_Symbol_CM_FixEnableT 171 218 /end CHARACTERISTIC
/begin CHARACTERISTIC efFREEZE_KI_SCP "[FIX] Fix sul congelamento integrale per fase di transizione" VALUE 0xFCBA94 Scalar_UWORD 0 TE_TM_SpeedCtrl_4ms_Symbol_CM_boolean_adm 0 1 /end CHARACTERISTIC
/begin CHARACTERISTIC efFREEZE_KI_SCP_EnFix "[FIX] Fix sul congelamento integrale per fase di transizione" VALUE 0xFCBA92 Scalar_UWORD 0 TE_TM_SpeedCtrl_4ms_Symbol_CM_FixEnableT 171 218 /end CHARACTERISTIC
/begin CHARACTERISTIC efGAIN_KI_HI "[FIX] Guadagno su KI per Inerzia virtuale del veicolo" VALUE 0xFCBE74 Scalar_UWORD 0 TE_TM_TorqBasCtrl4ms_Symbol_CM_ufix16_En10_adm 0 10 /end CHARACTERISTIC
/begin CHARACTERISTIC efGAIN_KI_HI_EnFix "[FIX] Guadagno su KI per Inerzia virtuale del veicolo" VALUE 0xFCBE72 Scalar_UWORD 0 TE_TM_TorqBasCtrl4ms_Symbol_CM_FixEnableT 171 218 /end CHARACTERISTIC
/begin CHARACTERISTIC efGAIN_KP_HI "[FIX] Guadagno su KP per Inerzia virtuale del veicolo" VALUE 0xFCBE70 Scalar_UWORD 0 TE_TM_TorqBasCtrl4ms_Symbol_CM_ufix16_En10_adm 0 10 /end CHARACTERISTIC
/begin CHARACTERISTIC efGAIN_KP_HI_EnFix "[FIX] Guadagno su KP per Inerzia virtuale del veicolo" VALUE 0xFCBE6E Scalar_UWORD 0 TE_TM_TorqBasCtrl4ms_Symbol_CM_FixEnableT 171 218 /end CHARACTERISTIC
/begin CHARACTERISTIC efGEAR_COUPLED "[FIX] Fix su cambio accoppiato per gestire init integrale di High Idle" VALUE 0xFCBE6C Scalar_UWORD 0 TE_TM_TorqBasCtrl4ms_Symbol_CM_boolean_adm 0 1 /end CHARACTERISTIC
/begin CHARACTERISTIC efGEAR_COUPLED_EnFix "[FIX] Fix su cambio accoppiato per gestire init integrale di High Idle" VALUE 0xFCBE6A Scalar_UWORD 0 TE_TM_TorqBasCtrl4ms_Symbol_CM_FixEnableT 171 218 /end CHARACTERISTIC
/begin CHARACTERISTIC efGEAR_OVER_SPD "[FIX] Fix per interdire (1) intervento della strategia di Over-Speed temporaneo per cambio disaccoppiato" VALUE 0xFCBE68 Scalar_UWORD 0 TE_TM_TorqBasCtrl4ms_Symbol_CM_boolean_adm 0 1 /end CHARACTERISTIC
/begin CHARACTERISTIC efGEAR_OVER_SPD_EnFix "[FIX] Fix per interdire (1) intervento della strategia di Over-Speed temporaneo per cambio disaccoppiato" VALUE 0xFCBE66 Scalar_UWORD 0 TE_TM_TorqBasCtrl4ms_Symbol_CM_FixEnableT 171 218 /end CHARACTERISTIC
/begin CHARACTERISTIC efGOV_HI_KI "[FIX] High governor KI parameter set" VALUE 0xFCBE64 Scalar_UWORD 0 TE_TM_TorqBasCtrl4ms_Symbol_CM_ufix16_En10_adm 0 1 /end CHARACTERISTIC
/begin CHARACTERISTIC efGOV_HI_KI_EnFix "[FIX] High governor KI parameter set" VALUE 0xFCBE62 Scalar_UWORD 0 TE_TM_TorqBasCtrl4ms_Symbol_CM_FixEnableT 171 218 /end CHARACTERISTIC
/begin CHARACTERISTIC efGOV_HI_KP "[FIX] High governor KP parameter set" VALUE 0xFCBE60 Scalar_UWORD 0 TE_TM_TorqBasCtrl4ms_Symbol_CM_ufix16_En10_adm 0 1 /end CHARACTERISTIC
/begin CHARACTERISTIC efGOV_HI_KP_EnFix "[FIX] High governor KP parameter set" VALUE 0xFCBE5E Scalar_UWORD 0 TE_TM_TorqBasCtrl4ms_Symbol_CM_FixEnableT 171 218 /end CHARACTERISTIC
/begin CHARACTERISTIC efHYS_N_CTRL_ADV_Enable "[FIX] Anticipo di giri con cui si fa lo SWITCH da Torque a Speed Control" VALUE 0xFCBA1A Scalar_UBYTE 0 TE_TM_TorqBas4ms_CM_FixEnableT 171 218 /end CHARACTERISTIC
/begin CHARACTERISTIC efHYS_N_CTRL_ADV_Value "[FIX] Anticipo di giri con cui si fa lo SWITCH da Torque a Speed Control" VALUE 0xFCBA18 Scalar_UWORD 0 TE_TM_TorqBas4ms_CM_uint16_rpm 0 10000 /end CHARACTERISTIC
/begin CHARACTERISTIC efHYS_N_CTRL_TOR_Enable "[FIX] Isteresi a salire (su rpm misurati) per spegnere il calcolo in background del contributo di coppia per giri obiettivo" VALUE 0xFCBA16 Scalar_UBYTE 0 TE_TM_TorqBas4ms_CM_FixEnableT 171 218 /end CHARACTERISTIC
/begin CHARACTERISTIC efHYS_N_CTRL_TOR_Value "[FIX] Isteresi a salire (su rpm misurati) per spegnere il calcolo in background del contributo di coppia per giri obiettivo" VALUE 0xFCBA14 Scalar_UWORD 0 TE_TM_TorqBas4ms_CM_uint16_rpm 0 10000 /end CHARACTERISTIC
/begin CHARACTERISTIC efHYS_T_CTRL_TOR_Enable "[FIX] Isteresi a salire (su % coppia richiesta rispetto a coppia calcolata per i giri) per passare a controllo di coppia" VALUE 0xFCBA12 Scalar_UBYTE 0 TE_TM_TorqBas4ms_CM_FixEnableT 171 218 /end CHARACTERISTIC
/begin CHARACTERISTIC efHYS_T_CTRL_TOR_Value "[FIX] Isteresi a salire (su % coppia richiesta rispetto a coppia calcolata per i giri) per passare a controllo di coppia" VALUE 0xFCBA10 Scalar_UWORD 0 TE_TM_TorqBas4ms_CM_ufix16_En4__ 0 100 /end CHARACTERISTIC
/begin CHARACTERISTIC efINIT_HI_INT "[FIX] Fix su init integrale del PID in High Idle" VALUE 0xFCBE5C Scalar_UWORD 0 TE_TM_TorqBasCtrl4ms_Symbol_CM_ufix16_En4__ 0 125 /end CHARACTERISTIC
/begin CHARACTERISTIC efINIT_HI_INT_EnFix "[FIX] Fix su init integrale del PID in High Idle" VALUE 0xFCBE5A Scalar_UWORD 0 TE_TM_TorqBasCtrl4ms_Symbol_CM_FixEnableT 171 218 /end CHARACTERISTIC
/begin CHARACTERISTIC efINIT_HI_INT_NO_GEAR "[FIX] Fix su init integrale del PID in High Idle con cambio non accoppiato" VALUE 0xFCBE58 Scalar_UWORD 0 TE_TM_TorqBasCtrl4ms_Symbol_CM_ufix16_En4__ 0 125 /end CHARACTERISTIC
/begin CHARACTERISTIC efINIT_HI_INT_NO_GEAR_EnFix "[FIX] Fix su init integrale del PID in High Idle con cambio non accoppiato" VALUE 0xFCBE56 Scalar_UWORD 0 TE_TM_TorqBasCtrl4ms_Symbol_CM_FixEnableT 171 218 /end CHARACTERISTIC
/begin CHARACTERISTIC efKDSPEED_CTRL "[FIX] Coefficiente del controllo derivativo RPM sui giri obiettivo PTO" VALUE 0xFCBA90 Scalar_UWORD 0 TE_TM_SpeedCtrl_4ms_Symbol_CM_ufix16_En15___s_on_rpm 0 1.953125 /end CHARACTERISTIC
/begin CHARACTERISTIC efKDSPEED_CTRL_EnFix "[FIX] Coefficiente del controllo derivativo RPM sui giri obiettivo PTO" VALUE 0xFCBA8E Scalar_UWORD 0 TE_TM_SpeedCtrl_4ms_Symbol_CM_FixEnableT 171 218 /end CHARACTERISTIC
/begin CHARACTERISTIC efKD_CC "[FIX] KD in CC f(rpm_error)" VALUE 0xFCBA8C Scalar_UWORD 0 TE_TM_SpeedCtrl_4ms_Symbol_CM_ufix16_En15___s_on_rpm 0 1.953125 /end CHARACTERISTIC
/begin CHARACTERISTIC efKD_CC_EnFix "[FIX] KD in CC f(rpm_error)" VALUE 0xFCBA8A Scalar_UWORD 0 TE_TM_SpeedCtrl_4ms_Symbol_CM_FixEnableT 171 218 /end CHARACTERISTIC
/begin CHARACTERISTIC efKD_CTRL_HI "[FIX] Contributo derivativo del Ctrl PID di High Idle" VALUE 0xFCBE54 Scalar_UWORD 0 TE_TM_TorqBasCtrl4ms_Symbol_CM_ufix16_En15___s_rpm 0 1.953125 /end CHARACTERISTIC
/begin CHARACTERISTIC efKD_CTRL_HI_EnFix "[FIX] Contributo derivativo del Ctrl PID di High Idle" VALUE 0xFCBE52 Scalar_UWORD 0 TE_TM_TorqBasCtrl4ms_Symbol_CM_FixEnableT 171 218 /end CHARACTERISTIC
/begin CHARACTERISTIC efKD_GAININERTIA "[FIX] Variazione del KD in funzione delle richieste di stiffness del Crtl PID" VALUE 0xFCBA88 Scalar_UWORD 0 TE_TM_SpeedCtrl_4ms_Symbol_CM_ufix16_En10_adm 0 10 /end CHARACTERISTIC
/begin CHARACTERISTIC efKD_GAININERTIA_EnFix "[FIX] Variazione del KD in funzione delle richieste di stiffness del Crtl PID" VALUE 0xFCBA86 Scalar_UWORD 0 TE_TM_SpeedCtrl_4ms_Symbol_CM_FixEnableT 171 218 /end CHARACTERISTIC
/begin CHARACTERISTIC efKF_OBT_HI_UP "[FIX] Ulteriore delta giri di anticipo per ingresso in High Idle funzione della derivata di giri" VALUE 0xFCBE50 Scalar_UWORD 0 TE_TM_TorqBasCtrl4ms_Symbol_CM_ufix16_En15_adm 0 1 /end CHARACTERISTIC
/begin CHARACTERISTIC efKF_OBT_HI_UP_EnFix "[FIX] Ulteriore delta giri di anticipo per ingresso in High Idle funzione della derivata di giri" VALUE 0xFCBE4E Scalar_UWORD 0 TE_TM_TorqBasCtrl4ms_Symbol_CM_FixEnableT 171 218 /end CHARACTERISTIC
/begin CHARACTERISTIC efKI1_ANTIW_UP_H "[FIX] AntiWindUp superiore del KI" VALUE 0xFCBA84 Scalar_UWORD 0 TE_TM_SpeedCtrl_4ms_Symbol_CM_ufix16_En4__ 0 100 /end CHARACTERISTIC
/begin CHARACTERISTIC efKI1_ANTIW_UP_H_EnFix "[FIX] AntiWindUp superiore del KI" VALUE 0xFCBA82 Scalar_UWORD 0 TE_TM_SpeedCtrl_4ms_Symbol_CM_FixEnableT 171 218 /end CHARACTERISTIC
/begin CHARACTERISTIC efKI1_ANTIW_UP_L "[FIX] AntiWindUp inferiore del KI" VALUE 0xFCBAAA Scalar_SWORD 0 TE_TM_SpeedCtrl_4ms_Symbol_CM_sfix16_En4__ -100 0 /end CHARACTERISTIC
/begin CHARACTERISTIC efKI1_ANTIW_UP_L_EnFix "[FIX] AntiWindUp inferiore del KI" VALUE 0xFCBAA8 Scalar_SWORD 0 TE_TM_SpeedCtrl_4ms_Symbol_CM_FixEnableT 171 218 /end CHARACTERISTIC
/begin CHARACTERISTIC efKISPEED_CTRL "[FIX] Coefficiente del controllo integrale su errore di giri obiettivo PTO" VALUE 0xFCBA80 Scalar_UWORD 0 TE_TM_SpeedCtrl_4ms_Symbol_CM_ufix16_En15___s_on_rpm 0 1.953125 /end CHARACTERISTIC
/begin CHARACTERISTIC efKISPEED_CTRL_EnFix "[FIX] Coefficiente del controllo integrale su errore di giri obiettivo PTO" VALUE 0xFCBA7E Scalar_UWORD 0 TE_TM_SpeedCtrl_4ms_Symbol_CM_FixEnableT 171 218 /end CHARACTERISTIC
/begin CHARACTERISTIC efKI_CC "[FIX] KI in CC f(rpm_error)" VALUE 0xFCBA7C Scalar_UWORD 0 TE_TM_SpeedCtrl_4ms_Symbol_CM_ufix16_En15___on_s_rpm 0 1.953125 /end CHARACTERISTIC
/begin CHARACTERISTIC efKI_CC_EnFix "[FIX] KI in CC f(rpm_error)" VALUE 0xFCBA7A Scalar_UWORD 0 TE_TM_SpeedCtrl_4ms_Symbol_CM_FixEnableT 171 218 /end CHARACTERISTIC
/begin CHARACTERISTIC efKI_CTRL_HI "[FIX] Contributo integrale del Ctrl PID di High Idle" VALUE 0xFCBE4C Scalar_UWORD 0 TE_TM_TorqBasCtrl4ms_Symbol_CM_ufix16_En15___rpm 0 1.953125 /end CHARACTERISTIC
/begin CHARACTERISTIC efKI_CTRL_HI_EnFix "[FIX] Contributo integrale del Ctrl PID di High Idle" VALUE 0xFCBE4A Scalar_UWORD 0 TE_TM_TorqBasCtrl4ms_Symbol_CM_FixEnableT 171 218 /end CHARACTERISTIC
/begin CHARACTERISTIC efKI_GAININERTIA "[FIX] Variazione del KI in funzione delle richieste di stiffness del Crtl PID" VALUE 0xFCBA78 Scalar_UWORD 0 TE_TM_SpeedCtrl_4ms_Symbol_CM_ufix16_En10_adm 0 10 /end CHARACTERISTIC
/begin CHARACTERISTIC efKI_GAININERTIA_EnFix "[FIX] Variazione del KI in funzione delle richieste di stiffness del Crtl PID" VALUE 0xFCBA76 Scalar_UWORD 0 TE_TM_SpeedCtrl_4ms_Symbol_CM_FixEnableT 171 218 /end CHARACTERISTIC
/begin CHARACTERISTIC efKNOCK_CTRL_TASP "[FIX] Tabella su Aria Aspirata per degrado Anticipo accensione in Knock Ctrl" VALUE 0xFCBE48 Scalar_UWORD 0 TE_TM_TorqBasCtrl4ms_Symbol_CM_ufix16_En4_degE 0 50 /end CHARACTERISTIC
/begin CHARACTERISTIC efKNOCK_CTRL_TASP_EnFix "[FIX] Tabella su Aria Aspirata per degrado Anticipo accensione in Knock Ctrl" VALUE 0xFCBE46 Scalar_UWORD 0 TE_TM_TorqBasCtrl4ms_Symbol_CM_FixEnableT 171 218 /end CHARACTERISTIC
/begin CHARACTERISTIC efKNOCK_CTRL_TQ "[FIX] Tabella su Punto Motore per degrado Anticipo accensione in Knock Ctrl" VALUE 0xFCBE44 Scalar_UWORD 0 TE_TM_TorqBasCtrl4ms_Symbol_CM_ufix16_En4_degE 0 50 /end CHARACTERISTIC
/begin CHARACTERISTIC efKNOCK_CTRL_TQ_EnFix "[FIX] Tabella su Punto Motore per degrado Anticipo accensione in Knock Ctrl" VALUE 0xFCBE42 Scalar_UWORD 0 TE_TM_TorqBasCtrl4ms_Symbol_CM_FixEnableT 171 218 /end CHARACTERISTIC
/begin CHARACTERISTIC efKPSPEED_CTRL "[FIX] Coefficiente del controllo proporzionale su errore di giri obiettivo PTO" VALUE 0xFCBA74 Scalar_UWORD 0 TE_TM_SpeedCtrl_4ms_Symbol_CM_ufix16_En15___rpm 0 1.953125 /end CHARACTERISTIC
/begin CHARACTERISTIC efKPSPEED_CTRL_EnFix "[FIX] Coefficiente del controllo proporzionale su errore di giri obiettivo PTO" VALUE 0xFCBA72 Scalar_UWORD 0 TE_TM_SpeedCtrl_4ms_Symbol_CM_FixEnableT 171 218 /end CHARACTERISTIC
/begin CHARACTERISTIC efKPTAIR_CTRL_Enable "[FIX] Coefficiente del controllo proporzionale su errore di giri obiettivo PTO" VALUE 0xFCBA0E Scalar_UBYTE 0 TE_TM_TorqBas4ms_CM_FixEnableT 171 218 /end CHARACTERISTIC
/begin CHARACTERISTIC efKPTAIR_CTRL_Value "[FIX] Coefficiente del controllo proporzionale su errore di giri obiettivo PTO" VALUE 0xFCBA0C Scalar_UWORD 0 TE_TM_TorqBas4ms_CM_ufix16_En12___degC 0 15.9997558594 /end CHARACTERISTIC
/begin CHARACTERISTIC efKPTEXH_CTRL_Enable "[FIX] Proportional coefficient Kp for exhaust temperature overheating - fix enable" VALUE 0xFCBA0A Scalar_UBYTE 0 TE_TM_TorqBas4ms_CM_FixEnableT 171 218 /end CHARACTERISTIC
/begin CHARACTERISTIC efKPTEXH_CTRL_Value "[FIX] Coefficiente del controllo proporzionale su errore di giri obiettivo PTO" VALUE 0xFCBA08 Scalar_UWORD 0 TE_TM_TorqBas4ms_CM_ufix16_En12___degC 0 15.9997558594 /end CHARACTERISTIC
/begin CHARACTERISTIC efKPTH2O_CTRL_Enable "[FIX] Coefficiente del controllo proporzionale su errore di giri obiettivo PTO" VALUE 0xFCBA06 Scalar_UBYTE 0 TE_TM_TorqBas4ms_CM_FixEnableT 171 218 /end CHARACTERISTIC
/begin CHARACTERISTIC efKPTH2O_CTRL_Value "[FIX] Coefficiente del controllo proporzionale su errore di giri obiettivo PTO" VALUE 0xFCBA04 Scalar_UWORD 0 TE_TM_TorqBas4ms_CM_ufix16_En12___degC 0 15.9997558594 /end CHARACTERISTIC
/begin CHARACTERISTIC efKP_CC "[FIX] KP in CC f(rpm_error)" VALUE 0xFCBA70 Scalar_UWORD 0 TE_TM_SpeedCtrl_4ms_Symbol_CM_ufix16_En15___rpm 0 1.99996948242 /end CHARACTERISTIC
/begin CHARACTERISTIC efKP_CC_EnFix "[FIX] KP in CC f(rpm_error)" VALUE 0xFCBA6E Scalar_UWORD 0 TE_TM_SpeedCtrl_4ms_Symbol_CM_FixEnableT 171 218 /end CHARACTERISTIC
/begin CHARACTERISTIC efKP_CTRL_HI "[FIX] Contributo proporzionale del Ctrl PID di High Idle" VALUE 0xFCBE40 Scalar_UWORD 0 TE_TM_TorqBasCtrl4ms_Symbol_CM_ufix16_En15___rpm 0 1.953125 /end CHARACTERISTIC
/begin CHARACTERISTIC efKP_CTRL_HI_EnFix "[FIX] Contributo proporzionale del Ctrl PID di High Idle" VALUE 0xFCBE3E Scalar_UWORD 0 TE_TM_TorqBasCtrl4ms_Symbol_CM_FixEnableT 171 218 /end CHARACTERISTIC
/begin CHARACTERISTIC efKP_GAININERTIA "[FIX] Variazione del KP in funzione delle richieste di stiffness del Crtl PID" VALUE 0xFCBA6C Scalar_UWORD 0 TE_TM_SpeedCtrl_4ms_Symbol_CM_ufix16_En10_adm 0 10 /end CHARACTERISTIC
/begin CHARACTERISTIC efKP_GAININERTIA_EnFix "[FIX] Variazione del KP in funzione delle richieste di stiffness del Crtl PID" VALUE 0xFCBA6A Scalar_UWORD 0 TE_TM_SpeedCtrl_4ms_Symbol_CM_FixEnableT 171 218 /end CHARACTERISTIC
/begin CHARACTERISTIC efMAX_PERC_CMUISTABS "[FIX] Fix sul valore superiore del feed-back di coppia" VALUE 0xFCC598 Scalar_UWORD 0 TE_TM_TorqCalcTDC_Symbol_CM_ufix16_En4__ 0 100 /end CHARACTERISTIC
/begin CHARACTERISTIC efMAX_PERC_CMUISTABS_EnFix "[FIX] Fix sul valore superiore del feed-back di coppia" VALUE 0xFCC596 Scalar_UWORD 0 TE_TM_TorqCalcTDC_Symbol_CM_FixEnableT 171 218 /end CHARACTERISTIC
/begin CHARACTERISTIC efMEAS_TORQ_DELAYED "[FIX] Fix su Percentuale di Coppia (assoluta) misurata non limitata" VALUE 0xFCC594 Scalar_UWORD 0 TE_TM_TorqCalcTDC_Symbol_CM_ufix16_En4__ 0 125 /end CHARACTERISTIC
/begin CHARACTERISTIC efMEAS_TORQ_DELAYED_EnFix "[FIX] Fix su Percentuale di Coppia (assoluta) misurata non limitata" VALUE 0xFCC592 Scalar_UWORD 0 TE_TM_TorqCalcTDC_Symbol_CM_FixEnableT 171 218 /end CHARACTERISTIC
/begin CHARACTERISTIC efMIN_PERC_CMUISTABS "[FIX] Fix sul valore inferiore del feed-back di coppia" VALUE 0xFCC590 Scalar_UWORD 0 TE_TM_TorqCalcTDC_Symbol_CM_ufix16_En4__ 0 100 /end CHARACTERISTIC
/begin CHARACTERISTIC efMIN_PERC_CMUISTABS_EnFix "[FIX] Fix sul valore inferiore del feed-back di coppia" VALUE 0xFCC58E Scalar_UWORD 0 TE_TM_TorqCalcTDC_Symbol_CM_FixEnableT 171 218 /end CHARACTERISTIC
/begin CHARACTERISTIC efOFF_REF_PTOP "[FIX] Fix per assegnare una percentuale di coppia fissa assorbita da PTO" VALUE 0xFCBA68 Scalar_UWORD 0 TE_TM_SpeedCtrl_4ms_Symbol_CM_ufix16_En4__ 0 100 /end CHARACTERISTIC
/begin CHARACTERISTIC efOFF_REF_PTOP_EnFix "[FIX] Fix per assegnare una percentuale di coppia fissa assorbita da PTO" VALUE 0xFCBA66 Scalar_UWORD 0 TE_TM_SpeedCtrl_4ms_Symbol_CM_FixEnableT 171 218 /end CHARACTERISTIC
/begin CHARACTERISTIC efOV_T_OFF_TIME_DIS_Enable "[FIX] Fix per disabilitare nuova gestione sovratemperatura al key on " VALUE 0xFCBA02 Scalar_UBYTE 0 TE_TM_TorqBas4ms_CM_FixEnableT 171 218 /end CHARACTERISTIC
/begin CHARACTERISTIC efOV_T_OFF_TIME_DIS_Value "[FIX] Fix per disabilitare nuova gestione sovratemperatura al key on " VALUE 0xFCBA01 Scalar_BOOLEAN 0 TE_TM_TorqBas4ms_CM_boolean_adm 0 1 /end CHARACTERISTIC
/begin CHARACTERISTIC efP1_IDLE_SPEED_Enable "[FIX] Fix sul valore dei giri obiettivo di Low Idle da inviare su CAN" VALUE 0xFCB728 Scalar_UBYTE 0 TE_TM_TorqCnfg1s_CM_FixEnableT 171 218 /end CHARACTERISTIC
/begin CHARACTERISTIC efP1_IDLE_SPEED_Value "[FIX] Fix sul valore dei giri obiettivo di Low Idle da inviare su CAN" VALUE 0xFCB726 Scalar_UWORD 0 TE_TM_TorqCnfg1s_CM_uint16_rpm 0 10000 /end CHARACTERISTIC
/begin CHARACTERISTIC efP2ENDSPEEDGOV_Enable "[FIX] Fix sul valore massimo dei giri a cui il T_inj non viene ancora tagliato" VALUE 0xFCB724 Scalar_UBYTE 0 TE_TM_TorqCnfg1s_CM_FixEnableT 171 218 /end CHARACTERISTIC
/begin CHARACTERISTIC efP2ENDSPEEDGOV_Value "[FIX] Fix sul valore massimo dei giri a cui il T_inj non viene ancora tagliato" VALUE 0xFCB722 Scalar_UWORD 0 TE_TM_TorqCnfg1s_CM_uint16_rpm 0 10000 /end CHARACTERISTIC
/begin CHARACTERISTIC efP6HIGH_IDLE_Enable "[FIX] Fix sul valore massimo dei giri a cui il T_inj viene portato a zero" VALUE 0xFCB720 Scalar_UBYTE 0 TE_TM_TorqCnfg1s_CM_FixEnableT 171 218 /end CHARACTERISTIC
/begin CHARACTERISTIC efP6HIGH_IDLE_Value "[FIX] Fix sul valore massimo dei giri a cui il T_inj viene portato a zero" VALUE 0xFCB71E Scalar_UWORD 0 TE_TM_TorqCnfg1s_CM_uint16_rpm 0 10000 /end CHARACTERISTIC
/begin CHARACTERISTIC efP6_GAIN_ENDSPE_Enable "[FIX] Pendenza del controllo High Idle - Gain of endspeed governor" VALUE 0xFCB71C Scalar_UBYTE 0 TE_TM_TorqCnfg1s_CM_FixEnableT 171 218 /end CHARACTERISTIC
/begin CHARACTERISTIC efP6_GAIN_ENDSPE_Value "[FIX] Pendenza del controllo High Idle - Gain of endspeed governor" VALUE 0xFCB71A Scalar_UWORD 0 TE_TM_TorqCnfg1s_CM_ufix16_En10___rpm 0 50.2 /end CHARACTERISTIC
/begin CHARACTERISTIC efP7_MOM_OVERSPE_Enable "[FIX] Fix su Momentary Overspeed (es. per cambio Marcia) sopra High-Idle" VALUE 0xFCB718 Scalar_UBYTE 0 TE_TM_TorqCnfg1s_CM_FixEnableT 171 218 /end CHARACTERISTIC
/begin CHARACTERISTIC efP7_MOM_OVERSPE_Value "[FIX] Fix su Momentary Overspeed (es. per cambio Marcia) sopra High-Idle" VALUE 0xFCB716 Scalar_UWORD 0 TE_TM_TorqCnfg1s_CM_uint16_rpm 0 10000 /end CHARACTERISTIC
/begin CHARACTERISTIC efPECMTHRESREEXT_Enable "[FIX] Fix su soglia inferiore (limite %Cmu richiesta agli attuatori) sotto il quale trascurare le richieste ext. di coppia" VALUE 0xFCBA00 Scalar_UBYTE 0 TE_TM_TorqBas4ms_CM_FixEnableT 171 218 /end CHARACTERISTIC
/begin CHARACTERISTIC efPECMTHRESREEXT_Value "[FIX] Fix su soglia inferiore (limite %Cmu richiesta agli attuatori) sotto il quale trascurare le richieste ext. di coppia" VALUE 0xFCB9FE Scalar_UWORD 0 TE_TM_TorqBas4ms_CM_ufix16_En4__ 0 100 /end CHARACTERISTIC
/begin CHARACTERISTIC efPERC_CMU_INF_COMB "[FIX] Fix sul valore inferiore della coppia programmata" VALUE 0xFCC58C Scalar_UWORD 0 TE_TM_TorqCalcTDC_Symbol_CM_ufix16_En4__ 0 100 /end CHARACTERISTIC
/begin CHARACTERISTIC efPERC_CMU_INF_COMB_EnFix "[FIX] Fix sul valore inferiore della coppia programmata" VALUE 0xFCC58A Scalar_UWORD 0 TE_TM_TorqCalcTDC_Symbol_CM_FixEnableT 171 218 /end CHARACTERISTIC
/begin CHARACTERISTIC efPERC_CMU_IST_ABS "[FIX] Fix su Attuale percentuale Assoluta (rif. a esCmu_Max_AbsOut) di Coppia Erogata dal motore" VALUE 0xFCC588 Scalar_UWORD 0 TE_TM_TorqCalcTDC_Symbol_CM_ufix16_En4__ 0 100 /end CHARACTERISTIC
/begin CHARACTERISTIC efPERC_CMU_IST_ABS_EnFix "[FIX] Fix su Attuale percentuale Assoluta (rif. a esCmu_Max_AbsOut) di Coppia Erogata dal motore" VALUE 0xFCC586 Scalar_UWORD 0 TE_TM_TorqCalcTDC_Symbol_CM_FixEnableT 171 218 /end CHARACTERISTIC
/begin CHARACTERISTIC efPERC_CMU_REQ_MGM_Enable "[FIX] Fix su Richiesta (percentuale di Coppia Erogata) da VCM (obiettivo di giri o di coppia) verso MF3" VALUE 0xFCB9FC Scalar_UBYTE 0 TE_TM_TorqBas4ms_CM_FixEnableT 171 218 /end CHARACTERISTIC
/begin CHARACTERISTIC efPERC_CMU_REQ_MGM_Value "[FIX] Fix su Richiesta (percentuale di Coppia Erogata) da VCM (obiettivo di giri o di coppia) verso MF3" VALUE 0xFCB9FA Scalar_UWORD 0 TE_TM_TorqBas4ms_CM_ufix16_En4__ 0 100 /end CHARACTERISTIC
/begin CHARACTERISTIC efPID_SPEED_CL "[FIX] Fix sulla richiesta netta di CLOSED LOOP calcolata dal PID (senza FEED-FORWARD)" VALUE 0xFCBAA6 Scalar_SWORD 0 TE_TM_SpeedCtrl_4ms_Symbol_CM_sfix16_En4__ -100 100 /end CHARACTERISTIC
/begin CHARACTERISTIC efPID_SPEED_CL_EnFix "[FIX] Fix sulla richiesta netta di CLOSED LOOP calcolata dal PID (senza FEED-FORWARD)" VALUE 0xFCBAA4 Scalar_SWORD 0 TE_TM_SpeedCtrl_4ms_Symbol_CM_FixEnableT 171 218 /end CHARACTERISTIC
/begin CHARACTERISTIC efPID_SPEED_OL "[FIX] Fix sulla richiesta finale di FEED-FORWARD (OPEN LOOP)" VALUE 0xFCBA64 Scalar_UWORD 0 TE_TM_SpeedCtrl_4ms_Symbol_CM_ufix16_En4__ 0 100 /end CHARACTERISTIC
/begin CHARACTERISTIC efPID_SPEED_OL_EnFix "[FIX] Fix sulla richiesta finale di FEED-FORWARD (OPEN LOOP)" VALUE 0xFCBA62 Scalar_UWORD 0 TE_TM_SpeedCtrl_4ms_Symbol_CM_FixEnableT 171 218 /end CHARACTERISTIC
/begin CHARACTERISTIC efPROG_TORQ_DELAYED "[FIX] Fix su Percentuale di Coppia (assoluta) programmata non limitata" VALUE 0xFCC584 Scalar_UWORD 0 TE_TM_TorqCalcTDC_Symbol_CM_ufix16_En4__ 0 125 /end CHARACTERISTIC
/begin CHARACTERISTIC efPROG_TORQ_DELAYED_EnFix "[FIX] Fix su Percentuale di Coppia (assoluta) programmata non limitata" VALUE 0xFCC582 Scalar_UWORD 0 TE_TM_TorqCalcTDC_Symbol_CM_FixEnableT 171 218 /end CHARACTERISTIC
/begin CHARACTERISTIC efPTO_PW_OFF "[FIX] Offset per potenza assorbita dalla PTO (funzione della richiesta esterna di stiffness del Crtl PID)" VALUE 0xFCBA60 Scalar_UWORD 0 TE_TM_SpeedCtrl_4ms_Symbol_CM_ufix16_En4_kW 0 256 /end CHARACTERISTIC
/begin CHARACTERISTIC efPTO_PW_OFF_EnFix "[FIX] Offset per potenza assorbita dalla PTO (funzione della richiesta esterna di stiffness del Crtl PID)" VALUE 0xFCBA5E Scalar_UWORD 0 TE_TM_SpeedCtrl_4ms_Symbol_CM_FixEnableT 171 218 /end CHARACTERISTIC
/begin CHARACTERISTIC efQAIR2CMU_CONV "[FIX] Conversione da massa di aria (mgcc) a Coppia Utile (Nm) potenziale" VALUE 0xFCBE3C Scalar_UWORD 0 TE_TM_TorqBasCtrl4ms_Symbol_CM_ufix16_En8_Nm_mgcc 0 10 /end CHARACTERISTIC
/begin CHARACTERISTIC efQAIR2CMU_CONV_EnFix "[FIX] Conversione da massa di aria (mgcc) a Coppia Utile (Nm) potenziale" VALUE 0xFCBE3A Scalar_UWORD 0 TE_TM_TorqBasCtrl4ms_Symbol_CM_FixEnableT 171 218 /end CHARACTERISTIC
/begin CHARACTERISTIC efQAIR_CRANK "[FIX] Mappa di aria minima per il cranking" VALUE 0xFCBE38 Scalar_UWORD 0 TE_TM_TorqBasCtrl4ms_Symbol_CM_ufix16_En4_kg_h 0 512 /end CHARACTERISTIC
/begin CHARACTERISTIC efQAIR_CRANK_EnFix "[FIX] Mappa di aria minima per il cranking" VALUE 0xFCBE36 Scalar_UWORD 0 TE_TM_TorqBasCtrl4ms_Symbol_CM_FixEnableT 171 218 /end CHARACTERISTIC
/begin CHARACTERISTIC efQAIR_DASHPOT "[FIX] Qair intorno alla zona di Low Idle" VALUE 0xFCBE34 Scalar_UWORD 0 TE_TM_TorqBasCtrl4ms_Symbol_CM_ufix16_En4_kg_h 0 512 /end CHARACTERISTIC
/begin CHARACTERISTIC efQAIR_DASHPOT_EnFix "[FIX] Qair intorno alla zona di Low Idle" VALUE 0xFCBE32 Scalar_UWORD 0 TE_TM_TorqBasCtrl4ms_Symbol_CM_FixEnableT 171 218 /end CHARACTERISTIC
/begin CHARACTERISTIC efQAIR_MAX_REF "[FIX] Equivalente di eference Air Flow (mg/cc) for Torque % determination" VALUE 0xFCBE30 Scalar_UWORD 0 TE_TM_TorqBasCtrl4ms_Symbol_CM_ufix16_En3_mg_cc 0.125 8191 /end CHARACTERISTIC
/begin CHARACTERISTIC efQAIR_MAX_REF_EnFix "[FIX] Equivalente di eference Air Flow (mg/cc) for Torque % determination" VALUE 0xFCBE2E Scalar_UWORD 0 TE_TM_TorqBasCtrl4ms_Symbol_CM_FixEnableT 171 218 /end CHARACTERISTIC
/begin CHARACTERISTIC efQAIR_REQ_TMP "[FIX] Fix su aria richiesta al modello farfalla sul ramo lento della Coppia" VALUE 0xFCBE2C Scalar_UWORD 0 TE_TM_TorqBasCtrl4ms_Symbol_CM_ufix16_En4_kg_h 0 3200 /end CHARACTERISTIC
/begin CHARACTERISTIC efQAIR_REQ_TMP_EnFix "[FIX] Fix su aria richiesta al modello farfalla sul ramo lento della Coppia" VALUE 0xFCBE2A Scalar_UWORD 0 TE_TM_TorqBasCtrl4ms_Symbol_CM_FixEnableT 171 218 /end CHARACTERISTIC
/begin CHARACTERISTIC efQMIN_HIGH_IDLE "[FIX] Aria di trafilamento in High Idle" VALUE 0xFCBE28 Scalar_UWORD 0 TE_TM_TorqBasCtrl4ms_Symbol_CM_ufix16_En4_kg_h 0 150 /end CHARACTERISTIC
/begin CHARACTERISTIC efQMIN_HIGH_IDLE_EnFix "[FIX] Aria di trafilamento in High Idle" VALUE 0xFCBE26 Scalar_UWORD 0 TE_TM_TorqBasCtrl4ms_Symbol_CM_FixEnableT 171 218 /end CHARACTERISTIC
/begin CHARACTERISTIC efRAPP_COMPR_VVA "[FIX] Rapporto di compressione in funzionamento VVA" VALUE 0xFC9CD4 Scalar_UWORD 0 TE_MAirReqATDC_Symbol_CM_ufix16_En8_adm 1 32 /end CHARACTERISTIC
/begin CHARACTERISTIC efRAPP_COMPR_VVA_EnFix "[FIX] Rapporto di compressione in funzionamento VVA" VALUE 0xFC9CD2 Scalar_UWORD 0 TE_MAirReqATDC_Symbol_CM_FixEnableT 171 218 /end CHARACTERISTIC
/begin CHARACTERISTIC efREF_CURVE_CONF "[FIX] Curva di riferimento del motore (percentuale di Cmu) dichiarata per la configurazione (CAN msg Tx ENG_CONF)" VALUE 0xFCBE24 Scalar_UWORD 0 TE_TM_TorqBasCtrl4ms_Symbol_CM_ufix16_En4__ 0 100 /end CHARACTERISTIC
/begin CHARACTERISTIC efREF_CURVE_CONF1_Enable "[FIX] Curva di riferimento del motore (percentuale di Cmu) dichiarata per la configurazione (CAN msg Tx ENG_CONF)" VALUE 0xFCB714 Scalar_UBYTE 0 TE_TM_TorqCnfg1s_CM_FixEnableT 171 218 /end CHARACTERISTIC
/begin CHARACTERISTIC efREF_CURVE_CONF1_Value "[FIX] Curva di riferimento del motore (percentuale di Cmu) dichiarata per la configurazione (CAN msg Tx ENG_CONF)" VALUE 0xFCB712 Scalar_UWORD 0 TE_TM_TorqCnfg1s_CM_ufix16_En4__ 0 100 /end CHARACTERISTIC
/begin CHARACTERISTIC efREF_CURVE_CONF2_Enable "[FIX] Curva di riferimento del motore (percentuale di Cmu P2) dichiarata per la configurazione (CAN msg Tx ENG_CONF)" VALUE 0xFCB710 Scalar_UBYTE 0 TE_TM_TorqCnfg1s_CM_FixEnableT 171 218 /end CHARACTERISTIC
/begin CHARACTERISTIC efREF_CURVE_CONF2_Value "[FIX] Curva di riferimento del motore (percentuale di Cmu P2) dichiarata per la configurazione (CAN msg Tx ENG_CONF)" VALUE 0xFCB70E Scalar_UWORD 0 TE_TM_TorqCnfg1s_CM_ufix16_En4__ 0 100 /end CHARACTERISTIC
/begin CHARACTERISTIC efREF_CURVE_CONF3_Enable "[FIX] Curva di riferimento del motore (percentuale di Cmu P3) dichiarata per la configurazione (CAN msg Tx ENG_CONF)" VALUE 0xFCB70C Scalar_UBYTE 0 TE_TM_TorqCnfg1s_CM_FixEnableT 171 218 /end CHARACTERISTIC
/begin CHARACTERISTIC efREF_CURVE_CONF3_Value "[FIX] Curva di riferimento del motore (percentuale di Cmu P3) dichiarata per la configurazione (CAN msg Tx ENG_CONF)" VALUE 0xFCB70A Scalar_UWORD 0 TE_TM_TorqCnfg1s_CM_ufix16_En4__ 0 100 /end CHARACTERISTIC
/begin CHARACTERISTIC efREF_CURVE_CONF4_Enable "[FIX] Curva di riferimento del motore (percentuale di Cmu P4) dichiarata per la configurazione (CAN msg Tx ENG_CONF)" VALUE 0xFCB708 Scalar_UBYTE 0 TE_TM_TorqCnfg1s_CM_FixEnableT 171 218 /end CHARACTERISTIC
/begin CHARACTERISTIC efREF_CURVE_CONF4_Value "[FIX] Curva di riferimento del motore (percentuale di Cmu P4) dichiarata per la configurazione (CAN msg Tx ENG_CONF)" VALUE 0xFCB706 Scalar_UWORD 0 TE_TM_TorqCnfg1s_CM_ufix16_En4__ 0 100 /end CHARACTERISTIC
/begin CHARACTERISTIC efREF_CURVE_CONF5_Enable "[FIX] Curva di riferimento del motore (percentuale di Cmu P5) dichiarata per la configurazione (CAN msg Tx ENG_CONF)" VALUE 0xFCB704 Scalar_UBYTE 0 TE_TM_TorqCnfg1s_CM_FixEnableT 171 218 /end CHARACTERISTIC
/begin CHARACTERISTIC efREF_CURVE_CONF5_Value "[FIX] Curva di riferimento del motore (percentuale di Cmu P5) dichiarata per la configurazione (CAN msg Tx ENG_CONF)" VALUE 0xFCB702 Scalar_UWORD 0 TE_TM_TorqCnfg1s_CM_ufix16_En4__ 0 100 /end CHARACTERISTIC
/begin CHARACTERISTIC efREF_CURVE_CONF6_Enable "[FIX] Curva di riferimento del motore (percentuale di Cmu P6) dichiarata per la configurazione (CAN msg Tx ENG_CONF)" VALUE 0xFCB700 Scalar_UBYTE 0 TE_TM_TorqCnfg1s_CM_FixEnableT 171 218 /end CHARACTERISTIC
/begin CHARACTERISTIC efREF_CURVE_CONF6_Value "[FIX] Curva di riferimento del motore (percentuale di Cmu P6) dichiarata per la configurazione (CAN msg Tx ENG_CONF)" VALUE 0xFCB6FE Scalar_UWORD 0 TE_TM_TorqCnfg1s_CM_ufix16_En4__ 0 100 /end CHARACTERISTIC
/begin CHARACTERISTIC efREF_CURVE_CONF7_Enable "[FIX] Curva di riferimento del motore (percentuale di Cmu P7) dichiarata per la configurazione (CAN msg Tx ENG_CONF)" VALUE 0xFCB6FC Scalar_UBYTE 0 TE_TM_TorqCnfg1s_CM_FixEnableT 171 218 /end CHARACTERISTIC
/begin CHARACTERISTIC efREF_CURVE_CONF7_Value "[FIX] Curva di riferimento del motore (percentuale di Cmu P7) dichiarata per la configurazione (CAN msg Tx ENG_CONF)" VALUE 0xFCB6FA Scalar_UWORD 0 TE_TM_TorqCnfg1s_CM_ufix16_En4__ 0 100 /end CHARACTERISTIC
/begin CHARACTERISTIC efREF_CURVE_CONF_EnFix "[FIX] Curva di riferimento del motore (percentuale di Cmu) dichiarata per la configurazione (CAN msg Tx ENG_CONF)" VALUE 0xFCBE22 Scalar_UWORD 0 TE_TM_TorqBasCtrl4ms_Symbol_CM_FixEnableT 171 218 /end CHARACTERISTIC
/begin CHARACTERISTIC efREF_CURVE_LTD_TEMP "[FIX] Curva di riferimento del motore (percentuale di Cmu) di derate temporizzato (protezione termica della turbo)" VALUE 0xFCBE20 Scalar_UWORD 0 TE_TM_TorqBasCtrl4ms_Symbol_CM_ufix16_En4__ 0 100 /end CHARACTERISTIC
/begin CHARACTERISTIC efREF_CURVE_LTD_TEMP_EnFix "[FIX] Curva di riferimento del motore (percentuale di Cmu) di derate temporizzato (protezione termica della turbo)" VALUE 0xFCBE1E Scalar_UWORD 0 TE_TM_TorqBasCtrl4ms_Symbol_CM_FixEnableT 171 218 /end CHARACTERISTIC
/begin CHARACTERISTIC efREF_CVCFG_RED_ON_Enable "[FIX] Fix per scegliere coppie su cui calcolre se attiva riduzione di coppia" VALUE 0xFCB9F8 Scalar_UBYTE 0 TE_TM_TorqBas4ms_CM_FixEnableT 171 218 /end CHARACTERISTIC
/begin CHARACTERISTIC efREF_CVCFG_RED_ON_Value "[FIX] Fix per scegliere coppie su cui calcolre se attiva riduzione di coppia" VALUE 0xFCB9F6 Scalar_UWORD 0 TE_TM_TorqBas4ms_CM_ufix16_En4__ 0 100 /end CHARACTERISTIC
/begin CHARACTERISTIC efRESET_KD "[FIX] Tabella zone di reset del KD" VALUE 0xFCBA5C Scalar_UWORD 0 TE_TM_SpeedCtrl_4ms_Symbol_CM_uint16_adm 0 1 /end CHARACTERISTIC
/begin CHARACTERISTIC efRESET_KD_EnFix "[FIX] Tabella zone di reset del KD" VALUE 0xFCBA5A Scalar_UWORD 0 TE_TM_SpeedCtrl_4ms_Symbol_CM_FixEnableT 171 218 /end CHARACTERISTIC
/begin CHARACTERISTIC efRE_CMU_ALL_TST_Enable "[FIX] Fix su Richiesta di Cmu lorda, prima delle limitazioni" VALUE 0xFCB9F4 Scalar_UBYTE 0 TE_TM_TorqBas4ms_CM_FixEnableT 171 218 /end CHARACTERISTIC
/begin CHARACTERISTIC efRE_CMU_ALL_TST_Value "[FIX] Fix su Richiesta di Cmu lorda, prima delle limitazioni" VALUE 0xFCB9F2 Scalar_UWORD 0 TE_TM_TorqBas4ms_CM_ufix16_En4__ 0 100 /end CHARACTERISTIC
/begin CHARACTERISTIC efRPM_SUP_OBJ "[FIX] Fix su flag che indica che i giri superano obiettivo di HI più delta" VALUE 0xFCBE1C Scalar_UWORD 0 TE_TM_TorqBasCtrl4ms_Symbol_CM_boolean_adm 0 1 /end CHARACTERISTIC
/begin CHARACTERISTIC efRPM_SUP_OBJ_EnFix "[FIX] Fix su flag che indica che i giri superano obiettivo di HI più delta" VALUE 0xFCBE1A Scalar_UWORD 0 TE_TM_TorqBasCtrl4ms_Symbol_CM_FixEnableT 171 218 /end CHARACTERISTIC
/begin CHARACTERISTIC efRPM_UPD_DOWN "[FIX] Fix su flag che indica se i giri in discesa tendono al limite inferiore o ai giri correnti" VALUE 0xFCBE18 Scalar_UWORD 0 TE_TM_TorqBasCtrl4ms_Symbol_CM_boolean_adm 0 1 /end CHARACTERISTIC
/begin CHARACTERISTIC efRPM_UPD_DOWN_EnFix "[FIX] Fix su flag che indica se i giri in discesa tendono al limite inferiore o ai giri correnti" VALUE 0xFCBE16 Scalar_UWORD 0 TE_TM_TorqBasCtrl4ms_Symbol_CM_FixEnableT 171 218 /end CHARACTERISTIC
/begin CHARACTERISTIC efSPD_CTRL2_ENG_MOD_Enable "[FIX] Fix su Controllo di Giri efficace attivo" VALUE 0xFCB9F0 Scalar_UBYTE 0 TE_TM_TorqBas4ms_CM_FixEnableT 171 218 /end CHARACTERISTIC
/begin CHARACTERISTIC efSPD_CTRL2_ENG_MOD_Value "[FIX] Fix su Controllo di Giri efficace attivo" VALUE 0xFCB9EF Scalar_BOOLEAN 0 TE_TM_TorqBas4ms_CM_boolean_adm 0 1 /end CHARACTERISTIC
/begin CHARACTERISTIC efSPEED_CTRL_MOD_Enable "[FIX] Fix su Flag che indica controllo di velocità attivo" VALUE 0xFCB9EE Scalar_UBYTE 0 TE_TM_TorqBas4ms_CM_FixEnableT 171 218 /end CHARACTERISTIC
/begin CHARACTERISTIC efSPEED_CTRL_MOD_Value "[FIX] Fix su Flag che indica controllo di velocità attivo" VALUE 0xFCB9ED Scalar_BOOLEAN 0 TE_TM_TorqBas4ms_CM_boolean_adm 0 1 /end CHARACTERISTIC
/begin CHARACTERISTIC efSTIFFNESS_OFF "[FIX] Offset Stifness richiesta al Ctrl PID (funzione della PTO State da CAN)" VALUE 0xFCBA58 Scalar_UWORD 0 TE_TM_SpeedCtrl_4ms_Symbol_CM_ufix16_En4__ 0 100 /end CHARACTERISTIC
/begin CHARACTERISTIC efSTIFFNESS_OFF_EnFix "[FIX] Offset Stifness richiesta al Ctrl PID (funzione della PTO State da CAN)" VALUE 0xFCBA56 Scalar_UWORD 0 TE_TM_SpeedCtrl_4ms_Symbol_CM_FixEnableT 171 218 /end CHARACTERISTIC
/begin CHARACTERISTIC efSW_DASHPOT "[FIX] Fix su Switch per escludere sempre (1) il DashPot o includerlo (0) o mantenerlo solo fuori dal Low Idle (OFF)" VALUE 0xFCBE14 Scalar_UWORD 0 TE_TM_TorqBasCtrl4ms_Symbol_CM_boolean_adm 0 1 /end CHARACTERISTIC
/begin CHARACTERISTIC efSW_DASHPOT_EnFix "[FIX] Fix su Switch per escludere sempre (1) il DashPot o includerlo (0) o mantenerlo solo fuori dal Low Idle (OFF)" VALUE 0xFCBE12 Scalar_UWORD 0 TE_TM_TorqBasCtrl4ms_Symbol_CM_FixEnableT 171 218 /end CHARACTERISTIC
/begin CHARACTERISTIC efSYS_GAIN_C_TOIL "[FIX]  " VALUE 0xFCBA54 Scalar_UWORD 0 TE_TM_SpeedCtrl_4ms_Symbol_CM_ufix16_En10_adm 0 10 /end CHARACTERISTIC
/begin CHARACTERISTIC efSYS_GAIN_C_TOIL_EnFix "[FIX]  " VALUE 0xFCBA52 Scalar_UWORD 0 TE_TM_SpeedCtrl_4ms_Symbol_CM_FixEnableT 171 218 /end CHARACTERISTIC
/begin CHARACTERISTIC efSYS_GAIN_GEARC "[FIX]  " VALUE 0xFCBA50 Scalar_UWORD 0 TE_TM_SpeedCtrl_4ms_Symbol_CM_ufix16_En10_adm 0 10 /end CHARACTERISTIC
/begin CHARACTERISTIC efSYS_GAIN_GEARC_EnFix "[FIX]  " VALUE 0xFCBA4E Scalar_UWORD 0 TE_TM_SpeedCtrl_4ms_Symbol_CM_FixEnableT 171 218 /end CHARACTERISTIC
/begin CHARACTERISTIC efTAIR_CTRL_OBJ_Enable "[FIX] Fix su soglia di temperatura aria oltre la quale effettuare il derate" VALUE 0xFCB9EC Scalar_UBYTE 0 TE_TM_TorqBas4ms_CM_FixEnableT 171 218 /end CHARACTERISTIC
/begin CHARACTERISTIC efTAIR_CTRL_OBJ_Value "[FIX] Fix su soglia di temperatura aria oltre la quale effettuare il derate" VALUE 0xFCB9EB Scalar_UBYTE 0 TE_TM_TorqBas4ms_CM_ufix8_Bn40_degC -40 130 /end CHARACTERISTIC
/begin CHARACTERISTIC efTARGET_AS_MEAS "[FIX] Fix per forzare Target = rpm letti" VALUE 0xFCBA4C Scalar_UWORD 0 TE_TM_SpeedCtrl_4ms_Symbol_CM_boolean_adm 0 1 /end CHARACTERISTIC
/begin CHARACTERISTIC efTARGET_AS_MEAS_EnFix "[FIX] Fix per forzare Target = rpm letti" VALUE 0xFCBA4A Scalar_UWORD 0 TE_TM_SpeedCtrl_4ms_Symbol_CM_FixEnableT 171 218 /end CHARACTERISTIC
/begin CHARACTERISTIC efTEMP_INF_LTD_Enable "[FIX] Limite inferiore derate per temperatura (acqua/aria)" VALUE 0xFCB9EA Scalar_UBYTE 0 TE_TM_TorqBas4ms_CM_FixEnableT 171 218 /end CHARACTERISTIC
/begin CHARACTERISTIC efTEMP_INF_LTD_Value "[FIX] Limite inferiore derate per temperatura (acqua/aria)" VALUE 0xFCB9E8 Scalar_UWORD 0 TE_TM_TorqBas4ms_CM_ufix16_En4__ 0 100 /end CHARACTERISTIC
/begin CHARACTERISTIC efTH2O_CTRL_OBJ_Enable "[FIX] Fix su soglia di temperatura acqua oltre la quale effettuare il derate" VALUE 0xFCB9E6 Scalar_UBYTE 0 TE_TM_TorqBas4ms_CM_FixEnableT 171 218 /end CHARACTERISTIC
/begin CHARACTERISTIC efTH2O_CTRL_OBJ_Value "[FIX] Fix su soglia di temperatura acqua oltre la quale effettuare il derate" VALUE 0xFCB9E4 Scalar_UWORD 0 TE_TM_TorqBas4ms_CM_ufix16_Bn40_degC -40 140 /end CHARACTERISTIC
/begin CHARACTERISTIC efTQCMTHRESREEXT_Enable "[FIX] Coppia Percentuale Cmu Assoluta misurata in Low Idle" VALUE 0xFCB9E2 Scalar_UBYTE 0 TE_TM_TorqBas4ms_CM_FixEnableT 171 218 /end CHARACTERISTIC
/begin CHARACTERISTIC efTQCMTHRESREEXT_Value "[FIX] Coppia Percentuale Cmu Assoluta misurata in Low Idle" VALUE 0xFCB9E0 Scalar_UWORD 0 TE_TM_TorqBas4ms_CM_ufix16_En4__ 0 100 /end CHARACTERISTIC
/begin CHARACTERISTIC efVALV_MOD_ID "[FIX] Fix on Valve mode identifier" VALUE 0xFC9CD0 Scalar_UWORD 0 TE_MAirReqATDC_Symbol_CM_uint8_adm 0 4 /end CHARACTERISTIC
/begin CHARACTERISTIC efVALV_MOD_ID_EnFix "[FIX] Fix on Valve mode identifier" VALUE 0xFC9CCE Scalar_UWORD 0 TE_MAirReqATDC_Symbol_CM_FixEnableT 171 218 /end CHARACTERISTIC
/begin CHARACTERISTIC efVEH_LTD_NOT_ACT "[FIX] Fix su limitazione velocità veicolo non attiva" VALUE 0xFCBE10 Scalar_UWORD 0 TE_TM_TorqBasCtrl4ms_Symbol_CM_boolean_adm 0 1 /end CHARACTERISTIC
/begin CHARACTERISTIC efVEH_LTD_NOT_ACT_EnFix "[FIX] Fix su limitazione velocità veicolo non attiva" VALUE 0xFCBE0E Scalar_UWORD 0 TE_TM_TorqBasCtrl4ms_Symbol_CM_FixEnableT 171 218 /end CHARACTERISTIC
/begin CHARACTERISTIC efVVA_FINJ1_SHIF "[FIX] Fi1 to FInj Shift. Delta on Injection timing (due to Fi1) to deliver the fuel into the cylinder when the valve is opened." VALUE 0xFC9CCC Scalar_UWORD 0 TE_MAirReqATDC_Symbol_CM_ufix16_En4_degree 0 720 /end CHARACTERISTIC
/begin CHARACTERISTIC efVVA_FINJ1_SHIF_EnFix "[FIX] Fi1 to FInj Shift. Delta on Injection timing (due to Fi1) to deliver the fuel into the cylinder when the valve is opened." VALUE 0xFC9CCA Scalar_UWORD 0 TE_MAirReqATDC_Symbol_CM_FixEnableT 171 218 /end CHARACTERISTIC
/begin CHARACTERISTIC efVVA_FINJ2_SHIF "[FIX] Fi2 to FInj Shift. Delta on Injection timing (due to Fi2) to deliver the fuel into the cylinder when the valve is opened." VALUE 0xFC9CC8 Scalar_UWORD 0 TE_MAirReqATDC_Symbol_CM_ufix16_En4_degree 0 720 /end CHARACTERISTIC
/begin CHARACTERISTIC efVVA_FINJ2_SHIF_EnFix "[FIX] Fi2 to FInj Shift. Delta on Injection timing (due to Fi2) to deliver the fuel into the cylinder when the valve is opened." VALUE 0xFC9CC6 Scalar_UWORD 0 TE_MAirReqATDC_Symbol_CM_FixEnableT 171 218 /end CHARACTERISTIC
/begin CHARACTERISTIC efVVA_IGNT1_SHIF "[FIX] Fi1 to Delta Advance Ignition Shift. Delta on Ingnition Spark Advance (due to Fi1) to burn correctly the fuel into the combustion chamber in the cylinder." VALUE 0xFC9CF4 Scalar_SWORD 0 TE_MAirReqATDC_Symbol_CM_sfix16_En4_degree -20 20 /end CHARACTERISTIC
/begin CHARACTERISTIC efVVA_IGNT1_SHIF_EnFix "[FIX] Fi1 to Delta Advance Ignition Shift. Delta on Ingnition Spark Advance (due to Fi1) to burn correctly the fuel into the combustion chamber in the cylinder." VALUE 0xFC9CF2 Scalar_SWORD 0 TE_MAirReqATDC_Symbol_CM_FixEnableT 171 218 /end CHARACTERISTIC
/begin CHARACTERISTIC efVVA_IGNT2_SHIF "[FIX] Fi2 to Delta Advance Ignition Shift. Delta on Ingnition Spark Advance (due to Fi2) to burn correctly the fuel into the combustion chamber in the cylinder." VALUE 0xFC9CF0 Scalar_SWORD 0 TE_MAirReqATDC_Symbol_CM_sfix16_En4_degree -20 20 /end CHARACTERISTIC
/begin CHARACTERISTIC efVVA_IGNT2_SHIF_EnFix "[FIX] Fi2 to Delta Advance Ignition Shift. Delta on Ingnition Spark Advance (due to Fi2) to burn correctly the fuel into the combustion chamber in the cylinder." VALUE 0xFC9CEE Scalar_SWORD 0 TE_MAirReqATDC_Symbol_CM_FixEnableT 171 218 /end CHARACTERISTIC
/begin AXIS_PTS ekAIR_COFF_ENGBRK "[XBK] Limite inferiore - in Cut Off - per aria calcolata dal ramo lento" 0xFCB72C NO_INPUT_QUANTITY Lookup1D_X_UWORD 0 Trqm_CtrlMgmt4ms_CM_uint16_rpm 8 0 10000 /end AXIS_PTS
/begin AXIS_PTS ekAIR_COFF_SMOOT "[XBK] Limite inferiore - in Cut Off - per aria calcolata dal ramo lento" 0xFCC56C NO_INPUT_QUANTITY Lookup1D_X_UWORD 0 TE_TM_TorqBasCtrl4ms_Symbol_CM_uint16_rpm 8 0 10000 /end AXIS_PTS
/begin AXIS_PTS ekANG_VVA_ECOBJE "[XBK] Fi2 calibration. Fi2 required closing angle for Early Closing Actuation." 0xFCA136 NO_INPUT_QUANTITY Lookup2D_X_UWORD 0 TE_MAirReqATDC_Symbol_CM_ufix16_En4_kg_h 8 0 3200 /end AXIS_PTS
/begin AXIS_PTS ekANG_VVA_ECOBJN "[YBK] Fi2 calibration. Fi2 required closing angle for Early Closing Actuation." 0xFCA126 NO_INPUT_QUANTITY Lookup2D_X_UWORD 0 TE_MAirReqATDC_Symbol_CM_uint16_rpm 8 0 10000 /end AXIS_PTS
/begin AXIS_PTS ekANG_VVA_LOOBJE "[XBK] Fi1 calibration. Fi1 required angle for Late Opening Actuation." 0xFCA116 NO_INPUT_QUANTITY Lookup2D_X_UWORD 0 TE_MAirReqATDC_Symbol_CM_ufix16_En4_kg_h 8 0 3200 /end AXIS_PTS
/begin AXIS_PTS ekANG_VVA_LOOBJN "[YBK] Fi1 calibration. Fi1 required angle for Late Opening Actuation." 0xFCA106 NO_INPUT_QUANTITY Lookup2D_X_UWORD 0 TE_MAirReqATDC_Symbol_CM_uint16_rpm 8 0 10000 /end AXIS_PTS
/begin AXIS_PTS ekCMU2QAIR_OBJCM "[XBK] Tabella di conversione della Coppia Utile obiettivo in Aria sul ramo lento" 0xFCC554 NO_INPUT_QUANTITY Lookup2D_X_UWORD 0 TE_TM_TorqBasCtrl4ms_Symbol_CM_ufix16_En4_N_m 12 0 4095 /end AXIS_PTS
/begin AXIS_PTS ekCMU2QAIR_OBJRP "[YBK] Tabella di conversione della Coppia Utile obiettivo in Aria sul ramo lento" 0xFCC53C NO_INPUT_QUANTITY Lookup2D_X_UWORD 0 TE_TM_TorqBasCtrl4ms_Symbol_CM_uint16_rpm 12 0 10000 /end AXIS_PTS
/begin AXIS_PTS ekDELAY_LTD_GAIN_PATM "[XBK] Guadagno del ritardo limitazione Full-Load per PAtm" 0xFCC52C NO_INPUT_QUANTITY Lookup1D_X_UWORD 0 TE_TM_TorqBasCtrl4ms_Symbol_CM_uint16_mbar 8 150 1150 /end AXIS_PTS
/begin AXIS_PTS ekDELAY_LTD_TH2O "[XBK] Ritardo limitazione Full-Load per Th2o" 0xFCC51C NO_INPUT_QUANTITY Lookup1D_X_UWORD 0 TE_TM_TorqBasCtrl4ms_Symbol_CM_ufix16_Bn40_degC 8 -40 140 /end AXIS_PTS
/begin AXIS_PTS ekDERATE_RPM_X "[YBK] Richiesta di riduzione percentuale di performance (derating per temperatura acqua)" 0xFCB9D0 NO_INPUT_QUANTITY Lookup2D_X_UWORD 0 TE_TM_TorqBas4ms_CM_uint16_rpm 8 0 10000 /end AXIS_PTS
/begin AXIS_PTS ekDERATE_TH2O_Y "[XBK] Richiesta di riduzione percentuale di performance (derating per temperatura acqua)" 0xFCB9C4 NO_INPUT_QUANTITY Lookup2D_X_UWORD 0 TE_TM_TorqBas4ms_CM_ufix16_Bn40_degC 6 -40 140 /end AXIS_PTS
/begin AXIS_PTS ekDERRPM_ADV_HI "[XBK] Ulteriore delta giri di anticipo per ingresso in High Idle funzione della derivata di giri" 0xFCC512 NO_INPUT_QUANTITY Lookup1D_X_UWORD 0 TE_TM_TorqBasCtrl4ms_Symbol_CM_ufix16_Bn32000_rpm_s 5 -32000 32000 /end AXIS_PTS
/begin AXIS_PTS ekDERRPM_KF_HI_UP "[XBK] Ulteriore delta giri di anticipo per ingresso in High Idle funzione della derivata di giri" 0xFCC508 NO_INPUT_QUANTITY Lookup1D_X_UWORD 0 TE_TM_TorqBasCtrl4ms_Symbol_CM_ufix16_Bn1000_rpm_s 5 -1000 1000 /end AXIS_PTS
/begin AXIS_PTS ekEGT_RPM "[XBK] Maximum exhaust target temperature " 0xFCB9B4 NO_INPUT_QUANTITY Lookup1D_X_UWORD 0 TE_TM_TorqBas4ms_CM_uint16_rpm 8 0 10000 /end AXIS_PTS
/begin AXIS_PTS ekENG2CMF_N_IST "[XBK] Coppia Resistente dovuta al movimento organico" 0xFCC4F0 NO_INPUT_QUANTITY Lookup1D_X_UWORD 0 TE_TM_TorqBasCtrl4ms_Symbol_CM_uint16_rpm 12 0 10000 /end AXIS_PTS
/begin AXIS_PTS ekENG2CMF_P_IPOI "[XBK] Coppia Resistente dovuta alla pressione del lubrificante" 0xFCC4E0 NO_INPUT_QUANTITY Lookup1D_X_UWORD 0 TE_TM_TorqBasCtrl4ms_Symbol_CM_uint16_mbar 8 250 6000 /end AXIS_PTS
/begin AXIS_PTS ekENG2CMF_T_ITOI "[XBK] Coppia Resistente dovuta alla viscosita del lubrificante" 0xFCC4D0 NO_INPUT_QUANTITY Lookup1D_X_UWORD 0 TE_TM_TorqBasCtrl4ms_Symbol_CM_ufix16_Bn40_degC 8 -40 140 /end AXIS_PTS
/begin AXIS_PTS ekETA2DADV_ETA "[XBK] Curva (inversa della Curva Unica) che fornisce il delta anticipo sul ramo veloce della Coppia" 0xFCC4C0 NO_INPUT_QUANTITY Lookup1D_X_UWORD 0 TE_TM_TorqBasCtrl4ms_Symbol_CM_ufix16_En8_adm 8 0.00390625 1 /end AXIS_PTS
/begin AXIS_PTS ekETA_D_ADV_IDA "[XBK] Curva Unica della efficienza del Ciclo Otto (Coppia Utile) in funzione del delta anticipo" 0xFCC602 NO_INPUT_QUANTITY Lookup1D_X_UWORD 0 TE_TM_TorqCalcTDC_Symbol_CM_ufix16_En4_degree 8 0 50 /end AXIS_PTS
/begin AXIS_PTS ekETA_LAM_IST_L "[XBK] Efficienza della Coppia Utile in funzione di lambda" 0xFCC5E0 NO_INPUT_QUANTITY Lookup1D_X_UWORD 0 TE_TM_TorqCalcTDC_Symbol_CM_ufix16_En8_adm 17 0 4 /end AXIS_PTS
/begin AXIS_PTS ekFI2_TO_VCYL "[XBK] Single Cylinder Volume varying with Fi2 actuation" 0xFCA0E6 NO_INPUT_QUANTITY Lookup1D_X_UWORD 0 TE_MAirReqATDC_Symbol_CM_ufix16_En4_degE 16 0 4095 /end AXIS_PTS
/begin AXIS_PTS ekGAIN_KI_HI "[XBK] Guadagno su KI per Inerzia virtuale del veicolo" 0xFCC4AC NO_INPUT_QUANTITY Lookup1D_X_UWORD 0 TE_TM_TorqBasCtrl4ms_Symbol_CM_ufix16_En10_m_n 10 0 8 /end AXIS_PTS
/begin AXIS_PTS ekGAIN_KP_HI "[XBK] Guadagno su KP per Inerzia virtuale del veicolo" 0xFCC498 NO_INPUT_QUANTITY Lookup1D_X_UWORD 0 TE_TM_TorqBasCtrl4ms_Symbol_CM_ufix16_En10_m_n 10 0 8 /end AXIS_PTS
/begin AXIS_PTS ekGOV_HI_KI "[XBK] High governor KI parameter set" 0xFCC490 NO_INPUT_QUANTITY Lookup1D_X_UWORD 0 TE_TM_TorqBasCtrl4ms_Symbol_CM_uint16_adm 4 0 3 /end AXIS_PTS
/begin AXIS_PTS ekGOV_HI_KP "[XBK] High governor KP parameter set" 0xFCC488 NO_INPUT_QUANTITY Lookup1D_X_UWORD 0 TE_TM_TorqBasCtrl4ms_Symbol_CM_uint16_adm 4 0 3 /end AXIS_PTS
/begin AXIS_PTS ekHYS_N_CTRLADVD "[XBK] Anticipo di giri con cui si fa lo SWITCH da Torque a Speed Control" 0xFCB9A0 NO_INPUT_QUANTITY Lookup1D_X_UWORD 0 TE_TM_TorqBas4ms_CM_ufix16_Bn32000_rpm_s 10 -32000 32000 /end AXIS_PTS
/begin AXIS_PTS ekHYS_N_CTRL_TOR "[XBK] Isteresi a salire (su rpm misurati) per spegnere il calcolo in background del contributo di coppia per giri obiettivo" 0xFCB990 esDelta_TorqC_TS Lookup1D_X_UWORD 0 TE_TM_TorqBas4ms_CM_ufix16_En4__ 8 0 100 /end AXIS_PTS
/begin AXIS_PTS ekHYS_T_CTRL_T_N "[XBK] Isteresi a salire (su % coppia richiesta rispetto a coppia calcolata per i giri) per passare a controllo di coppia" 0xFCB980 NO_INPUT_QUANTITY Lookup1D_X_UWORD 0 TE_TM_TorqBas4ms_CM_uint16_rpm 8 0 10000 /end AXIS_PTS
/begin AXIS_PTS ekKDSPEED_CTRL_E "[YBK] Coefficiente del controllo derivativo RPM sui giri obiettivo PTO" 0xFCBD94 NO_INPUT_QUANTITY Lookup2D_X_UWORD 0 TE_TM_SpeedCtrl_4ms_Symbol_CM_ufix16_Bn1800_rpm 7 -1800 1800 /end AXIS_PTS
/begin AXIS_PTS ekKDSPEED_CTRL_N "[XBK] Coefficiente del controllo derivativo RPM sui giri obiettivo PTO" 0xFCBD88 NO_INPUT_QUANTITY Lookup2D_X_UWORD 0 TE_TM_SpeedCtrl_4ms_Symbol_CM_uint16_rpm 6 0 10000 /end AXIS_PTS
/begin AXIS_PTS ekKD_CC "[XBK] KD in CC f(rpm_error)" 0xFCBD7A NO_INPUT_QUANTITY Lookup1D_X_UWORD 0 TE_TM_SpeedCtrl_4ms_Symbol_CM_ufix16_Bn1800_rpm 7 -1800 1800 /end AXIS_PTS
/begin AXIS_PTS ekKD_CTRL_NERR "[YBK] Contributo derivativo del Ctrl PID di High Idle" 0xFCC47A NO_INPUT_QUANTITY Lookup2D_X_UWORD 0 TE_TM_TorqBasCtrl4ms_Symbol_CM_ufix16_Bn1800_rpm 7 -1800 1800 /end AXIS_PTS
/begin AXIS_PTS ekKD_CTRL_NLDT "[XBK] Contributo derivativo del Ctrl PID di High Idle" 0xFCC46E NO_INPUT_QUANTITY Lookup2D_X_UWORD 0 TE_TM_TorqBasCtrl4ms_Symbol_CM_uint16_rpm 6 0 10000 /end AXIS_PTS
/begin AXIS_PTS ekKD_GAININERTIA "[XBK] Variazione del KD in funzione delle richieste di stiffness del Crtl PID" 0xFCBD6A NO_INPUT_QUANTITY Lookup1D_X_UWORD 0 TE_TM_SpeedCtrl_4ms_Symbol_CM_uint16_adm 8 1 8 /end AXIS_PTS
/begin AXIS_PTS ekKI1ANTIWUPH_DN "[YBK] AntiWindUp superiore del KI" 0xFCBD60 NO_INPUT_QUANTITY Lookup2D_X_UWORD 0 TE_TM_SpeedCtrl_4ms_Symbol_CM_ufix16_Bn32000_rpm_s 5 -32000 32000 /end AXIS_PTS
/begin AXIS_PTS ekKI1ANTIWUPH_EN "[XBK] AntiWindUp superiore del KI" 0xFCBD56 NO_INPUT_QUANTITY Lookup2D_X_UWORD 0 TE_TM_SpeedCtrl_4ms_Symbol_CM_ufix16_Bn1800_rpm 5 -1800 1800 /end AXIS_PTS
/begin AXIS_PTS ekKI1ANTIWUPL_DN "[YBK] AntiWindUp inferiore del KI" 0xFCBD4C NO_INPUT_QUANTITY Lookup2D_X_UWORD 0 TE_TM_SpeedCtrl_4ms_Symbol_CM_ufix16_Bn32000_rpm_s 5 -32000 32000 /end AXIS_PTS
/begin AXIS_PTS ekKI1ANTIWUPL_EN "[XBK] AntiWindUp inferiore del KI" 0xFCBD42 NO_INPUT_QUANTITY Lookup2D_X_UWORD 0 TE_TM_SpeedCtrl_4ms_Symbol_CM_ufix16_Bn1800_rpm 5 -1800 1800 /end AXIS_PTS
/begin AXIS_PTS ekKISPEED_CTRL_E "[YBK] Coefficiente del controllo integrale su errore di giri obiettivo PTO" 0xFCBD34 NO_INPUT_QUANTITY Lookup2D_X_UWORD 0 TE_TM_SpeedCtrl_4ms_Symbol_CM_ufix16_Bn1800_rpm 7 -1800 1800 /end AXIS_PTS
/begin AXIS_PTS ekKISPEED_CTRL_N "[XBK] Coefficiente del controllo integrale su errore di giri obiettivo PTO" 0xFCBD28 NO_INPUT_QUANTITY Lookup2D_X_UWORD 0 TE_TM_SpeedCtrl_4ms_Symbol_CM_uint16_rpm 6 0 10000 /end AXIS_PTS
/begin AXIS_PTS ekKI_CC "[XBK] KI in CC f(rpm_error)" 0xFCBD1A NO_INPUT_QUANTITY Lookup1D_X_UWORD 0 TE_TM_SpeedCtrl_4ms_Symbol_CM_ufix16_Bn1800_rpm 7 -1800 1800 /end AXIS_PTS
/begin AXIS_PTS ekKI_CTRL_HI_NERR "[YBK] Contributo integrale del Ctrl PID di High Idle" 0xFCC460 NO_INPUT_QUANTITY Lookup2D_X_UWORD 0 TE_TM_TorqBasCtrl4ms_Symbol_CM_ufix16_Bn1800_rpm 7 -1800 1800 /end AXIS_PTS
/begin AXIS_PTS ekKI_CTRL_HI_NLTD "[XBK] Contributo integrale del Ctrl PID di High Idle" 0xFCC454 NO_INPUT_QUANTITY Lookup2D_X_UWORD 0 TE_TM_TorqBasCtrl4ms_Symbol_CM_uint16_rpm 6 0 10000 /end AXIS_PTS
/begin AXIS_PTS ekKI_GAININERTIA "[XBK] Variazione del KI in funzione delle richieste di stiffness del Crtl PID" 0xFCBD0A NO_INPUT_QUANTITY Lookup1D_X_UWORD 0 TE_TM_SpeedCtrl_4ms_Symbol_CM_uint16_adm 8 1 8 /end AXIS_PTS
/begin AXIS_PTS ekKI_GAIN_C_TOIL "[XBK]  " 0xFCBCFE NO_INPUT_QUANTITY Lookup1D_X_UWORD 0 TE_TM_SpeedCtrl_4ms_Symbol_CM_ufix16_Bn40_degC 6 -40 130 /end AXIS_PTS
/begin AXIS_PTS ekKNOCK_CTRL_ETASP "[YBK] Tabella su Aria Aspirata per degrado Anticipo accensione in Knock Ctrl" 0xFCC448 NO_INPUT_QUANTITY Lookup2D_X_UWORD 0 TE_TM_TorqBasCtrl4ms_Symbol_CM_ufix16_En10_adm 6 0 3 /end AXIS_PTS
/begin AXIS_PTS ekKNOCK_CTRL_SP "[YBK] Tabella su Punto Motore per degrado Anticipo accensione in Knock Ctrl" 0xFCC43C NO_INPUT_QUANTITY Lookup2D_X_UWORD 0 TE_TM_TorqBasCtrl4ms_Symbol_CM_ufix16_En10_adm 6 0 3 /end AXIS_PTS
/begin AXIS_PTS ekKNOCK_CTRL_TAIR "[XBK] Tabella su Aria Aspirata per degrado Anticipo accensione in Knock Ctrl" 0xFCC42C NO_INPUT_QUANTITY Lookup2D_X_UWORD 0 TE_TM_TorqBasCtrl4ms_Symbol_CM_ufix16_Bn40_degC 8 -40 140 /end AXIS_PTS
/begin AXIS_PTS ekKNOCK_CTRL_TH20 "[XBK] Tabella su Punto Motore per degrado Anticipo accensione in Knock Ctrl" 0xFCC41C NO_INPUT_QUANTITY Lookup2D_X_UWORD 0 TE_TM_TorqBasCtrl4ms_Symbol_CM_ufix16_Bn40_degC 8 -40 140 /end AXIS_PTS
/begin AXIS_PTS ekKPSPEED_CTRL_E "[YBK] Coefficiente del controllo proporzionale su errore di giri obiettivo PTO" 0xFCBCF0 NO_INPUT_QUANTITY Lookup2D_X_UWORD 0 TE_TM_SpeedCtrl_4ms_Symbol_CM_ufix16_Bn1800_rpm 7 -1800 1800 /end AXIS_PTS
/begin AXIS_PTS ekKPSPEED_CTRL_N "[XBK] Coefficiente del controllo proporzionale su errore di giri obiettivo PTO" 0xFCBCE4 NO_INPUT_QUANTITY Lookup2D_X_UWORD 0 TE_TM_SpeedCtrl_4ms_Symbol_CM_uint16_rpm 6 0 10000 /end AXIS_PTS
/begin AXIS_PTS ekKPTAIR_CTRL_E "[YBK] Coefficiente del controllo proporzionale su errore di giri obiettivo PTO" 0xFCB972 NO_INPUT_QUANTITY Lookup2D_X_UWORD 0 TE_TM_TorqBas4ms_CM_uint16_degC 7 0 100 /end AXIS_PTS
/begin AXIS_PTS ekKPTAIR_CTRL_T "[XBK] Coefficiente del controllo proporzionale su errore di giri obiettivo PTO" 0xFCB966 NO_INPUT_QUANTITY Lookup2D_X_UWORD 0 TE_TM_TorqBas4ms_CM_uint16_rpm 6 0 10000 /end AXIS_PTS
/begin AXIS_PTS ekKPTEXH_CTRL_E "[YBK] Proportional coefficient Kp for exhaust temperature overheating  " 0xFCB958 NO_INPUT_QUANTITY Lookup2D_X_UWORD 0 TE_TM_TorqBas4ms_CM_uint16_degC 7 0 100 /end AXIS_PTS
/begin AXIS_PTS ekKPTEXH_CTRL_T "[XBK] Proportional coefficient Kp for exhaust temperature overheating  " 0xFCB94C NO_INPUT_QUANTITY Lookup2D_X_UWORD 0 TE_TM_TorqBas4ms_CM_uint16_rpm 6 0 10000 /end AXIS_PTS
/begin AXIS_PTS ekKPTH2O_CTRL_E "[YBK] Coefficiente del controllo proporzionale su errore di giri obiettivo PTO" 0xFCB93E NO_INPUT_QUANTITY Lookup2D_X_UWORD 0 TE_TM_TorqBas4ms_CM_uint16_degC 7 0 100 /end AXIS_PTS
/begin AXIS_PTS ekKPTH2O_CTRL_T "[XBK] Coefficiente del controllo proporzionale su errore di giri obiettivo PTO" 0xFCB932 NO_INPUT_QUANTITY Lookup2D_X_UWORD 0 TE_TM_TorqBas4ms_CM_uint16_rpm 6 0 10000 /end AXIS_PTS
/begin AXIS_PTS ekKP_CC "[XBK] KP in CC f(rpm_error)" 0xFCBCD6 NO_INPUT_QUANTITY Lookup1D_X_UWORD 0 TE_TM_SpeedCtrl_4ms_Symbol_CM_ufix16_Bn1800_rpm 7 -1800 1800 /end AXIS_PTS
/begin AXIS_PTS ekKP_CTRL_HI_NERR "[YBK] Contributo proporzionale del Ctrl PID di High Idle" 0xFCC40E NO_INPUT_QUANTITY Lookup2D_X_UWORD 0 TE_TM_TorqBasCtrl4ms_Symbol_CM_ufix16_Bn1800_rpm 7 -1800 1800 /end AXIS_PTS
/begin AXIS_PTS ekKP_CTRL_HI_NLTD "[XBK] Contributo proporzionale del Ctrl PID di High Idle" 0xFCC402 NO_INPUT_QUANTITY Lookup2D_X_UWORD 0 TE_TM_TorqBasCtrl4ms_Symbol_CM_uint16_rpm 6 0 10000 /end AXIS_PTS
/begin AXIS_PTS ekKP_GAININERTIA "[XBK] Variazione del KP in funzione delle richieste di stiffness del Crtl PID" 0xFCBCC6 NO_INPUT_QUANTITY Lookup1D_X_UWORD 0 TE_TM_SpeedCtrl_4ms_Symbol_CM_uint16_adm 8 1 8 /end AXIS_PTS
/begin AXIS_PTS ekPTO_PW_OFF "[XBK] Offset per potenza assorbita dalla PTO (funzione della richiesta esterna di stiffness del Crtl PID)" 0xFCBCB6 NO_INPUT_QUANTITY Lookup1D_X_UWORD 0 TE_TM_SpeedCtrl_4ms_Symbol_CM_uint16_adm 8 0 31 /end AXIS_PTS
/begin AXIS_PTS ekQAIR2CMU_CONV "[XBK] Conversione da massa di aria (mgcc) a Coppia Utile (Nm) potenziale" 0xFCC3F2 NO_INPUT_QUANTITY Lookup1D_X_UWORD 0 TE_TM_TorqBasCtrl4ms_Symbol_CM_ufix16_En10_adm 8 0.015625 1.599609375 /end AXIS_PTS
/begin AXIS_PTS ekQAIR_CRANK_N "[XBK] Mappa di aria minima per il cranking" 0xFCC3E2 NO_INPUT_QUANTITY Lookup2D_X_UWORD 0 TE_TM_TorqBasCtrl4ms_Symbol_CM_uint16_rpm 8 0 10000 /end AXIS_PTS
/begin AXIS_PTS ekQAIR_CRANK_T "[YBK] Mappa di aria minima per il cranking" 0xFCC3DA NO_INPUT_QUANTITY Lookup2D_X_UWORD 0 TE_TM_TorqBasCtrl4ms_Symbol_CM_ufix16_Bn40_degC 4 -40 130 /end AXIS_PTS
/begin AXIS_PTS ekQAIR_DASHPOT_N "[XBK] Qair intorno alla zona di Low Idle" 0xFCC3CA NO_INPUT_QUANTITY Lookup2D_X_UWORD 0 TE_TM_TorqBasCtrl4ms_Symbol_CM_uint16_rpm 8 0 10000 /end AXIS_PTS
/begin AXIS_PTS ekQAIR_DASHPOT_T "[YBK] Qair intorno alla zona di Low Idle" 0xFCC3C2 NO_INPUT_QUANTITY Lookup2D_X_UWORD 0 TE_TM_TorqBasCtrl4ms_Symbol_CM_ufix16_Bn40_degC 4 -40 130 /end AXIS_PTS
/begin AXIS_PTS ekQAIR_MAX_REF "[XBK] Equivalente di eference Air Flow (mg/cc) for Torque % determination" 0xFCC3B2 NO_INPUT_QUANTITY Lookup1D_X_UWORD 0 TE_TM_TorqBasCtrl4ms_Symbol_CM_ufix16_En10_adm 8 0.015625 1.599609375 /end AXIS_PTS
/begin AXIS_PTS ekQMIN_HIGHIDLEN "[XBK] Aria di trafilamento in High Idle" 0xFCC3A2 NO_INPUT_QUANTITY Lookup1D_X_UWORD 0 TE_TM_TorqBasCtrl4ms_Symbol_CM_uint16_rpm 8 0 10000 /end AXIS_PTS
/begin AXIS_PTS ekREF_CURVE_CONF "[XBK] Curva di riferimento del motore (percentuale di Cmu) dichiarata per la configurazione (CAN msg Tx ENG_CONF)" 0xFCC380 NO_INPUT_QUANTITY Lookup1D_X_UWORD 0 TE_TM_TorqBasCtrl4ms_Symbol_CM_uint16_rpm 17 0 10000 /end AXIS_PTS
/begin AXIS_PTS ekREF_CURVE_CONF1 "[XBK] Curva di riferimento del motore (percentuale di Cmu) dichiarata per la configurazione (CAN msg Tx ENG_CONF)" 0xFCB6D8 NO_INPUT_QUANTITY Lookup1D_X_UWORD 0 TE_TM_TorqCnfg1s_CM_uint16_rpm 17 0 10000 /end AXIS_PTS
/begin AXIS_PTS ekREF_CURVE_LTD_TMP "[XBK] Curva di riferimento del motore (percentuale di Cmu) di derate temporizzato (protezione termica della turbo)" 0xFCC35E NO_INPUT_QUANTITY Lookup1D_X_UWORD 0 TE_TM_TorqBasCtrl4ms_Symbol_CM_uint16_rpm 17 0 10000 /end AXIS_PTS
/begin AXIS_PTS ekRESET_KD_DERR "[YBK] Tabella zone di reset del KD" 0xFCBCB0 NO_INPUT_QUANTITY Lookup2D_X_UWORD 0 TE_TM_SpeedCtrl_4ms_Symbol_CM_ufix16_Bn1_adm 3 -1 1 /end AXIS_PTS
/begin AXIS_PTS ekRESET_KD_ERR "[XBK] Tabella zone di reset del KD" 0xFCBCAA NO_INPUT_QUANTITY Lookup2D_X_UWORD 0 TE_TM_SpeedCtrl_4ms_Symbol_CM_ufix16_Bn1_adm 3 -1 1 /end AXIS_PTS
/begin AXIS_PTS ekSTIFFNESS_OFF "[XBK] Offset Stifness richiesta al Ctrl PID (funzione della PTO State da CAN)" 0xFCBC9A NO_INPUT_QUANTITY Lookup1D_X_UWORD 0 TE_TM_SpeedCtrl_4ms_Symbol_CM_uint16_adm 8 1 8 /end AXIS_PTS
/begin AXIS_PTS ekSYS_GAIN_GEARC "[XBK]  " 0xFCBC88 NO_INPUT_QUANTITY Lookup1D_X_UWORD 0 TE_TM_SpeedCtrl_4ms_Symbol_CM_ufix16_Bn125_adm 9 -125 125 /end AXIS_PTS
/begin AXIS_PTS ekTEMP_INF_LTD "[XBK] Limite inferiore derate per temperatura (acqua/aria)" 0xFCB922 NO_INPUT_QUANTITY Lookup1D_X_UWORD 0 TE_TM_TorqBas4ms_CM_uint16_rpm 8 0 10000 /end AXIS_PTS
/begin AXIS_PTS ekVVA_FINJ1_SFI1 "[XBK] Fi1 to FInj Shift. Delta on Injection timing (due to Fi1) to deliver the fuel into the cylinder when the valve is opened." 0xFCA0D6 NO_INPUT_QUANTITY Lookup2D_X_UWORD 0 TE_MAirReqATDC_Symbol_CM_ufix16_En4_degE 8 0 4095 /end AXIS_PTS
/begin AXIS_PTS ekVVA_FINJ1_S_N "[YBK] Fi1 to FInj Shift. Delta on Injection timing (due to Fi1) to deliver the fuel into the cylinder when the valve is opened." 0xFCA0C6 NO_INPUT_QUANTITY Lookup2D_X_UWORD 0 TE_MAirReqATDC_Symbol_CM_uint16_rpm 8 0 10000 /end AXIS_PTS
/begin AXIS_PTS ekVVA_FINJ2_SFI2 "[XBK] Fi2 to FInj Shift. Delta on Injection timing (due to Fi2) to deliver the fuel into the cylinder when the valve is opened." 0xFCA0B6 NO_INPUT_QUANTITY Lookup2D_X_UWORD 0 TE_MAirReqATDC_Symbol_CM_ufix16_En4_degE 8 0 4095 /end AXIS_PTS
/begin AXIS_PTS ekVVA_FINJ2_S_N "[YBK] Fi2 to FInj Shift. Delta on Injection timing (due to Fi2) to deliver the fuel into the cylinder when the valve is opened." 0xFCA0A6 NO_INPUT_QUANTITY Lookup2D_X_UWORD 0 TE_MAirReqATDC_Symbol_CM_uint16_rpm 8 0 10000 /end AXIS_PTS
/begin AXIS_PTS ekVVA_IGNT1_SFI1 "[XBK] Fi1 to Delta Advance Ignition Shift. Delta on Ingnition Spark Advance (due to Fi1) to burn correctly the fuel into the combustion chamber in the cylinder." 0xFCA096 NO_INPUT_QUANTITY Lookup2D_X_UWORD 0 TE_MAirReqATDC_Symbol_CM_ufix16_En4_degE 8 0 4095 /end AXIS_PTS
/begin AXIS_PTS ekVVA_IGNT1_S_N "[YBK] Fi1 to Delta Advance Ignition Shift. Delta on Ingnition Spark Advance (due to Fi1) to burn correctly the fuel into the combustion chamber in the cylinder." 0xFCA086 NO_INPUT_QUANTITY Lookup2D_X_UWORD 0 TE_MAirReqATDC_Symbol_CM_uint16_rpm 8 0 10000 /end AXIS_PTS
/begin AXIS_PTS ekVVA_IGNT2_SFI2 "[XBK] Fi2 to Delta Advance Ignition Shift. Delta on Ingnition Spark Advance (due to Fi2) to burn correctly the fuel into the combustion chamber in the cylinder." 0xFCA076 NO_INPUT_QUANTITY Lookup2D_X_UWORD 0 TE_MAirReqATDC_Symbol_CM_ufix16_En4_degE 8 0 4095 /end AXIS_PTS
/begin AXIS_PTS ekVVA_IGNT2_S_N "[YBK] Fi2 to Delta Advance Ignition Shift. Delta on Ingnition Spark Advance (due to Fi2) to burn correctly the fuel into the combustion chamber in the cylinder." 0xFCA066 NO_INPUT_QUANTITY Lookup2D_X_UWORD 0 TE_MAirReqATDC_Symbol_CM_uint16_rpm 8 0 10000 /end AXIS_PTS
/begin CHARACTERISTIC esAIRM_REQ_LIMIT "Air Mass Request Limitation in full load" VALUE 0xFC9CC4 Scalar_UWORD 0 TE_MAirReqATDC_Symbol_CM_ufix16_En4_mgcc 0 1600 /end CHARACTERISTIC
/begin CHARACTERISTIC esAIR_PRE_WARNING "Soglia di Pre-Warning sulla Tair" VALUE 0xFCB920 Scalar_UBYTE 0 TE_TM_TorqBas4ms_CM_ufix8_Bn40_degC -40 130 /end CHARACTERISTIC
/begin CHARACTERISTIC esAIR_WARNING "Soglia di Warning sulla Tair" VALUE 0xFCB91F Scalar_UBYTE 0 TE_TM_TorqBas4ms_CM_ufix8_Bn40_degC -40 130 /end CHARACTERISTIC
/begin CHARACTERISTIC esANG_CHIUS_VALV "Angolo chiusura valvole" VALUE 0xFC9CC2 Scalar_UWORD 0 TE_MAirReqATDC_Symbol_CM_uint16_degM 180 540 /end CHARACTERISTIC
/begin CHARACTERISTIC esAPPLICABLE_TMAX "Percentage of applicable T720 as maximum injection time" VALUE 0xFCB91E Scalar_UBYTE 0 TE_TM_TorqBas4ms_CM_ufix8_Sp01_adm 0 1 /end CHARACTERISTIC
/begin MEASUREMENT esAirMReqLimit "ir Mass Request Limitation in full load" UWORD MairTDC_CM_ufix16_En4_mgcc 0 0 0 1600 ECU_ADDRESS 0x40003754 /end MEASUREMENT
/begin MEASUREMENT esAirOverTemp "Registro di stato Tair Overtemperature" UBYTE TE_TM_TorqBas4ms_CM_uint8_adm 0 0 0 2 ECU_ADDRESS 0x400043CA /end MEASUREMENT
/begin MEASUREMENT esAngVVAECObj "i2 required closing angle for Early Closing Actuation" UWORD MairTDC_CM_ufix16_En4_degE 0 0 0 4095 ECU_ADDRESS 0x40003758 /end MEASUREMENT
/begin MEASUREMENT esAngVVALOObj "i1 required opening angle for Late Opening Actuation" UWORD MairTDC_CM_ufix16_En4_degE 0 0 0 4095 ECU_ADDRESS 0x40003756 /end MEASUREMENT
/begin MEASUREMENT esAngVvaEcObj "[OUT] Fi2 calibration. Fi2 required closing angle for Early Closing Actuation." UWORD TE_MAirReqATDC_Symbol_CM_ufix16_En4_degE 0 0 0 4095 ECU_ADDRESS 0x40003786 /end MEASUREMENT
/begin MEASUREMENT esAngVvaLoObj "[OUT] Fi1 calibration. Fi1 required angle for Late Opening Actuation." UWORD TE_MAirReqATDC_Symbol_CM_ufix16_En4_degE 0 0 0 4095 ECU_ADDRESS 0x40003784 /end MEASUREMENT
/begin CHARACTERISTIC esCAM_ASP_DELTA "Forecasting of the shiftimg betweenthe cam & the crankshaft" VALUE 0xFC9CEC Scalar_SWORD 0 TE_MAirReqATDC_Symbol_CM_sfix16_En4_degE -128 128 /end CHARACTERISTIC
/begin CHARACTERISTIC esCM_ACTIVE "Flag di attivazione della strategia di Torque Management" VALUE 0xFCB6D6 Scalar_BOOLEAN 0 TE_TM_TorqCnfg1s_CM_boolean_adm 0 1 /end CHARACTERISTIC
/begin CHARACTERISTIC esCM_ADV_ACTIVE "Flag di abilitazione della richiesta di Coppia Utile calcolata nel ramo veloce (anticipo)" VALUE 0xFCBDE5 Scalar_BOOLEAN 0 TE_TM_TorqBasCtrl4ms_Symbol_CM_boolean_adm 0 1 /end CHARACTERISTIC
/begin MEASUREMENT esCamAspDelta "orecasting of the shiftimg betweenthe cam & the crankshaft" SWORD MairTDC_CM_sfix16_En4_degE 0 0 -128 128 ECU_ADDRESS 0x4000374E /end MEASUREMENT
/begin MEASUREMENT esCmActive "Flag che indica lo stato attivo del controllo Torque-Based, per la richiesta di coppia generica" UBYTE Trqm_CtrlMgmt1s_CM_boolean_adm 0 0 0 1 ECU_ADDRESS 0x4000420A /end MEASUREMENT
/begin MEASUREMENT esCmAdvActive "Flag che indica se attiva la richiesta di Coppia calcolata nel ramo veloce (anticipo)" UBYTE IgntTDC_CM_boolean_adm 0 0 0 1 ECU_ADDRESS 0x4000427C /end MEASUREMENT
/begin MEASUREMENT esCmeMaxAval "Coppia Erogata massima disponibile a un dato regime" UWORD Trqm_CtrlMgmt4ms_CM_ufix16_En4_N_m 0 0 0 4095 ECU_ADDRESS 0x400042AE /end MEASUREMENT
/begin MEASUREMENT esCmeObjNoLimTst "Coppia erogata (Clutch Torque) obiettivo (a monte Ctrl High Idle)" UWORD TE_TM_TorqBasCtrl4ms_Symbol_CM_ufix16_En4_Nm 0 0 0 4095 ECU_ADDRESS 0x40004482 /end MEASUREMENT
/begin MEASUREMENT esCme_Ist_Tst "Coppia Utile istantanea fornita dal ciclo Otto" UWORD TE_TM_TorqCalcTDC_Symbol_CM_ufix16_En4_N_m 0 0 0 4095 ECU_ADDRESS 0x40004500 /end MEASUREMENT
/begin MEASUREMENT esCme_Max_AbsOut "Coppia Erogata massima possibile per il motore nella applicazione" UWORD Trqm_CtrlMgmt4ms_CM_ufix16_En4_N_m 0 0 0 4095 ECU_ADDRESS 0x400042A8 /end MEASUREMENT
/begin MEASUREMENT esCmfPerIstAbTst "Percentuale Assoluta (riferita a esCmu_Max_AbsOut) delle Friction" UWORD TE_TM_TorqCalcTDC_Symbol_CM_ufix16_En4__ 0 0 0 125 ECU_ADDRESS 0x400044FE /end MEASUREMENT
/begin MEASUREMENT esCmfPerIstRelTs "Percentuale Relativa (riferita a esCmuMaxAval) delle Friction" UWORD TE_TM_TorqCalcTDC_Symbol_CM_ufix16_En4__ 0 0 0 125 ECU_ADDRESS 0x400044FC /end MEASUREMENT
/begin MEASUREMENT esCmfPerRelsAcsrs "Friction percentuale (rispetto alla Cmu assoluta) equivalente agli accessori" UWORD TE_TM_TorqCalcTDC_Symbol_CM_ufix16_En4__ 0 0 0 125 ECU_ADDRESS 0x400044FA /end MEASUREMENT
/begin MEASUREMENT esCmf_Ist "Coppia di Friction istantanea" UWORD Trqm_CtrlMgmt4ms_CM_ufix16_En4_N_m 0 0 0 4095 ECU_ADDRESS 0x400042AA /end MEASUREMENT
/begin MEASUREMENT esCmu2AdvOn "Flag di stato che indica se il calcolo della coppia veloce è attivo" UBYTE Trqm_CtrlMgmt4ms_CM_boolean_adm 0 0 0 1 ECU_ADDRESS 0x40004279 /end MEASUREMENT
/begin MEASUREMENT esCmu2qairObj "[OUT] Tabella di conversione della Coppia Utile obiettivo in Aria sul ramo lento" UWORD TE_TM_TorqBasCtrl4ms_Symbol_CM_ufix16_En4_kg_h 0 0 0 4095 ECU_ADDRESS 0x40004480 /end MEASUREMENT
/begin MEASUREMENT esCmuAirLamAdTst "Coppia Utile obiettivo degradata per attuale valore di lambda e delta anticipo sul ramo lento" UWORD TE_TM_TorqBasCtrl4ms_Symbol_CM_ufix16_En4_N_m 0 0 0 4095 ECU_ADDRESS 0x4000447E /end MEASUREMENT
/begin MEASUREMENT esCmuAirLamTst "Coppia Utile obiettivo degradata per attuale valore di lambda sul ramo lento" UWORD TE_TM_TorqBasCtrl4ms_Symbol_CM_ufix16_En4_N_m 0 0 0 4095 ECU_ADDRESS 0x4000447C /end MEASUREMENT
/begin MEASUREMENT esCmuDadvReqTst "Coppia Utile istantanea degradata per attuale valore di lambda sul ramo veloce" UWORD TE_TM_TorqBasCtrl4ms_Symbol_CM_ufix16_En4_N_m 0 0 0 4095 ECU_ADDRESS 0x4000447A /end MEASUREMENT
/begin MEASUREMENT esCmuDerateTinj "Richiesta di coppia (% di Cmu_Max) limitata per Tinj_Max" UWORD TE_TM_TorqBas4ms_CM_ufix16_En4__ 0 0 0 100 ECU_ADDRESS 0x400043C8 /end MEASUREMENT
/begin MEASUREMENT esCmuLtdVirtualT "Coppia limite superiore in High Idle" UWORD TE_TM_TorqBasCtrl4ms_Symbol_CM_ufix16_En4_N_m 0 0 0 4095 ECU_ADDRESS 0x40004478 /end MEASUREMENT
/begin MEASUREMENT esCmuObjLimitTst "Coppia Utile obiettivo richiesta al ciclo Otto, limitata per fuorigiri" UWORD TE_TM_TorqBasCtrl4ms_Symbol_CM_ufix16_En4_N_m 0 0 0 4095 ECU_ADDRESS 0x40004476 /end MEASUREMENT
/begin MEASUREMENT esCmuObjNoLimTst "Coppia Utile obiettivo richiesta al ciclo Otto prima della limitazione per fuorigiri" UWORD TE_TM_TorqBasCtrl4ms_Symbol_CM_ufix16_En4_N_m 0 0 0 4095 ECU_ADDRESS 0x40004474 /end MEASUREMENT
/begin MEASUREMENT esCmuPercReqDef "ercentuale finale di richiesta di Coppia Utile nel Manager" UWORD J1939dl_Tx50ms_CM_ufix16_En4__ 0 0 0 100 ECU_ADDRESS 0x400042C6 /end MEASUREMENT
/begin MEASUREMENT esCmuRedMF3_On "lag che indica che la MF3 sta limitando la coppia richiesta" UBYTE J1939dl_Tx100ms_CM_boolean_adm 0 0 0 1 ECU_ADDRESS 0x40004288 /end MEASUREMENT
/begin MEASUREMENT esCmuRedVCM_On "lag che indica che la VCM (via CAN) sta limitando la coppia richiesta" UBYTE J1939dl_Tx100ms_CM_boolean_adm 0 0 0 1 ECU_ADDRESS 0x40004289 /end MEASUREMENT
/begin MEASUREMENT esCmuReduction "Limitazione di coppia esterna (VCM)" UWORD Trqm_CtrlMgmt4ms_CM_ufix16_En4__ 0 0 0 100 ECU_ADDRESS 0x400042C4 /end MEASUREMENT
/begin MEASUREMENT esCmuSpd_Ltd_Mod "Flag on (1) if Limitation Mode (Torque or Speed) is request" UBYTE Trqm_CtrlMgmt4ms_CM_boolean_adm 0 0 0 1 ECU_ADDRESS 0x40004287 /end MEASUREMENT
/begin MEASUREMENT esCmu_Ctrl_Mode "Flag di stato che vale 1 se attivo il controllo di coppia, 0 se attivo il controllo di giri" UBYTE Trqm_CtrlMgmt4ms_CM_boolean_adm 0 0 0 1 ECU_ADDRESS 0x40004283 /end MEASUREMENT
/begin MEASUREMENT esCmu_Ist "oppia Utile attualmente erogata" UWORD Trqm_CtrlMgmt4ms_CM_ufix16_En4_N_m 0 0 0 4095 ECU_ADDRESS 0x400042A6 /end MEASUREMENT
/begin MEASUREMENT esCmu_Max_AbsOut "Massima Coppia Utile assoluta fornita dal ciclo Otto" UWORD Idle4ms_CM_ufix16_En4_N_m 0 0 0 4095 ECU_ADDRESS 0x400042A2 /end MEASUREMENT
/begin MEASUREMENT esCmu_Max_Aval "assima Coppia Utile che sarebbe disponibile nel punto motore attuale" UWORD Trqm_CtrlMgmt4ms_CM_ufix16_En4_N_m 0 0 0 4095 ECU_ADDRESS 0x400042A4 /end MEASUREMENT
/begin MEASUREMENT esCtrlOff_Mode "Flag on (1) if NO Control Mode (Torque or Speed) is request" UBYTE Trqm_CtrlMgmt4ms_CM_boolean_adm 0 0 0 1 ECU_ADDRESS 0x40004284 /end MEASUREMENT
/begin MEASUREMENT esDAdvIstTst "Delta anticipo istantaneo (differenza fra anticipo attuato e anticipo ottimo)" UWORD TE_TM_TorqCalcTDC_Symbol_CM_ufix16_En4_degree 0 0 0 50 ECU_ADDRESS 0x400044F8 /end MEASUREMENT
/begin CHARACTERISTIC esDECR_INIT_INTEGR "Nr step_4ms of decrement for initialization of PTO integral inherited from Low Idle Ctrl" VALUE 0xFCBA33 Scalar_UBYTE 0 TE_TM_InitIntegrSpd4ms_Symbol_CM_uint8_4ms 1 255 /end CHARACTERISTIC
/begin CHARACTERISTIC esDELAY_TORQ_F_BACK "Calibrazione per il numero di ritardi nella attuazione farfalla (1->0 ritardi; 2->1;...; 13->12)" VALUE 0xFCC57D Scalar_UBYTE 0 TE_TM_TorqCalcTDC_Symbol_CM_uint8_adm 1 13 /end CHARACTERISTIC
/begin CHARACTERISTIC esDELTA_INF_TRQ_FBK "Delta coppia per definire banda di tolleranza del FeedBack di coppia" VALUE 0xFCC580 Scalar_UWORD 0 TE_TM_TorqCalcTDC_Symbol_CM_ufix16_En4__ 0 100 /end CHARACTERISTIC
/begin CHARACTERISTIC esDELTA_MAX_HI "Diminuzione del target di giri in fase di approccio, rimossa alla max velocità" VALUE 0xFCBDE4 Scalar_UBYTE 0 TE_TM_TorqBasCtrl4ms_Symbol_CM_uint8_rpm 0 250 /end CHARACTERISTIC
/begin CHARACTERISTIC esDELTA_MAX_RPM_LTD "Delta sui giri massimi per limitazione velocità veicolo" VALUE 0xFCBDE3 Scalar_UBYTE 0 TE_TM_TorqBasCtrl4ms_Symbol_CM_uint8_rpm 0 200 /end CHARACTERISTIC
/begin CHARACTERISTIC esDELTA_N_VV_MD "Hysteresis on RPM variations to change Valve Mode Actuation" VALUE 0xFC9CC0 Scalar_UWORD 0 TE_MAirReqATDC_Symbol_CM_uint16_rpm 0 10000 /end CHARACTERISTIC
/begin CHARACTERISTIC esDELTA_QA_VV_MD "Hysteresis on Qair Request variations to change Valve Mode Actuation" VALUE 0xFC9CBE Scalar_UWORD 0 TE_MAirReqATDC_Symbol_CM_ufix16_En4_kg_h 0 200 /end CHARACTERISTIC
/begin CHARACTERISTIC esDELTA_RPM_ADV_HI "Delta giri di anticipo per ingresso in High Idle" VALUE 0xFCBE0C Scalar_UWORD 0 TE_TM_TorqBasCtrl4ms_Symbol_CM_uint16_rpm 0 500 /end CHARACTERISTIC
/begin CHARACTERISTIC esDELT_N_COF_PID "Delta di giri da sommare a obiettivo giri del PID per togliere interferenze del Cut-Off" VALUE 0xFCBA48 Scalar_UWORD 0 TE_TM_SpeedCtrl_4ms_Symbol_CM_uint16_rpm 0 2000 /end CHARACTERISTIC
/begin CHARACTERISTIC esDERATAIR_DERNEG "Limitazione derivata negativa Derate Temperatura aria" VALUE 0xFCB91C Scalar_UWORD 0 TE_TM_TorqBas4ms_CM_ufix16_En8___4ms 0 100 /end CHARACTERISTIC
/begin CHARACTERISTIC esDERATAIR_DERPOS "Limitazione derivata positiva Derate Temperatura aria" VALUE 0xFCB91A Scalar_UWORD 0 TE_TM_TorqBas4ms_CM_ufix16_En8___4ms 0 100 /end CHARACTERISTIC
/begin CHARACTERISTIC esDERATEXH_DERNEG "Exhaust temperature derate negative limitation " VALUE 0xFCB918 Scalar_UWORD 0 TE_TM_TorqBas4ms_CM_ufix16_En8___4ms 0 100 /end CHARACTERISTIC
/begin CHARACTERISTIC esDERATEXH_DERPOS "Exhaust temperature derate positive limitation " VALUE 0xFCB916 Scalar_UWORD 0 TE_TM_TorqBas4ms_CM_ufix16_En8___4ms 0 100 /end CHARACTERISTIC
/begin CHARACTERISTIC esDERATH2O_DERNEG "Limitazione derivata negativa Derate Temperatura acqua" VALUE 0xFCB914 Scalar_UWORD 0 TE_TM_TorqBas4ms_CM_ufix16_En8___4ms 0 100 /end CHARACTERISTIC
/begin CHARACTERISTIC esDERATH2O_DERPOS "Limitazione derivata positiva Derate Temperatura acqua" VALUE 0xFCB912 Scalar_UWORD 0 TE_TM_TorqBas4ms_CM_ufix16_En8___4ms 0 100 /end CHARACTERISTIC
/begin CHARACTERISTIC esDER_DEADBND_KI "Banda morta su derivata giri per AntiWindUp su KI" VALUE 0xFCBA46 Scalar_UWORD 0 TE_TM_SpeedCtrl_4ms_Symbol_CM_uint16_rpm_s 0 32000 /end CHARACTERISTIC
/begin CHARACTERISTIC esDER_DEAD_BND "Banda morta su derivata giri per KD" VALUE 0xFCBA44 Scalar_UWORD 0 TE_TM_SpeedCtrl_4ms_Symbol_CM_uint16_rpm_s 0 32000 /end CHARACTERISTIC
/begin CHARACTERISTIC esDER_LIM_USE_EN "Flag di abilitazione uso derivata sui giri (1), (0 per uso max rpm memorizzati)" VALUE 0xFCBDE2 Scalar_BOOLEAN 0 TE_TM_TorqBasCtrl4ms_Symbol_CM_boolean_adm 0 1 /end CHARACTERISTIC
/begin CHARACTERISTIC esD_OBJ_RPM_INFD "Limite inferiore finale per delta giri obiettivo per PTO" VALUE 0xFCBAA2 Scalar_SWORD 0 TE_TM_SpeedCtrl_4ms_Symbol_CM_int16_rpm -10000 0 /end CHARACTERISTIC
/begin MEASUREMENT esDelayLtdGainPatm "[OUT] Guadagno del ritardo limitazione Full-Load per PAtm" UWORD TE_TM_TorqBasCtrl4ms_Symbol_CM_ufix16_En10_adm 0 0 0 10 ECU_ADDRESS 0x40004472 /end MEASUREMENT
/begin MEASUREMENT esDelayLtdTh2o "[OUT] Ritardo limitazione Full-Load per Th2o" UWORD TE_TM_TorqBasCtrl4ms_Symbol_CM_uint16_s 0 0 0 3600 ECU_ADDRESS 0x40004470 /end MEASUREMENT
/begin MEASUREMENT esDeltaAdvKnockCtrl "Delta anticipo da togliere per Knock Ctrl" UWORD TE_TM_TorqBasCtrl4ms_Symbol_CM_ufix16_En4_degE 0 0 0 50 ECU_ADDRESS 0x4000446E /end MEASUREMENT
/begin MEASUREMENT esDeltaDerrpmAdvHi "[OUT] Ulteriore delta giri di anticipo per ingresso in High Idle funzione della derivata di giri" UWORD TE_TM_TorqBasCtrl4ms_Symbol_CM_ufix16_Bn500_rpm 0 0 -500 500 ECU_ADDRESS 0x4000446C /end MEASUREMENT
/begin MEASUREMENT esDelta_Adv_Filt "Delta Anticipo Filtrato" SWORD TE_TM_TorqBasCtrl4ms_Symbol_CM_sfix16_En4_degree 0 0 0 50 ECU_ADDRESS 0x4000448A /end MEASUREMENT
/begin MEASUREMENT esDelta_Adv_Req "Richiesta di delta anticipo calcolato nel ramo veloce della Coppia" SWORD IgntTDC_CM_sfix16_En4_degree 0 0 -20 60 ECU_ADDRESS 0x40004292 /end MEASUREMENT
/begin MEASUREMENT esDelta_FInj "elta on Injection timing (due to VVA) to deliver the fuel into the cylinder when the valve is opened" UWORD InjtTDC_CM_ufix16_En4_degree 0 0 0 720 ECU_ADDRESS 0x40003750 /end MEASUREMENT
/begin MEASUREMENT esDelta_Ignition "elta on Ingnition Spark Advance (due to Fi1 or Fi2) to burn correctly the fuel into the combustion chamber in the cylinder" SWORD IgntTDC_CM_sfix16_En4_deg 0 0 -20 20 ECU_ADDRESS 0x4000374C /end MEASUREMENT
/begin MEASUREMENT esDelta_RPMAdvHI "Delta giri (rispetto al regime di OverSpeed) con cui si inizia a tagliare  la coppia per High Idle" UWORD Trqm_CtrlMgmt1s_CM_uint16_rpm 0 0 0 10000 ECU_ADDRESS 0x400042C8 /end MEASUREMENT
/begin MEASUREMENT esDelta_TorqC_TS "Differenza fra coppia richiesta e coppia calcolata per giri obiettivo" UWORD TE_TM_TorqBas4ms_CM_ufix16_En4__ 0 0 0 100 ECU_ADDRESS 0x400043C6 /end MEASUREMENT
/begin MEASUREMENT esDer_RPM_100ms "Derivata deigli RPM calolata ogni 100ms" SWORD EgmdTDC_CM_int16_rpm_s 0 0 -32000 32000 ECU_ADDRESS 0x40004504 /end MEASUREMENT
/begin MEASUREMENT esDeraTairLimDer "Derate per temperatura aria con limitazione di derivata" UWORD TE_TM_TorqBas4ms_CM_ufix16_En8__ 0 0 0 100 ECU_ADDRESS 0x400043C4 /end MEASUREMENT
/begin MEASUREMENT esDeraTairTmp "Derate per sovratemperatura aria (senza filtro sulla derivata)" UWORD TE_TM_TorqBas4ms_CM_ufix16_En8__ 0 0 0 100 ECU_ADDRESS 0x400043C2 /end MEASUREMENT
/begin MEASUREMENT esDeraTexhLimDer "Derate for exhaust temperature overheating (with filtering)" UWORD TE_TM_TorqBas4ms_CM_ufix16_En8__ 0 0 0 100 ECU_ADDRESS 0x400043C0 /end MEASUREMENT
/begin MEASUREMENT esDeraTexhTmp "Derate for exhaust temperature overheating (without filtering)" UWORD TE_TM_TorqBas4ms_CM_ufix16_En8__ 0 0 0 100 ECU_ADDRESS 0x400043BE /end MEASUREMENT
/begin MEASUREMENT esDeraTh2oLimDer "Derate per temperatura acqua con limitazione di derivata" UWORD TE_TM_TorqBas4ms_CM_ufix16_En8__ 0 0 0 100 ECU_ADDRESS 0x400043BC /end MEASUREMENT
/begin MEASUREMENT esDeratTh2oTmp "Derate per sovratemperatura acqua (senza filtro sulla derivata)" UWORD TE_TM_TorqBas4ms_CM_ufix16_En8__ 0 0 0 100 ECU_ADDRESS 0x400043BA /end MEASUREMENT
/begin MEASUREMENT esDerateTh2o "[OUT] Richiesta di riduzione percentuale di performance (derating per temperatura acqua)" UWORD TE_TM_TorqBas4ms_CM_ufix16_En4__ 0 0 0 100 ECU_ADDRESS 0x400043B8 /end MEASUREMENT
/begin MEASUREMENT esDerateTinj "Fattore di derate della Coppia dovuto alla limitazione del Tinj" UWORD TE_TM_TorqBas4ms_CM_ufix16_En10_adm 0 0 0 1 ECU_ADDRESS 0x400043B6 /end MEASUREMENT
/begin MEASUREMENT esDpAsp "Depressione di pompaggio in aspirazione" UWORD TE_TM_TorqBasCtrl4ms_Symbol_CM_uint16_mbar 0 0 0 3000 ECU_ADDRESS 0x4000446A /end MEASUREMENT
/begin MEASUREMENT esDpSca "Depressione di pompaggio in scarico" UWORD TE_TM_TorqBasCtrl4ms_Symbol_CM_uint16_mbar 0 0 0 3000 ECU_ADDRESS 0x40004468 /end MEASUREMENT
/begin CHARACTERISTIC esENBRK_FREQ "Engine Brake actuator command duty cylce to apply when Engine Brake is ON." VALUE 0xFC4D1E Scalar_UWORD 0 EngineBrakeMgm50ms_CM_ufix16_S10_Hz 20 10000 /end CHARACTERISTIC
/begin CHARACTERISTIC esENBRK_IN_CUTOFF_TIME "Time since the engine mode is CUT_OFF to wait before the activation of the Engine Brake actuator." VALUE 0xFC4D1C Scalar_UWORD 0 EngineBrakeMgm50ms_CM_ufix16_Sp05_s 0 35 /end CHARACTERISTIC
/begin CHARACTERISTIC esENBRK_REQ_SRC_CAN "Enable Engine Brake request using TSC1 TR message" VALUE 0xFC4D1A Scalar_BOOLEAN 0 EngineBrakeMgm50ms_CM_boolean_adm 0 1 /end CHARACTERISTIC
/begin CHARACTERISTIC esENBRK_STRONG_DC "Engine Brake actuator command duty cylce to apply when Engine Brake is ON in STRONG mode." VALUE 0xFC4D18 Scalar_UWORD 0 EngineBrakeMgm50ms_CM_ufix16_En4__ 0 100 /end CHARACTERISTIC
/begin CHARACTERISTIC esENBRK_STRONG_THR "Requested negative torque threshold below which the Engine Brake DC is the STRONG one." VALUE 0xFC4D16 Scalar_SWORD 0 EngineBrakeMgm50ms_CM_sfix16_En4__ -100 0 /end CHARACTERISTIC
/begin CHARACTERISTIC esENBRK_WEAK_DC "Engine Brake actuator command duty cylce to apply when Engine Brake is ON in WEAK mode." VALUE 0xFC4D14 Scalar_UWORD 0 EngineBrakeMgm50ms_CM_ufix16_En4__ 0 100 /end CHARACTERISTIC
/begin CHARACTERISTIC esENBRK_WEAK_THR "Requested negative torque threshold below which the Engine Brake DC is the WEAK one." VALUE 0xFC4D12 Scalar_SWORD 0 EngineBrakeMgm50ms_CM_sfix16_En4__ -100 0 /end CHARACTERISTIC
/begin CHARACTERISTIC esENG2CMP_GAIN "Gain per la misura del pompaggio" VALUE 0xFCBE0A Scalar_UWORD 0 TE_TM_TorqBasCtrl4ms_Symbol_CM_ufix16_En10_adm 0 10 /end CHARACTERISTIC
/begin CHARACTERISTIC esENG_BRAKE_EN "Enable Engine Brake actuator management" VALUE 0xFC4D10 Scalar_BOOLEAN 0 EngineBrakeMgm50ms_CM_boolean_adm 0 1 /end CHARACTERISTIC
/begin CHARACTERISTIC esEN_DER_RPM "Flag di attivazione del calcolo della derivata degli RPM" VALUE 0xFCC612 Scalar_BOOLEAN 0 TE_TM_DerRPM_100ms_CM_boolean_adm 0 1 /end CHARACTERISTIC
/begin CHARACTERISTIC esEN_FAST_DER_CM "Flag per Switch fra derivata veloce (50 ms) o lenta (100 ms)" VALUE 0xFCBA36 Scalar_BOOLEAN 0 TE_TM_SpeedCtrl_4ms_Symbol_CM_boolean_adm 0 1 /end CHARACTERISTIC
/begin CHARACTERISTIC esEN_HIGH_IDLE "Enable limitazione High Idle" VALUE 0xFCBDE1 Scalar_BOOLEAN 0 TE_TM_TorqBasCtrl4ms_Symbol_CM_boolean_adm 0 1 /end CHARACTERISTIC
/begin CHARACTERISTIC esEN_LTD_TMP "Enable temporary Full-Load performance Limitation for Engine protection" VALUE 0xFCBDE0 Scalar_BOOLEAN 0 TE_TM_TorqBasCtrl4ms_Symbol_CM_boolean_adm 0 1 /end CHARACTERISTIC
/begin CHARACTERISTIC esEN_N_OBJ_FILTR "Switch per obiettivo di giri: (0) non-filtrato, (1) filtrato e (2) filtrato-forzato" VALUE 0xFCBA35 Scalar_UBYTE 0 TE_TM_SpeedCtrl_4ms_Symbol_CM_uint8_adm 0 2 /end CHARACTERISTIC
/begin CHARACTERISTIC esEN_TE_TORQMODE "Abilitazione calcolo Torque Mode per 1-Box" VALUE 0xFCBDDF Scalar_BOOLEAN 0 TE_TM_TorqBasCtrl4ms_Symbol_CM_boolean_adm 0 1 /end CHARACTERISTIC
/begin CHARACTERISTIC esERR_DEADBND_KI "Banda morta su errore giri per AntiWindUp su KI" VALUE 0xFCBA42 Scalar_UWORD 0 TE_TM_SpeedCtrl_4ms_Symbol_CM_uint16_rpm 0 10000 /end CHARACTERISTIC
/begin CHARACTERISTIC esERR_DEAD_BND_D "Banda morta su errore per resettare Integrale KI2" VALUE 0xFCBA40 Scalar_UWORD 0 TE_TM_SpeedCtrl_4ms_Symbol_CM_uint16_rpm 0 10000 /end CHARACTERISTIC
/begin CHARACTERISTIC esETM_FUEL_LTD "Engine Torque Mode" VALUE 0xFCBDDE Scalar_UBYTE 0 TE_TM_TorqBasCtrl4ms_Symbol_CM_uint8_adm 0 15 /end CHARACTERISTIC
/begin CHARACTERISTIC esETM_HSPD_GOV "Engine Torque Mode" VALUE 0xFCBDDD Scalar_UBYTE 0 TE_TM_TorqBasCtrl4ms_Symbol_CM_uint8_adm 0 15 /end CHARACTERISTIC
/begin CHARACTERISTIC esETM_IDLING "Engine Torque Mode" VALUE 0xFCBDDC Scalar_UBYTE 0 TE_TM_TorqBasCtrl4ms_Symbol_CM_uint8_adm 0 15 /end CHARACTERISTIC
/begin CHARACTERISTIC esETM_SPD_DEMAN "Engine Torque Mode" VALUE 0xFCBDDB Scalar_UBYTE 0 TE_TM_TorqBasCtrl4ms_Symbol_CM_uint8_adm 0 15 /end CHARACTERISTIC
/begin CHARACTERISTIC esETM_TORQ_DEMAN "Engine Torque Mode" VALUE 0xFCBDDA Scalar_UBYTE 0 TE_TM_TorqBasCtrl4ms_Symbol_CM_uint8_adm 0 15 /end CHARACTERISTIC
/begin CHARACTERISTIC esETM_TORQ_LTD "Engine Torque Mode" VALUE 0xFCBDD9 Scalar_UBYTE 0 TE_TM_TorqBasCtrl4ms_Symbol_CM_uint8_adm 0 15 /end CHARACTERISTIC
/begin CHARACTERISTIC esETM_VCM_EXE_TD "Engine Torque Mode" VALUE 0xFCBDD8 Scalar_UBYTE 0 TE_TM_TorqBasCtrl4ms_Symbol_CM_uint8_adm 0 15 /end CHARACTERISTIC
/begin MEASUREMENT esEgtMaxVal "[TESTPOINT] Exhaust target max temperature beyond which derate is active" UWORD TE_TM_TorqBas4ms_CM_ufix16_Bn40_degC 0 0 -40 1000 ECU_ADDRESS 0x400043B4 /end MEASUREMENT
/begin MEASUREMENT esEnReLimDiagTst "Limite superiore alla richiesta di coppia per diagnosi" UWORD TE_TM_TorqBas4ms_CM_ufix16_En4__ 0 0 0 100 ECU_ADDRESS 0x400043B2 /end MEASUREMENT
/begin MEASUREMENT esEnReLimSupTst "Limitazione motoristica alle richieste di Coppia Utile" UWORD TE_TM_TorqBas4ms_CM_ufix16_En4__ 0 0 0 100 ECU_ADDRESS 0x400043B0 /end MEASUREMENT
/begin MEASUREMENT esEnSpeedCtrlPID "Abilitazione del calcolo del PID" UBYTE Airq4ms_CM_boolean_adm 0 0 0 1 ECU_ADDRESS 0x4000427E /end MEASUREMENT
/begin MEASUREMENT esEnTSC1xMgm "Abilitazione FSM per discriminare fra Controllo di Giri o di Coppia" UBYTE TE_TM_TorqBas4ms_CM_boolean_adm 0 0 0 1 ECU_ADDRESS 0x400043AE /end MEASUREMENT
/begin MEASUREMENT esEndSpeedGov "Valore massimo dei giri a cui il T_inj non viene ancora tagliato" UWORD TE_TM_TorqCnfg1s_CM_uint16_rpm 0 0 0 10000 ECU_ADDRESS 0x4000425A /end MEASUREMENT
/begin MEASUREMENT esEng2CmfAsp "Coppia di pompaggio in aspirazione" UWORD TE_TM_TorqBasCtrl4ms_Symbol_CM_ufix16_En4_N_m 0 0 0 4095 ECU_ADDRESS 0x40004466 /end MEASUREMENT
/begin MEASUREMENT esEng2CmfSca "Coppia di pompaggio sullo scarico" UWORD TE_TM_TorqBasCtrl4ms_Symbol_CM_ufix16_En4_N_m 0 0 0 4095 ECU_ADDRESS 0x40004464 /end MEASUREMENT
/begin MEASUREMENT esEng2cmfNIst "[OUT] Coppia Resistente dovuta al movimento organico" UWORD TE_TM_TorqBasCtrl4ms_Symbol_CM_ufix16_En4_N_m 0 0 0 4095 ECU_ADDRESS 0x40004462 /end MEASUREMENT
/begin MEASUREMENT esEng2cmfPIst "[OUT] Coppia Resistente dovuta alla pressione del lubrificante" UWORD TE_TM_TorqBasCtrl4ms_Symbol_CM_ufix16_En4_N_m 0 0 0 4095 ECU_ADDRESS 0x40004460 /end MEASUREMENT
/begin MEASUREMENT esEng2cmfTIst "[OUT] Coppia Resistente dovuta alla viscosita del lubrificante" UWORD TE_TM_TorqBasCtrl4ms_Symbol_CM_ufix16_En4_N_m 0 0 0 4095 ECU_ADDRESS 0x4000445E /end MEASUREMENT
/begin MEASUREMENT esEngBrkDutyTmp "Engine Brake actuator command duty cycle (before fix)" UWORD EngineBrakeMgm50ms_CM_ufix16_En4__ 0 0 0 100 ECU_ADDRESS 0x40002A6E /end MEASUREMENT
/begin MEASUREMENT esEngBrkEn "Logical AND of all the enabling condition to require the activation of the Engine Brake actuator command." UBYTE Egbrk50ms_CM_boolean_adm 0 0 0 1 ECU_ADDRESS 0x40002A68 /end MEASUREMENT
/begin MEASUREMENT esEngDemPercTorq "Richiesta interna di coppia (=0 se VCM <>0)" UWORD Trqm_CtrlMgmt4ms_CM_ufix16_En4__ 0 0 0 100 ECU_ADDRESS 0x400042C0 /end MEASUREMENT
/begin MEASUREMENT esEngOverTemp "Flag di stato del Warning per Over-Temperature" UBYTE J1939dl_Tx50ms_CM_uint8_adm 0 0 0 7 ECU_ADDRESS 0x4000428C /end MEASUREMENT
/begin MEASUREMENT esEngReqLimSup "imitazione di coppia interna (MF3 engine+diagnosi)" UWORD Trqm_CtrlMgmt4ms_CM_ufix16_En4__ 0 0 0 100 ECU_ADDRESS 0x400042B8 /end MEASUREMENT
/begin MEASUREMENT esEngTrqMode "Engine torque mode generato da MF3" UBYTE DiagSym100ms_CM_uint8_adm 0 0 0 15 ECU_ADDRESS 0x4000428A /end MEASUREMENT
/begin MEASUREMENT esErrCntLim "Contatore per lo smoothing tra Rpm e Target statico" UWORD TE_TM_SpeedCtrl_4ms_Symbol_CM_ufix16_En10_adm 0 0 0 1 ECU_ADDRESS 0x4000432C /end MEASUREMENT
/begin MEASUREMENT esErrNReallHI "Valore massimo di giri per High Idle" UWORD TE_TM_TorqBasCtrl4ms_Symbol_CM_ufix16_Bn1800_rpm 0 0 -1800 1800 ECU_ADDRESS 0x4000445C /end MEASUREMENT
/begin MEASUREMENT esErrorTAir "Errore sulla TAir per il Ctrl P della temperatura" SWORD TE_TM_TorqBas4ms_CM_int16_degC 0 0 -100 0 ECU_ADDRESS 0x400043AC /end MEASUREMENT
/begin MEASUREMENT esErrorTexh "Exhaust temperature error computation value " SWORD TE_TM_TorqBas4ms_CM_int16_degC 0 0 -100 0 ECU_ADDRESS 0x400043AA /end MEASUREMENT
/begin MEASUREMENT esErrorTh2o "Errore sulla TAir per il Ctrl P della temperatura" UBYTE TE_TM_TorqBas4ms_CM_ufix8_Bn100_degC 0 0 -100 0 ECU_ADDRESS 0x400043A8 /end MEASUREMENT
/begin MEASUREMENT esEta2Dadv "[OUT] Curva (inversa della Curva Unica) che fornisce il delta anticipo sul ramo veloce della Coppia" UWORD TE_TM_TorqBasCtrl4ms_Symbol_CM_ufix16_En4_degree 0 0 0 50 ECU_ADDRESS 0x4000445A /end MEASUREMENT
/begin MEASUREMENT esEtaAll "Efficienza totale dei parametri (anticipo, stechiometria) che influenzano la coppia" UWORD Trqm_CtrlMgmtTDC_CM_ufix16_En8_adm 0 0 0 1.3984375 ECU_ADDRESS 0x400044B2 /end MEASUREMENT
/begin MEASUREMENT esEtaCutOffIst "Efficienza istantanea sulla combustione attiva / disattiva nei cilindri" UWORD Trqm_CtrlMgmtTDC_CM_ufix16_En8_adm 0 0 0 1 ECU_ADDRESS 0x400044B8 /end MEASUREMENT
/begin MEASUREMENT esEtaDAdvIsta "[OUT] Curva Unica della efficienza del Ciclo Otto (Coppia Utile) in funzione del delta anticipo" UWORD TE_TM_TorqCalcTDC_Symbol_CM_ufix16_En8_adm 0 0 0.00390625 1 ECU_ADDRESS 0x400044F6 /end MEASUREMENT
/begin MEASUREMENT esEtaDadvReDefTs "Efficienza istantanea richiesta sul ramo veloce" UWORD TE_TM_TorqBasCtrl4ms_Symbol_CM_ufix16_En8_adm 0 0 0.00390625 1 ECU_ADDRESS 0x40004458 /end MEASUREMENT
/begin MEASUREMENT esEtaDavIst "Efficienza istantanea della parametrizzazione anticipo accensione" UWORD Trqm_CtrlMgmt4ms_CM_ufix16_En8_adm 0 0 0 1 ECU_ADDRESS 0x400044B4 /end MEASUREMENT
/begin MEASUREMENT esEtaLamIst "Efficienza istantanea della stechiometrica del titolo di miscela" UWORD Trqm_CtrlMgmt4ms_CM_ufix16_En8_adm 0 0 0 1.4 ECU_ADDRESS 0x400044B6 /end MEASUREMENT
/begin MEASUREMENT esEtaLamIsta "[OUT] Efficienza della Coppia Utile in funzione di lambda" UWORD TE_TM_TorqCalcTDC_Symbol_CM_ufix16_En8_adm 0 0 0 1 ECU_ADDRESS 0x400044F4 /end MEASUREMENT
/begin CHARACTERISTIC esF1_F2_FL "Durata fase di aspirazione- Valore uguale ad asF1_F2" VALUE 0xFC9CBC Scalar_UWORD 0 TE_MAirReqATDC_Symbol_CM_uint16_degM 180 360 /end CHARACTERISTIC
/begin MEASUREMENT esFFwCmOffNobj "Friction in Feed-Forward (su rpm Obiettivo)" UWORD Trqm_CtrlMgmt4ms_CM_ufix16_En4__ 0 0 0 100 ECU_ADDRESS 0x400042B4 /end MEASUREMENT
/begin CHARACTERISTIC esFRAM_UPD_CNTE2 "Mod 16 counter for frame updating information" VALUE 0xFC9CAA Scalar_UBYTE 0 TE_MAirReqATDC_Symbol_CM_uint8_adm 0 255 /end CHARACTERISTIC
/begin MEASUREMENT esFi1Fi2Vva "elta fase di aspirazione in funzionamento VVA" UWORD Airq_CtrlMgmtTDC_CM_uint16_degM 0 0 180 360 ECU_ADDRESS 0x4000375A /end MEASUREMENT
/begin MEASUREMENT esFi2ToVcyl "[OUT] Single Cylinder Volume varying with Fi2 actuation" UWORD TE_MAirReqATDC_Symbol_CM_ufix16_En4_cc 0 0 0 4095 ECU_ADDRESS 0x40003782 /end MEASUREMENT
/begin MEASUREMENT esForceNormal "Flag per inibire il modo motore Minimo" UBYTE EgmdTDC_CM_boolean_adm 0 0 0 1 ECU_ADDRESS 0x4000427F /end MEASUREMENT
/begin MEASUREMENT esFrameUpdCntE2 "od 16 counter for frame updating information" UBYTE MairTDC_CM_uint8_adm 0 0 0 15 ECU_ADDRESS 0x40003748 /end MEASUREMENT
/begin MEASUREMENT esGainKiHi "[OUT] Guadagno su KI per Inerzia virtuale del veicolo" UWORD TE_TM_TorqBasCtrl4ms_Symbol_CM_ufix16_En10_adm 0 0 0 10 ECU_ADDRESS 0x40004456 /end MEASUREMENT
/begin MEASUREMENT esGainKpHi "[OUT] Guadagno su KP per Inerzia virtuale del veicolo" UWORD TE_TM_TorqBasCtrl4ms_Symbol_CM_ufix16_En10_adm 0 0 0 10 ECU_ADDRESS 0x40004454 /end MEASUREMENT
/begin MEASUREMENT esGovHiKi "[OUT] High governor KI parameter set" UWORD TE_TM_TorqBasCtrl4ms_Symbol_CM_ufix16_En10_adm 0 0 0 1 ECU_ADDRESS 0x40004452 /end MEASUREMENT
/begin MEASUREMENT esGovHiKp "[OUT] High governor KP parameter set" UWORD TE_TM_TorqBasCtrl4ms_Symbol_CM_ufix16_En10_adm 0 0 0 1 ECU_ADDRESS 0x40004450 /end MEASUREMENT
/begin CHARACTERISTIC esHI_DELTA_UNDER_MAX "Offset rispetto al target massimo in relazione ai giri" VALUE 0xFCBEC8 Scalar_SWORD 0 TE_TM_TorqBasCtrl4ms_Symbol_CM_int16_rpm -1000 1000 /end CHARACTERISTIC
/begin CHARACTERISTIC esHI_OBJ_DELTA_ERR "Offset sul target per dare come obiettivo esN_Ltd_HighIdle or esN_Ltd_HighIdle_Low" VALUE 0xFCBDE6 Scalar_BYTE 0 TE_TM_TorqBasCtrl4ms_Symbol_CM_int8_rpm -125 125 /end CHARACTERISTIC
/begin MEASUREMENT esHighIdleLtdDef "imitazione finale superiore (%) del Ctrl High Idle" UWORD Trqm_CtrlMgmt4ms_CM_ufix16_En4__ 0 0 0 100 ECU_ADDRESS 0x4000429C /end MEASUREMENT
/begin MEASUREMENT esHighIdlePIDLtd "Calcolo contributo finale Ctrl PID di High Idle" UWORD TE_TM_TorqBasCtrl4ms_Symbol_CM_ufix16_En4__ 0 0 0 100 ECU_ADDRESS 0x4000444E /end MEASUREMENT
/begin MEASUREMENT esHigh_Idle_ON "Stato di High Idle attivo (1)" UBYTE Airq4ms_CM_boolean_adm 0 0 0 1 ECU_ADDRESS 0x40004278 /end MEASUREMENT
/begin MEASUREMENT esHysNCtrlAdv "[OUT] Anticipo di giri con cui si fa lo SWITCH da Torque a Speed Control" UWORD TE_TM_TorqBas4ms_CM_uint16_rpm 0 0 0 10000 ECU_ADDRESS 0x400043A6 /end MEASUREMENT
/begin MEASUREMENT esHysNCtrlTor "[OUT] Isteresi a salire (su rpm misurati) per spegnere il calcolo in background del contributo di coppia per giri obiettivo" UWORD TE_TM_TorqBas4ms_CM_uint16_rpm 0 0 0 10000 ECU_ADDRESS 0x400043A4 /end MEASUREMENT
/begin MEASUREMENT esHysTCtrlTor "[OUT] Isteresi a salire (su % coppia richiesta rispetto a coppia calcolata per i giri) per passare a controllo di coppia" UWORD TE_TM_TorqBas4ms_CM_ufix16_En4__ 0 0 0 100 ECU_ADDRESS 0x400043A2 /end MEASUREMENT
/begin MEASUREMENT esIdleCtrl2EngMod "lag che segnala che il Low Idle sta vincendo sulle altre richieste dic oppia" UBYTE Idle4ms_CM_boolean_adm 0 0 0 1 ECU_ADDRESS 0x40004282 /end MEASUREMENT
/begin CHARACTERISTIC esKFILT_DADV "Costante di tempo filtro richiesta Delta Anticipo (ramo veloce)" VALUE 0xFCBE08 Scalar_UWORD 0 TE_TM_TorqBasCtrl4ms_Symbol_CM_ufix16_En10_adm 0 1 /end CHARACTERISTIC
/begin CHARACTERISTIC esKF_OBT_HI_DOWN "Costante del filtro passa basso sul taget di giri in discesa" VALUE 0xFCBE06 Scalar_UWORD 0 TE_TM_TorqBasCtrl4ms_Symbol_CM_ufix16_En15_adm 0 1 /end CHARACTERISTIC
/begin CHARACTERISTIC esK_LPF_RIF_PID_N "Costante di Tempo del Filtro1 sul Riferimento statico di giri in Speed Control" VALUE 0xFCBA3E Scalar_UWORD 0 TE_TM_SpeedCtrl_4ms_Symbol_CM_ufix16_En8_adm 0 1 /end CHARACTERISTIC
/begin MEASUREMENT esKdCc "[OUT] KD in CC f(rpm_error)" UWORD TE_TM_SpeedCtrl_4ms_Symbol_CM_ufix16_En15___s_on_rpm 0 0 0 1.953125 ECU_ADDRESS 0x4000432A /end MEASUREMENT
/begin MEASUREMENT esKdCtrlHi "[OUT] Contributo derivativo del Ctrl PID di High Idle" UWORD TE_TM_TorqBasCtrl4ms_Symbol_CM_ufix16_En15___s_rpm 0 0 0 1.953125 ECU_ADDRESS 0x4000444C /end MEASUREMENT
/begin MEASUREMENT esKdGaininertia "[OUT] Variazione del KD in funzione delle richieste di stiffness del Crtl PID" UWORD TE_TM_SpeedCtrl_4ms_Symbol_CM_ufix16_En10_adm 0 0 0 10 ECU_ADDRESS 0x40004328 /end MEASUREMENT
/begin MEASUREMENT esKdHIdle "Contributo finale derivativo Ctrl PID High Idle" SWORD TE_TM_TorqBasCtrl4ms_Symbol_CM_sfix16_En4__ 0 0 -100 100 ECU_ADDRESS 0x40004488 /end MEASUREMENT
/begin MEASUREMENT esKdSpeedPercTst "Contributo del controllo derivativo su errore di giri per obiettivo PTO" SWORD TE_TM_SpeedCtrl_4ms_Symbol_CM_sfix16_En4__ 0 0 -100 100 ECU_ADDRESS 0x40004338 /end MEASUREMENT
/begin MEASUREMENT esKdspeedCtrl "[OUT] Coefficiente del controllo derivativo RPM sui giri obiettivo PTO" UWORD TE_TM_SpeedCtrl_4ms_Symbol_CM_ufix16_En15___s_on_rpm 0 0 0 1.953125 ECU_ADDRESS 0x40004326 /end MEASUREMENT
/begin MEASUREMENT esKfObtHiUp "[OUT] Ulteriore delta giri di anticipo per ingresso in High Idle funzione della derivata di giri" UWORD TE_TM_TorqBasCtrl4ms_Symbol_CM_ufix16_En15_adm 0 0 0 1 ECU_ADDRESS 0x4000444A /end MEASUREMENT
/begin MEASUREMENT esKi1AntiwUpH "[OUT] AntiWindUp superiore del KI" UWORD TE_TM_SpeedCtrl_4ms_Symbol_CM_ufix16_En4__ 0 0 0 100 ECU_ADDRESS 0x40004324 /end MEASUREMENT
/begin MEASUREMENT esKi1AntiwUpL "[OUT] AntiWindUp inferiore del KI" SWORD TE_TM_SpeedCtrl_4ms_Symbol_CM_sfix16_En4__ 0 0 -100 0 ECU_ADDRESS 0x40004336 /end MEASUREMENT
/begin MEASUREMENT esKiCc "[OUT] KI in CC f(rpm_error)" UWORD TE_TM_SpeedCtrl_4ms_Symbol_CM_ufix16_En15___on_s_rpm 0 0 0 1.953125 ECU_ADDRESS 0x40004322 /end MEASUREMENT
/begin MEASUREMENT esKiCtrlHi "[OUT] Contributo integrale del Ctrl PID di High Idle" UWORD TE_TM_TorqBasCtrl4ms_Symbol_CM_ufix16_En15___rpm 0 0 0 1.953125 ECU_ADDRESS 0x40004448 /end MEASUREMENT
/begin MEASUREMENT esKiGaininertia "[OUT] Variazione del KI in funzione delle richieste di stiffness del Crtl PID" UWORD TE_TM_SpeedCtrl_4ms_Symbol_CM_ufix16_En10_adm 0 0 0 10 ECU_ADDRESS 0x40004320 /end MEASUREMENT
/begin MEASUREMENT esKiHIdle "Contributo finale integrale Ctrl PID High Idle" SWORD TE_TM_TorqBasCtrl4ms_Symbol_CM_sfix16_En4__ 0 0 -100 100 ECU_ADDRESS 0x40004486 /end MEASUREMENT
/begin MEASUREMENT esKiSpeedPerc "ntegral part of PID in closed loop PTO engine speed control" SWORD Idle4ms_CM_sfix16_En4__ 0 0 -100 100 ECU_ADDRESS 0x40004294 /end MEASUREMENT
/begin MEASUREMENT esKiSpeedPercInit "ynamic Init value for Integral part in PTO PID" SWORD Trqm_CtrlMgmt4ms_CM_sfix16_En4__ 0 0 -100 100 ECU_ADDRESS 0x40004296 /end MEASUREMENT
/begin MEASUREMENT esKispeedCtrl "[OUT] Coefficiente del controllo integrale su errore di giri obiettivo PTO" UWORD TE_TM_SpeedCtrl_4ms_Symbol_CM_ufix16_En15___s_on_rpm 0 0 0 1.953125 ECU_ADDRESS 0x4000431E /end MEASUREMENT
/begin MEASUREMENT esKnockCtrlTasp "[OUT] Tabella su Aria Aspirata per degrado Anticipo accensione in Knock Ctrl" UWORD TE_TM_TorqBasCtrl4ms_Symbol_CM_ufix16_En4_degE 0 0 0 50 ECU_ADDRESS 0x40004446 /end MEASUREMENT
/begin MEASUREMENT esKnockCtrlTq "[OUT] Tabella su Punto Motore per degrado Anticipo accensione in Knock Ctrl" UWORD TE_TM_TorqBasCtrl4ms_Symbol_CM_ufix16_En4_degE 0 0 0 50 ECU_ADDRESS 0x40004444 /end MEASUREMENT
/begin MEASUREMENT esKnockLtd "Flag che indica la limitazione per Knock Ctrl attiva" UBYTE TE_TM_TorqBasCtrl4ms_Symbol_CM_boolean_adm 0 0 0 1 ECU_ADDRESS 0x40004412 /end MEASUREMENT
/begin MEASUREMENT esKpCc "[OUT] KP in CC f(rpm_error)" UWORD TE_TM_SpeedCtrl_4ms_Symbol_CM_ufix16_En15___rpm 0 0 0 1.99996948242 ECU_ADDRESS 0x4000431C /end MEASUREMENT
/begin MEASUREMENT esKpCtrlHi "[OUT] Contributo proporzionale del Ctrl PID di High Idle" UWORD TE_TM_TorqBasCtrl4ms_Symbol_CM_ufix16_En15___rpm 0 0 0 1.953125 ECU_ADDRESS 0x40004442 /end MEASUREMENT
/begin MEASUREMENT esKpGaininertia "[OUT] Variazione del KP in funzione delle richieste di stiffness del Crtl PID" UWORD TE_TM_SpeedCtrl_4ms_Symbol_CM_ufix16_En10_adm 0 0 0 10 ECU_ADDRESS 0x4000431A /end MEASUREMENT
/begin MEASUREMENT esKpHIdle "Contributo finale proporzionale Ctrl PID High Idle" SWORD TE_TM_TorqBasCtrl4ms_Symbol_CM_sfix16_En4__ 0 0 -100 100 ECU_ADDRESS 0x40004484 /end MEASUREMENT
/begin MEASUREMENT esKpSpeedPercTst "Contributo del controllo proporzionale su errore di giri per obiettivo PTO" SWORD TE_TM_SpeedCtrl_4ms_Symbol_CM_sfix16_En4__ 0 0 -100 100 ECU_ADDRESS 0x40004334 /end MEASUREMENT
/begin MEASUREMENT esKpTairTmp "Contributo per sovra-temperatura aria (senza offset nè ltd di derivata)" UWORD TE_TM_TorqBas4ms_CM_ufix16_En8_Bn100__ 0 0 -100 0 ECU_ADDRESS 0x400043A0 /end MEASUREMENT
/begin MEASUREMENT esKpTexhCtrl "[OUT] Kp proportional coefficient for exhaust temperature overheating" UWORD TE_TM_TorqBas4ms_CM_ufix16_En12___degC 0 0 0 15.9997558594 ECU_ADDRESS 0x4000439E /end MEASUREMENT
/begin MEASUREMENT esKpTexhTmp "Proportional contribute for exhaust temperature overheating" UWORD TE_TM_TorqBas4ms_CM_ufix16_En8_Bn100__ 0 0 -100 0 ECU_ADDRESS 0x4000439C /end MEASUREMENT
/begin MEASUREMENT esKpTh2oTmp "Contributo per sovra-temperatura acqua (senza offset nè ltd di derivata)" UWORD TE_TM_TorqBas4ms_CM_ufix16_En8_Bn100__ 0 0 -100 0 ECU_ADDRESS 0x4000439A /end MEASUREMENT
/begin MEASUREMENT esKpspeedCtrl "[OUT] Coefficiente del controllo proporzionale su errore di giri obiettivo PTO" UWORD TE_TM_SpeedCtrl_4ms_Symbol_CM_ufix16_En15___rpm 0 0 0 1.953125 ECU_ADDRESS 0x40004318 /end MEASUREMENT
/begin MEASUREMENT esKptH2OCtrl "[OUT] Coefficiente del controllo proporzionale su errore di giri obiettivo PTO" UWORD TE_TM_TorqBas4ms_CM_ufix16_En12___degC 0 0 0 15.9997558594 ECU_ADDRESS 0x40004398 /end MEASUREMENT
/begin MEASUREMENT esKptairCtrl "[OUT] Coefficiente del controllo proporzionale su errore di giri obiettivo PTO" UWORD TE_TM_TorqBas4ms_CM_ufix16_En12___degC 0 0 0 15.9997558594 ECU_ADDRESS 0x40004396 /end MEASUREMENT
/begin CHARACTERISTIC esLIM_UP_RPM_SPD "Massimo numero di giri per limitazione OverSpeed MF3 (limite High Idle endogeno)" VALUE 0xFCBE04 Scalar_UWORD 0 TE_TM_TorqBasCtrl4ms_Symbol_CM_uint16_rpm 0 10000 /end CHARACTERISTIC
/begin MEASUREMENT esLowHiObjEn "Flag che permette di passare come New HI Target esN_Ltd_HighIdle (1) o  esN_Ltd_HighIdle-Delta (2)" UBYTE TE_TM_TorqBasCtrl4ms_Symbol_CM_boolean_adm 0 0 0 1 ECU_ADDRESS 0x40004411 /end MEASUREMENT
/begin MEASUREMENT esLtdCounter "Contatore istantaneo banda Full-Load/Ltd/Hys" ULONG TE_TM_TorqBasCtrl4ms_Symbol_CM_uint32_4ms 0 0 0 900000 ECU_ADDRESS 0x40004494 /end MEASUREMENT
/begin MEASUREMENT esLtdOff_Mode "Flag on (1) if NO Speed and Torque Limitation is request" UBYTE Trqm_CtrlMgmt4ms_CM_boolean_adm 0 0 0 1 ECU_ADDRESS 0x40004286 /end MEASUREMENT
/begin MEASUREMENT esLtdSmoothDecr "Fattore di Smoothing 1 -> 0 per Ltd Full-Load" UWORD TE_TM_TorqBasCtrl4ms_Symbol_CM_ufix16_En10_adm 0 0 0 1 ECU_ADDRESS 0x40004440 /end MEASUREMENT
/begin MEASUREMENT esLtdSmoothDecrInt "Smoothing Factor 1 -> 0 on inherited Integral init" UWORD TE_TM_InitIntegrSpd4ms_Symbol_CM_ufix16_En10_adm 0 0 0 1 ECU_ADDRESS 0x400042D8 /end MEASUREMENT
/begin MEASUREMENT esLtdSmoothIncr "Fattore di Smoothing 0 -> 1 per Ltd Full-Load" UWORD TE_TM_TorqBasCtrl4ms_Symbol_CM_ufix16_En10_adm 0 0 0 1 ECU_ADDRESS 0x4000443E /end MEASUREMENT
/begin MEASUREMENT esLtd_FSM "Flag che indica lo stato di Ltd del Full-Load (1 = Ltd; 0 = Full-Load)" UBYTE TE_TM_TorqBasCtrl4ms_Symbol_CM_boolean_adm 0 0 0 1 ECU_ADDRESS 0x40004410 /end MEASUREMENT
/begin MEASUREMENT esMF3LtdTinj "Flag che indica se la MF3 sta limitando la coppia a causa del Tinj" UBYTE Trqm_CtrlMgmt4ms_CM_boolean_adm 0 0 0 1 ECU_ADDRESS 0x40004281 /end MEASUREMENT
/begin CHARACTERISTIC esMIN_DER_RPM_100MS "Minimo valore derivata giri calcolata ogni 100ms" VALUE 0xFCBEC6 Scalar_SWORD 0 TE_TM_TorqBasCtrl4ms_Symbol_CM_int16_rpm_s -200 0 /end CHARACTERISTIC
/begin MEASUREMENT esMaxPercCmuIstAbs "Limitazione superiore del feed-back di coppia (esogena ed endogena)" UWORD TE_TM_TorqCalcTDC_Symbol_CM_ufix16_En4__ 0 0 0 100 ECU_ADDRESS 0x400044F2 /end MEASUREMENT
/begin MEASUREMENT esMaxTinj "Tinj massimo programmabile agli attuali giri motore" UWORD TE_TM_TorqBas4ms_CM_ufix16_E4_us 0 0 0 65520 ECU_ADDRESS 0x40004394 /end MEASUREMENT
/begin MEASUREMENT esMinPercCmuIstAbs "Limitazione inferiore del feed-back di coppia (esogena ed endogena)" UWORD TE_TM_TorqCalcTDC_Symbol_CM_ufix16_En4__ 0 0 0 100 ECU_ADDRESS 0x400044F0 /end MEASUREMENT
/begin CHARACTERISTIC esNEW_DERATE_TH2O_EN "Abilitazione della nuovo derate proporzionale per temperatura" VALUE 0xFCB910 Scalar_BOOLEAN 0 TE_TM_TorqBas4ms_CM_boolean_adm 0 1 /end CHARACTERISTIC
/begin CHARACTERISTIC esNEW_TARGET_TYPE "Abilitazione al tipo di targer per regolazione HI (1: esN_Ltd_HighIdle; 2: RPM; 3: esN_Ltd_HighIdle or esN_Ltd_HighIdle_Low)" VALUE 0xFCBDD7 Scalar_UBYTE 0 TE_TM_TorqBasCtrl4ms_Symbol_CM_uint8_adm 1 3 /end CHARACTERISTIC
/begin MEASUREMENT esN_CoffPid "oglia di giri per evitare interferenze del Cut-Off" UWORD EgmdTDC_CM_uint16_rpm 0 0 0 10000 ECU_ADDRESS 0x400042CC /end MEASUREMENT
/begin MEASUREMENT esN_Ltd_HiFRLOld "Valore target di giri per High Idle old" ULONG TE_TM_TorqBasCtrl4ms_Symbol_CM_ufix32_Sp004_rpm 0 0 0 10000 ECU_ADDRESS 0x40004490 /end MEASUREMENT
/begin MEASUREMENT esN_Ltd_HighIdle "Valore massimo di giri (OverSpeed) per High Idle" UWORD Idle4ms_CM_uint16_rpm 0 0 0 10000 ECU_ADDRESS 0x400042CA /end MEASUREMENT
/begin MEASUREMENT esN_Ltd_HighIdle2 "Valore massimo di giri (OverSpeed) dinamico per High Idle" UWORD TE_TM_TorqBasCtrl4ms_Symbol_CM_uint16_rpm 0 0 0 10000 ECU_ADDRESS 0x4000443C /end MEASUREMENT
/begin MEASUREMENT esN_Ltd_HighIdleF "Valore massimo di giri (OverSpeed) per High Idle filtrato" UWORD TE_TM_TorqBasCtrl4ms_Symbol_CM_uint16_rpm 0 0 0 10000 ECU_ADDRESS 0x4000443A /end MEASUREMENT
/begin MEASUREMENT esNewTarget "Valore target di giri per High Idle non saturato" UWORD TE_TM_TorqBasCtrl4ms_Symbol_CM_uint16_rpm 0 0 0 10000 ECU_ADDRESS 0x40004438 /end MEASUREMENT
/begin CHARACTERISTIC esOV_TMP_PRE_WAR "Soglia di pre-warning per Engine Coolant (poi al msg CAN in Tx EDC2BC)" VALUE 0xFCB90E Scalar_UWORD 0 TE_TM_TorqBas4ms_CM_ufix16_Bn40_degC -40 140 /end CHARACTERISTIC
/begin CHARACTERISTIC esOV_TMP_WARNING "Soglia di warning per Engine Coolant (poi al msg CAN in Tx EDC2BC)" VALUE 0xFCB90C Scalar_UWORD 0 TE_TM_TorqBas4ms_CM_ufix16_Bn40_degC -40 140 /end CHARACTERISTIC
/begin CHARACTERISTIC esOV_T_LAMP_OFF_TIME "Soglia di tempo con motore avviato dopo la quale si abilita la segnalazione di sovratemperatura" VALUE 0xFCB90A Scalar_UWORD 0 TE_TM_TorqBas4ms_CM_uint16_sec 0 100 /end CHARACTERISTIC
/begin MEASUREMENT esOffNmInertPTOP "Testpoint percentuale di coppia equivalente a offset di potenza richiesta in feed-forward da PTO" UWORD TE_TM_SpeedCtrl_4ms_Symbol_CM_ufix16_En4__ 0 0 0 100 ECU_ADDRESS 0x40004316 /end MEASUREMENT
/begin MEASUREMENT esOffNm_InertPTO "Offset richiesto per PTO (in  Nm) in funzione della stiffness del Ctrl" UWORD TE_TM_SpeedCtrl_4ms_Symbol_CM_ufix16_En4_Nm 0 0 0 4095 ECU_ADDRESS 0x40004314 /end MEASUREMENT
/begin MEASUREMENT esP1IdleSpeed "Giri motore in Idle" UWORD J1939dl_Tx1s_CM_uint16_rpm 0 0 0 10000 ECU_ADDRESS 0x40004222 /end MEASUREMENT
/begin MEASUREMENT esP1PercCmu "Percentuale (relativa a esCmu_Max_AbsOut) di Coppia Erogata nel punto esP1IdleSpeed (Idle)" UWORD Idle4ms_CM_ufix16_En4__ 0 0 0 100 ECU_ADDRESS 0x40004216 /end MEASUREMENT
/begin MEASUREMENT esP2EndSpeedGov "Valore massimo dei giri a cui la Coppia Erogata non viene ancora tagliata" UWORD Boost_CtrlMgmt50ms_CM_uint16_rpm 0 0 0 10000 ECU_ADDRESS 0x40004228 /end MEASUREMENT
/begin MEASUREMENT esP2PercCmu "Valore percentuale (relativa a esCmu_Max_AbsOut) di Coppia Erogata nel punto esP2EndSpeedGov" UWORD J1939dl_Tx1s_CM_ufix16_En4__ 0 0 0 100 ECU_ADDRESS 0x4000421C /end MEASUREMENT
/begin MEASUREMENT esP3DownP4Speed "Giri motore superiori al punto esP1IdleSpeed (Idle) e inferiori a esP2EndSpeedGov" UWORD J1939dl_Tx1s_CM_uint16_rpm 0 0 0 10000 ECU_ADDRESS 0x40004220 /end MEASUREMENT
/begin MEASUREMENT esP3PercCmu "Valore percentuale (relativa a esCmu_Max_AbsOut) di Coppia Erogata nel punto esP3DownP4Speed" UWORD J1939dl_Tx1s_CM_ufix16_En4__ 0 0 0 100 ECU_ADDRESS 0x40004214 /end MEASUREMENT
/begin CHARACTERISTIC esP3_DOWN_P4_SPE "Giri motore superiori al punto esP1IdleSpeed (Idle) e inferiori a esP2EndSpeedGov" VALUE 0xFCB6D4 Scalar_UWORD 0 TE_TM_TorqCnfg1s_CM_uint16_rpm 0 10000 /end CHARACTERISTIC
/begin MEASUREMENT esP4DownP5Speed "Giri motore superiori al punto esP3DownP4Speed e inferiori a esP2EndSpeedGov" UWORD J1939dl_Tx1s_CM_uint16_rpm 0 0 0 10000 ECU_ADDRESS 0x40004224 /end MEASUREMENT
/begin MEASUREMENT esP4PercCmu "Valore percentuale (relativa a esCmu_Max_AbsOut) di Coppia Erogata nel punto esP4DownP5Speed" UWORD J1939dl_Tx1s_CM_ufix16_En4__ 0 0 0 100 ECU_ADDRESS 0x40004218 /end MEASUREMENT
/begin CHARACTERISTIC esP4_DOWN_P5_SPE "Giri motore superiori al punto esP3DownP4Speed e inferiori a esP2EndSpeedGov" VALUE 0xFCB6D2 Scalar_UWORD 0 TE_TM_TorqCnfg1s_CM_uint16_rpm 0 10000 /end CHARACTERISTIC
/begin MEASUREMENT esP5DownEndSpeed "Giri di motore superiori al punto esP4PercCmu e inferiori a esP2EndSpeedGov" UWORD Boost_CtrlMgmt50ms_CM_uint16_rpm 0 0 0 10000 ECU_ADDRESS 0x40004226 /end MEASUREMENT
/begin MEASUREMENT esP5PercCmu "Valore percentuale (relativa a esCmu_Max_AbsOut) di Coppia Erogata nel punto esP5DownEndSpeed" UWORD J1939dl_Tx1s_CM_ufix16_En4__ 0 0 0 100 ECU_ADDRESS 0x4000421A /end MEASUREMENT
/begin CHARACTERISTIC esP5_DOWN_ENDSPE "Giri di motore superiori al punto esP4PercCme e inferiori a esP2EndSpeedGov" VALUE 0xFCB6D0 Scalar_UWORD 0 TE_TM_TorqCnfg1s_CM_uint16_rpm 0 10000 /end CHARACTERISTIC
/begin MEASUREMENT esP6GainEndSpeed "Valore della pendenza della retta che raccorda la Coppia (=0) nel punto esP6HighIdle con la esP6RefEngCmu" UWORD J1939dl_Tx1s_CM_ufix16_En10___rpm 0 0 0 50.2 ECU_ADDRESS 0x4000420C /end MEASUREMENT
/begin MEASUREMENT esP6HighIdle "Valore dei giri superiore a esP2EndSpeedGov, in cui la Coppia Erogata è nulla" UWORD J1939dl_Tx1s_CM_uint16_rpm 0 0 0 10000 ECU_ADDRESS 0x4000422A /end MEASUREMENT
/begin MEASUREMENT esP6PercCmu "Percentuale di massima coppia disponibile nel punto di High Idle" UWORD Trqm_CtrlMgmt1s_CM_ufix16_En4__ 0 0 0 100 ECU_ADDRESS 0x40004212 /end MEASUREMENT
/begin MEASUREMENT esP6RefEngCmu "Coppia Erogata di riferimento per il guadagno esP6GainEndSpeed" UWORD DiagSym100ms_CM_ufix16_En4_N_m 0 0 0 4095 ECU_ADDRESS 0x4000421E /end MEASUREMENT
/begin MEASUREMENT esP7MaxTimeOverS "Tempo massimo per cui è lecito che i giri motore raggiungano il valore esP7MomOverspeed " UWORD J1939dl_Tx1s_CM_ufix16_En10_s 0 0 0.00390625 10 ECU_ADDRESS 0x4000420E /end MEASUREMENT
/begin MEASUREMENT esP7MomOverspeed "Valore di giri superiore a esP6HighIdle, per temporaneo fuorigiri (es. in cambio marcia), in cui la Coppia Erogata è nulla" UWORD J1939dl_Tx1s_CM_uint16_rpm 0 0 0 10000 ECU_ADDRESS 0x4000422C /end MEASUREMENT
/begin CHARACTERISTIC esPW_MECHPTO_ENG "Offset in kW assorbiti dalla PTO meccanica accoppiata (info Mech PTO Engaged da CAN)" VALUE 0xFCBA3C Scalar_UWORD 0 TE_TM_SpeedCtrl_4ms_Symbol_CM_ufix16_En4_kW 0 256 /end CHARACTERISTIC
/begin MEASUREMENT esPerCmuAbsNoLtd "Percentuale di Cmu assoluta calcolata dalla Qair misurata" UWORD TE_TM_TorqCalcTDC_Symbol_CM_ufix16_En4__ 0 0 0 125 ECU_ADDRESS 0x400044EE /end MEASUREMENT
/begin MEASUREMENT esPercCmfIstAbs "ttuale percentuale (relativa a esCme_Max_AbsOut) di Coppia di Friction del motore" SWORD J1939dl_Tx100ms_CM_sfix16_En4__ 0 0 -125 125 ECU_ADDRESS 0x400044AC /end MEASUREMENT
/begin MEASUREMENT esPercCmfIstRel "ttuale percentuale relativa (riferita a esCmuMaxAval) di Coppia di Friction del motore" SWORD Trqm_CtrlMgmtTDC_CM_sfix16_En4__ 0 0 -125 125 ECU_ADDRESS 0x400044AA /end MEASUREMENT
/begin MEASUREMENT esPercCmuInfComb "Coppia (percentuale di Cmu_Max) limite inferiore per garantire la combustione / evitare di risucchiare olio dai cilindri" UWORD TE_TM_TorqCalcTDC_Symbol_CM_ufix16_En4__ 0 0 0 100 ECU_ADDRESS 0x400044EC /end MEASUREMENT
/begin MEASUREMENT esPercCmuIstAbs "Attuale percentuale Assoluta (rif. a esCmu_Max_AbsOut) di Coppia Erogata dal motore" SWORD DiagSym100ms_CM_sfix16_En4__ 0 0 -125 125 ECU_ADDRESS 0x400044B0 /end MEASUREMENT
/begin MEASUREMENT esPercCmuIstAbs4Seen "alore istantaneo finale (percentuale di Cmu_Max) di Coppia Interna (Cmu) massima programmata" UWORD Thrp_Mgmt50ms_CM_ufix16_En4__ 0 0 0 100 ECU_ADDRESS 0x400044A4 /end MEASUREMENT
/begin MEASUREMENT esPercCmuIstAbsFbk "Feed back di coppia (Cmu) intermedio (li. a 100% ma senza limitazioni esogene)" UWORD TE_TM_TorqCalcTDC_Symbol_CM_ufix16_En4__ 0 0 0 100 ECU_ADDRESS 0x400044EA /end MEASUREMENT
/begin MEASUREMENT esPercCmuIstAbsProgr "Percentuale di Coppia (assoluta) programmata non limitata" UWORD Trqm_CtrlMgmtTDC_CM_ufix16_En4__ 0 0 0 125 ECU_ADDRESS 0x400044A6 /end MEASUREMENT
/begin MEASUREMENT esPercCmuIstAbsReal "Percentuale di Coppia (assoluta) misurata non limitata" UWORD J1939dl_Tx50ms_CM_ufix16_En4__ 0 0 0 125 ECU_ADDRESS 0x400044A8 /end MEASUREMENT
/begin MEASUREMENT esPercCmuIstRel "Attuale percentuale Relativa (rif. a esCmu_Max_Aval) di Coppia Erogata dal motore" SWORD DiagSym100ms_CM_sfix16_En4__ 0 0 -125 125 ECU_ADDRESS 0x400044AE /end MEASUREMENT
/begin MEASUREMENT esPercCmuReqMgm "Richiesta (percentuale di Coppia Erogata) da VCM (obiettivo di giri o di coppia) verso MF3" UWORD DiagSym100ms_CM_ufix16_En4__ 0 0 0 100 ECU_ADDRESS 0x400042C2 /end MEASUREMENT
/begin MEASUREMENT esPercCmuReq_Tmp "Coppia Cmu Assoluta o equivalente a Giri Obj, richiesti da esterno via CAN" UWORD TE_TM_TorqBas4ms_CM_ufix16_En4__ 0 0 0 100 ECU_ADDRESS 0x40004392 /end MEASUREMENT
/begin MEASUREMENT esPtoPwOff "[OUT] Offset per potenza assorbita dalla PTO (funzione della richiesta esterna di stiffness del Crtl PID)" UWORD TE_TM_SpeedCtrl_4ms_Symbol_CM_ufix16_En4_kW 0 0 0 256 ECU_ADDRESS 0x40004312 /end MEASUREMENT
/begin MEASUREMENT esPw_Ist "Potenza istantanea (kW) erogata (clutch) dal motore" UWORD Trqm_CtrlMgmtTDC_CM_ufix16_En2_kW 0 0 0 1024 ECU_ADDRESS 0x400044A2 /end MEASUREMENT
/begin CHARACTERISTIC esQAIR_DEV_STD "Deviazione standard (3 sigma) sulla esQAIR_MAX_REF" VALUE 0xFCC57E Scalar_UWORD 0 TE_TM_TorqCalcTDC_Symbol_CM_ufix16_En3_Bn4095_mg_cc -4095 4095 /end CHARACTERISTIC
/begin MEASUREMENT esQAir2CmuConv "[OUT] Conversione da massa di aria (mgcc) a Coppia Utile (Nm) potenziale" UWORD TE_TM_TorqBasCtrl4ms_Symbol_CM_ufix16_En8_Nm_mgcc 0 0 0 10 ECU_ADDRESS 0x40004436 /end MEASUREMENT
/begin MEASUREMENT esQAirMaxRef "[OUT] Equivalente di eference Air Flow (mg/cc) for Torque % determination" UWORD TE_TM_TorqBasCtrl4ms_Symbol_CM_ufix16_En3_mg_cc 0 0 0.125 8191 ECU_ADDRESS 0x40004434 /end MEASUREMENT
/begin MEASUREMENT esQAir_Request "Richiesta di aria calcolata nel ramo lento della Coppia" UWORD EgrMgm4ms_CM_ufix16_En4_kg_h 0 0 0 3200 ECU_ADDRESS 0x400042AC /end MEASUREMENT
/begin MEASUREMENT esQAir_Request_tmp "Richiesta di aria calcolata nel ramo lento della Coppia (pre Engine Brake Limitation)" UWORD Trqm_CtrlMgmt4ms_CM_ufix16_En4_kg_h 0 0 0 3200 ECU_ADDRESS 0x40004276 /end MEASUREMENT
/begin MEASUREMENT esQairCrank "[OUT] Mappa di aria minima per il cranking" UWORD TE_TM_TorqBasCtrl4ms_Symbol_CM_ufix16_En4_kg_h 0 0 0 512 ECU_ADDRESS 0x40004432 /end MEASUREMENT
/begin MEASUREMENT esQairDashpot "[OUT] Qair intorno alla zona di Low Idle" UWORD TE_TM_TorqBasCtrl4ms_Symbol_CM_ufix16_En4_kg_h 0 0 0 512 ECU_ADDRESS 0x40004430 /end MEASUREMENT
/begin MEASUREMENT esQairLimCOff "[OUT] Limite inferiore - in Cut Off - per aria calcolata dal ramo lento" UWORD TE_TM_TorqBasCtrl4ms_Symbol_CM_ufix16_En4_kg_h 0 0 0 512 ECU_ADDRESS 0x4000442E /end MEASUREMENT
/begin MEASUREMENT esQairLimCOffEngBrk "[OUT] Limite inferiore - in Cut Off quando attiva gestione Engine Brake tramite attuatore- per aria calcolata dal ramo lento" UWORD Trqm_CtrlMgmt4ms_CM_ufix16_En4_kg_h 0 0 0 512 ECU_ADDRESS 0x40004274 /end MEASUREMENT
/begin MEASUREMENT esQairReqInfDef "ria minima di combustione / depressione per evitare di aspirare olio nei cilindri" UWORD Trqm_CtrlMgmt4ms_CM_ufix16_En4_kg_h 0 0 0 512 ECU_ADDRESS 0x4000429A /end MEASUREMENT
/begin MEASUREMENT esQairReqInfDef_tmp "Aria minima di combustione / depressione per evitare di aspirare olio nei cilindri (pre Engine Brake Limitation)" UWORD Trqm_CtrlMgmt4ms_CM_ufix16_En4_kg_h 0 0 0 512 ECU_ADDRESS 0x40004272 /end MEASUREMENT
/begin MEASUREMENT esQair_MaxAbsOut "ria in mg/cc nel punto di coppia massima esCmu_Max_AbsOut" UWORD Boost_CtrlMgmt50ms_CM_ufix16_En3_mg_cc 0 0 0.125 8191 ECU_ADDRESS 0x40004290 /end MEASUREMENT
/begin MEASUREMENT esQminHighIdle "[OUT] Aria di trafilamento in High Idle" UWORD TE_TM_TorqBasCtrl4ms_Symbol_CM_ufix16_En4_kg_h 0 0 0 150 ECU_ADDRESS 0x4000442C /end MEASUREMENT
/begin CHARACTERISTIC esRAPP_COMPRES_FL "Rapporto di compressione- Valore uguale ad asRAPP_COMPRES" VALUE 0xFC9CBA Scalar_UWORD 0 TE_MAirReqATDC_Symbol_CM_ufix16_En8_adm 1 32 /end CHARACTERISTIC
/begin CHARACTERISTIC esRATIO_RAMPDOWN "Frazione (da 0 a 0.99) di esTimeCounter per effettuare il Ramp-down alla Ltd" VALUE 0xFCBE02 Scalar_UWORD 0 TE_TM_TorqBasCtrl4ms_Symbol_CM_ufix16_En10_adm 0 0.9990234375 /end CHARACTERISTIC
/begin CHARACTERISTIC esRATIO_RAMPUP "Frazione (da 0 a 0.99) di esTimeCounter per effettuare il Ramp-up al Full-Load" VALUE 0xFCBE00 Scalar_UWORD 0 TE_TM_TorqBasCtrl4ms_Symbol_CM_ufix16_En10_adm 0 0.9990234375 /end CHARACTERISTIC
/begin CHARACTERISTIC esREF_CURVE_LTD_HYS "Isteresi sulla curva di limitazione della strategia di Full-Load" VALUE 0xFCBDFE Scalar_UWORD 0 TE_TM_TorqBasCtrl4ms_Symbol_CM_ufix16_En4__ 0 100 /end CHARACTERISTIC
/begin MEASUREMENT esRPM1_rif_dinam "Giri obiettivo statico PTO filtrato" UWORD TE_TM_SpeedCtrl_4ms_Symbol_CM_uint16_rpm 0 0 0 10000 ECU_ADDRESS 0x40004310 /end MEASUREMENT
/begin MEASUREMENT esRPM_Advance "Predizione di giri in High Idle" UWORD TE_TM_TorqBasCtrl4ms_Symbol_CM_uint16_rpm 0 0 0 10000 ECU_ADDRESS 0x4000442A /end MEASUREMENT
/begin CHARACTERISTIC esRPM_TARGET_THR "Calibrazione per scegliere di definire le zone a diversa pendenza con i giri (1) 0 il target al passo precedente (0)" VALUE 0xFCBDD6 Scalar_BOOLEAN 0 TE_TM_TorqBasCtrl4ms_Symbol_CM_boolean_adm 0 1 /end CHARACTERISTIC
/begin MEASUREMENT esRPM_kW_to_Nm "onversione run-time da kW a Nm in base al regime" UWORD Idle4ms_CM_ufix16_En6_ks 0 0 0 1023 ECU_ADDRESS 0x4000428E /end MEASUREMENT
/begin MEASUREMENT esRampDownCounter "Counter step (4ms) di Ramp-down da Full-Load a Ltd" UWORD TE_TM_TorqBasCtrl4ms_Symbol_CM_uint16_4ms 0 0 0 60000 ECU_ADDRESS 0x40004428 /end MEASUREMENT
/begin MEASUREMENT esRampUpCounter "Counter step (4ms) di Ramp-up da Ltd a Full-Load" UWORD TE_TM_TorqBasCtrl4ms_Symbol_CM_uint16_4ms 0 0 0 60000 ECU_ADDRESS 0x40004426 /end MEASUREMENT
/begin MEASUREMENT esRappComprVva "apporto di compressione in funzionamento VVA" UWORD Airq_CtrlMgmtTDC_CM_ufix16_En8_adm 0 0 1 32 ECU_ADDRESS 0x4000374A /end MEASUREMENT
/begin MEASUREMENT esRatioVel2Rem "Rapporto fra velocità veicolo e giri motore" UWORD TE_TM_TorqBasCtrl4ms_Symbol_CM_ufix16_En10_m_n 0 0 0 8 ECU_ADDRESS 0x40004424 /end MEASUREMENT
/begin MEASUREMENT esReCmuAll "Richiesta di Coppia grezza (senza limitazioni) in percentuale (riferita alla Cmu_Max)" UWORD Trqm_CtrlMgmt4ms_CM_ufix16_En4__ 0 0 0 100 ECU_ADDRESS 0x400042BA /end MEASUREMENT
/begin MEASUREMENT esRePerCmuIdDef "Richiesta interna di percentuale ci Cmu equivalente per Idle" UWORD Trqm_CtrlMgmt4ms_CM_ufix16_En4__ 0 0 0 100 ECU_ADDRESS 0x400042BE /end MEASUREMENT
/begin MEASUREMENT esRefCurveConf "[OUT] Curva di riferimento del motore (percentuale di Cmu) dichiarata per la configurazione (CAN msg Tx ENG_CONF)" UWORD TE_TM_TorqBasCtrl4ms_Symbol_CM_ufix16_En4__ 0 0 0 100 ECU_ADDRESS 0x40004422 /end MEASUREMENT
/begin MEASUREMENT esRefCurveConf1 "[OUT] Curva di riferimento del motore (percentuale di Cmu) dichiarata per la configurazione (CAN msg Tx ENG_CONF)" UWORD TE_TM_TorqCnfg1s_CM_ufix16_En4__ 0 0 0 100 ECU_ADDRESS 0x40004258 /end MEASUREMENT
/begin MEASUREMENT esRefCurveConf2 "[OUT] Curva di riferimento del motore (percentuale di Cmu) dichiarata per la configurazione (CAN msg Tx ENG_CONF)" UWORD TE_TM_TorqCnfg1s_CM_ufix16_En4__ 0 0 0 100 ECU_ADDRESS 0x40004256 /end MEASUREMENT
/begin MEASUREMENT esRefCurveConf3 "[OUT] Curva di riferimento del motore (percentuale di Cmu) dichiarata per la configurazione (CAN msg Tx ENG_CONF)" UWORD TE_TM_TorqCnfg1s_CM_ufix16_En4__ 0 0 0 100 ECU_ADDRESS 0x40004254 /end MEASUREMENT
/begin MEASUREMENT esRefCurveConf4 "[OUT] Curva di riferimento del motore (percentuale di Cmu) dichiarata per la configurazione (CAN msg Tx ENG_CONF)" UWORD TE_TM_TorqCnfg1s_CM_ufix16_En4__ 0 0 0 100 ECU_ADDRESS 0x40004252 /end MEASUREMENT
/begin MEASUREMENT esRefCurveConf5 "[OUT] Curva di riferimento del motore (percentuale di Cmu) dichiarata per la configurazione (CAN msg Tx ENG_CONF)" UWORD TE_TM_TorqCnfg1s_CM_ufix16_En4__ 0 0 0 100 ECU_ADDRESS 0x40004250 /end MEASUREMENT
/begin MEASUREMENT esRefCurveConf6 "[OUT] Curva di riferimento del motore (percentuale di Cmu) dichiarata per la configurazione (CAN msg Tx ENG_CONF)" UWORD TE_TM_TorqCnfg1s_CM_ufix16_En4__ 0 0 0 100 ECU_ADDRESS 0x4000424E /end MEASUREMENT
/begin MEASUREMENT esRefCurveConf7 "[OUT] Curva di riferimento del motore (percentuale di Cmu) dichiarata per la configurazione (CAN msg Tx ENG_CONF)" UWORD TE_TM_TorqCnfg1s_CM_ufix16_En4__ 0 0 0 100 ECU_ADDRESS 0x4000424C /end MEASUREMENT
/begin MEASUREMENT esRefCurveConfNoLtd "alore istantaneo (percentuale di Cmu_Max) di Coppia Interna (Cmu) massima dichiarata per il motore (non limitata)" UWORD Trqm_CtrlMgmt4ms_CM_ufix16_En4__ 0 0 0 100 ECU_ADDRESS 0x4000429E /end MEASUREMENT
/begin MEASUREMENT esRefCurveConfig "Percentuale istantanea di Cmu (Mas Abs) disponibile al regime attuale" UWORD Boost_CtrlMgmt50ms_CM_ufix16_En4__ 0 0 0 100 ECU_ADDRESS 0x400042A0 /end MEASUREMENT
/begin MEASUREMENT esRefCurveLtdHys "Soglia inferiore per la coppia richiesta per cambiare stato nella FSM della limitazione al Full-Load" UWORD TE_TM_TorqBasCtrl4ms_Symbol_CM_ufix16_En4__ 0 0 0 100 ECU_ADDRESS 0x40004420 /end MEASUREMENT
/begin MEASUREMENT esRefCurveLtdLongTerm "Valore finale della curva di limitazione del Full-Load" UWORD TE_TM_TorqBasCtrl4ms_Symbol_CM_ufix16_En4__ 0 0 0 100 ECU_ADDRESS 0x4000441E /end MEASUREMENT
/begin MEASUREMENT esRefCurveLtdShortTerm "Valore istantaneo della curva di limitazione del Full-Load" UWORD TE_TM_TorqBasCtrl4ms_Symbol_CM_ufix16_En4__ 0 0 0 100 ECU_ADDRESS 0x4000441C /end MEASUREMENT
/begin MEASUREMENT esRefCurveLtdTemp "[OUT] Curva di riferimento del motore (percentuale di Cmu) di derate temporizzato (protezione termica della turbo)" UWORD TE_TM_TorqBasCtrl4ms_Symbol_CM_ufix16_En4__ 0 0 0 100 ECU_ADDRESS 0x4000441A /end MEASUREMENT
/begin MEASUREMENT esReqCmWinsHI "Flag che indica che la richiesta di coppia vince sul Ctrl di High Idle " UBYTE TE_TM_TorqBasCtrl4ms_Symbol_CM_boolean_adm 0 0 0 1 ECU_ADDRESS 0x4000440F /end MEASUREMENT
/begin MEASUREMENT esResetKd "[OUT] Tabella zone di reset del KD" UWORD TE_TM_SpeedCtrl_4ms_Symbol_CM_uint16_adm 0 0 0 1 ECU_ADDRESS 0x4000430E /end MEASUREMENT
/begin MEASUREMENT esRpmErrLimF "Errore su Target rispetto al Target limitato" SWORD TE_TM_SpeedCtrl_4ms_Symbol_CM_int16_rpm 0 0 -3000 3000 ECU_ADDRESS 0x40004332 /end MEASUREMENT
/begin MEASUREMENT esRpmObDynForced "Target filtrato e forzato" UWORD TE_TM_SpeedCtrl_4ms_Symbol_CM_uint16_rpm 0 0 0 3000 ECU_ADDRESS 0x4000430C /end MEASUREMENT
/begin CHARACTERISTIC esSTEP_DW_1 "Step negativo di giri per raccordo in High Idle nella fascia 1 vicino al limite di velocità" VALUE 0xFCBDFC Scalar_UWORD 0 TE_TM_TorqBasCtrl4ms_Symbol_CM_ufix16_Sp004_rpm 0 15 /end CHARACTERISTIC
/begin CHARACTERISTIC esSTEP_DW_2 "Step negativo di giri per raccordo in High Idle nella fascia 2 vicino al limite di velocità" VALUE 0xFCBDFA Scalar_UWORD 0 TE_TM_TorqBasCtrl4ms_Symbol_CM_ufix16_Sp004_rpm 0 15 /end CHARACTERISTIC
/begin CHARACTERISTIC esSTEP_DW_3 "Step negativo di giri per raccordo in High Idle nella fascia 3 vicino al limite di velocità" VALUE 0xFCBDF8 Scalar_UWORD 0 TE_TM_TorqBasCtrl4ms_Symbol_CM_ufix16_Sp004_rpm 0 15 /end CHARACTERISTIC
/begin CHARACTERISTIC esSTEP_DW_NEUTR "Step negativo di giri per raccordo in High Idle neutro" VALUE 0xFCBDF6 Scalar_UWORD 0 TE_TM_TorqBasCtrl4ms_Symbol_CM_ufix16_Sp004_rpm 0 15 /end CHARACTERISTIC
/begin CHARACTERISTIC esSTEP_LIM_DELTA_HI "Step di decremento del limite inferiore sul delta High Idle" VALUE 0xFCBDF4 Scalar_UWORD 0 TE_TM_TorqBasCtrl4ms_Symbol_CM_ufix16_Sp004_rpm 0 15 /end CHARACTERISTIC
/begin CHARACTERISTIC esSTEP_OVERTARGET "Numero di passi (4ms) per raccordo tra Rpm e Target statico da un sovraregime" VALUE 0xFCBA3A Scalar_UWORD 0 TE_TM_SpeedCtrl_4ms_Symbol_CM_uint16_4ms 0 4800 /end CHARACTERISTIC
/begin CHARACTERISTIC esSTEP_UNDERTARGET "Numero di passi (4ms) per raccordo tra Rpm e Target statico da un sottoregime" VALUE 0xFCBA38 Scalar_UWORD 0 TE_TM_SpeedCtrl_4ms_Symbol_CM_uint16_4ms 0 4800 /end CHARACTERISTIC
/begin CHARACTERISTIC esSTEP_UP_1 "Step positivo di giri per raccordo in High Idle nella fascia 1 vicino al limite di velocità" VALUE 0xFCBDF2 Scalar_UWORD 0 TE_TM_TorqBasCtrl4ms_Symbol_CM_ufix16_Sp004_rpm 0 15 /end CHARACTERISTIC
/begin CHARACTERISTIC esSTEP_UP_2 "Step positivo di giri per raccordo in High Idle nella fascia 2 vicino al limite di velocità" VALUE 0xFCBDF0 Scalar_UWORD 0 TE_TM_TorqBasCtrl4ms_Symbol_CM_ufix16_Sp004_rpm 0 15 /end CHARACTERISTIC
/begin CHARACTERISTIC esSTEP_UP_3 "Step positivo di giri per raccordo in High Idle nella fascia 3 vicino al limite di velocità" VALUE 0xFCBDEE Scalar_UWORD 0 TE_TM_TorqBasCtrl4ms_Symbol_CM_ufix16_Sp004_rpm 0 15 /end CHARACTERISTIC
/begin CHARACTERISTIC esSTEP_UP_NEUTR "Step positivo di giri per raccordo in High Idle neutro" VALUE 0xFCBDEC Scalar_UWORD 0 TE_TM_TorqBasCtrl4ms_Symbol_CM_ufix16_Sp004_rpm 0 15 /end CHARACTERISTIC
/begin CHARACTERISTIC esSWITCH_SMOOTH_TOT "Linear Smoothing Counter on OL <-> CL switch " VALUE 0xFC9CB8 Scalar_UWORD 0 TE_MAirReqATDC_Symbol_CM_uint16_adm 1 1000 /end CHARACTERISTIC
/begin CHARACTERISTIC esSW_AWUP_S_HI "Switch fra Anti-WindUpSup-HI scelto fra Richiesta di coppia (1) o Curva massima (0)" VALUE 0xFCBDD5 Scalar_BOOLEAN 0 TE_TM_TorqBasCtrl4ms_Symbol_CM_boolean_adm 0 1 /end CHARACTERISTIC
/begin CHARACTERISTIC esSW_FDBCKT_PROGR2REAL "Switch per feed-back di coppia da programmata (0) a reale (1) misurata" VALUE 0xFCC57C Scalar_BOOLEAN 0 TE_TM_TorqCalcTDC_Symbol_CM_boolean_adm 0 1 /end CHARACTERISTIC
/begin CHARACTERISTIC esSW_FFW_STATIC "Enable FFW static vs. kW pre-set PTO" VALUE 0xFCBA34 Scalar_BOOLEAN 0 TE_TM_SpeedCtrl_4ms_Symbol_CM_boolean_adm 0 1 /end CHARACTERISTIC
/begin CHARACTERISTIC esSW_REF_REQ_CMU "Switch per usare la richiesta di coppia (0 = req intermedia; 1 = req. finale) nella strategia di limitazione del Full-Load" VALUE 0xFCBDD4 Scalar_BOOLEAN 0 TE_TM_TorqBasCtrl4ms_Symbol_CM_boolean_adm 0 1 /end CHARACTERISTIC
/begin MEASUREMENT esS_Ctrl_M_FSM "Flag che attivare il calcolo del contributo di coppia equivalente ai giri obiettivo richiesti" UBYTE TE_TM_TorqBas4ms_CM_uint8_adm 0 0 0 1 ECU_ADDRESS 0x40004390 /end MEASUREMENT
/begin MEASUREMENT esSpd2PerCmeTst "Richiesta di Giri tradotta dal PID in percentuale (di Cme in qsto pto del calcolo)" SWORD TE_TM_SpeedCtrl_4ms_Symbol_CM_sfix16_En4__ 0 0 -100 100 ECU_ADDRESS 0x40004330 /end MEASUREMENT
/begin MEASUREMENT esSpdCtrl2EngMod "Controllo di Giri efficace attivo" UBYTE Airq4ms_CM_boolean_adm 0 0 0 1 ECU_ADDRESS 0x40004280 /end MEASUREMENT
/begin MEASUREMENT esSpdReqVCMFiltT "Giri obiettivo del PID filtrati (raccordo graduale)" UWORD TE_TM_SpeedCtrl_4ms_Symbol_CM_uint16_rpm 0 0 0 10000 ECU_ADDRESS 0x4000430A /end MEASUREMENT
/begin MEASUREMENT esSpeedCtrlStiffness "Selettore del Ctrl PID (morbido o nervoso)" UBYTE TE_TM_SpeedCtrl_4ms_Symbol_CM_uint8_adm 0 0 1 8 ECU_ADDRESS 0x40004300 /end MEASUREMENT
/begin MEASUREMENT esSpeedRedMF3_On "Flag che indica se è attiva la limitazione interna di giri da MF3" UBYTE Idle4ms_CM_boolean_adm 0 0 0 1 ECU_ADDRESS 0x4000427A /end MEASUREMENT
/begin MEASUREMENT esSpeedRedVCM_On "lag che indica se è attiva la limitazione interna di giri da VCM" UBYTE Idle4ms_CM_boolean_adm 0 0 0 1 ECU_ADDRESS 0x4000427B /end MEASUREMENT
/begin MEASUREMENT esSpeedReqVCMPercCmu "Percentuale di massima coppia disponibile nel punto di target di giri" UWORD Trqm_CtrlMgmt1s_CM_ufix16_En4__ 0 0 0 100 ECU_ADDRESS 0x40004210 /end MEASUREMENT
/begin MEASUREMENT esSpeed_Ctrl_Mod "Flag che indica controllo di velocità attivo" UBYTE Boost_CtrlMgmt50ms_CM_boolean_adm 0 0 0 1 ECU_ADDRESS 0x40004285 /end MEASUREMENT
/begin MEASUREMENT esSpeed_Err_Int "Integrale errore di giri" SLONG TE_TM_SpeedCtrl_4ms_Symbol_CM_sfix32_En11_rpm_s 0 0 -7.2001953125 7.2001953125 ECU_ADDRESS 0x4000433C /end MEASUREMENT
/begin MEASUREMENT esSpeed_ErrorTst "Errore sui giri obiettivo" SWORD TE_TM_SpeedCtrl_4ms_Symbol_CM_int16_rpm 0 0 -1800 1800 ECU_ADDRESS 0x4000432E /end MEASUREMENT
/begin MEASUREMENT esSpeed_Req_Per "Richiesta (percentuale di Coppia Utile) dal controllo di giri verso il Torque Manager" UWORD Trqm_CtrlMgmt4ms_CM_ufix16_En4__ 0 0 0 100 ECU_ADDRESS 0x400042B6 /end MEASUREMENT
/begin MEASUREMENT esSpeed_Req_Perc_OL "Actual Open Loop value of PTO engine speed control" UWORD Trqm_CtrlMgmt4ms_CM_ufix16_En4__ 0 0 0 100 ECU_ADDRESS 0x400042B2 /end MEASUREMENT
/begin MEASUREMENT esStepDw_NewTarget "Step negativo di giri per raccordo in High Idle" UWORD TE_TM_TorqBasCtrl4ms_Symbol_CM_ufix16_Sp004_rpm 0 0 0 15 ECU_ADDRESS 0x40004418 /end MEASUREMENT
/begin MEASUREMENT esStepUp_NewTarget "Step positivo di giri per raccordo in High Idle" UWORD TE_TM_TorqBasCtrl4ms_Symbol_CM_ufix16_Sp004_rpm 0 0 0 15 ECU_ADDRESS 0x40004416 /end MEASUREMENT
/begin MEASUREMENT esStiffnessOff "[OUT] Offset Stifness richiesta al Ctrl PID (funzione della PTO State da CAN)" UWORD TE_TM_SpeedCtrl_4ms_Symbol_CM_ufix16_En4__ 0 0 0 100 ECU_ADDRESS 0x40004308 /end MEASUREMENT
/begin MEASUREMENT esSysGainCToil "[OUT]  " UWORD TE_TM_SpeedCtrl_4ms_Symbol_CM_ufix16_En10_adm 0 0 0 10 ECU_ADDRESS 0x40004306 /end MEASUREMENT
/begin MEASUREMENT esSysGainGearc "[OUT]  " UWORD TE_TM_SpeedCtrl_4ms_Symbol_CM_ufix16_En10_adm 0 0 0 10 ECU_ADDRESS 0x40004304 /end MEASUREMENT
/begin MEASUREMENT esSysGainSpeedCtrl "Gain su parte di closed loop (netta) del Controllo di Giri in funzione di Gear e Toil" UWORD Trqm_CtrlMgmt4ms_CM_ufix16_En10_adm 0 0 0 10 ECU_ADDRESS 0x40004298 /end MEASUREMENT
/begin MEASUREMENT esT720Tinj "T720 computation for injection derate" ULONG TE_TM_TorqBas4ms_CM_uint32_us 0 0 0 1040000 ECU_ADDRESS 0x4000438C /end MEASUREMENT
/begin CHARACTERISTIC esTAIR_INF_LTD "Limite inferiore di limitazione percentuale della coppia Max per Tair troppo calda" VALUE 0xFCB908 Scalar_UWORD 0 TE_TM_TorqBas4ms_CM_ufix16_En8__ 0 100 /end CHARACTERISTIC
/begin CHARACTERISTIC esTEXH_DERATE_EN "Exhaust temperature derate strategy enable" VALUE 0xFCB906 Scalar_BOOLEAN 0 TE_TM_TorqBas4ms_CM_boolean_adm 0 1 /end CHARACTERISTIC
/begin CHARACTERISTIC esTEXH_INF_LTD "Percentage torque lower limit for exhaust temperature overheating " VALUE 0xFCB904 Scalar_UWORD 0 TE_TM_TorqBas4ms_CM_ufix16_En8__ 0 100 /end CHARACTERISTIC
/begin CHARACTERISTIC esTEXH_PRE_WARNING "Exhaust temperature Pre-Warning threshold " VALUE 0xFCB902 Scalar_UWORD 0 TE_TM_TorqBas4ms_CM_ufix16_Bn40_degC -40 1000 /end CHARACTERISTIC
/begin CHARACTERISTIC esTEXH_WARNING "Exhaust temperature Warning threshold " VALUE 0xFCB900 Scalar_UWORD 0 TE_TM_TorqBas4ms_CM_ufix16_Bn40_degC -40 1000 /end CHARACTERISTIC
/begin CHARACTERISTIC esTH2O_INF_LTD "Limite inferiore di limitazione percentuale della coppia Max per Tair troppo calda" VALUE 0xFCB8FE Scalar_UWORD 0 TE_TM_TorqBas4ms_CM_ufix16_En8__ 0 100 /end CHARACTERISTIC
/begin CHARACTERISTIC esTIME_MOM_OVERS "Tempo massimo per cui è lecito che i giri motore raggiungano il valore esP7MomOverspeed" VALUE 0xFCB6CE Scalar_UWORD 0 TE_TM_TorqCnfg1s_CM_ufix16_En10_s 0.00390625 10 /end CHARACTERISTIC
/begin MEASUREMENT esT_Ctrl_M_FSM "Flag che attiva la richiesta di coppia (anzichè la richiesta di coppia equivalente ai giri obiettivo)" UBYTE TE_TM_TorqBas4ms_CM_uint8_adm 0 0 1 2 ECU_ADDRESS 0x4000438A /end MEASUREMENT
/begin MEASUREMENT esTexhOverTemp "Exhaust temperature severity state" UBYTE J1939dl_Tx100ms_CM_uint8_adm 0 0 0 2 ECU_ADDRESS 0x4000428B /end MEASUREMENT
/begin MEASUREMENT esTh2oInfLtd "[OUT] Limite inferiore derate per temperatura (acqua/aria)" UWORD TE_TM_TorqBas4ms_CM_ufix16_En4__ 0 0 0 100 ECU_ADDRESS 0x40004388 /end MEASUREMENT
/begin MEASUREMENT esTimeCounter "Nr. di step (4ms) equivalente al Time delay per Ltd del Full-Load" ULONG TE_TM_TorqBasCtrl4ms_Symbol_CM_uint32_4ms 0 0 0 900000 ECU_ADDRESS 0x4000448C /end MEASUREMENT
/begin MEASUREMENT esTimeHeat "Time delay per Ltd del Full-Load" UWORD TE_TM_TorqBasCtrl4ms_Symbol_CM_uint16_s 0 0 0 3600 ECU_ADDRESS 0x40004414 /end MEASUREMENT
/begin MEASUREMENT esTorqModeTst "Engine Torque Mode FSM per One-Box" UBYTE TE_TM_TorqBasCtrl4ms_Symbol_CM_uint8_adm 0 0 0 15 ECU_ADDRESS 0x4000440E /end MEASUREMENT
/begin MEASUREMENT esTorqWinsAgainstSpd "orque wins on Speed request" UBYTE Trqm_CtrlMgmt4ms_CM_boolean_adm 0 0 0 1 ECU_ADDRESS 0x4000427D /end MEASUREMENT
/begin MEASUREMENT esTorqueReqExt "Richiesta esterna di coppia (in %)" UWORD Thrp4ms_CM_ufix16_En4__ 0 0 0 100 ECU_ADDRESS 0x400042BC /end MEASUREMENT
/begin MEASUREMENT esTrigObjFilForced "Contatore per lo smoothing tra Rpm e Target statico" UWORD TE_TM_SpeedCtrl_4ms_Symbol_CM_ufix16_En10_adm 0 0 0 1 ECU_ADDRESS 0x40004302 /end MEASUREMENT
/begin CHARACTERISTIC esVCYL_UNIT_REF "Vcyl Calibration. Single Cylinder Volume." VALUE 0xFC9CB6 Scalar_UWORD 0 TE_MAirReqATDC_Symbol_CM_ufix16_En4_cc 0 4095 /end CHARACTERISTIC
/begin MEASUREMENT esVCyl_Eff "Effective Single Cylinder Volume" UWORD Airq_CtrlMgmtTDC_CM_ufix16_En4_cc 0 0 0 4095 ECU_ADDRESS 0x40003752 /end MEASUREMENT
/begin CHARACTERISTIC esVEH_LTD_THR1 "Soglia 1 di avvicinamento a obiettivo giri per limitazione velocità veicolo" VALUE 0xFCBDEA Scalar_UWORD 0 TE_TM_TorqBasCtrl4ms_Symbol_CM_uint16_rpm 0 1000 /end CHARACTERISTIC
/begin CHARACTERISTIC esVEH_LTD_THR2 "Soglia 2 di avvicinamento a obiettivo giri per limitazione velocità veicolo" VALUE 0xFCBDE8 Scalar_UWORD 0 TE_TM_TorqBasCtrl4ms_Symbol_CM_uint16_rpm 0 1000 /end CHARACTERISTIC
/begin CHARACTERISTIC esVOL_CAM_COMB "Volume camera di combustione" VALUE 0xFC9CB4 Scalar_UWORD 0 TE_MAirReqATDC_Symbol_CM_ufix16_En4_cc 1 4095 /end CHARACTERISTIC
/begin MEASUREMENT esVVAThrottleLowLim "Lower Trhottle Limitation for Fi2 Activation" UWORD MairTDC_CM_uint16__ 0 0 0 100 ECU_ADDRESS 0x4000375C /end MEASUREMENT
/begin CHARACTERISTIC esVVA_FINJ3_SHIF "Fi2 to FInj Shift. Delta on Injection timing (due to mode 4 or 5) to deliver the fuel into the cylinder when the valve is opened." VALUE 0xFC9CB2 Scalar_UWORD 0 TE_MAirReqATDC_Symbol_CM_ufix16_En4_degree 0 720 /end CHARACTERISTIC
/begin CHARACTERISTIC esVVA_IGNT3_SHIF "Fi2 to Delta Advance Ignition Shift. Delta on Ingnition Spark Advance (due to mode 4 or 5) to burn correctly the fuel into the combustion chamber in the cylinder." VALUE 0xFC9CEA Scalar_SWORD 0 TE_MAirReqATDC_Symbol_CM_sfix16_En4_degree -20 20 /end CHARACTERISTIC
/begin CHARACTERISTIC esVVA_THROT_INF "Lower Trhottle Limitation for Fi2 Activation" VALUE 0xFC9CB0 Scalar_UWORD 0 TE_MAirReqATDC_Symbol_CM_uint16__ 0 100 /end CHARACTERISTIC
/begin MEASUREMENT esValvModIdTbTst "Valore intyerpolato dalla tabaella con isteresi etVALV_MOD_ID" UBYTE TE_MAirReqATDC_Symbol_CM_uint8_adm 0 0 0 4 ECU_ADDRESS 0x4000377A /end MEASUREMENT
/begin MEASUREMENT esValveModeId "alve mode identifier" UBYTE MairTDC_CM_uint8_adm 0 0 0 255 ECU_ADDRESS 0x40003749 /end MEASUREMENT
/begin MEASUREMENT esVehicCmuOff "FW for PTO mode-stiffness" UWORD Idle4ms_CM_ufix16_En4__ 0 0 0 100 ECU_ADDRESS 0x400042B0 /end MEASUREMENT
/begin MEASUREMENT esVvaFinj1Shif "[OUT] Fi1 to FInj Shift. Delta on Injection timing (due to Fi1) to deliver the fuel into the cylinder when the valve is opened." UWORD TE_MAirReqATDC_Symbol_CM_ufix16_En4_degree 0 0 0 720 ECU_ADDRESS 0x40003780 /end MEASUREMENT
/begin MEASUREMENT esVvaFinj2Shif "[OUT] Fi2 to FInj Shift. Delta on Injection timing (due to Fi2) to deliver the fuel into the cylinder when the valve is opened." UWORD TE_MAirReqATDC_Symbol_CM_ufix16_En4_degree 0 0 0 720 ECU_ADDRESS 0x4000377E /end MEASUREMENT
/begin MEASUREMENT esVvaIgnt1Shif "[OUT] Fi1 to Delta Advance Ignition Shift. Delta on Ingnition Spark Advance (due to Fi1) to burn correctly the fuel into the combustion chamber in the cylinder." SWORD TE_MAirReqATDC_Symbol_CM_sfix16_En4_degree 0 0 -20 20 ECU_ADDRESS 0x4000378A /end MEASUREMENT
/begin MEASUREMENT esVvaIgnt2Shif "[OUT] Fi2 to Delta Advance Ignition Shift. Delta on Ingnition Spark Advance (due to Fi2) to burn correctly the fuel into the combustion chamber in the cylinder." SWORD TE_MAirReqATDC_Symbol_CM_sfix16_En4_degree 0 0 -20 20 ECU_ADDRESS 0x40003788 /end MEASUREMENT
/begin CHARACTERISTIC etANG_VVA_EC_OBJ "Fi2 calibration. Fi2 required closing angle for Early Closing Actuation." MAP 0xFC9FE6 Lookup2DSF_UWORD 0 TE_MAirReqATDC_Symbol_CM_ufix16_En4_degE 0 4095
 /begin AXIS_DESCR COM_AXIS NO_INPUT_QUANTITY TE_MAirReqATDC_Symbol_CM_uint16_rpm 8 0 10000 AXIS_PTS_REF ekANG_VVA_ECOBJN /end AXIS_DESCR
 /begin AXIS_DESCR COM_AXIS NO_INPUT_QUANTITY TE_MAirReqATDC_Symbol_CM_ufix16_En4_kg_h 8 0 3200 AXIS_PTS_REF ekANG_VVA_ECOBJE /end AXIS_DESCR
/end CHARACTERISTIC
/begin CHARACTERISTIC etANG_VVA_LO_OBJ "Fi1 calibration. Fi1 required angle for Late Opening Actuation." MAP 0xFC9F66 Lookup2DSF_UWORD 0 TE_MAirReqATDC_Symbol_CM_ufix16_En4_degE 0 4095
 /begin AXIS_DESCR COM_AXIS NO_INPUT_QUANTITY TE_MAirReqATDC_Symbol_CM_uint16_rpm 8 0 10000 AXIS_PTS_REF ekANG_VVA_LOOBJN /end AXIS_DESCR
 /begin AXIS_DESCR COM_AXIS NO_INPUT_QUANTITY TE_MAirReqATDC_Symbol_CM_ufix16_En4_kg_h 8 0 3200 AXIS_PTS_REF ekANG_VVA_LOOBJE /end AXIS_DESCR
/end CHARACTERISTIC
/begin CHARACTERISTIC etCMU2QAIR_OBJ "Tabella di conversione della Coppia Utile obiettivo in Aria sul ramo lento" MAP 0xFCC23E Lookup2DSF_UWORD 0 TE_TM_TorqBasCtrl4ms_Symbol_CM_ufix16_En4_kg_h 0 4095
 /begin AXIS_DESCR COM_AXIS NO_INPUT_QUANTITY TE_TM_TorqBasCtrl4ms_Symbol_CM_uint16_rpm 12 0 10000 AXIS_PTS_REF ekCMU2QAIR_OBJRP /end AXIS_DESCR
 /begin AXIS_DESCR COM_AXIS NO_INPUT_QUANTITY TE_TM_TorqBasCtrl4ms_Symbol_CM_ufix16_En4_N_m 12 0 4095 AXIS_PTS_REF ekCMU2QAIR_OBJCM /end AXIS_DESCR
/end CHARACTERISTIC
/begin CHARACTERISTIC etDERATE_TH2O "Richiesta di riduzione percentuale di performance (derating per temperatura acqua)" MAP 0xFCB89E Lookup2D_UWORD 0 TE_TM_TorqBas4ms_CM_ufix16_En4__ 0 100
 /begin AXIS_DESCR COM_AXIS NO_INPUT_QUANTITY TE_TM_TorqBas4ms_CM_uint16_rpm 8 0 10000 AXIS_PTS_REF ekDERATE_RPM_X /end AXIS_DESCR
 /begin AXIS_DESCR COM_AXIS NO_INPUT_QUANTITY TE_TM_TorqBas4ms_CM_ufix16_Bn40_degC 6 -40 140 AXIS_PTS_REF ekDERATE_TH2O_Y /end AXIS_DESCR
/end CHARACTERISTIC
/begin CHARACTERISTIC etKDSPEED_CTRL "Coefficiente del controllo derivativo RPM sui giri obiettivo PTO" MAP 0xFCBC34 Lookup2DSF_UWORD 0 TE_TM_SpeedCtrl_4ms_Symbol_CM_ufix16_En15___s_on_rpm 0 1.953125
 /begin AXIS_DESCR COM_AXIS NO_INPUT_QUANTITY TE_TM_SpeedCtrl_4ms_Symbol_CM_ufix16_Bn1800_rpm 7 -1800 1800 AXIS_PTS_REF ekKDSPEED_CTRL_E /end AXIS_DESCR
 /begin AXIS_DESCR COM_AXIS NO_INPUT_QUANTITY TE_TM_SpeedCtrl_4ms_Symbol_CM_uint16_rpm 6 0 10000 AXIS_PTS_REF ekKDSPEED_CTRL_N /end AXIS_DESCR
/end CHARACTERISTIC
/begin CHARACTERISTIC etKD_CTRL_HI "Contributo derivativo del Ctrl PID di High Idle" MAP 0xFCC1EA Lookup2DSF_UWORD 0 TE_TM_TorqBasCtrl4ms_Symbol_CM_ufix16_En15___s_rpm 0 1.953125
 /begin AXIS_DESCR COM_AXIS NO_INPUT_QUANTITY TE_TM_TorqBasCtrl4ms_Symbol_CM_ufix16_Bn1800_rpm 7 -1800 1800 AXIS_PTS_REF ekKD_CTRL_NERR /end AXIS_DESCR
 /begin AXIS_DESCR COM_AXIS NO_INPUT_QUANTITY TE_TM_TorqBasCtrl4ms_Symbol_CM_uint16_rpm 6 0 10000 AXIS_PTS_REF ekKD_CTRL_NLDT /end AXIS_DESCR
/end CHARACTERISTIC
/begin CHARACTERISTIC etKI1_ANTIW_UP_H "AntiWindUp superiore del KI" MAP 0xFCBC02 Lookup2DSF_UWORD 0 TE_TM_SpeedCtrl_4ms_Symbol_CM_ufix16_En4__ 0 100
 /begin AXIS_DESCR COM_AXIS NO_INPUT_QUANTITY TE_TM_SpeedCtrl_4ms_Symbol_CM_ufix16_Bn32000_rpm_s 5 -32000 32000 AXIS_PTS_REF ekKI1ANTIWUPH_DN /end AXIS_DESCR
 /begin AXIS_DESCR COM_AXIS NO_INPUT_QUANTITY TE_TM_SpeedCtrl_4ms_Symbol_CM_ufix16_Bn1800_rpm 5 -1800 1800 AXIS_PTS_REF ekKI1ANTIWUPH_EN /end AXIS_DESCR
/end CHARACTERISTIC
/begin CHARACTERISTIC etKI1_ANTIW_UP_L "AntiWindUp inferiore del KI" MAP 0xFCBDA2 Lookup2DSF_WORD 0 TE_TM_SpeedCtrl_4ms_Symbol_CM_sfix16_En4__ -100 0
 /begin AXIS_DESCR COM_AXIS NO_INPUT_QUANTITY TE_TM_SpeedCtrl_4ms_Symbol_CM_ufix16_Bn32000_rpm_s 5 -32000 32000 AXIS_PTS_REF ekKI1ANTIWUPL_DN /end AXIS_DESCR
 /begin AXIS_DESCR COM_AXIS NO_INPUT_QUANTITY TE_TM_SpeedCtrl_4ms_Symbol_CM_ufix16_Bn1800_rpm 5 -1800 1800 AXIS_PTS_REF ekKI1ANTIWUPL_EN /end AXIS_DESCR
/end CHARACTERISTIC
/begin CHARACTERISTIC etKISPEED_CTRL "Coefficiente del controllo integrale su errore di giri obiettivo PTO" MAP 0xFCBBAE Lookup2DSF_UWORD 0 TE_TM_SpeedCtrl_4ms_Symbol_CM_ufix16_En15___s_on_rpm 0 1.953125
 /begin AXIS_DESCR COM_AXIS NO_INPUT_QUANTITY TE_TM_SpeedCtrl_4ms_Symbol_CM_ufix16_Bn1800_rpm 7 -1800 1800 AXIS_PTS_REF ekKISPEED_CTRL_E /end AXIS_DESCR
 /begin AXIS_DESCR COM_AXIS NO_INPUT_QUANTITY TE_TM_SpeedCtrl_4ms_Symbol_CM_uint16_rpm 6 0 10000 AXIS_PTS_REF ekKISPEED_CTRL_N /end AXIS_DESCR
/end CHARACTERISTIC
/begin CHARACTERISTIC etKI_CTRL_HI "Contributo integrale del Ctrl PID di High Idle" MAP 0xFCC196 Lookup2DSF_UWORD 0 TE_TM_TorqBasCtrl4ms_Symbol_CM_ufix16_En15___rpm 0 1.953125
 /begin AXIS_DESCR COM_AXIS NO_INPUT_QUANTITY TE_TM_TorqBasCtrl4ms_Symbol_CM_ufix16_Bn1800_rpm 7 -1800 1800 AXIS_PTS_REF ekKI_CTRL_HI_NERR /end AXIS_DESCR
 /begin AXIS_DESCR COM_AXIS NO_INPUT_QUANTITY TE_TM_TorqBasCtrl4ms_Symbol_CM_uint16_rpm 6 0 10000 AXIS_PTS_REF ekKI_CTRL_HI_NLTD /end AXIS_DESCR
/end CHARACTERISTIC
/begin CHARACTERISTIC etKNOCK_CTRL_TASP "Tabella su Aria Aspirata per degrado Anticipo accensione in Knock Ctrl" MAP 0xFCC136 Lookup2DSF_UWORD 0 TE_TM_TorqBasCtrl4ms_Symbol_CM_ufix16_En4_degE 0 50
 /begin AXIS_DESCR COM_AXIS NO_INPUT_QUANTITY TE_TM_TorqBasCtrl4ms_Symbol_CM_ufix16_En10_adm 6 0 3 AXIS_PTS_REF ekKNOCK_CTRL_ETASP /end AXIS_DESCR
 /begin AXIS_DESCR COM_AXIS NO_INPUT_QUANTITY TE_TM_TorqBasCtrl4ms_Symbol_CM_ufix16_Bn40_degC 8 -40 140 AXIS_PTS_REF ekKNOCK_CTRL_TAIR /end AXIS_DESCR
/end CHARACTERISTIC
/begin CHARACTERISTIC etKNOCK_CTRL_THSP "Tabella su Punto Motore per degrado Anticipo accensione in Knock Ctrl" MAP 0xFCC0D6 Lookup2DSF_UWORD 0 TE_TM_TorqBasCtrl4ms_Symbol_CM_ufix16_En4_degE 0 50
 /begin AXIS_DESCR COM_AXIS NO_INPUT_QUANTITY TE_TM_TorqBasCtrl4ms_Symbol_CM_ufix16_En10_adm 6 0 3 AXIS_PTS_REF ekKNOCK_CTRL_SP /end AXIS_DESCR
 /begin AXIS_DESCR COM_AXIS NO_INPUT_QUANTITY TE_TM_TorqBasCtrl4ms_Symbol_CM_ufix16_Bn40_degC 8 -40 140 AXIS_PTS_REF ekKNOCK_CTRL_TH20 /end AXIS_DESCR
/end CHARACTERISTIC
/begin CHARACTERISTIC etKPSPEED_CTRL "Coefficiente del controllo proporzionale su errore di giri obiettivo PTO" MAP 0xFCBB5A Lookup2DSF_UWORD 0 TE_TM_SpeedCtrl_4ms_Symbol_CM_ufix16_En15___rpm 0 1.953125
 /begin AXIS_DESCR COM_AXIS NO_INPUT_QUANTITY TE_TM_SpeedCtrl_4ms_Symbol_CM_ufix16_Bn1800_rpm 7 -1800 1800 AXIS_PTS_REF ekKPSPEED_CTRL_E /end AXIS_DESCR
 /begin AXIS_DESCR COM_AXIS NO_INPUT_QUANTITY TE_TM_SpeedCtrl_4ms_Symbol_CM_uint16_rpm 6 0 10000 AXIS_PTS_REF ekKPSPEED_CTRL_N /end AXIS_DESCR
/end CHARACTERISTIC
/begin CHARACTERISTIC etKPTAIR_CTRL "[FIX] Proportional coefficient Kp for exhaust temperature overheating" MAP 0xFCB84A Lookup2D_UWORD 0 TE_TM_TorqBas4ms_CM_ufix16_En12___degC 0 15.9997558594
 /begin AXIS_DESCR COM_AXIS NO_INPUT_QUANTITY TE_TM_TorqBas4ms_CM_uint16_degC 7 0 100 AXIS_PTS_REF ekKPTAIR_CTRL_E /end AXIS_DESCR
 /begin AXIS_DESCR COM_AXIS NO_INPUT_QUANTITY TE_TM_TorqBas4ms_CM_uint16_rpm 6 0 10000 AXIS_PTS_REF ekKPTAIR_CTRL_T /end AXIS_DESCR
/end CHARACTERISTIC
/begin CHARACTERISTIC etKPTEXH_CTRL "Proportional coefficient Kp for exhaust temperature overheating  " MAP 0xFCB7F6 Lookup2D_UWORD 0 TE_TM_TorqBas4ms_CM_ufix16_En12___degC 0 15.9997558594
 /begin AXIS_DESCR COM_AXIS NO_INPUT_QUANTITY TE_TM_TorqBas4ms_CM_uint16_degC 7 0 100 AXIS_PTS_REF ekKPTEXH_CTRL_E /end AXIS_DESCR
 /begin AXIS_DESCR COM_AXIS NO_INPUT_QUANTITY TE_TM_TorqBas4ms_CM_uint16_rpm 6 0 10000 AXIS_PTS_REF ekKPTEXH_CTRL_T /end AXIS_DESCR
/end CHARACTERISTIC
/begin CHARACTERISTIC etKPTH2O_CTRL "Coefficiente del controllo proporzionale su errore di giri obiettivo PTO" MAP 0xFCB7A2 Lookup2D_UWORD 0 TE_TM_TorqBas4ms_CM_ufix16_En12___degC 0 15.9997558594
 /begin AXIS_DESCR COM_AXIS NO_INPUT_QUANTITY TE_TM_TorqBas4ms_CM_uint16_degC 7 0 100 AXIS_PTS_REF ekKPTH2O_CTRL_E /end AXIS_DESCR
 /begin AXIS_DESCR COM_AXIS NO_INPUT_QUANTITY TE_TM_TorqBas4ms_CM_uint16_rpm 6 0 10000 AXIS_PTS_REF ekKPTH2O_CTRL_T /end AXIS_DESCR
/end CHARACTERISTIC
/begin CHARACTERISTIC etKP_CTRL_HI "Contributo proporzionale del Ctrl PID di High Idle" MAP 0xFCC082 Lookup2DSF_UWORD 0 TE_TM_TorqBasCtrl4ms_Symbol_CM_ufix16_En15___rpm 0 1.953125
 /begin AXIS_DESCR COM_AXIS NO_INPUT_QUANTITY TE_TM_TorqBasCtrl4ms_Symbol_CM_ufix16_Bn1800_rpm 7 -1800 1800 AXIS_PTS_REF ekKP_CTRL_HI_NERR /end AXIS_DESCR
 /begin AXIS_DESCR COM_AXIS NO_INPUT_QUANTITY TE_TM_TorqBasCtrl4ms_Symbol_CM_uint16_rpm 6 0 10000 AXIS_PTS_REF ekKP_CTRL_HI_NLTD /end AXIS_DESCR
/end CHARACTERISTIC
/begin CHARACTERISTIC etQAIR_CRANK "Mappa di aria minima per il cranking" MAP 0xFCC042 Lookup2DSF_UWORD 0 TE_TM_TorqBasCtrl4ms_Symbol_CM_ufix16_En4_kg_h 0 512
 /begin AXIS_DESCR COM_AXIS NO_INPUT_QUANTITY TE_TM_TorqBasCtrl4ms_Symbol_CM_ufix16_Bn40_degC 4 -40 130 AXIS_PTS_REF ekQAIR_CRANK_T /end AXIS_DESCR
 /begin AXIS_DESCR COM_AXIS NO_INPUT_QUANTITY TE_TM_TorqBasCtrl4ms_Symbol_CM_uint16_rpm 8 0 10000 AXIS_PTS_REF ekQAIR_CRANK_N /end AXIS_DESCR
/end CHARACTERISTIC
/begin CHARACTERISTIC etQAIR_DASHPOT "Qair intorno alla zona di Low Idle" MAP 0xFCC002 Lookup2DSF_UWORD 0 TE_TM_TorqBasCtrl4ms_Symbol_CM_ufix16_En4_kg_h 0 512
 /begin AXIS_DESCR COM_AXIS NO_INPUT_QUANTITY TE_TM_TorqBasCtrl4ms_Symbol_CM_ufix16_Bn40_degC 4 -40 130 AXIS_PTS_REF ekQAIR_DASHPOT_T /end AXIS_DESCR
 /begin AXIS_DESCR COM_AXIS NO_INPUT_QUANTITY TE_TM_TorqBasCtrl4ms_Symbol_CM_uint16_rpm 8 0 10000 AXIS_PTS_REF ekQAIR_DASHPOT_N /end AXIS_DESCR
/end CHARACTERISTIC
/begin CHARACTERISTIC etRESET_KD "Tabella zone di reset del KD" MAP 0xFCBB48 Lookup2DSF_UWORD 0 TE_TM_SpeedCtrl_4ms_Symbol_CM_uint16_adm 0 1
 /begin AXIS_DESCR COM_AXIS NO_INPUT_QUANTITY TE_TM_SpeedCtrl_4ms_Symbol_CM_ufix16_Bn1_adm 3 -1 1 AXIS_PTS_REF ekRESET_KD_DERR /end AXIS_DESCR
 /begin AXIS_DESCR COM_AXIS NO_INPUT_QUANTITY TE_TM_SpeedCtrl_4ms_Symbol_CM_ufix16_Bn1_adm 3 -1 1 AXIS_PTS_REF ekRESET_KD_ERR /end AXIS_DESCR
/end CHARACTERISTIC
/begin CHARACTERISTIC etVVA_FINJ1_SHIF "Fi1 to FInj Shift. Delta on Injection timing (due to Fi1) to deliver the fuel into the cylinder when the valve is opened." MAP 0xFC9EE6 Lookup2DSF_UWORD 0 TE_MAirReqATDC_Symbol_CM_ufix16_En4_degree 0 720
 /begin AXIS_DESCR COM_AXIS NO_INPUT_QUANTITY TE_MAirReqATDC_Symbol_CM_uint16_rpm 8 0 10000 AXIS_PTS_REF ekVVA_FINJ1_S_N /end AXIS_DESCR
 /begin AXIS_DESCR COM_AXIS NO_INPUT_QUANTITY TE_MAirReqATDC_Symbol_CM_ufix16_En4_degE 8 0 4095 AXIS_PTS_REF ekVVA_FINJ1_SFI1 /end AXIS_DESCR
/end CHARACTERISTIC
/begin CHARACTERISTIC etVVA_FINJ2_SHIF "Fi2 to FInj Shift. Delta on Injection timing (due to Fi2) to deliver the fuel into the cylinder when the valve is opened." MAP 0xFC9E66 Lookup2DSF_UWORD 0 TE_MAirReqATDC_Symbol_CM_ufix16_En4_degree 0 720
 /begin AXIS_DESCR COM_AXIS NO_INPUT_QUANTITY TE_MAirReqATDC_Symbol_CM_uint16_rpm 8 0 10000 AXIS_PTS_REF ekVVA_FINJ2_S_N /end AXIS_DESCR
 /begin AXIS_DESCR COM_AXIS NO_INPUT_QUANTITY TE_MAirReqATDC_Symbol_CM_ufix16_En4_degE 8 0 4095 AXIS_PTS_REF ekVVA_FINJ2_SFI2 /end AXIS_DESCR
/end CHARACTERISTIC
/begin CHARACTERISTIC etVVA_IGNT1_SHIF "Fi1 to Delta Advance Ignition Shift. Delta on Ingnition Spark Advance (due to Fi1) to burn correctly the fuel into the combustion chamber in the cylinder." MAP 0xFCA1C6 Lookup2DSF_WORD 0 TE_MAirReqATDC_Symbol_CM_sfix16_En4_degree -20 20
 /begin AXIS_DESCR COM_AXIS NO_INPUT_QUANTITY TE_MAirReqATDC_Symbol_CM_uint16_rpm 8 0 10000 AXIS_PTS_REF ekVVA_IGNT1_S_N /end AXIS_DESCR
 /begin AXIS_DESCR COM_AXIS NO_INPUT_QUANTITY TE_MAirReqATDC_Symbol_CM_ufix16_En4_degE 8 0 4095 AXIS_PTS_REF ekVVA_IGNT1_SFI1 /end AXIS_DESCR
/end CHARACTERISTIC
/begin CHARACTERISTIC etVVA_IGNT2_SHIF "Fi2 to Delta Advance Ignition Shift. Delta on Ingnition Spark Advance (due to Fi2) to burn correctly the fuel into the combustion chamber in the cylinder." MAP 0xFCA146 Lookup2DSF_WORD 0 TE_MAirReqATDC_Symbol_CM_sfix16_En4_degree -20 20
 /begin AXIS_DESCR COM_AXIS NO_INPUT_QUANTITY TE_MAirReqATDC_Symbol_CM_uint16_rpm 8 0 10000 AXIS_PTS_REF ekVVA_IGNT2_S_N /end AXIS_DESCR
 /begin AXIS_DESCR COM_AXIS NO_INPUT_QUANTITY TE_MAirReqATDC_Symbol_CM_ufix16_En4_degE 8 0 4095 AXIS_PTS_REF ekVVA_IGNT2_SFI2 /end AXIS_DESCR
/end CHARACTERISTIC
/begin CHARACTERISTIC evAIR_COFF_ENGBRK "Limite inferiore - in Cut Off quando attiva strategia di Engine Brake tramite attuatore- per aria calcolata dal ramo lento" CURVE 0xFCB73C Lookup1D_UWORD 0 Trqm_CtrlMgmt4ms_CM_ufix16_En4_kg_h 0 512
 /begin AXIS_DESCR COM_AXIS NO_INPUT_QUANTITY Trqm_CtrlMgmt4ms_CM_uint16_rpm 8 0 10000 AXIS_PTS_REF ekAIR_COFF_ENGBRK /end AXIS_DESCR
/end CHARACTERISTIC
/begin CHARACTERISTIC evAIR_COFF_SMOOT "Limite inferiore - in Cut Off - per aria calcolata dal ramo lento" CURVE 0xFCBFF2 Lookup1D_UWORD 0 TE_TM_TorqBasCtrl4ms_Symbol_CM_ufix16_En4_kg_h 0 512
 /begin AXIS_DESCR COM_AXIS NO_INPUT_QUANTITY TE_TM_TorqBasCtrl4ms_Symbol_CM_uint16_rpm 8 0 10000 AXIS_PTS_REF ekAIR_COFF_SMOOT /end AXIS_DESCR
/end CHARACTERISTIC
/begin CHARACTERISTIC evDELAY_LTD_GAIN_PATM "Guadagno del ritardo limitazione Full-Load per PAtm" CURVE 0xFCBFE2 Lookup1D_UWORD 0 TE_TM_TorqBasCtrl4ms_Symbol_CM_ufix16_En10_adm 0 10
 /begin AXIS_DESCR COM_AXIS NO_INPUT_QUANTITY TE_TM_TorqBasCtrl4ms_Symbol_CM_uint16_mbar 8 150 1150 AXIS_PTS_REF ekDELAY_LTD_GAIN_PATM /end AXIS_DESCR
/end CHARACTERISTIC
/begin CHARACTERISTIC evDELAY_LTD_TH2O "Ritardo limitazione Full-Load per Th2o" CURVE 0xFCBFD2 Lookup1D_UWORD 0 TE_TM_TorqBasCtrl4ms_Symbol_CM_uint16_s 0 3600
 /begin AXIS_DESCR COM_AXIS NO_INPUT_QUANTITY TE_TM_TorqBasCtrl4ms_Symbol_CM_ufix16_Bn40_degC 8 -40 140 AXIS_PTS_REF ekDELAY_LTD_TH2O /end AXIS_DESCR
/end CHARACTERISTIC
/begin CHARACTERISTIC evDELTA_DERRPM_ADV_HI "Ulteriore delta giri di anticipo per ingresso in High Idle funzione della derivata di giri" CURVE 0xFCBFC8 Lookup1D_UWORD 0 TE_TM_TorqBasCtrl4ms_Symbol_CM_ufix16_Bn500_rpm -500 500
 /begin AXIS_DESCR COM_AXIS NO_INPUT_QUANTITY TE_TM_TorqBasCtrl4ms_Symbol_CM_ufix16_Bn32000_rpm_s 5 -32000 32000 AXIS_PTS_REF ekDERRPM_ADV_HI /end AXIS_DESCR
/end CHARACTERISTIC
/begin CHARACTERISTIC evEGT_MAX "Exhaust target max temperature beyond which derate is active" CURVE 0xFCB792 Lookup1D_UWORD 0 TE_TM_TorqBas4ms_CM_ufix16_Bn40_degC -40 10000
 /begin AXIS_DESCR COM_AXIS NO_INPUT_QUANTITY TE_TM_TorqBas4ms_CM_uint16_rpm 8 0 10000 AXIS_PTS_REF ekEGT_RPM /end AXIS_DESCR
/end CHARACTERISTIC
/begin CHARACTERISTIC evENG2CMF_N_IST "Coppia Resistente dovuta al movimento organico" CURVE 0xFCBFB0 Lookup1D_UWORD 0 TE_TM_TorqBasCtrl4ms_Symbol_CM_ufix16_En4_N_m 0 4095
 /begin AXIS_DESCR COM_AXIS NO_INPUT_QUANTITY TE_TM_TorqBasCtrl4ms_Symbol_CM_uint16_rpm 12 0 10000 AXIS_PTS_REF ekENG2CMF_N_IST /end AXIS_DESCR
/end CHARACTERISTIC
/begin CHARACTERISTIC evENG2CMF_P_IST "Coppia Resistente dovuta alla pressione del lubrificante" CURVE 0xFCBFA0 Lookup1D_UWORD 0 TE_TM_TorqBasCtrl4ms_Symbol_CM_ufix16_En4_N_m 0 4095
 /begin AXIS_DESCR COM_AXIS NO_INPUT_QUANTITY TE_TM_TorqBasCtrl4ms_Symbol_CM_uint16_mbar 8 250 6000 AXIS_PTS_REF ekENG2CMF_P_IPOI /end AXIS_DESCR
/end CHARACTERISTIC
/begin CHARACTERISTIC evENG2CMF_T_IST "Coppia Resistente dovuta alla viscosita del lubrificante" CURVE 0xFCBF90 Lookup1D_UWORD 0 TE_TM_TorqBasCtrl4ms_Symbol_CM_ufix16_En4_N_m 0 4095
 /begin AXIS_DESCR COM_AXIS NO_INPUT_QUANTITY TE_TM_TorqBasCtrl4ms_Symbol_CM_ufix16_Bn40_degC 8 -40 140 AXIS_PTS_REF ekENG2CMF_T_ITOI /end AXIS_DESCR
/end CHARACTERISTIC
/begin CHARACTERISTIC evETA2DADV "Curva (inversa della Curva Unica) che fornisce il delta anticipo sul ramo veloce della Coppia" CURVE 0xFCBF80 Lookup1D_UWORD 0 TE_TM_TorqBasCtrl4ms_Symbol_CM_ufix16_En4_degree 0 50
 /begin AXIS_DESCR COM_AXIS NO_INPUT_QUANTITY TE_TM_TorqBasCtrl4ms_Symbol_CM_ufix16_En8_adm 8 0.00390625 1 AXIS_PTS_REF ekETA2DADV_ETA /end AXIS_DESCR
/end CHARACTERISTIC
/begin CHARACTERISTIC evETA_D_ADV_ISTA "Curva Unica della efficienza del Ciclo Otto (Coppia Utile) in funzione del delta anticipo" CURVE 0xFCC5D0 Lookup1D_UWORD 0 TE_TM_TorqCalcTDC_Symbol_CM_ufix16_En8_adm 0.00390625 1
 /begin AXIS_DESCR COM_AXIS NO_INPUT_QUANTITY TE_TM_TorqCalcTDC_Symbol_CM_ufix16_En4_degree 8 0 50 AXIS_PTS_REF ekETA_D_ADV_IDA /end AXIS_DESCR
/end CHARACTERISTIC
/begin CHARACTERISTIC evETA_LAM_ISTA "Efficienza della Coppia Utile in funzione di lambda" CURVE 0xFCC5AE Lookup1D_UWORD 0 TE_TM_TorqCalcTDC_Symbol_CM_ufix16_En8_adm 0 1
 /begin AXIS_DESCR COM_AXIS NO_INPUT_QUANTITY TE_TM_TorqCalcTDC_Symbol_CM_ufix16_En8_adm 17 0 4 AXIS_PTS_REF ekETA_LAM_IST_L /end AXIS_DESCR
/end CHARACTERISTIC
/begin CHARACTERISTIC evFI2_TO_VCYL "Single Cylinder Volume varying with Fi2 actuation" CURVE 0xFC9E46 Lookup1D_UWORD 0 TE_MAirReqATDC_Symbol_CM_ufix16_En4_cc 0 4095
 /begin AXIS_DESCR COM_AXIS NO_INPUT_QUANTITY TE_MAirReqATDC_Symbol_CM_ufix16_En4_degE 16 0 4095 AXIS_PTS_REF ekFI2_TO_VCYL /end AXIS_DESCR
/end CHARACTERISTIC
/begin CHARACTERISTIC evGAIN_KI_HI "Guadagno su KI per Inerzia virtuale del veicolo" CURVE 0xFCBF6C Lookup1D_UWORD 0 TE_TM_TorqBasCtrl4ms_Symbol_CM_ufix16_En10_adm 0 10
 /begin AXIS_DESCR COM_AXIS NO_INPUT_QUANTITY TE_TM_TorqBasCtrl4ms_Symbol_CM_ufix16_En10_m_n 10 0 8 AXIS_PTS_REF ekGAIN_KI_HI /end AXIS_DESCR
/end CHARACTERISTIC
/begin CHARACTERISTIC evGAIN_KP_HI "Guadagno su KP per Inerzia virtuale del veicolo" CURVE 0xFCBF58 Lookup1D_UWORD 0 TE_TM_TorqBasCtrl4ms_Symbol_CM_ufix16_En10_adm 0 10
 /begin AXIS_DESCR COM_AXIS NO_INPUT_QUANTITY TE_TM_TorqBasCtrl4ms_Symbol_CM_ufix16_En10_m_n 10 0 8 AXIS_PTS_REF ekGAIN_KP_HI /end AXIS_DESCR
/end CHARACTERISTIC
/begin CHARACTERISTIC evGOV_HI_KI "High governor KI parameter set" CURVE 0xFCBF50 Lookup1D_UWORD 0 TE_TM_TorqBasCtrl4ms_Symbol_CM_ufix16_En10_adm 0 1
 /begin AXIS_DESCR COM_AXIS NO_INPUT_QUANTITY TE_TM_TorqBasCtrl4ms_Symbol_CM_uint16_adm 4 0 3 AXIS_PTS_REF ekGOV_HI_KI /end AXIS_DESCR
/end CHARACTERISTIC
/begin CHARACTERISTIC evGOV_HI_KP "High governor KP parameter set" CURVE 0xFCBF48 Lookup1D_UWORD 0 TE_TM_TorqBasCtrl4ms_Symbol_CM_ufix16_En10_adm 0 1
 /begin AXIS_DESCR COM_AXIS NO_INPUT_QUANTITY TE_TM_TorqBasCtrl4ms_Symbol_CM_uint16_adm 4 0 3 AXIS_PTS_REF ekGOV_HI_KP /end AXIS_DESCR
/end CHARACTERISTIC
/begin CHARACTERISTIC evHYS_N_CTRL_ADV "Anticipo di giri con cui si fa lo SWITCH da Torque a Speed Control" CURVE 0xFCB77E Lookup1D_UWORD 0 TE_TM_TorqBas4ms_CM_uint16_rpm 0 10000
 /begin AXIS_DESCR COM_AXIS NO_INPUT_QUANTITY TE_TM_TorqBas4ms_CM_ufix16_Bn32000_rpm_s 10 -32000 32000 AXIS_PTS_REF ekHYS_N_CTRLADVD /end AXIS_DESCR
/end CHARACTERISTIC
/begin CHARACTERISTIC evHYS_N_CTRL_TOR "Isteresi a salire (su rpm misurati) per spegnere il calcolo in background del contributo di coppia per giri obiettivo" CURVE 0xFCB76E Lookup1D_UWORD 0 TE_TM_TorqBas4ms_CM_uint16_rpm 0 10000
 /begin AXIS_DESCR COM_AXIS esDelta_TorqC_TS TE_TM_TorqBas4ms_CM_ufix16_En4__ 8 0 100 AXIS_PTS_REF ekHYS_N_CTRL_TOR /end AXIS_DESCR
/end CHARACTERISTIC
/begin CHARACTERISTIC evHYS_T_CTRL_TOR "Isteresi a salire (su % coppia richiesta rispetto a coppia calcolata per i giri) per passare a controllo di coppia" CURVE 0xFCB75E Lookup1D_UWORD 0 TE_TM_TorqBas4ms_CM_ufix16_En4__ 0 100
 /begin AXIS_DESCR COM_AXIS NO_INPUT_QUANTITY TE_TM_TorqBas4ms_CM_uint16_rpm 8 0 10000 AXIS_PTS_REF ekHYS_T_CTRL_T_N /end AXIS_DESCR
/end CHARACTERISTIC
/begin CHARACTERISTIC evKD_CC "KD in CC f(rpm_error)" CURVE 0xFCBB3A Lookup1D_UWORD 0 TE_TM_SpeedCtrl_4ms_Symbol_CM_ufix16_En15___s_on_rpm 0 1.953125
 /begin AXIS_DESCR COM_AXIS NO_INPUT_QUANTITY TE_TM_SpeedCtrl_4ms_Symbol_CM_ufix16_Bn1800_rpm 7 -1800 1800 AXIS_PTS_REF ekKD_CC /end AXIS_DESCR
/end CHARACTERISTIC
/begin CHARACTERISTIC evKD_GAININERTIA "Variazione del KD in funzione delle richieste di stiffness del Crtl PID" CURVE 0xFCBB2A Lookup1D_UWORD 0 TE_TM_SpeedCtrl_4ms_Symbol_CM_ufix16_En10_adm 0 10
 /begin AXIS_DESCR COM_AXIS NO_INPUT_QUANTITY TE_TM_SpeedCtrl_4ms_Symbol_CM_uint16_adm 8 1 8 AXIS_PTS_REF ekKD_GAININERTIA /end AXIS_DESCR
/end CHARACTERISTIC
/begin CHARACTERISTIC evKF_OBT_HI_UP "Ulteriore delta giri di anticipo per ingresso in High Idle funzione della derivata di giri" CURVE 0xFCBF3E Lookup1D_UWORD 0 TE_TM_TorqBasCtrl4ms_Symbol_CM_ufix16_En15_adm 0 1
 /begin AXIS_DESCR COM_AXIS NO_INPUT_QUANTITY TE_TM_TorqBasCtrl4ms_Symbol_CM_ufix16_Bn1000_rpm_s 5 -1000 1000 AXIS_PTS_REF ekDERRPM_KF_HI_UP /end AXIS_DESCR
/end CHARACTERISTIC
/begin CHARACTERISTIC evKI_CC "KI in CC f(rpm_error)" CURVE 0xFCBB1C Lookup1D_UWORD 0 TE_TM_SpeedCtrl_4ms_Symbol_CM_ufix16_En15___on_s_rpm 0 1.953125
 /begin AXIS_DESCR COM_AXIS NO_INPUT_QUANTITY TE_TM_SpeedCtrl_4ms_Symbol_CM_ufix16_Bn1800_rpm 7 -1800 1800 AXIS_PTS_REF ekKI_CC /end AXIS_DESCR
/end CHARACTERISTIC
/begin CHARACTERISTIC evKI_GAININERTIA "Variazione del KI in funzione delle richieste di stiffness del Crtl PID" CURVE 0xFCBB0C Lookup1D_UWORD 0 TE_TM_SpeedCtrl_4ms_Symbol_CM_ufix16_En10_adm 0 10
 /begin AXIS_DESCR COM_AXIS NO_INPUT_QUANTITY TE_TM_SpeedCtrl_4ms_Symbol_CM_uint16_adm 8 1 8 AXIS_PTS_REF ekKI_GAININERTIA /end AXIS_DESCR
/end CHARACTERISTIC
/begin CHARACTERISTIC evKP_CC "KP in CC f(rpm_error)" CURVE 0xFCBAFE Lookup1D_UWORD 0 TE_TM_SpeedCtrl_4ms_Symbol_CM_ufix16_En15___rpm 0 1.99996948242
 /begin AXIS_DESCR COM_AXIS NO_INPUT_QUANTITY TE_TM_SpeedCtrl_4ms_Symbol_CM_ufix16_Bn1800_rpm 7 -1800 1800 AXIS_PTS_REF ekKP_CC /end AXIS_DESCR
/end CHARACTERISTIC
/begin CHARACTERISTIC evKP_GAININERTIA "Variazione del KP in funzione delle richieste di stiffness del Crtl PID" CURVE 0xFCBAEE Lookup1D_UWORD 0 TE_TM_SpeedCtrl_4ms_Symbol_CM_ufix16_En10_adm 0 10
 /begin AXIS_DESCR COM_AXIS NO_INPUT_QUANTITY TE_TM_SpeedCtrl_4ms_Symbol_CM_uint16_adm 8 1 8 AXIS_PTS_REF ekKP_GAININERTIA /end AXIS_DESCR
/end CHARACTERISTIC
/begin CHARACTERISTIC evPTO_PW_OFF "Offset per potenza assorbita dalla PTO (funzione della richiesta esterna di stiffness del Crtl PID)" CURVE 0xFCBADE Lookup1D_UWORD 0 TE_TM_SpeedCtrl_4ms_Symbol_CM_ufix16_En4_kW 0 256
 /begin AXIS_DESCR COM_AXIS NO_INPUT_QUANTITY TE_TM_SpeedCtrl_4ms_Symbol_CM_uint16_adm 8 0 31 AXIS_PTS_REF ekPTO_PW_OFF /end AXIS_DESCR
/end CHARACTERISTIC
/begin CHARACTERISTIC evQAIR2CMU_CONV "Conversione da massa di aria (mgcc) a Coppia Utile (Nm) potenziale" CURVE 0xFCBF2E Lookup1D_UWORD 0 TE_TM_TorqBasCtrl4ms_Symbol_CM_ufix16_En8_Nm_mgcc 0 10
 /begin AXIS_DESCR COM_AXIS NO_INPUT_QUANTITY TE_TM_TorqBasCtrl4ms_Symbol_CM_ufix16_En10_adm 8 0.015625 1.599609375 AXIS_PTS_REF ekQAIR2CMU_CONV /end AXIS_DESCR
/end CHARACTERISTIC
/begin CHARACTERISTIC evQAIR_MAX_REF "Equivalente di eference Air Flow (mg/cc) for Torque % determination" CURVE 0xFCBF1E Lookup1D_UWORD 0 TE_TM_TorqBasCtrl4ms_Symbol_CM_ufix16_En3_mg_cc 0.125 8191
 /begin AXIS_DESCR COM_AXIS NO_INPUT_QUANTITY TE_TM_TorqBasCtrl4ms_Symbol_CM_ufix16_En10_adm 8 0.015625 1.599609375 AXIS_PTS_REF ekQAIR_MAX_REF /end AXIS_DESCR
/end CHARACTERISTIC
/begin CHARACTERISTIC evQMIN_HIGH_IDLE "Aria di trafilamento in High Idle" CURVE 0xFCBF0E Lookup1D_UWORD 0 TE_TM_TorqBasCtrl4ms_Symbol_CM_ufix16_En4_kg_h 0 150
 /begin AXIS_DESCR COM_AXIS NO_INPUT_QUANTITY TE_TM_TorqBasCtrl4ms_Symbol_CM_uint16_rpm 8 0 10000 AXIS_PTS_REF ekQMIN_HIGHIDLEN /end AXIS_DESCR
/end CHARACTERISTIC
/begin CHARACTERISTIC evREF_CURVE_CONF "Curva di riferimento del motore (percentuale di Cmu) dichiarata per la configurazione (CAN msg Tx ENG_CONF)" CURVE 0xFCBEEC Lookup1D_UWORD 0 TE_TM_TorqBasCtrl4ms_Symbol_CM_ufix16_En4__ 0 100
 /begin AXIS_DESCR COM_AXIS NO_INPUT_QUANTITY TE_TM_TorqBasCtrl4ms_Symbol_CM_uint16_rpm 17 0 10000 AXIS_PTS_REF ekREF_CURVE_CONF /end AXIS_DESCR
/end CHARACTERISTIC
/begin CHARACTERISTIC evREF_CURVE_CONF1 "Curva di riferimento del motore (percentuale di Cmu) dichiarata per la configurazione (CAN msg Tx ENG_CONF)" CURVE 0xFCB6AC Lookup1D_UWORD 0 TE_TM_TorqCnfg1s_CM_ufix16_En4__ 0 100
 /begin AXIS_DESCR COM_AXIS NO_INPUT_QUANTITY TE_TM_TorqCnfg1s_CM_uint16_rpm 17 0 10000 AXIS_PTS_REF ekREF_CURVE_CONF1 /end AXIS_DESCR
/end CHARACTERISTIC
/begin CHARACTERISTIC evREF_CURVE_LTD_TMP "Curva di riferimento del motore (percentuale di Cmu) di derate temporizzato (protezione termica della turbo)" CURVE 0xFCBECA Lookup1D_UWORD 0 TE_TM_TorqBasCtrl4ms_Symbol_CM_ufix16_En4__ 0 100
 /begin AXIS_DESCR COM_AXIS NO_INPUT_QUANTITY TE_TM_TorqBasCtrl4ms_Symbol_CM_uint16_rpm 17 0 10000 AXIS_PTS_REF ekREF_CURVE_LTD_TMP /end AXIS_DESCR
/end CHARACTERISTIC
/begin CHARACTERISTIC evSTIFFNESS_OFF "Offset Stifness richiesta al Ctrl PID (funzione della PTO State da CAN)" CURVE 0xFCBACE Lookup1D_UWORD 0 TE_TM_SpeedCtrl_4ms_Symbol_CM_ufix16_En4__ 0 100
 /begin AXIS_DESCR COM_AXIS NO_INPUT_QUANTITY TE_TM_SpeedCtrl_4ms_Symbol_CM_uint16_adm 8 1 8 AXIS_PTS_REF ekSTIFFNESS_OFF /end AXIS_DESCR
/end CHARACTERISTIC
/begin CHARACTERISTIC evSYS_GAIN_C_TOIL "" CURVE 0xFCBAC2 Lookup1D_UWORD 0 TE_TM_SpeedCtrl_4ms_Symbol_CM_ufix16_En10_adm 0 10
 /begin AXIS_DESCR COM_AXIS NO_INPUT_QUANTITY TE_TM_SpeedCtrl_4ms_Symbol_CM_ufix16_Bn40_degC 6 -40 130 AXIS_PTS_REF ekKI_GAIN_C_TOIL /end AXIS_DESCR
/end CHARACTERISTIC
/begin CHARACTERISTIC evSYS_GAIN_GEARC "" CURVE 0xFCBAB0 Lookup1D_UWORD 0 TE_TM_SpeedCtrl_4ms_Symbol_CM_ufix16_En10_adm 0 10
 /begin AXIS_DESCR COM_AXIS NO_INPUT_QUANTITY TE_TM_SpeedCtrl_4ms_Symbol_CM_ufix16_Bn125_adm 9 -125 125 AXIS_PTS_REF ekSYS_GAIN_GEARC /end AXIS_DESCR
/end CHARACTERISTIC
/begin CHARACTERISTIC evTEMP_INF_LTD "Limite inferiore derate per temperatura (acqua/aria)" CURVE 0xFCB74E Lookup1D_UWORD 0 TE_TM_TorqBas4ms_CM_ufix16_En4__ 0 100
 /begin AXIS_DESCR COM_AXIS NO_INPUT_QUANTITY TE_TM_TorqBas4ms_CM_uint16_rpm 8 0 10000 AXIS_PTS_REF ekTEMP_INF_LTD /end AXIS_DESCR
/end CHARACTERISTIC
/begin CHARACTERISTIC ff2CLOSED_LOOP "[FIX] Fix sulla operatività per temperatura della sonda lambda" VALUE 0xFC4056 Scalar_UWORD 0 LambdaPostTDC_Symbol_CM_boolean_adm 0 1 /end CHARACTERISTIC
/begin CHARACTERISTIC ff2CLOSED_LOOP_EnFix "[FIX] Fix sulla operatività per temperatura della sonda lambda" VALUE 0xFC4054 Scalar_UWORD 0 LambdaPostTDC_Symbol_CM_FixEnableT 171 218 /end CHARACTERISTIC
/begin CHARACTERISTIC ff2HEAT_DC1_Enable "[FIX] Vettore dei valori di duty-cycles di comando del riscaldatore sonda lambda - fase 1" VALUE 0xFC45FE Scalar_UBYTE 0 LambdaHeater_2_100ms_CM_FixEnableT 171 218 /end CHARACTERISTIC
/begin CHARACTERISTIC ff2HEAT_DC1_Value "[FIX] Vettore dei valori di duty-cycles di comando del riscaldatore sonda lambda - fase 1" VALUE 0xFC45FC Scalar_UWORD 0 LambdaHeater_2_100ms_CM_uint16__ 0 100 /end CHARACTERISTIC
/begin CHARACTERISTIC ff2HEAT_DC2_Enable "[FIX] Vettore dei valori di duty-cycles di comando del riscaldatore sonda lambda - fase 2" VALUE 0xFC45FA Scalar_UBYTE 0 LambdaHeater_2_100ms_CM_FixEnableT 171 218 /end CHARACTERISTIC
/begin CHARACTERISTIC ff2HEAT_DC2_Value "[FIX] Vettore dei valori di duty-cycles di comando del riscaldatore sonda lambda - fase 2" VALUE 0xFC45F8 Scalar_UWORD 0 LambdaHeater_2_100ms_CM_uint16__ 0 100 /end CHARACTERISTIC
/begin CHARACTERISTIC ff2HEAT_DC3_Enable "[FIX] Vettore dei valori di duty-cycles di comando del riscaldatore sonda lambda - fase 3" VALUE 0xFC45F6 Scalar_UBYTE 0 LambdaHeater_2_100ms_CM_FixEnableT 171 218 /end CHARACTERISTIC
/begin CHARACTERISTIC ff2HEAT_DC3_Value "[FIX] Vettore dei valori di duty-cycles di comando del riscaldatore sonda lambda - fase 3" VALUE 0xFC45F4 Scalar_UWORD 0 LambdaHeater_2_100ms_CM_uint16__ 0 100 /end CHARACTERISTIC
/begin CHARACTERISTIC ff2HEAT_DC_Enable "[FIX] Tabella dei valori di duty-cycles di comando del riscaldatore sonda lambda dopo le tre fasi di preriscaldamento" VALUE 0xFC45F2 Scalar_UBYTE 0 LambdaHeater_2_100ms_CM_FixEnableT 171 218 /end CHARACTERISTIC
/begin CHARACTERISTIC ff2HEAT_DC_Value "[FIX] Tabella dei valori di duty-cycles di comando del riscaldatore sonda lambda dopo le tre fasi di preriscaldamento" VALUE 0xFC45F0 Scalar_UWORD 0 LambdaHeater_2_100ms_CM_uint16__ 0 100 /end CHARACTERISTIC
/begin CHARACTERISTIC ff2HEAT_T1_Enable "[FIX] Vettore che calcola la durata attuazione del duty-cycles nella - fase 1" VALUE 0xFC45EE Scalar_UBYTE 0 LambdaHeater_2_100ms_CM_FixEnableT 171 218 /end CHARACTERISTIC
/begin CHARACTERISTIC ff2HEAT_T1_Value "[FIX] Vettore che calcola la durata attuazione del duty-cycles nella - fase 1" VALUE 0xFC45EC Scalar_UWORD 0 LambdaHeater_2_100ms_CM_ufix16_Sp1_s 0 255 /end CHARACTERISTIC
/begin CHARACTERISTIC ff2HEAT_T2_Enable "[FIX] Vettore che calcola la durata attuazione del duty-cycles nella - fase 2" VALUE 0xFC45EA Scalar_UBYTE 0 LambdaHeater_2_100ms_CM_FixEnableT 171 218 /end CHARACTERISTIC
/begin CHARACTERISTIC ff2HEAT_T2_Value "[FIX] Vettore che calcola la durata attuazione del duty-cycles nella - fase 2" VALUE 0xFC45E8 Scalar_UWORD 0 LambdaHeater_2_100ms_CM_ufix16_Sp1_s 0 255 /end CHARACTERISTIC
/begin CHARACTERISTIC ff2HEAT_T3_Enable "[FIX] Vettore che calcola la durata attuazione del duty-cycles nella - fase 3" VALUE 0xFC45E6 Scalar_UBYTE 0 LambdaHeater_2_100ms_CM_FixEnableT 171 218 /end CHARACTERISTIC
/begin CHARACTERISTIC ff2HEAT_T3_Value "[FIX] Vettore che calcola la durata attuazione del duty-cycles nella - fase 3" VALUE 0xFC45E4 Scalar_UWORD 0 LambdaHeater_2_100ms_CM_ufix16_Sp1_s 0 255 /end CHARACTERISTIC
/begin CHARACTERISTIC ff2LH_DUTY_RIF_Enable "[FIX] Fix sul valore finale del duty-cycles applicato al riscaldatore della sonda lambda" VALUE 0xFC45E2 Scalar_UBYTE 0 LambdaHeater_2_100ms_CM_FixEnableT 171 218 /end CHARACTERISTIC
/begin CHARACTERISTIC ff2LH_DUTY_RIF_Value "[FIX] Fix sul valore finale del duty-cycles applicato al riscaldatore della sonda lambda" VALUE 0xFC45E0 Scalar_UWORD 0 LambdaHeater_2_100ms_CM_uint16__ 0 100 /end CHARACTERISTIC
/begin CHARACTERISTIC ff2T_LAMBDA_OK_Enable "[FIX] Fix sulla operatività per temperatura della sonda lambda" VALUE 0xFC45DE Scalar_UBYTE 0 LambdaHeater_2_100ms_CM_FixEnableT 171 218 /end CHARACTERISTIC
/begin CHARACTERISTIC ff2T_LAMBDA_OK_Value "[FIX] Fix sulla operatività per temperatura della sonda lambda" VALUE 0xFC45DD Scalar_BOOLEAN 0 LambdaHeater_2_100ms_CM_boolean_adm 0 1 /end CHARACTERISTIC
/begin CHARACTERISTIC ffAUTHOR_LIMITS_Enable "[FIX] Fix sullo stato di saturazione della sonda" VALUE 0xFC4028 Scalar_UBYTE 0 LambdaPreTDC_CM_FixEnableT 171 218 /end CHARACTERISTIC
/begin COMPU_METHOD Airq4ms_CM_boolean_adm "Q = V" RAT_FUNC "%1.0" "adm" COEFFS 0 1 0 0 0 1 /end COMPU_METHOD
/begin COMPU_METHOD Airq_CtrlMgmtTDC_CM_ufix16_En4_cc "Q = V*16.000000" RAT_FUNC "%8.4" "cc" COEFFS 0 16 0 0 0 1 /end COMPU_METHOD
/begin COMPU_METHOD Airq_CtrlMgmtTDC_CM_ufix16_En8_adm "Q = V*256.000000" RAT_FUNC "%11.8" "adm" COEFFS 0 256 0 0 0 1 /end COMPU_METHOD
/begin COMPU_METHOD Airq_CtrlMgmtTDC_CM_uint16_degM "Q = V" RAT_FUNC "%5.0" "degM" COEFFS 0 1 0 0 0 1 /end COMPU_METHOD
/begin COMPU_METHOD Boost_CtrlMgmt50ms_CM_boolean_adm "Q = V" RAT_FUNC "%1.0" "adm" COEFFS 0 1 0 0 0 1 /end COMPU_METHOD
/begin COMPU_METHOD Boost_CtrlMgmt50ms_CM_ufix16_En3_mg_cc "Q = V*8.000000" RAT_FUNC "%7.3" "mg/cc" COEFFS 0 8 0 0 0 1 /end COMPU_METHOD
/begin COMPU_METHOD Boost_CtrlMgmt50ms_CM_ufix16_En4__ "Q = V*16.000000" RAT_FUNC "%8.4" "%" COEFFS 0 16 0 0 0 1 /end COMPU_METHOD
/begin COMPU_METHOD Boost_CtrlMgmt50ms_CM_uint16_rpm "Q = V" RAT_FUNC "%5.0" "rpm" COEFFS 0 1 0 0 0 1 /end COMPU_METHOD
/begin COMPU_METHOD DiagSym100ms_CM_sfix16_En4__ "Q = V*16.000000" RAT_FUNC "%8.4" "%" COEFFS 0 16 0 0 0 1 /end COMPU_METHOD
/begin COMPU_METHOD DiagSym100ms_CM_ufix16_En4_N_m "Q = V*16.000000" RAT_FUNC "%8.4" "N*m" COEFFS 0 16 0 0 0 1 /end COMPU_METHOD
/begin COMPU_METHOD DiagSym100ms_CM_ufix16_En4__ "Q = V*16.000000" RAT_FUNC "%8.4" "%" COEFFS 0 16 0 0 0 1 /end COMPU_METHOD
/begin COMPU_METHOD DiagSym100ms_CM_uint8_adm "Q = V" RAT_FUNC "%3.0" "adm" COEFFS 0 1 0 0 0 1 /end COMPU_METHOD
/begin COMPU_METHOD Egbrk50ms_CM_boolean_adm "Q = V" RAT_FUNC "%1.0" "adm" COEFFS 0 1 0 0 0 1 /end COMPU_METHOD
/begin COMPU_METHOD EgmdTDC_CM_boolean_adm "Q = V" RAT_FUNC "%1.0" "adm" COEFFS 0 1 0 0 0 1 /end COMPU_METHOD
/begin COMPU_METHOD EgmdTDC_CM_int16_rpm_s "Q = V" RAT_FUNC "%5.0" "rpm/s" COEFFS 0 1 0 0 0 1 /end COMPU_METHOD
/begin COMPU_METHOD EgmdTDC_CM_uint16_rpm "Q = V" RAT_FUNC "%5.0" "rpm" COEFFS 0 1 0 0 0 1 /end COMPU_METHOD
/begin COMPU_METHOD EgrMgm4ms_CM_ufix16_En4_kg_h "Q = V*16.000000" RAT_FUNC "%8.4" "kg/h" COEFFS 0 16 0 0 0 1 /end COMPU_METHOD
/begin COMPU_METHOD EngineBrakeMgm50ms_CM_FixEnableT "Enumerated data type: FixEnableT" TAB_VERB "%0.6" "" COMPU_TAB_REF VTAB_FOR_EngineBrakeMgm50ms_CM_FixEnableT /end COMPU_METHOD
/begin COMPU_METHOD EngineBrakeMgm50ms_CM_boolean_adm "Q = V" RAT_FUNC "%1.0" "adm" COEFFS 0 1 0 0 0 1 /end COMPU_METHOD
/begin COMPU_METHOD EngineBrakeMgm50ms_CM_sfix16_En4__ "Q = V*16.000000" RAT_FUNC "%8.4" "%" COEFFS 0 16 0 0 0 1 /end COMPU_METHOD
/begin COMPU_METHOD EngineBrakeMgm50ms_CM_ufix16_En4__ "Q = V*16.000000" RAT_FUNC "%8.4" "%" COEFFS 0 16 0 0 0 1 /end COMPU_METHOD
/begin COMPU_METHOD EngineBrakeMgm50ms_CM_ufix16_S10_Hz "Q = V/10.000000" RAT_FUNC "%0.6" "Hz" COEFFS 0 1 0 0 0 10 /end COMPU_METHOD
/begin COMPU_METHOD EngineBrakeMgm50ms_CM_ufix16_Sp05_s "Q = V*20.000000" RAT_FUNC "%0.6" "s" COEFFS 0 20 0 0 0 1 /end COMPU_METHOD
/begin COMPU_METHOD Idle4ms_CM_boolean_adm "Q = V" RAT_FUNC "%1.0" "adm" COEFFS 0 1 0 0 0 1 /end COMPU_METHOD
/begin COMPU_METHOD Idle4ms_CM_sfix16_En4__ "Q = V*16.000000" RAT_FUNC "%8.4" "%" COEFFS 0 16 0 0 0 1 /end COMPU_METHOD
/begin COMPU_METHOD Idle4ms_CM_ufix16_En4_N_m "Q = V*16.000000" RAT_FUNC "%8.4" "N*m" COEFFS 0 16 0 0 0 1 /end COMPU_METHOD
/begin COMPU_METHOD Idle4ms_CM_ufix16_En4__ "Q = V*16.000000" RAT_FUNC "%8.4" "%" COEFFS 0 16 0 0 0 1 /end COMPU_METHOD
/begin COMPU_METHOD Idle4ms_CM_ufix16_En6_ks "Q = V*64.000000" RAT_FUNC "%10.6" "ks" COEFFS 0 64 0 0 0 1 /end COMPU_METHOD
/begin COMPU_METHOD Idle4ms_CM_uint16_rpm "Q = V" RAT_FUNC "%5.0" "rpm" COEFFS 0 1 0 0 0 1 /end COMPU_METHOD
/begin COMPU_METHOD IgntTDC_CM_boolean_adm "Q = V" RAT_FUNC "%1.0" "adm" COEFFS 0 1 0 0 0 1 /end COMPU_METHOD
/begin COMPU_METHOD IgntTDC_CM_sfix16_En4_deg "Q = V*16.000000" RAT_FUNC "%8.4" "deg" COEFFS 0 16 0 0 0 1 /end COMPU_METHOD
/begin COMPU_METHOD IgntTDC_CM_sfix16_En4_degree "Q = V*16.000000" RAT_FUNC "%8.4" "degree" COEFFS 0 16 0 0 0 1 /end COMPU_METHOD
/begin COMPU_METHOD InjtTDC_CM_ufix16_En4_degree "Q = V*16.000000" RAT_FUNC "%8.4" "degree" COEFFS 0 16 0 0 0 1 /end COMPU_METHOD
/begin COMPU_METHOD InjtTDC_CM_ufix16_S50_mV "Q = V/50.000000" RAT_FUNC "%0.6" "mV" COEFFS 0 1 0 0 0 50 /end COMPU_METHOD
/begin COMPU_METHOD InjtTDC_CM_uint16_mbar "Q = V" RAT_FUNC "%5.0" "mbar" COEFFS 0 1 0 0 0 1 /end COMPU_METHOD
/begin COMPU_METHOD InjtTDC_CM_uint16_rpm "Q = V" RAT_FUNC "%5.0" "rpm" COEFFS 0 1 0 0 0 1 /end COMPU_METHOD
/begin COMPU_METHOD InjtTDC_CM_uint16_tdc "Q = V" RAT_FUNC "%5.0" "tdc" COEFFS 0 1 0 0 0 1 /end COMPU_METHOD
/begin COMPU_METHOD Injt_SetParameters4ms_CM_eEGST_adm "Enumerated data type: eEGST" TAB_VERB "%0.6" "adm" COMPU_TAB_REF VTAB_FOR_Injt_SetParameters4ms_CM_eEGST_adm /end COMPU_METHOD
/begin COMPU_METHOD Injt_SetParameters4ms_CM_ufix16_Bn40_degC "Q = (V+40.000000)/1.000000" RAT_FUNC "%0.6" "degC" COEFFS 0 1 40 0 0 1 /end COMPU_METHOD
/begin COMPU_METHOD Injt_SetParameters4ms_CM_ufix16_S50_mV "Q = V/50.000000" RAT_FUNC "%0.6" "mV" COEFFS 0 1 0 0 0 50 /end COMPU_METHOD
/begin COMPU_METHOD Injt_SetParameters4ms_CM_uint16_mbar "Q = V" RAT_FUNC "%5.0" "mbar" COEFFS 0 1 0 0 0 1 /end COMPU_METHOD
/begin COMPU_METHOD J1939dl_Rx100ms_CM_ufix2_adm "Q = V/1.000000" RAT_FUNC "%3.0" "adm" COEFFS 0 1 0 0 0 1 /end COMPU_METHOD
/begin COMPU_METHOD J1939dl_Rx100ms_CM_ufix3_adm "Q = V/1.000000" RAT_FUNC "%3.0" "adm" COEFFS 0 1 0 0 0 1 /end COMPU_METHOD
/begin COMPU_METHOD J1939dl_Rx1s_CM_ufix8_B1985_year "Q = (V-1985.000000)/1.000000" RAT_FUNC "%0.6" "year" COEFFS 0 1 -1985 0 0 1 /end COMPU_METHOD
/begin COMPU_METHOD J1939dl_Rx1s_CM_ufix8_En2_day "Q = V*4.000000" RAT_FUNC "%4.2" "day" COEFFS 0 4 0 0 0 1 /end COMPU_METHOD
/begin COMPU_METHOD J1939dl_Rx1s_CM_ufix8_En2_sec "Q = V*4.000000" RAT_FUNC "%4.2" "sec" COEFFS 0 4 0 0 0 1 /end COMPU_METHOD
/begin COMPU_METHOD J1939dl_Rx1s_CM_uint8_adm "Q = V" RAT_FUNC "%3.0" "adm" COEFFS 0 1 0 0 0 1 /end COMPU_METHOD
/begin COMPU_METHOD J1939dl_Rx1s_CM_uint8_hour "Q = V" RAT_FUNC "%3.0" "hour" COEFFS 0 1 0 0 0 1 /end COMPU_METHOD
/begin COMPU_METHOD J1939dl_Rx1s_CM_uint8_min "Q = V" RAT_FUNC "%3.0" "min" COEFFS 0 1 0 0 0 1 /end COMPU_METHOD
/begin COMPU_METHOD J1939dl_Rx1s_CM_uint8_month "Q = V" RAT_FUNC "%3.0" "month" COEFFS 0 1 0 0 0 1 /end COMPU_METHOD
/begin COMPU_METHOD J1939dl_Rx50ms_CM_sfix16_En4__ "Q = V*16.000000" RAT_FUNC "%8.4" "%" COEFFS 0 16 0 0 0 1 /end COMPU_METHOD
/begin COMPU_METHOD J1939dl_Rx50ms_CM_sfix16_Sp01_Bn40p96__ "Q = (V+40.960000)*100.000000" RAT_FUNC "%0.6" "%" COEFFS 0 100 4096 0 0 1 /end COMPU_METHOD
/begin COMPU_METHOD J1939dl_Rx50ms_CM_ufix8_Sp4__ "Q = V*2.500000" RAT_FUNC "%0.6" "%" COEFFS 0 2.5 0 0 0 1 /end COMPU_METHOD
/begin COMPU_METHOD J1939dl_Rx50ms_CM_uint16_km_h "Q = V" RAT_FUNC "%5.0" "km/h" COEFFS 0 1 0 0 0 1 /end COMPU_METHOD
/begin COMPU_METHOD J1939dl_Tx100ms_CM_boolean_adm "Q = V" RAT_FUNC "%1.0" "adm" COEFFS 0 1 0 0 0 1 /end COMPU_METHOD
/begin COMPU_METHOD J1939dl_Tx100ms_CM_sfix16_En4__ "Q = V*16.000000" RAT_FUNC "%8.4" "%" COEFFS 0 16 0 0 0 1 /end COMPU_METHOD
/begin COMPU_METHOD J1939dl_Tx100ms_CM_ufix16_Bn40_degC "Q = (V+40.000000)/1.000000" RAT_FUNC "%0.6" "degC" COEFFS 0 1 40 0 0 1 /end COMPU_METHOD
/begin COMPU_METHOD J1939dl_Tx100ms_CM_ufix16_En10_adm "Q = V*1024.000000" RAT_FUNC "%12.10" "adm" COEFFS 0 1024 0 0 0 1 /end COMPU_METHOD
/begin COMPU_METHOD J1939dl_Tx100ms_CM_uint16_km_h "Q = V" RAT_FUNC "%5.0" "km/h" COEFFS 0 1 0 0 0 1 /end COMPU_METHOD
/begin COMPU_METHOD J1939dl_Tx100ms_CM_uint8_adm "Q = V" RAT_FUNC "%3.0" "adm" COEFFS 0 1 0 0 0 1 /end COMPU_METHOD
/begin COMPU_METHOD J1939dl_Tx1s_CM_tKeyState_adm "Enumerated data type: tKeyState" TAB_VERB "%0.6" "adm" COMPU_TAB_REF VTAB_FOR_J1939dl_Tx1s_CM_tKeyState_adm /end COMPU_METHOD
/begin COMPU_METHOD J1939dl_Tx1s_CM_ufix16_Bn40_degC "Q = (V+40.000000)/1.000000" RAT_FUNC "%0.6" "degC" COEFFS 0 1 40 0 0 1 /end COMPU_METHOD
/begin COMPU_METHOD J1939dl_Tx1s_CM_ufix16_En10___rpm "Q = V*1024.000000" RAT_FUNC "%12.10" "%/rpm" COEFFS 0 1024 0 0 0 1 /end COMPU_METHOD
/begin COMPU_METHOD J1939dl_Tx1s_CM_ufix16_En10_s "Q = V*1024.000000" RAT_FUNC "%12.10" "s" COEFFS 0 1024 0 0 0 1 /end COMPU_METHOD
/begin COMPU_METHOD J1939dl_Tx1s_CM_ufix16_En4_N_m "Q = V*16.000000" RAT_FUNC "%8.4" "N*m" COEFFS 0 16 0 0 0 1 /end COMPU_METHOD
/begin COMPU_METHOD J1939dl_Tx1s_CM_ufix16_En4__ "Q = V*16.000000" RAT_FUNC "%8.4" "%" COEFFS 0 16 0 0 0 1 /end COMPU_METHOD
/begin COMPU_METHOD J1939dl_Tx1s_CM_ufix8_Sp4__ "Q = V*2.500000" RAT_FUNC "%0.6" "%" COEFFS 0 2.5 0 0 0 1 /end COMPU_METHOD
/begin COMPU_METHOD J1939dl_Tx1s_CM_uint16_rpm "Q = V" RAT_FUNC "%5.0" "rpm" COEFFS 0 1 0 0 0 1 /end COMPU_METHOD
/begin COMPU_METHOD J1939dl_Tx4ms_CM_eEGMD_adm "Enumerated data type: eEGMD" TAB_VERB "%0.6" "adm" COMPU_TAB_REF VTAB_FOR_J1939dl_Tx4ms_CM_eEGMD_adm /end COMPU_METHOD
/begin COMPU_METHOD J1939dl_Tx4ms_CM_sfix16_En4__ "Q = V*16.000000" RAT_FUNC "%8.4" "%" COEFFS 0 16 0 0 0 1 /end COMPU_METHOD
/begin COMPU_METHOD J1939dl_Tx4ms_CM_ufix16_E2_mbar "Q = V/4.000000" RAT_FUNC "%5.0" "mbar" COEFFS 0 1 0 0 0 4 /end COMPU_METHOD
/begin COMPU_METHOD J1939dl_Tx4ms_CM_ufix16_En3_rpm "Q = V*8.000000" RAT_FUNC "%7.3" "rpm" COEFFS 0 8 0 0 0 1 /end COMPU_METHOD
/begin COMPU_METHOD J1939dl_Tx4ms_CM_ufix16_En4__ "Q = V*16.000000" RAT_FUNC "%8.4" "%" COEFFS 0 16 0 0 0 1 /end COMPU_METHOD
/begin COMPU_METHOD J1939dl_Tx50ms_CM_ufix16_En4__ "Q = V*16.000000" RAT_FUNC "%8.4" "%" COEFFS 0 16 0 0 0 1 /end COMPU_METHOD
/begin COMPU_METHOD J1939dl_Tx50ms_CM_uint8_adm "Q = V" RAT_FUNC "%3.0" "adm" COEFFS 0 1 0 0 0 1 /end COMPU_METHOD
/begin COMPU_METHOD LambdaHeater_2_100ms_CM_FixEnableT "Enumerated data type: FixEnableT" TAB_VERB "%0.6" "" COMPU_TAB_REF VTAB_FOR_LambdaHeater_2_100ms_CM_FixEnableT /end COMPU_METHOD
/begin COMPU_METHOD LambdaHeater_2_100ms_CM_boolean_adm "Q = V" RAT_FUNC "%1.0" "adm" COEFFS 0 1 0 0 0 1 /end COMPU_METHOD
/begin COMPU_METHOD LambdaHeater_2_100ms_CM_ufix16_Sp1_s "Q = V*10.000000" RAT_FUNC "%0.6" "s" COEFFS 0 10 0 0 0 1 /end COMPU_METHOD
/begin COMPU_METHOD LambdaHeater_2_100ms_CM_uint16__ "Q = V" RAT_FUNC "%5.0" "%" COEFFS 0 1 0 0 0 1 /end COMPU_METHOD
/begin COMPU_METHOD LambdaPostTDC_Symbol_CM_FixEnableT "Enumerated data type: FixEnableT" TAB_VERB "%0.6" "" COMPU_TAB_REF VTAB_FOR_LambdaPostTDC_Symbol_CM_FixEnableT /end COMPU_METHOD
/begin COMPU_METHOD LambdaPostTDC_Symbol_CM_boolean_adm "Q = V" RAT_FUNC "%1.0" "adm" COEFFS 0 1 0 0 0 1 /end COMPU_METHOD
/begin COMPU_METHOD LambdaPreTDC_CM_FixEnableT "Enumerated data type: FixEnableT" TAB_VERB "%0.6" "" COMPU_TAB_REF VTAB_FOR_LambdaPreTDC_CM_FixEnableT /end COMPU_METHOD
/begin COMPU_METHOD MairTDC_CM_sfix16_En4_degE "Q = V*16.000000" RAT_FUNC "%8.4" "degE" COEFFS 0 16 0 0 0 1 /end COMPU_METHOD
/begin COMPU_METHOD MairTDC_CM_ufix16_En4_degE "Q = V*16.000000" RAT_FUNC "%8.4" "degE" COEFFS 0 16 0 0 0 1 /end COMPU_METHOD
/begin COMPU_METHOD MairTDC_CM_ufix16_En4_mgcc "Q = V*16.000000" RAT_FUNC "%8.4" "mgcc" COEFFS 0 16 0 0 0 1 /end COMPU_METHOD
/begin COMPU_METHOD MairTDC_CM_uint16__ "Q = V" RAT_FUNC "%5.0" "%" COEFFS 0 1 0 0 0 1 /end COMPU_METHOD
/begin COMPU_METHOD MairTDC_CM_uint8_adm "Q = V" RAT_FUNC "%3.0" "adm" COEFFS 0 1 0 0 0 1 /end COMPU_METHOD
/begin COMPU_METHOD TE_MAirReqATDC_Symbol_CM_FixEnableT "Enumerated data type: FixEnableT" TAB_VERB "%0.6" "" COMPU_TAB_REF VTAB_FOR_TE_MAirReqATDC_Symbol_CM_FixEnableT /end COMPU_METHOD
/begin COMPU_METHOD TE_MAirReqATDC_Symbol_CM_sfix16_En4_degE "Q = V*16.000000" RAT_FUNC "%8.4" "degE" COEFFS 0 16 0 0 0 1 /end COMPU_METHOD
/begin COMPU_METHOD TE_MAirReqATDC_Symbol_CM_sfix16_En4_degree "Q = V*16.000000" RAT_FUNC "%8.4" "degree" COEFFS 0 16 0 0 0 1 /end COMPU_METHOD
/begin COMPU_METHOD TE_MAirReqATDC_Symbol_CM_ufix16_En4_cc "Q = V*16.000000" RAT_FUNC "%8.4" "cc" COEFFS 0 16 0 0 0 1 /end COMPU_METHOD
/begin COMPU_METHOD TE_MAirReqATDC_Symbol_CM_ufix16_En4_degE "Q = V*16.000000" RAT_FUNC "%8.4" "degE" COEFFS 0 16 0 0 0 1 /end COMPU_METHOD
/begin COMPU_METHOD TE_MAirReqATDC_Symbol_CM_ufix16_En4_degree "Q = V*16.000000" RAT_FUNC "%8.4" "degree" COEFFS 0 16 0 0 0 1 /end COMPU_METHOD
/begin COMPU_METHOD TE_MAirReqATDC_Symbol_CM_ufix16_En4_kg_h "Q = V*16.000000" RAT_FUNC "%8.4" "kg/h" COEFFS 0 16 0 0 0 1 /end COMPU_METHOD
/begin COMPU_METHOD TE_MAirReqATDC_Symbol_CM_ufix16_En4_mgcc "Q = V*16.000000" RAT_FUNC "%8.4" "mgcc" COEFFS 0 16 0 0 0 1 /end COMPU_METHOD
/begin COMPU_METHOD TE_MAirReqATDC_Symbol_CM_ufix16_En8_adm "Q = V*256.000000" RAT_FUNC "%11.8" "adm" COEFFS 0 256 0 0 0 1 /end COMPU_METHOD
/begin COMPU_METHOD TE_MAirReqATDC_Symbol_CM_uint16__ "Q = V" RAT_FUNC "%5.0" "%" COEFFS 0 1 0 0 0 1 /end COMPU_METHOD
/begin COMPU_METHOD TE_MAirReqATDC_Symbol_CM_uint16_adm "Q = V" RAT_FUNC "%5.0" "adm" COEFFS 0 1 0 0 0 1 /end COMPU_METHOD
/begin COMPU_METHOD TE_MAirReqATDC_Symbol_CM_uint16_degM "Q = V" RAT_FUNC "%5.0" "degM" COEFFS 0 1 0 0 0 1 /end COMPU_METHOD
/begin COMPU_METHOD TE_MAirReqATDC_Symbol_CM_uint16_rpm "Q = V" RAT_FUNC "%5.0" "rpm" COEFFS 0 1 0 0 0 1 /end COMPU_METHOD
/begin COMPU_METHOD TE_MAirReqATDC_Symbol_CM_uint8_adm "Q = V" RAT_FUNC "%3.0" "adm" COEFFS 0 1 0 0 0 1 /end COMPU_METHOD
/begin COMPU_METHOD TE_TM_DerRPM_100ms_CM_boolean_adm "Q = V" RAT_FUNC "%1.0" "adm" COEFFS 0 1 0 0 0 1 /end COMPU_METHOD
/begin COMPU_METHOD TE_TM_FFW4ms_Symbol_CM_FixEnableT "Enumerated data type: FixEnableT" TAB_VERB "%0.6" "" COMPU_TAB_REF VTAB_FOR_TE_TM_FFW4ms_Symbol_CM_FixEnableT /end COMPU_METHOD
/begin COMPU_METHOD TE_TM_InitIntegrSpd4ms_Symbol_CM_ufix16_En10_adm "Q = V*1024.000000" RAT_FUNC "%12.10" "adm" COEFFS 0 1024 0 0 0 1 /end COMPU_METHOD
/begin COMPU_METHOD TE_TM_InitIntegrSpd4ms_Symbol_CM_uint8_4ms "Q = V" RAT_FUNC "%3.0" "4ms" COEFFS 0 1 0 0 0 1 /end COMPU_METHOD
/begin COMPU_METHOD TE_TM_SpeedCtrl_4ms_Symbol_CM_FixEnableT "Enumerated data type: FixEnableT" TAB_VERB "%0.6" "" COMPU_TAB_REF VTAB_FOR_TE_TM_SpeedCtrl_4ms_Symbol_CM_FixEnableT /end COMPU_METHOD
/begin COMPU_METHOD TE_TM_SpeedCtrl_4ms_Symbol_CM_boolean_adm "Q = V" RAT_FUNC "%1.0" "adm" COEFFS 0 1 0 0 0 1 /end COMPU_METHOD
/begin COMPU_METHOD TE_TM_SpeedCtrl_4ms_Symbol_CM_int16_rpm "Q = V" RAT_FUNC "%5.0" "rpm" COEFFS 0 1 0 0 0 1 /end COMPU_METHOD
/begin COMPU_METHOD TE_TM_SpeedCtrl_4ms_Symbol_CM_sfix16_En4__ "Q = V*16.000000" RAT_FUNC "%8.4" "%" COEFFS 0 16 0 0 0 1 /end COMPU_METHOD
/begin COMPU_METHOD TE_TM_SpeedCtrl_4ms_Symbol_CM_sfix32_En11_rpm_s "Q = V*2048.000000" RAT_FUNC "%18.11" "rpm*s" COEFFS 0 2048 0 0 0 1 /end COMPU_METHOD
/begin COMPU_METHOD TE_TM_SpeedCtrl_4ms_Symbol_CM_ufix16_Bn125_adm "Q = (V+125.000000)/1.000000" RAT_FUNC "%0.6" "adm" COEFFS 0 1 125 0 0 1 /end COMPU_METHOD
/begin COMPU_METHOD TE_TM_SpeedCtrl_4ms_Symbol_CM_ufix16_Bn1800_rpm "Q = (V+1800.000000)/1.000000" RAT_FUNC "%0.6" "rpm" COEFFS 0 1 1800 0 0 1 /end COMPU_METHOD
/begin COMPU_METHOD TE_TM_SpeedCtrl_4ms_Symbol_CM_ufix16_Bn1_adm "Q = (V+1.000000)/1.000000" RAT_FUNC "%0.6" "adm" COEFFS 0 1 1 0 0 1 /end COMPU_METHOD
/begin COMPU_METHOD TE_TM_SpeedCtrl_4ms_Symbol_CM_ufix16_Bn32000_rpm_s "Q = (V+32000.000000)/1.000000" RAT_FUNC "%0.6" "rpm/s" COEFFS 0 1 32000 0 0 1 /end COMPU_METHOD
/begin COMPU_METHOD TE_TM_SpeedCtrl_4ms_Symbol_CM_ufix16_Bn40_degC "Q = (V+40.000000)/1.000000" RAT_FUNC "%0.6" "degC" COEFFS 0 1 40 0 0 1 /end COMPU_METHOD
/begin COMPU_METHOD TE_TM_SpeedCtrl_4ms_Symbol_CM_ufix16_En10_adm "Q = V*1024.000000" RAT_FUNC "%12.10" "adm" COEFFS 0 1024 0 0 0 1 /end COMPU_METHOD
/begin COMPU_METHOD TE_TM_SpeedCtrl_4ms_Symbol_CM_ufix16_En15___on_s_rpm "Q = V*32768.000000" RAT_FUNC "%16.15" "% on s rpm" COEFFS 0 32768 0 0 0 1 /end COMPU_METHOD
/begin COMPU_METHOD TE_TM_SpeedCtrl_4ms_Symbol_CM_ufix16_En15___rpm "Q = V*32768.000000" RAT_FUNC "%16.15" "%/rpm" COEFFS 0 32768 0 0 0 1 /end COMPU_METHOD
/begin COMPU_METHOD TE_TM_SpeedCtrl_4ms_Symbol_CM_ufix16_En15___s_on_rpm "Q = V*32768.000000" RAT_FUNC "%16.15" "% s on rpm" COEFFS 0 32768 0 0 0 1 /end COMPU_METHOD
/begin COMPU_METHOD TE_TM_SpeedCtrl_4ms_Symbol_CM_ufix16_En4_Nm "Q = V*16.000000" RAT_FUNC "%8.4" "Nm" COEFFS 0 16 0 0 0 1 /end COMPU_METHOD
/begin COMPU_METHOD TE_TM_SpeedCtrl_4ms_Symbol_CM_ufix16_En4__ "Q = V*16.000000" RAT_FUNC "%8.4" "%" COEFFS 0 16 0 0 0 1 /end COMPU_METHOD
/begin COMPU_METHOD TE_TM_SpeedCtrl_4ms_Symbol_CM_ufix16_En4_kW "Q = V*16.000000" RAT_FUNC "%8.4" "kW" COEFFS 0 16 0 0 0 1 /end COMPU_METHOD
/begin COMPU_METHOD TE_TM_SpeedCtrl_4ms_Symbol_CM_ufix16_En8_adm "Q = V*256.000000" RAT_FUNC "%11.8" "adm" COEFFS 0 256 0 0 0 1 /end COMPU_METHOD
/begin COMPU_METHOD TE_TM_SpeedCtrl_4ms_Symbol_CM_uint16_4ms "Q = V" RAT_FUNC "%5.0" "4ms" COEFFS 0 1 0 0 0 1 /end COMPU_METHOD
/begin COMPU_METHOD TE_TM_SpeedCtrl_4ms_Symbol_CM_uint16_adm "Q = V" RAT_FUNC "%5.0" "adm" COEFFS 0 1 0 0 0 1 /end COMPU_METHOD
/begin COMPU_METHOD TE_TM_SpeedCtrl_4ms_Symbol_CM_uint16_rpm "Q = V" RAT_FUNC "%5.0" "rpm" COEFFS 0 1 0 0 0 1 /end COMPU_METHOD
/begin COMPU_METHOD TE_TM_SpeedCtrl_4ms_Symbol_CM_uint16_rpm_s "Q = V" RAT_FUNC "%5.0" "rpm/s" COEFFS 0 1 0 0 0 1 /end COMPU_METHOD
/begin COMPU_METHOD TE_TM_SpeedCtrl_4ms_Symbol_CM_uint8_adm "Q = V" RAT_FUNC "%3.0" "adm" COEFFS 0 1 0 0 0 1 /end COMPU_METHOD
/begin COMPU_METHOD TE_TM_TorqBas4ms_CM_FixEnableT "Enumerated data type: FixEnableT" TAB_VERB "%0.6" "" COMPU_TAB_REF VTAB_FOR_TE_TM_TorqBas4ms_CM_FixEnableT /end COMPU_METHOD
/begin COMPU_METHOD TE_TM_TorqBas4ms_CM_boolean_adm "Q = V" RAT_FUNC "%1.0" "adm" COEFFS 0 1 0 0 0 1 /end COMPU_METHOD
/begin COMPU_METHOD TE_TM_TorqBas4ms_CM_int16_degC "Q = V" RAT_FUNC "%5.0" "degC" COEFFS 0 1 0 0 0 1 /end COMPU_METHOD
/begin COMPU_METHOD TE_TM_TorqBas4ms_CM_ufix16_Bn32000_rpm_s "Q = (V+32000.000000)/1.000000" RAT_FUNC "%0.6" "rpm/s" COEFFS 0 1 32000 0 0 1 /end COMPU_METHOD
/begin COMPU_METHOD TE_TM_TorqBas4ms_CM_ufix16_Bn40_degC "Q = (V+40.000000)/1.000000" RAT_FUNC "%0.6" "degC" COEFFS 0 1 40 0 0 1 /end COMPU_METHOD
/begin COMPU_METHOD TE_TM_TorqBas4ms_CM_ufix16_E4_us "Q = V/16.000000" RAT_FUNC "%5.0" "us" COEFFS 0 1 0 0 0 16 /end COMPU_METHOD
/begin COMPU_METHOD TE_TM_TorqBas4ms_CM_ufix16_En10_adm "Q = V*1024.000000" RAT_FUNC "%12.10" "adm" COEFFS 0 1024 0 0 0 1 /end COMPU_METHOD
/begin COMPU_METHOD TE_TM_TorqBas4ms_CM_ufix16_En12___degC "Q = V*4096.000000" RAT_FUNC "%14.12" "%/degC" COEFFS 0 4096 0 0 0 1 /end COMPU_METHOD
/begin COMPU_METHOD TE_TM_TorqBas4ms_CM_ufix16_En4__ "Q = V*16.000000" RAT_FUNC "%8.4" "%" COEFFS 0 16 0 0 0 1 /end COMPU_METHOD
/begin COMPU_METHOD TE_TM_TorqBas4ms_CM_ufix16_En8_Bn100__ "Q = (V+100.000000)*256.000000" RAT_FUNC "%0.6" "%" COEFFS 0 256 25600 0 0 1 /end COMPU_METHOD
/begin COMPU_METHOD TE_TM_TorqBas4ms_CM_ufix16_En8__ "Q = V*256.000000" RAT_FUNC "%11.8" "%" COEFFS 0 256 0 0 0 1 /end COMPU_METHOD
/begin COMPU_METHOD TE_TM_TorqBas4ms_CM_ufix16_En8___4ms "Q = V*256.000000" RAT_FUNC "%11.8" "%/4ms" COEFFS 0 256 0 0 0 1 /end COMPU_METHOD
/begin COMPU_METHOD TE_TM_TorqBas4ms_CM_ufix8_Bn100_degC "Q = (V+100.000000)/1.000000" RAT_FUNC "%0.6" "degC" COEFFS 0 1 100 0 0 1 /end COMPU_METHOD
/begin COMPU_METHOD TE_TM_TorqBas4ms_CM_ufix8_Bn40_degC "Q = (V+40.000000)/1.000000" RAT_FUNC "%0.6" "degC" COEFFS 0 1 40 0 0 1 /end COMPU_METHOD
/begin COMPU_METHOD TE_TM_TorqBas4ms_CM_ufix8_Sp01_adm "Q = V*100.000000" RAT_FUNC "%0.6" "adm" COEFFS 0 100 0 0 0 1 /end COMPU_METHOD
/begin COMPU_METHOD TE_TM_TorqBas4ms_CM_uint16_degC "Q = V" RAT_FUNC "%5.0" "degC" COEFFS 0 1 0 0 0 1 /end COMPU_METHOD
/begin COMPU_METHOD TE_TM_TorqBas4ms_CM_uint16_rpm "Q = V" RAT_FUNC "%5.0" "rpm" COEFFS 0 1 0 0 0 1 /end COMPU_METHOD
/begin COMPU_METHOD TE_TM_TorqBas4ms_CM_uint16_sec "Q = V" RAT_FUNC "%5.0" "sec" COEFFS 0 1 0 0 0 1 /end COMPU_METHOD
/begin COMPU_METHOD TE_TM_TorqBas4ms_CM_uint32_us "Q = V" RAT_FUNC "%10.0" "us" COEFFS 0 1 0 0 0 1 /end COMPU_METHOD
/begin COMPU_METHOD TE_TM_TorqBas4ms_CM_uint8_adm "Q = V" RAT_FUNC "%3.0" "adm" COEFFS 0 1 0 0 0 1 /end COMPU_METHOD
/begin COMPU_METHOD TE_TM_TorqBasCtrl4ms_Symbol_CM_FixEnableT "Enumerated data type: FixEnableT" TAB_VERB "%0.6" "" COMPU_TAB_REF VTAB_FOR_TE_TM_TorqBasCtrl4ms_Symbol_CM_FixEnableT /end COMPU_METHOD
/begin COMPU_METHOD TE_TM_TorqBasCtrl4ms_Symbol_CM_boolean_adm "Q = V" RAT_FUNC "%1.0" "adm" COEFFS 0 1 0 0 0 1 /end COMPU_METHOD
/begin COMPU_METHOD TE_TM_TorqBasCtrl4ms_Symbol_CM_int16_rpm "Q = V" RAT_FUNC "%5.0" "rpm" COEFFS 0 1 0 0 0 1 /end COMPU_METHOD
/begin COMPU_METHOD TE_TM_TorqBasCtrl4ms_Symbol_CM_int16_rpm_s "Q = V" RAT_FUNC "%5.0" "rpm/s" COEFFS 0 1 0 0 0 1 /end COMPU_METHOD
/begin COMPU_METHOD TE_TM_TorqBasCtrl4ms_Symbol_CM_int8_rpm "Q = V" RAT_FUNC "%3.0" "rpm" COEFFS 0 1 0 0 0 1 /end COMPU_METHOD
/begin COMPU_METHOD TE_TM_TorqBasCtrl4ms_Symbol_CM_sfix16_En4__ "Q = V*16.000000" RAT_FUNC "%8.4" "%" COEFFS 0 16 0 0 0 1 /end COMPU_METHOD
/begin COMPU_METHOD TE_TM_TorqBasCtrl4ms_Symbol_CM_sfix16_En4_degree "Q = V*16.000000" RAT_FUNC "%8.4" "degree" COEFFS 0 16 0 0 0 1 /end COMPU_METHOD
/begin COMPU_METHOD TE_TM_TorqBasCtrl4ms_Symbol_CM_ufix16_Bn1000_rpm_s "Q = (V+1000.000000)/1.000000" RAT_FUNC "%0.6" "rpm/s" COEFFS 0 1 1000 0 0 1 /end COMPU_METHOD
/begin COMPU_METHOD TE_TM_TorqBasCtrl4ms_Symbol_CM_ufix16_Bn1800_rpm "Q = (V+1800.000000)/1.000000" RAT_FUNC "%0.6" "rpm" COEFFS 0 1 1800 0 0 1 /end COMPU_METHOD
/begin COMPU_METHOD TE_TM_TorqBasCtrl4ms_Symbol_CM_ufix16_Bn32000_rpm_s "Q = (V+32000.000000)/1.000000" RAT_FUNC "%0.6" "rpm/s" COEFFS 0 1 32000 0 0 1 /end COMPU_METHOD
/begin COMPU_METHOD TE_TM_TorqBasCtrl4ms_Symbol_CM_ufix16_Bn40_degC "Q = (V+40.000000)/1.000000" RAT_FUNC "%0.6" "degC" COEFFS 0 1 40 0 0 1 /end COMPU_METHOD
/begin COMPU_METHOD TE_TM_TorqBasCtrl4ms_Symbol_CM_ufix16_Bn500_rpm "Q = (V+500.000000)/1.000000" RAT_FUNC "%0.6" "rpm" COEFFS 0 1 500 0 0 1 /end COMPU_METHOD
/begin COMPU_METHOD TE_TM_TorqBasCtrl4ms_Symbol_CM_ufix16_En10_adm "Q = V*1024.000000" RAT_FUNC "%12.10" "adm" COEFFS 0 1024 0 0 0 1 /end COMPU_METHOD
/begin COMPU_METHOD TE_TM_TorqBasCtrl4ms_Symbol_CM_ufix16_En10_m_n "Q = V*1024.000000" RAT_FUNC "%12.10" "m/n" COEFFS 0 1024 0 0 0 1 /end COMPU_METHOD
/begin COMPU_METHOD TE_TM_TorqBasCtrl4ms_Symbol_CM_ufix16_En15___rpm "Q = V*32768.000000" RAT_FUNC "%16.15" "%/rpm" COEFFS 0 32768 0 0 0 1 /end COMPU_METHOD
/begin COMPU_METHOD TE_TM_TorqBasCtrl4ms_Symbol_CM_ufix16_En15___s_rpm "Q = V*32768.000000" RAT_FUNC "%16.15" "%*s/rpm" COEFFS 0 32768 0 0 0 1 /end COMPU_METHOD
/begin COMPU_METHOD TE_TM_TorqBasCtrl4ms_Symbol_CM_ufix16_En15_adm "Q = V*32768.000000" RAT_FUNC "%16.15" "adm" COEFFS 0 32768 0 0 0 1 /end COMPU_METHOD
/begin COMPU_METHOD TE_TM_TorqBasCtrl4ms_Symbol_CM_ufix16_En3_mg_cc "Q = V*8.000000" RAT_FUNC "%7.3" "mg/cc" COEFFS 0 8 0 0 0 1 /end COMPU_METHOD
/begin COMPU_METHOD TE_TM_TorqBasCtrl4ms_Symbol_CM_ufix16_En4_N_m "Q = V*16.000000" RAT_FUNC "%8.4" "N*m" COEFFS 0 16 0 0 0 1 /end COMPU_METHOD
/begin COMPU_METHOD TE_TM_TorqBasCtrl4ms_Symbol_CM_ufix16_En4_Nm "Q = V*16.000000" RAT_FUNC "%8.4" "Nm" COEFFS 0 16 0 0 0 1 /end COMPU_METHOD
/begin COMPU_METHOD TE_TM_TorqBasCtrl4ms_Symbol_CM_ufix16_En4__ "Q = V*16.000000" RAT_FUNC "%8.4" "%" COEFFS 0 16 0 0 0 1 /end COMPU_METHOD
/begin COMPU_METHOD TE_TM_TorqBasCtrl4ms_Symbol_CM_ufix16_En4_degE "Q = V*16.000000" RAT_FUNC "%8.4" "degE" COEFFS 0 16 0 0 0 1 /end COMPU_METHOD
/begin COMPU_METHOD TE_TM_TorqBasCtrl4ms_Symbol_CM_ufix16_En4_degree "Q = V*16.000000" RAT_FUNC "%8.4" "degree" COEFFS 0 16 0 0 0 1 /end COMPU_METHOD
/begin COMPU_METHOD TE_TM_TorqBasCtrl4ms_Symbol_CM_ufix16_En4_kg_h "Q = V*16.000000" RAT_FUNC "%8.4" "kg/h" COEFFS 0 16 0 0 0 1 /end COMPU_METHOD
/begin COMPU_METHOD TE_TM_TorqBasCtrl4ms_Symbol_CM_ufix16_En8_Nm_mgcc "Q = V*256.000000" RAT_FUNC "%11.8" "Nm/mgcc" COEFFS 0 256 0 0 0 1 /end COMPU_METHOD
/begin COMPU_METHOD TE_TM_TorqBasCtrl4ms_Symbol_CM_ufix16_En8_adm "Q = V*256.000000" RAT_FUNC "%11.8" "adm" COEFFS 0 256 0 0 0 1 /end COMPU_METHOD
/begin COMPU_METHOD TE_TM_TorqBasCtrl4ms_Symbol_CM_ufix16_Sp004_rpm "Q = V*250.000000" RAT_FUNC "%0.6" "rpm" COEFFS 0 250 0 0 0 1 /end COMPU_METHOD
/begin COMPU_METHOD TE_TM_TorqBasCtrl4ms_Symbol_CM_ufix32_Sp004_rpm "Q = V*250.000000" RAT_FUNC "%0.6" "rpm" COEFFS 0 250 0 0 0 1 /end COMPU_METHOD
/begin COMPU_METHOD TE_TM_TorqBasCtrl4ms_Symbol_CM_uint16_4ms "Q = V" RAT_FUNC "%5.0" "4ms" COEFFS 0 1 0 0 0 1 /end COMPU_METHOD
/begin COMPU_METHOD TE_TM_TorqBasCtrl4ms_Symbol_CM_uint16_adm "Q = V" RAT_FUNC "%5.0" "adm" COEFFS 0 1 0 0 0 1 /end COMPU_METHOD
/begin COMPU_METHOD TE_TM_TorqBasCtrl4ms_Symbol_CM_uint16_mbar "Q = V" RAT_FUNC "%5.0" "mbar" COEFFS 0 1 0 0 0 1 /end COMPU_METHOD
/begin COMPU_METHOD TE_TM_TorqBasCtrl4ms_Symbol_CM_uint16_rpm "Q = V" RAT_FUNC "%5.0" "rpm" COEFFS 0 1 0 0 0 1 /end COMPU_METHOD
/begin COMPU_METHOD TE_TM_TorqBasCtrl4ms_Symbol_CM_uint16_s "Q = V" RAT_FUNC "%5.0" "s" COEFFS 0 1 0 0 0 1 /end COMPU_METHOD
/begin COMPU_METHOD TE_TM_TorqBasCtrl4ms_Symbol_CM_uint32_4ms "Q = V" RAT_FUNC "%10.0" "4ms" COEFFS 0 1 0 0 0 1 /end COMPU_METHOD
/begin COMPU_METHOD TE_TM_TorqBasCtrl4ms_Symbol_CM_uint8_adm "Q = V" RAT_FUNC "%3.0" "adm" COEFFS 0 1 0 0 0 1 /end COMPU_METHOD
/begin COMPU_METHOD TE_TM_TorqBasCtrl4ms_Symbol_CM_uint8_rpm "Q = V" RAT_FUNC "%3.0" "rpm" COEFFS 0 1 0 0 0 1 /end COMPU_METHOD
/begin COMPU_METHOD TE_TM_TorqCalcTDC_Symbol_CM_FixEnableT "Enumerated data type: FixEnableT" TAB_VERB "%0.6" "" COMPU_TAB_REF VTAB_FOR_TE_TM_TorqCalcTDC_Symbol_CM_FixEnableT /end COMPU_METHOD
/begin COMPU_METHOD TE_TM_TorqCalcTDC_Symbol_CM_boolean_adm "Q = V" RAT_FUNC "%1.0" "adm" COEFFS 0 1 0 0 0 1 /end COMPU_METHOD
/begin COMPU_METHOD TE_TM_TorqCalcTDC_Symbol_CM_ufix16_En3_Bn4095_mg_cc "Q = (V+4095.000000)*8.000000" RAT_FUNC "%0.6" "mg/cc" COEFFS 0 8 32760 0 0 1 /end COMPU_METHOD
/begin COMPU_METHOD TE_TM_TorqCalcTDC_Symbol_CM_ufix16_En4_N_m "Q = V*16.000000" RAT_FUNC "%8.4" "N*m" COEFFS 0 16 0 0 0 1 /end COMPU_METHOD
/begin COMPU_METHOD TE_TM_TorqCalcTDC_Symbol_CM_ufix16_En4__ "Q = V*16.000000" RAT_FUNC "%8.4" "%" COEFFS 0 16 0 0 0 1 /end COMPU_METHOD
/begin COMPU_METHOD TE_TM_TorqCalcTDC_Symbol_CM_ufix16_En4_degree "Q = V*16.000000" RAT_FUNC "%8.4" "degree" COEFFS 0 16 0 0 0 1 /end COMPU_METHOD
/begin COMPU_METHOD TE_TM_TorqCalcTDC_Symbol_CM_ufix16_En8_adm "Q = V*256.000000" RAT_FUNC "%11.8" "adm" COEFFS 0 256 0 0 0 1 /end COMPU_METHOD
/begin COMPU_METHOD TE_TM_TorqCalcTDC_Symbol_CM_uint8_adm "Q = V" RAT_FUNC "%3.0" "adm" COEFFS 0 1 0 0 0 1 /end COMPU_METHOD
/begin COMPU_METHOD TE_TM_TorqCnfg1s_CM_FixEnableT "Enumerated data type: FixEnableT" TAB_VERB "%0.6" "" COMPU_TAB_REF VTAB_FOR_TE_TM_TorqCnfg1s_CM_FixEnableT /end COMPU_METHOD
/begin COMPU_METHOD TE_TM_TorqCnfg1s_CM_boolean_adm "Q = V" RAT_FUNC "%1.0" "adm" COEFFS 0 1 0 0 0 1 /end COMPU_METHOD
/begin COMPU_METHOD TE_TM_TorqCnfg1s_CM_ufix16_En10___rpm "Q = V*1024.000000" RAT_FUNC "%12.10" "%/rpm" COEFFS 0 1024 0 0 0 1 /end COMPU_METHOD
/begin COMPU_METHOD TE_TM_TorqCnfg1s_CM_ufix16_En10_s "Q = V*1024.000000" RAT_FUNC "%12.10" "s" COEFFS 0 1024 0 0 0 1 /end COMPU_METHOD
/begin COMPU_METHOD TE_TM_TorqCnfg1s_CM_ufix16_En4__ "Q = V*16.000000" RAT_FUNC "%8.4" "%" COEFFS 0 16 0 0 0 1 /end COMPU_METHOD
/begin COMPU_METHOD TE_TM_TorqCnfg1s_CM_uint16_rpm "Q = V" RAT_FUNC "%5.0" "rpm" COEFFS 0 1 0 0 0 1 /end COMPU_METHOD
/begin COMPU_METHOD Thrp4ms_CM_ufix16_En4__ "Q = V*16.000000" RAT_FUNC "%8.4" "%" COEFFS 0 16 0 0 0 1 /end COMPU_METHOD
/begin COMPU_METHOD Thrp_Mgmt50ms_CM_ufix16_En4__ "Q = V*16.000000" RAT_FUNC "%8.4" "%" COEFFS 0 16 0 0 0 1 /end COMPU_METHOD
/begin COMPU_METHOD Trqm_CtrlMgmt1s_CM_boolean_adm "Q = V" RAT_FUNC "%1.0" "adm" COEFFS 0 1 0 0 0 1 /end COMPU_METHOD
/begin COMPU_METHOD Trqm_CtrlMgmt1s_CM_ufix16_En4__ "Q = V*16.000000" RAT_FUNC "%8.4" "%" COEFFS 0 16 0 0 0 1 /end COMPU_METHOD
/begin COMPU_METHOD Trqm_CtrlMgmt1s_CM_uint16_rpm "Q = V" RAT_FUNC "%5.0" "rpm" COEFFS 0 1 0 0 0 1 /end COMPU_METHOD
/begin COMPU_METHOD Trqm_CtrlMgmt4ms_CM_boolean_adm "Q = V" RAT_FUNC "%1.0" "adm" COEFFS 0 1 0 0 0 1 /end COMPU_METHOD
/begin COMPU_METHOD Trqm_CtrlMgmt4ms_CM_sfix16_En4__ "Q = V*16.000000" RAT_FUNC "%8.4" "%" COEFFS 0 16 0 0 0 1 /end COMPU_METHOD
/begin COMPU_METHOD Trqm_CtrlMgmt4ms_CM_ufix16_En10_adm "Q = V*1024.000000" RAT_FUNC "%12.10" "adm" COEFFS 0 1024 0 0 0 1 /end COMPU_METHOD
/begin COMPU_METHOD Trqm_CtrlMgmt4ms_CM_ufix16_En4_N_m "Q = V*16.000000" RAT_FUNC "%8.4" "N*m" COEFFS 0 16 0 0 0 1 /end COMPU_METHOD
/begin COMPU_METHOD Trqm_CtrlMgmt4ms_CM_ufix16_En4__ "Q = V*16.000000" RAT_FUNC "%8.4" "%" COEFFS 0 16 0 0 0 1 /end COMPU_METHOD
/begin COMPU_METHOD Trqm_CtrlMgmt4ms_CM_ufix16_En4_kg_h "Q = V*16.000000" RAT_FUNC "%8.4" "kg/h" COEFFS 0 16 0 0 0 1 /end COMPU_METHOD
/begin COMPU_METHOD Trqm_CtrlMgmt4ms_CM_ufix16_En8_adm "Q = V*256.000000" RAT_FUNC "%11.8" "adm" COEFFS 0 256 0 0 0 1 /end COMPU_METHOD
/begin COMPU_METHOD Trqm_CtrlMgmt4ms_CM_uint16_rpm "Q = V" RAT_FUNC "%5.0" "rpm" COEFFS 0 1 0 0 0 1 /end COMPU_METHOD
/begin COMPU_METHOD Trqm_CtrlMgmtTDC_CM_sfix16_En4__ "Q = V*16.000000" RAT_FUNC "%8.4" "%" COEFFS 0 16 0 0 0 1 /end COMPU_METHOD
/begin COMPU_METHOD Trqm_CtrlMgmtTDC_CM_ufix16_En2_kW "Q = V*4.000000" RAT_FUNC "%7.2" "kW" COEFFS 0 4 0 0 0 1 /end COMPU_METHOD
/begin COMPU_METHOD Trqm_CtrlMgmtTDC_CM_ufix16_En4__ "Q = V*16.000000" RAT_FUNC "%8.4" "%" COEFFS 0 16 0 0 0 1 /end COMPU_METHOD
/begin COMPU_METHOD Trqm_CtrlMgmtTDC_CM_ufix16_En8_adm "Q = V*256.000000" RAT_FUNC "%11.8" "adm" COEFFS 0 256 0 0 0 1 /end COMPU_METHOD
/begin COMPU_VTAB VTAB_FOR_EngineBrakeMgm50ms_CM_FixEnableT "Enumerated data type: FixEnableT" TAB_VERB 2 171 "Enable" 218 "Disable" /end COMPU_VTAB
/begin COMPU_VTAB VTAB_FOR_Injt_SetParameters4ms_CM_eEGST_adm "Enumerated data type: eEGST" TAB_VERB 8 0 "POWER_ON" 1 "WAIT" 2 "RUN" 3 "POWER_LATCH" 4 "POWER_OFF" 5 "SHUTDOWN" 6 "ACTDIAG_WAIT" 7 "SAFETY_CHECK" /end COMPU_VTAB
/begin COMPU_VTAB VTAB_FOR_J1939dl_Tx1s_CM_tKeyState_adm "Enumerated data type: tKeyState" TAB_VERB 2 0 "KEY_OFF" 1 "KEY_ON" /end COMPU_VTAB
/begin COMPU_VTAB VTAB_FOR_J1939dl_Tx4ms_CM_eEGMD_adm "Enumerated data type: eEGMD" TAB_VERB 5 0 "NOT_DETERM" 1 "CRANK" 2 "IDLE" 3 "NORMAL" 4 "CUT_OFF" /end COMPU_VTAB
/begin COMPU_VTAB VTAB_FOR_LambdaHeater_2_100ms_CM_FixEnableT "Enumerated data type: FixEnableT" TAB_VERB 2 171 "Enable" 218 "Disable" /end COMPU_VTAB
/begin COMPU_VTAB VTAB_FOR_LambdaPostTDC_Symbol_CM_FixEnableT "Enumerated data type: FixEnableT" TAB_VERB 2 171 "Enable" 218 "Disable" /end COMPU_VTAB
/begin COMPU_VTAB VTAB_FOR_LambdaPreTDC_CM_FixEnableT "Enumerated data type: FixEnableT" TAB_VERB 2 171 "Enable" 218 "Disable" /end COMPU_VTAB
/begin COMPU_VTAB VTAB_FOR_TE_MAirReqATDC_Symbol_CM_FixEnableT "Enumerated data type: FixEnableT" TAB_VERB 2 171 "Enable" 218 "Disable" /end COMPU_VTAB
/begin COMPU_VTAB VTAB_FOR_TE_TM_FFW4ms_Symbol_CM_FixEnableT "Enumerated data type: FixEnableT" TAB_VERB 2 171 "Enable" 218 "Disable" /end COMPU_VTAB
/begin COMPU_VTAB VTAB_FOR_TE_TM_SpeedCtrl_4ms_Symbol_CM_FixEnableT "Enumerated data type: FixEnableT" TAB_VERB 2 171 "Enable" 218 "Disable" /end COMPU_VTAB
/begin COMPU_VTAB VTAB_FOR_TE_TM_TorqBas4ms_CM_FixEnableT "Enumerated data type: FixEnableT" TAB_VERB 2 171 "Enable" 218 "Disable" /end COMPU_VTAB
/begin COMPU_VTAB VTAB_FOR_TE_TM_TorqBasCtrl4ms_Symbol_CM_FixEnableT "Enumerated data type: FixEnableT" TAB_VERB 2 171 "Enable" 218 "Disable" /end COMPU_VTAB
/begin COMPU_VTAB VTAB_FOR_TE_TM_TorqCalcTDC_Symbol_CM_FixEnableT "Enumerated data type: FixEnableT" TAB_VERB 2 171 "Enable" 218 "Disable" /end COMPU_VTAB
/begin COMPU_VTAB VTAB_FOR_TE_TM_TorqCnfg1s_CM_FixEnableT "Enumerated data type: FixEnableT" TAB_VERB 2 171 "Enable" 218 "Disable" /end COMPU_VTAB
/begin RECORD_LAYOUT Lookup1D_UWORD FNC_VALUES 1 UWORD COLUMN_DIR DIRECT /end RECORD_LAYOUT
/begin RECORD_LAYOUT Lookup1D_X_UWORD AXIS_PTS_X 1 UWORD INDEX_INCR DIRECT /end RECORD_LAYOUT
/begin RECORD_LAYOUT Lookup2DSF_UWORD FNC_VALUES 1 UWORD ROW_DIR DIRECT /end RECORD_LAYOUT
/begin RECORD_LAYOUT Lookup2DSF_WORD FNC_VALUES 1 SWORD ROW_DIR DIRECT /end RECORD_LAYOUT
/begin RECORD_LAYOUT Lookup2D_UWORD FNC_VALUES 1 UWORD COLUMN_DIR DIRECT /end RECORD_LAYOUT
/begin RECORD_LAYOUT Lookup2D_X_UWORD AXIS_PTS_X 1 UWORD INDEX_INCR DIRECT /end RECORD_LAYOUT
/begin RECORD_LAYOUT Scalar_BOOLEAN FNC_VALUES 1 UBYTE COLUMN_DIR DIRECT /end RECORD_LAYOUT
/begin RECORD_LAYOUT Scalar_BYTE FNC_VALUES 1 SBYTE COLUMN_DIR DIRECT /end RECORD_LAYOUT
/begin RECORD_LAYOUT Scalar_SWORD FNC_VALUES 1 SWORD COLUMN_DIR DIRECT /end RECORD_LAYOUT
/begin RECORD_LAYOUT Scalar_UBYTE FNC_VALUES 1 UBYTE COLUMN_DIR DIRECT /end RECORD_LAYOUT
/begin RECORD_LAYOUT Scalar_UWORD FNC_VALUES 1 UWORD COLUMN_DIR DIRECT /end RECORD_LAYOUT
/end MODULE
/end PROJECT
