/* generated by ASAP2 Updater - ASAP2 Tool-Set Version 12.0.0 */
ASAP2_VERSION 1 70
/begin PROJECT XCPonCANFD "Generated for ETAS and Vector "
/begin MODULE XCPonCANFD "Generated for ETAS and Vector "
/begin MOD_PAR "XCPonCANFD" VERSION "42" ADDR_EPK 0xFC0000 EPK "11111720200227" SUPPLIER "METATRON"
 /begin MEMORY_SEGMENT APPL_PRES "" RESERVED FLASH INTERN 0x840048 0x8 -1 -1 -1 -1 -1
  /begin IF_DATA XCP
   /begin SEGMENT 0x01 0x02 0x00 0x00 0x00 /begin CHECKSUM XCP_CRC_32 MAX_BLOCK_SIZE 0xFFFF /end CHECKSUM
    /begin PAGE 0x01 ECU_ACCESS_WITH_XCP_ONLY XCP_READ_ACCESS_WITH_ECU_ONLY XCP_WRITE_ACCESS_NOT_ALLOWED /end PAGE
   /end SEGMENT
  /end IF_DATA
 /end MEMORY_SEGMENT
 /begin MEMORY_SEGMENT CALIB "" DATA FLASH INTERN 0xFC0000 0x20000 -1 -1 -1 -1 -1
  /begin IF_DATA XCP
   /begin SEGMENT 0x00 0x02 0x00 0x00 0x00 /begin CHECKSUM XCP_CRC_32 MAX_BLOCK_SIZE 0xFFFF /end CHECKSUM
    /begin PAGE 0x01 ECU_ACCESS_WITH_XCP_ONLY XCP_READ_ACCESS_WITH_ECU_ONLY XCP_WRITE_ACCESS_NOT_ALLOWED /end PAGE
    /begin PAGE 0x00 ECU_ACCESS_WITH_XCP_ONLY XCP_READ_ACCESS_WITH_ECU_ONLY XCP_WRITE_ACCESS_WITH_ECU_ONLY /end PAGE
   /end SEGMENT
  /end IF_DATA
 /end MEMORY_SEGMENT
 /begin MEMORY_SEGMENT CODE0 "" CODE FLASH INTERN 0x840000 0x48 -1 -1 -1 -1 -1
  /begin IF_DATA XCP
   /begin SEGMENT 0x05 0x01 0x00 0x00 0x00 /begin CHECKSUM XCP_CRC_32 MAX_BLOCK_SIZE 0xFFFF /end CHECKSUM
    /begin PAGE 0x00 ECU_ACCESS_DONT_CARE XCP_READ_ACCESS_DONT_CARE XCP_WRITE_ACCESS_NOT_ALLOWED /end PAGE
   /end SEGMENT
  /end IF_DATA
 /end MEMORY_SEGMENT
 /begin MEMORY_SEGMENT CODE1 "" CODE FLASH INTERN 0x840050 0x10 -1 -1 -1 -1 -1
  /begin IF_DATA XCP
   /begin SEGMENT 0x02 0x02 0x00 0x00 0x00 /begin CHECKSUM XCP_CRC_32 MAX_BLOCK_SIZE 0xFFFF /end CHECKSUM
    /begin PAGE 0x01 ECU_ACCESS_WITH_XCP_ONLY XCP_READ_ACCESS_WITH_ECU_ONLY XCP_WRITE_ACCESS_NOT_ALLOWED /end PAGE
    /begin PAGE 0x00 ECU_ACCESS_WITH_XCP_ONLY XCP_READ_ACCESS_WITH_ECU_ONLY XCP_WRITE_ACCESS_WITH_ECU_ONLY /end PAGE
   /end SEGMENT
  /end IF_DATA
 /end MEMORY_SEGMENT
 /begin MEMORY_SEGMENT CODE2 "" RESERVED FLASH INTERN 0x840070 0x67FF90 -1 -1 -1 -1 -1
  /begin IF_DATA XCP
   /begin SEGMENT 0x04 0x02 0x00 0x00 0x00 /begin CHECKSUM XCP_CRC_32 MAX_BLOCK_SIZE 0xFFFF /end CHECKSUM
    /begin PAGE 0x01 ECU_ACCESS_WITH_XCP_ONLY XCP_READ_ACCESS_WITH_ECU_ONLY XCP_WRITE_ACCESS_NOT_ALLOWED /end PAGE
   /end SEGMENT
  /end IF_DATA
 /end MEMORY_SEGMENT
 /begin MEMORY_SEGMENT EPK_CODE "" CODE FLASH INTERN 0x840060 0x10 -1 -1 -1 -1 -1
  /begin IF_DATA XCP
   /begin SEGMENT 0x03 0x02 0x00 0x00 0x00 /begin CHECKSUM XCP_CRC_32 MAX_BLOCK_SIZE 0xFFFF /end CHECKSUM
    /begin PAGE 0x01 ECU_ACCESS_WITH_XCP_ONLY XCP_READ_ACCESS_WITH_ECU_ONLY XCP_WRITE_ACCESS_NOT_ALLOWED /end PAGE
   /end SEGMENT
  /end IF_DATA
 /end MEMORY_SEGMENT
/end MOD_PAR
/begin MOD_COMMON "XCPonCANFD" BYTE_ORDER MSB_FIRST ALIGNMENT_BYTE 1 ALIGNMENT_WORD 2 ALIGNMENT_LONG 4 ALIGNMENT_FLOAT32_IEEE 4 ALIGNMENT_FLOAT64_IEEE 8 ALIGNMENT_INT64 8 /end MOD_COMMON
/begin IF_DATA XCPplus 0x0103
 /begin PROTOCOL_LAYER 0x0103 0x64 0x64 0x00 0x00 0x00 0x00 0x00 0x40 0x40 BYTE_ORDER_MSB_FIRST ADDRESS_GRANULARITY_BYTE OPTIONAL_CMD PROGRAM_MAX OPTIONAL_CMD PROGRAM_NEXT OPTIONAL_CMD PROGRAM_RESET OPTIONAL_CMD PROGRAM OPTIONAL_CMD PROGRAM_CLEAR OPTIONAL_CMD PROGRAM_START OPTIONAL_CMD ALLOC_ODT_ENTRY OPTIONAL_CMD ALLOC_ODT OPTIONAL_CMD ALLOC_DAQ OPTIONAL_CMD FREE_DAQ OPTIONAL_CMD GET_DAQ_EVENT_INFO OPTIONAL_CMD GET_DAQ_RESOLUTION_INFO OPTIONAL_CMD GET_DAQ_PROCESSOR_INFO OPTIONAL_CMD GET_DAQ_CLOCK OPTIONAL_CMD START_STOP_SYNCH OPTIONAL_CMD START_STOP_DAQ_LIST OPTIONAL_CMD GET_DAQ_LIST_MODE OPTIONAL_CMD SET_DAQ_LIST_MODE OPTIONAL_CMD WRITE_DAQ OPTIONAL_CMD SET_DAQ_PTR OPTIONAL_CMD CLEAR_DAQ_LIST OPTIONAL_CMD GET_CAL_PAGE OPTIONAL_CMD SET_CAL_PAGE OPTIONAL_CMD SHORT_DOWNLOAD OPTIONAL_CMD DOWNLOAD_MAX OPTIONAL_CMD DOWNLOAD_NEXT OPTIONAL_CMD DOWNLOAD OPTIONAL_CMD BUILD_CHECKSUM OPTIONAL_CMD SHORT_UPLOAD OPTIONAL_CMD UPLOAD OPTIONAL_CMD SET_MTA OPTIONAL_CMD UNLOCK OPTIONAL_CMD GET_SEED OPTIONAL_CMD GET_ID OPTIONAL_CMD GET_COMM_MODE_INFO COMMUNICATION_MODE_SUPPORTED BLOCK SLAVE MASTER 0x04 0x00 SEED_AND_KEY_EXTERNAL_FUNCTION "SeedNKeyXcp.dll" /end PROTOCOL_LAYER
 /begin DAQ DYNAMIC 0x00 0x09 0x00 OPTIMISATION_TYPE_DEFAULT ADDRESS_EXTENSION_FREE IDENTIFICATION_FIELD_TYPE_RELATIVE_BYTE GRANULARITY_ODT_ENTRY_SIZE_DAQ_BYTE 0x3E OVERLOAD_INDICATION_PID
  /begin EVENT "EVT_Tdc" "EVT_Tdc" 0x00 DAQ 0x01 0x00 0x00 0x00 CONSISTENCY DAQ /begin MIN_CYCLE_TIME 0x64 0x03 /end MIN_CYCLE_TIME /end EVENT
  /begin EVENT "EVT_1ms" "EVT_1ms" 0x01 DAQ 0x01 0x01 0x06 0x00 CONSISTENCY DAQ /end EVENT
  /begin EVENT "EVT_2ms" "EVT_2ms" 0x02 DAQ 0x01 0x02 0x06 0x00 CONSISTENCY DAQ /end EVENT
  /begin EVENT "EVT_4ms" "EVT_4ms" 0x03 DAQ 0x01 0x04 0x06 0x00 CONSISTENCY DAQ /end EVENT
  /begin EVENT "EVT_10ms" "EVT_10ms" 0x04 DAQ 0x01 0x0A 0x06 0x00 CONSISTENCY DAQ /end EVENT
  /begin EVENT "EVT_50ms" "EVT_50ms" 0x05 DAQ 0x01 0x05 0x07 0x00 CONSISTENCY DAQ /end EVENT
  /begin EVENT "EVT_100ms" "EVT_100ms" 0x06 DAQ 0xFF 0x01 0x08 0x00 CONSISTENCY DAQ /end EVENT
  /begin EVENT "EVT_1s" "EVT_1s" 0x07 DAQ 0xFF 0x01 0x09 0x00 CONSISTENCY DAQ /end EVENT
  /begin EVENT "EVT_5s" "EVT_5s" 0x08 DAQ 0xFF 0x05 0x09 0x00 CONSISTENCY DAQ /end EVENT
 /end DAQ
 /begin PAG 0x02 /end PAG
 /begin PGM PGM_MODE_ABSOLUTE 0x20 0x00 /begin SECTOR "FLASH" 0x00 0x800000 0x040000 0x00 0x00 0x00 /end SECTOR /begin SECTOR "FLASH" 0x01 0x840000 0x040000 0x00 0x00 0x00 /end SECTOR /begin SECTOR "FLASH" 0x02 0x880000 0x040000 0x00 0x00 0x00 /end SECTOR /begin SECTOR "FLASH" 0x03 0x8C0000 0x040000 0x00 0x00 0x00 /end SECTOR /begin SECTOR "FLASH" 0x04 0x900000 0x040000 0x00 0x00 0x00 /end SECTOR /begin SECTOR "FLASH" 0x05 0x940000 0x040000 0x00 0x00 0x00 /end SECTOR /begin SECTOR "FLASH" 0x06 0x980000 0x040000 0x00 0x00 0x00 /end SECTOR /begin SECTOR "FLASH" 0x07 0x9C0000 0x040000 0x00 0x00 0x00 /end SECTOR /begin SECTOR "FLASH" 0x08 0xA00000 0x040000 0x00 0x00 0x00 /end SECTOR /begin SECTOR "FLASH" 0x09 0xA40000 0x040000 0x00 0x00 0x00 /end SECTOR /begin SECTOR "FLASH" 0x0A 0xA80000 0x040000 0x00 0x00 0x00 /end SECTOR /begin SECTOR "FLASH" 0x0B 0xAC0000 0x040000 0x00 0x00 0x00 /end SECTOR /begin SECTOR "FLASH" 0x0C 0xB00000 0x040000 0x00 0x00 0x00 /end SECTOR /begin SECTOR "FLASH" 0x0D 0xB40000 0x040000 0x00 0x00 0x00 /end SECTOR /begin SECTOR "FLASH" 0x0E 0xB80000 0x040000 0x00 0x00 0x00 /end SECTOR /begin SECTOR "FLASH" 0x0F 0xBC0000 0x040000 0x00 0x00 0x00 /end SECTOR /begin SECTOR "FLASH" 0x10 0xC00000 0x040000 0x00 0x00 0x00 /end SECTOR /begin SECTOR "FLASH" 0x11 0xC40000 0x040000 0x00 0x00 0x00 /end SECTOR /begin SECTOR "FLASH" 0x12 0xC80000 0x040000 0x00 0x00 0x00 /end SECTOR /begin SECTOR "FLASH" 0x13 0xCC0000 0x040000 0x00 0x00 0x00 /end SECTOR /begin SECTOR "FLASH" 0x14 0xD00000 0x040000 0x00 0x00 0x00 /end SECTOR /begin SECTOR "FLASH" 0x15 0xD40000 0x040000 0x00 0x00 0x00 /end SECTOR /begin SECTOR "FLASH" 0x16 0xD80000 0x040000 0x00 0x00 0x00 /end SECTOR /begin SECTOR "FLASH" 0x17 0xDC0000 0x040000 0x00 0x00 0x00 /end SECTOR /begin SECTOR "FLASH" 0x18 0xE00000 0x040000 0x00 0x00 0x00 /end SECTOR /begin SECTOR "FLASH" 0x19 0xE40000 0x040000 0x00 0x00 0x00 /end SECTOR /begin SECTOR "FLASH" 0x1A 0xE80000 0x040000 0x00 0x00 0x00 /end SECTOR /begin SECTOR "FLASH" 0x1B 0xEC0000 0x040000 0x00 0x00 0x00 /end SECTOR /begin SECTOR "FLASH" 0x1C 0xF00000 0x040000 0x00 0x00 0x00 /end SECTOR /begin SECTOR "FLASH" 0x1D 0xF40000 0x040000 0x00 0x00 0x00 /end SECTOR /begin SECTOR "FLASH" 0x1E 0xF80000 0x040000 0x00 0x00 0x00 /end SECTOR /begin SECTOR "FLASH" 0x1F 0xFC0000 0x020000 0x00 0x00 0x00 /end SECTOR /end PGM
 /begin XCP_ON_CAN 0x0103 CAN_ID_MASTER 0x0750 CAN_ID_SLAVE 0x0760 BAUDRATE 0x0F4240 SAMPLE_POINT 0x4B SAMPLE_RATE SINGLE BTL_CYCLES 0x08 SJW 0x02 SYNC_EDGE SINGLE
  /begin CAN_FD MAX_DLC 0x40 CAN_FD_DATA_TRANSFER_BAUDRATE 0x3D0900 SAMPLE_POINT 0x50 BTL_CYCLES 0x08 SJW 0x02 SYNC_EDGE SINGLE MAX_DLC_REQUIRED SECONDARY_SAMPLE_POINT 0x50 TRANSCEIVER_DELAY_COMPENSATION OFF /end CAN_FD
  MAX_DLC_REQUIRED /end XCP_ON_CAN
/end IF_DATA
/begin CHARACTERISTIC CCVS_SA "S.A.  for CCVS_RX" VALUE 0xFCDA53 Scalar_UBYTE 0 CCVS_SA.CONVERSION 0 255 /end CHARACTERISTIC
/begin CHARACTERISTIC CalSwIdentifier "Identifier of calibration set" ASCII 0xFDFFF0 Scalar_UBYTE 0 NO_COMPU_METHOD 0 255 NUMBER 12 /end CHARACTERISTIC
/begin MEASUREMENT GSEC_usrRecEnable "Active Recovery Indicator Vector" UBYTE GSEC_usrRecEnable.Conversion 0 0 0 255 ECU_ADDRESS 0x40005880 MATRIX_DIM 16 /end MEASUREMENT
/begin CHARACTERISTIC J1939_TxDisable_AltFuel "Fix to disable Tx of Message CAN AltFuel" VALUE 0xFCDA32 Scalar_BOOLEAN 0 J1939_TxDisable_AltFuel.CONVERSION 0 1 /end CHARACTERISTIC
/begin CHARACTERISTIC J1939_TxDisable_CcvsTx "Fix to disable Tx of Message CAN CcvsTx" VALUE 0xFCDA33 Scalar_BOOLEAN 0 J1939_TxDisable_CcvsTx.CONVERSION 0 1 /end CHARACTERISTIC
/begin CHARACTERISTIC J1939_TxDisable_Dm1 "Fix to disable Tx of Message CAN Dm1" VALUE 0xFCDA4D Scalar_BOOLEAN 0 J1939_TxDisable_Dm1.CONVERSION 0 1 /end CHARACTERISTIC
/begin CHARACTERISTIC J1939_TxDisable_Dm4 "Fix to disable Tx of Message CAN Dm4" VALUE 0xFCDA4F Scalar_BOOLEAN 0 J1939_TxDisable_Dm4.CONVERSION 0 1 /end CHARACTERISTIC
/begin CHARACTERISTIC J1939_TxDisable_Edc2Bc "Fix to disable Tx of Message CAN Edc2Bc" VALUE 0xFCDA34 Scalar_BOOLEAN 0 J1939_TxDisable_Edc2Bc.CONVERSION 0 1 /end CHARACTERISTIC
/begin CHARACTERISTIC J1939_TxDisable_Eec1 "Fix to disable Tx of Message CAN Eec1" VALUE 0xFCDA35 Scalar_BOOLEAN 0 J1939_TxDisable_Eec1.CONVERSION 0 1 /end CHARACTERISTIC
/begin CHARACTERISTIC J1939_TxDisable_Eec2 "Fix to disable Tx of Message CAN Eec2" VALUE 0xFCDA36 Scalar_BOOLEAN 0 J1939_TxDisable_Eec2.CONVERSION 0 1 /end CHARACTERISTIC
/begin CHARACTERISTIC J1939_TxDisable_Eec3 "Fix to disable Tx of Message CAN Eec3" VALUE 0xFCDA37 Scalar_BOOLEAN 0 J1939_TxDisable_Eec3.CONVERSION 0 1 /end CHARACTERISTIC
/begin CHARACTERISTIC J1939_TxDisable_EngConf "Fix to disable Tx of Message CAN EngConf" VALUE 0xFCDA51 Scalar_BOOLEAN 0 J1939_TxDisable_EngConf.CONVERSION 0 1 /end CHARACTERISTIC
/begin CHARACTERISTIC J1939_TxDisable_EngHours "Fix to disable Tx of Message CAN EngHours" VALUE 0xFCDA38 Scalar_BOOLEAN 0 J1939_TxDisable_EngHours.CONVERSION 0 1 /end CHARACTERISTIC
/begin CHARACTERISTIC J1939_TxDisable_EngTemp "Fix to disable Tx of Message CAN EngTemp" VALUE 0xFCDA39 Scalar_BOOLEAN 0 J1939_TxDisable_EngTemp.CONVERSION 0 1 /end CHARACTERISTIC
/begin CHARACTERISTIC J1939_TxDisable_Erc1Er "Fix to disable Tx of Message CAN Erc1Er" VALUE 0xFCDA4A Scalar_BOOLEAN 0 J1939_TxDisable_Erc1Er.CONVERSION 0 1 /end CHARACTERISTIC
/begin CHARACTERISTIC J1939_TxDisable_FluidPress "Fix to disable Tx of Message CAN FluidPress" VALUE 0xFCDA45 Scalar_BOOLEAN 0 J1939_TxDisable_FluidPress.CONVERSION 0 1 /end CHARACTERISTIC
/begin CHARACTERISTIC J1939_TxDisable_InLetCond "Fix to disable Tx of Message CAN InLetCond" VALUE 0xFCDA46 Scalar_BOOLEAN 0 J1939_TxDisable_InLetCond.CONVERSION 0 1 /end CHARACTERISTIC
/begin CHARACTERISTIC J1939_TxDisable_PgnRequestAck "Fix to disable Tx of Message CAN PgnRequestAck" VALUE 0xFCDA48 Scalar_BOOLEAN 0 J1939_TxDisable_PgnRequestAck.CONVERSION 0 1 /end CHARACTERISTIC
/begin CHARACTERISTIC J1939_TxDisable_RetConf "Fix to disable Tx of Message CAN RetConf" VALUE 0xFCDA50 Scalar_BOOLEAN 0 J1939_TxDisable_RetConf.CONVERSION 0 1 /end CHARACTERISTIC
/begin CHARACTERISTIC J1939_TxDisable_Shutdown "Fix to disable Tx of Message CAN Shutdown" VALUE 0xFCDA47 Scalar_BOOLEAN 0 J1939_TxDisable_Shutdown.CONVERSION 0 1 /end CHARACTERISTIC
/begin MEASUREMENT J1939_bBc2Edc1Absent "Logic state  of Absent condition CAN Message Bc2Edc1" UBYTE J1939_bBc2Edc1Absent.CONVERSION 0 0 0 1 ECU_ADDRESS 0x400058D9 /end MEASUREMENT
/begin MEASUREMENT J1939_bBc2Edc2Absent "Logic state  of Absent condition CAN Message Bc2Edc2" UBYTE J1939_bBc2Edc2Absent.CONVERSION 0 0 0 1 ECU_ADDRESS 0x400058D8 /end MEASUREMENT
/begin MEASUREMENT J1939_bCCVSAbsent "Logic state  of Absent condition CAN Message CCVS" UBYTE J1939_bCCVSAbsent.CONVERSION 0 0 0 1 ECU_ADDRESS 0x400058DF /end MEASUREMENT
/begin MEASUREMENT J1939_bEtc1Absent "Logic state  of Absent condition CAN Message Etc1" UBYTE J1939_bEtc1Absent.CONVERSION 0 0 0 1 ECU_ADDRESS 0x400058D5 /end MEASUREMENT
/begin MEASUREMENT J1939_bEtc2Absent "Log state  of Absent condition CAN Message Etc2" UBYTE J1939_bEtc2Absent.CONVERSION 0 0 0 1 ECU_ADDRESS 0x400058D4 /end MEASUREMENT
/begin MEASUREMENT J1939_bTco1Absent "Logic state  of Absent condition CAN Message Tco1" UBYTE J1939_bTco1Absent.CONVERSION 0 0 0 1 ECU_ADDRESS 0x400058D7 /end MEASUREMENT
/begin MEASUREMENT J1939_bTimeDateAbsent "Logic state  of Absent condition CAN Message TimeDate" UBYTE J1939_bTimeDateAbsent.CONVERSION 0 0 0 1 ECU_ADDRESS 0x400058D6 /end MEASUREMENT
/begin MEASUREMENT J1939_bTsc1C1Absent "Logic state  of Absent condition CAN Message Tsc1C1" UBYTE J1939_bTsc1C1Absent.CONVERSION 0 0 0 1 ECU_ADDRESS 0x400058DE /end MEASUREMENT
/begin MEASUREMENT J1939_bTsc1C2Absent "Logic state  of Absent condition CAN Message Tsc1C2" UBYTE J1939_bTsc1C2Absent.CONVERSION 0 0 0 1 ECU_ADDRESS 0x400058DD /end MEASUREMENT
/begin MEASUREMENT J1939_bTsc1LAbsent "Logic state  of Absent condition CAN Message Tsc1L" UBYTE J1939_bTsc1LAbsent.CONVERSION 0 0 0 1 ECU_ADDRESS 0x400058DC /end MEASUREMENT
/begin MEASUREMENT J1939_bTsc1TRAbsent "Logic state  of Absent condition CAN Message Tsc1TR" UBYTE J1939_bTsc1TRAbsent.CONVERSION 0 0 0 1 ECU_ADDRESS 0x400058DB /end MEASUREMENT
/begin MEASUREMENT J1939_bUssAbsent "Logic state  of Absent condition CAN Message Uss" UBYTE J1939_bUssAbsent.CONVERSION 0 0 0 1 ECU_ADDRESS 0x400058DA /end MEASUREMENT
/begin MEASUREMENT J1939_bVcm2EcmAbsent "Logic state  of Absent condition CAN Message Vcm2Ecm" UBYTE J1939_bVcm2EcmAbsent.CONVERSION 0 0 0 1 ECU_ADDRESS 0x400058D3 /end MEASUREMENT
/begin MEASUREMENT MEAS_CpuLoad "Cpu Load [%]" UBYTE MEAS.CONVERSION 0 0 0 255 ECU_ADDRESS 0x4000A204 /end MEASUREMENT
/begin MEASUREMENT MEAS_CpuLoadMax "Max Cpu Load [%]" UBYTE MEAS.CONVERSION 0 0 0 255 ECU_ADDRESS 0x4000A1FC /end MEASUREMENT
/begin MEASUREMENT MEAS_CpuLoadMin "Min Cpu Load [%]" UBYTE MEAS.CONVERSION 0 0 0 255 ECU_ADDRESS 0x4000A1FD /end MEASUREMENT
/begin MEASUREMENT MEAS_PmsHalf_CpuMaxTime "Max Cpu usage for task PmsHalf [us]" UWORD MEAS.CONVERSION 0 0 0 65535 ECU_ADDRESS 0x4000A19E /end MEASUREMENT
/begin MEASUREMENT MEAS_PmsHalf_CpuMeanTime "Cpu usage for task PmsHalf [us]" UWORD MEAS.CONVERSION 0 0 0 65535 ECU_ADDRESS 0x4000A1CE /end MEASUREMENT
/begin MEASUREMENT MEAS_PmsHalf_CpuMinTime "Min Cpu usage for task PmsHalf [us]" UWORD MEAS.CONVERSION 0 0 0 65535 ECU_ADDRESS 0x4000A1B6 /end MEASUREMENT
/begin MEASUREMENT MEAS_PmsHalf_CpuTime "Cpu usage for task PmsHalf [us]" UWORD MEAS.CONVERSION 0 0 0 65535 ECU_ADDRESS 0x4000A186 /end MEASUREMENT
/begin MEASUREMENT MEAS_PmsHalf_DeltaTime "Duration Time for task PmsHalf [us]" UWORD MEAS.CONVERSION 0 0 0 65535 ECU_ADDRESS 0x4000A1E6 /end MEASUREMENT
/begin MEASUREMENT MEAS_PmsHigh_CpuMaxTime "Max Cpu usage for task PmsLow [us]" UWORD MEAS.CONVERSION 0 0 0 65535 ECU_ADDRESS 0x4000A19C /end MEASUREMENT
/begin MEASUREMENT MEAS_PmsHigh_CpuMeanTime "Cpu usage for task PmsLow [us]" UWORD MEAS.CONVERSION 0 0 0 65535 ECU_ADDRESS 0x4000A1CC /end MEASUREMENT
/begin MEASUREMENT MEAS_PmsHigh_CpuMinTime "Min Cpu usage for task PmsLow [us]" UWORD MEAS.CONVERSION 0 0 0 65535 ECU_ADDRESS 0x4000A1B4 /end MEASUREMENT
/begin MEASUREMENT MEAS_PmsHigh_CpuTime "Cpu usage for task PmsLow [us]" UWORD MEAS.CONVERSION 0 0 0 65535 ECU_ADDRESS 0x4000A184 /end MEASUREMENT
/begin MEASUREMENT MEAS_PmsHigh_DeltaTime "Duration Time for task PmsLow [us]" UWORD MEAS.CONVERSION 0 0 0 65535 ECU_ADDRESS 0x4000A1E4 /end MEASUREMENT
/begin MEASUREMENT MEAS_PmsLow_CpuMaxTime "Max Cpu usage for task PmsLow [us]" UWORD MEAS.CONVERSION 0 0 0 65535 ECU_ADDRESS 0x4000A1A6 /end MEASUREMENT
/begin MEASUREMENT MEAS_PmsLow_CpuMeanTime "Cpu usage for task PmsLow [us]" UWORD MEAS.CONVERSION 0 0 0 65535 ECU_ADDRESS 0x4000A1D6 /end MEASUREMENT
/begin MEASUREMENT MEAS_PmsLow_CpuMinTime "Min Cpu usage for task PmsLow [us]" UWORD MEAS.CONVERSION 0 0 0 65535 ECU_ADDRESS 0x4000A1BE /end MEASUREMENT
/begin MEASUREMENT MEAS_PmsLow_CpuTime "Cpu usage for task PmsLow [us]" UWORD MEAS.CONVERSION 0 0 0 65535 ECU_ADDRESS 0x4000A18E /end MEASUREMENT
/begin MEASUREMENT MEAS_PmsLow_DeltaTime "Duration Time for task PmsLow [us]" UWORD MEAS.CONVERSION 0 0 0 65535 ECU_ADDRESS 0x4000A1EE /end MEASUREMENT
/begin CHARACTERISTIC MEAS_Reset "Clear Measurament" VALUE 0xFCDA5A Scalar_UBYTE 0 MEAS_ENABLE_RESET.CONVERSION 0 255 /end CHARACTERISTIC
/begin MEASUREMENT MEAS_TskTm_100ms_CpuMaxTime "Max Cpu usage for task 100ms [us]" UWORD MEAS.CONVERSION 0 0 0 65535 ECU_ADDRESS 0x4000A1AA /end MEASUREMENT
/begin MEASUREMENT MEAS_TskTm_100ms_CpuMeanTime "Cpu usage for task 100ms [us]" UWORD MEAS.CONVERSION 0 0 0 65535 ECU_ADDRESS 0x4000A1DA /end MEASUREMENT
/begin MEASUREMENT MEAS_TskTm_100ms_CpuMinTime "Min Cpu usage for task 100ms [us]" UWORD MEAS.CONVERSION 0 0 0 65535 ECU_ADDRESS 0x4000A1C2 /end MEASUREMENT
/begin MEASUREMENT MEAS_TskTm_100ms_CpuTime "Cpu usage for task 100ms [us]" UWORD MEAS.CONVERSION 0 0 0 65535 ECU_ADDRESS 0x4000A192 /end MEASUREMENT
/begin MEASUREMENT MEAS_TskTm_100ms_DeltaTime "Duration Time for task 100ms [us]" UWORD MEAS.CONVERSION 0 0 0 65535 ECU_ADDRESS 0x4000A1F2 /end MEASUREMENT
/begin MEASUREMENT MEAS_TskTm_10ms_CpuMaxTime "Max Cpu usage for task 10ms [us]" UWORD MEAS.CONVERSION 0 0 0 65535 ECU_ADDRESS 0x4000A1A4 /end MEASUREMENT
/begin MEASUREMENT MEAS_TskTm_10ms_CpuMeanTime "Cpu usage for task 10ms [us]" UWORD MEAS.CONVERSION 0 0 0 65535 ECU_ADDRESS 0x4000A1D4 /end MEASUREMENT
/begin MEASUREMENT MEAS_TskTm_10ms_CpuMinTime "Min Cpu usage for task 10ms [us]" UWORD MEAS.CONVERSION 0 0 0 65535 ECU_ADDRESS 0x4000A1BC /end MEASUREMENT
/begin MEASUREMENT MEAS_TskTm_10ms_CpuTime "Cpu usage for task 10ms [us]" UWORD MEAS.CONVERSION 0 0 0 65535 ECU_ADDRESS 0x4000A18C /end MEASUREMENT
/begin MEASUREMENT MEAS_TskTm_10ms_DeltaTime "Duration Time for task 10ms [us]" UWORD MEAS.CONVERSION 0 0 0 65535 ECU_ADDRESS 0x4000A1EC /end MEASUREMENT
/begin MEASUREMENT MEAS_TskTm_1ms_CpuMaxTime "Max Cpu usage for task 1ms [us]" UWORD MEAS.CONVERSION 0 0 0 65535 ECU_ADDRESS 0x4000A1A0 /end MEASUREMENT
/begin MEASUREMENT MEAS_TskTm_1ms_CpuMeanTime "Cpu usage for task 1ms [us]" UWORD MEAS.CONVERSION 0 0 0 65535 ECU_ADDRESS 0x4000A1D0 /end MEASUREMENT
/begin MEASUREMENT MEAS_TskTm_1ms_CpuMinTime "Min Cpu usage for task 1ms [us]" UWORD MEAS.CONVERSION 0 0 0 65535 ECU_ADDRESS 0x4000A1B8 /end MEASUREMENT
/begin MEASUREMENT MEAS_TskTm_1ms_CpuTime "Cpu usage for task 1ms [us]" UWORD MEAS.CONVERSION 0 0 0 65535 ECU_ADDRESS 0x4000A188 /end MEASUREMENT
/begin MEASUREMENT MEAS_TskTm_1ms_DeltaTime "Duration Time for task 1ms [us]" UWORD MEAS.CONVERSION 0 0 0 65535 ECU_ADDRESS 0x4000A1E8 /end MEASUREMENT
/begin MEASUREMENT MEAS_TskTm_1s_CpuMaxTime "Max Cpu usage for task 1s [us]" UWORD MEAS.CONVERSION 0 0 0 65535 ECU_ADDRESS 0x4000A1AC /end MEASUREMENT
/begin MEASUREMENT MEAS_TskTm_1s_CpuMeanTime "Cpu usage for task 1s [us]" UWORD MEAS.CONVERSION 0 0 0 65535 ECU_ADDRESS 0x4000A1DC /end MEASUREMENT
/begin MEASUREMENT MEAS_TskTm_1s_CpuMinTime "Min Cpu usage for task 1s [us]" UWORD MEAS.CONVERSION 0 0 0 65535 ECU_ADDRESS 0x4000A1C4 /end MEASUREMENT
/begin MEASUREMENT MEAS_TskTm_1s_CpuTime "Cpu usage for task 1s [us]" UWORD MEAS.CONVERSION 0 0 0 65535 ECU_ADDRESS 0x4000A194 /end MEASUREMENT
/begin MEASUREMENT MEAS_TskTm_1s_DeltaTime "Duration Time for task 1s [us]" UWORD MEAS.CONVERSION 0 0 0 65535 ECU_ADDRESS 0x4000A1F4 /end MEASUREMENT
/begin MEASUREMENT MEAS_TskTm_2ms_CpuMaxTime "Max Cpu usage for task 2ms [us]" UWORD MEAS.CONVERSION 0 0 0 65535 ECU_ADDRESS 0x4000A1B0 /end MEASUREMENT
/begin MEASUREMENT MEAS_TskTm_2ms_CpuMeanTime "Cpu usage for task 2ms [us]" UWORD MEAS.CONVERSION 0 0 0 65535 ECU_ADDRESS 0x4000A1E0 /end MEASUREMENT
/begin MEASUREMENT MEAS_TskTm_2ms_CpuMinTime "Min Cpu usage for task 2ms [us]" UWORD MEAS.CONVERSION 0 0 0 65535 ECU_ADDRESS 0x4000A1C8 /end MEASUREMENT
/begin MEASUREMENT MEAS_TskTm_2ms_CpuTime "Cpu usage for task 2ms [us]" UWORD MEAS.CONVERSION 0 0 0 65535 ECU_ADDRESS 0x4000A198 /end MEASUREMENT
/begin MEASUREMENT MEAS_TskTm_2ms_DeltaTime "Duration Time for task 2ms [us]" UWORD MEAS.CONVERSION 0 0 0 65535 ECU_ADDRESS 0x4000A1F8 /end MEASUREMENT
/begin MEASUREMENT MEAS_TskTm_4ms_CpuMaxTime "Max Cpu usage for task 4ms [us]" UWORD MEAS.CONVERSION 0 0 0 65535 ECU_ADDRESS 0x4000A1A2 /end MEASUREMENT
/begin MEASUREMENT MEAS_TskTm_4ms_CpuMeanTime "Cpu usage for task 4ms [us]" UWORD MEAS.CONVERSION 0 0 0 65535 ECU_ADDRESS 0x4000A1D2 /end MEASUREMENT
/begin MEASUREMENT MEAS_TskTm_4ms_CpuMinTime "Min Cpu usage for task 4ms [us]" UWORD MEAS.CONVERSION 0 0 0 65535 ECU_ADDRESS 0x4000A1BA /end MEASUREMENT
/begin MEASUREMENT MEAS_TskTm_4ms_CpuTime "Cpu usage for task 4ms [us]" UWORD MEAS.CONVERSION 0 0 0 65535 ECU_ADDRESS 0x4000A18A /end MEASUREMENT
/begin MEASUREMENT MEAS_TskTm_4ms_DeltaTime "Duration Time for task 4ms [us]" UWORD MEAS.CONVERSION 0 0 0 65535 ECU_ADDRESS 0x4000A1EA /end MEASUREMENT
/begin MEASUREMENT MEAS_TskTm_50ms_CpuMaxTime "Max Cpu usage for task 50ms [us]" UWORD MEAS.CONVERSION 0 0 0 65535 ECU_ADDRESS 0x4000A1A8 /end MEASUREMENT
/begin MEASUREMENT MEAS_TskTm_50ms_CpuMeanTime "Cpu usage for task 50ms [us]" UWORD MEAS.CONVERSION 0 0 0 65535 ECU_ADDRESS 0x4000A1D8 /end MEASUREMENT
/begin MEASUREMENT MEAS_TskTm_50ms_CpuMinTime "Min Cpu usage for task 50ms [us]" UWORD MEAS.CONVERSION 0 0 0 65535 ECU_ADDRESS 0x4000A1C0 /end MEASUREMENT
/begin MEASUREMENT MEAS_TskTm_50ms_CpuTime "Cpu usage for task 50ms [us]" UWORD MEAS.CONVERSION 0 0 0 65535 ECU_ADDRESS 0x4000A190 /end MEASUREMENT
/begin MEASUREMENT MEAS_TskTm_50ms_DeltaTime "Duration Time for task 50ms [us]" UWORD MEAS.CONVERSION 0 0 0 65535 ECU_ADDRESS 0x4000A1F0 /end MEASUREMENT
/begin MEASUREMENT MEAS_TskTm_5s_CpuMaxTime "Max Cpu usage for task 5s [us]" UWORD MEAS.CONVERSION 0 0 0 65535 ECU_ADDRESS 0x4000A1AE /end MEASUREMENT
/begin MEASUREMENT MEAS_TskTm_5s_CpuMeanTime "Cpu usage for task 5s [us]" UWORD MEAS.CONVERSION 0 0 0 65535 ECU_ADDRESS 0x4000A1DE /end MEASUREMENT
/begin MEASUREMENT MEAS_TskTm_5s_CpuMinTime "Min Cpu usage for task 5s [us]" UWORD MEAS.CONVERSION 0 0 0 65535 ECU_ADDRESS 0x4000A1C6 /end MEASUREMENT
/begin MEASUREMENT MEAS_TskTm_5s_CpuTime "Cpu usage for task 5s [us]" UWORD MEAS.CONVERSION 0 0 0 65535 ECU_ADDRESS 0x4000A196 /end MEASUREMENT
/begin MEASUREMENT MEAS_TskTm_5s_DeltaTime "Duration Time for task 5s [us]" UWORD MEAS.CONVERSION 0 0 0 65535 ECU_ADDRESS 0x4000A1F6 /end MEASUREMENT
/begin MEASUREMENT MEAS_Tsk_Background_CpuMaxTime "Max Cpu usage for task Background [us]" UWORD MEAS.CONVERSION 0 0 0 65535 ECU_ADDRESS 0x4000A1B2 /end MEASUREMENT
/begin MEASUREMENT MEAS_Tsk_Background_CpuMeanTime "Cpu usage for task Background [us]" UWORD MEAS.CONVERSION 0 0 0 65535 ECU_ADDRESS 0x4000A1E2 /end MEASUREMENT
/begin MEASUREMENT MEAS_Tsk_Background_CpuMinTime "Min Cpu usage for task Background [us]" UWORD MEAS.CONVERSION 0 0 0 65535 ECU_ADDRESS 0x4000A1CA /end MEASUREMENT
/begin MEASUREMENT MEAS_Tsk_Background_CpuTime "Cpu usage for task Background [us]" UWORD MEAS.CONVERSION 0 0 0 65535 ECU_ADDRESS 0x4000A19A /end MEASUREMENT
/begin MEASUREMENT MEAS_Tsk_Background_DeltaTime "Duration Time for task Background [us]" UWORD MEAS.CONVERSION 0 0 0 65535 ECU_ADDRESS 0x4000A1FA /end MEASUREMENT
/begin CHARACTERISTIC OsTaskDisableAPI "Fix to disable API Execution" VALUE 0xFCDA5B Scalar_BOOLEAN 0 OsTaskDisableAPI.CONVERSION 0 1 /end CHARACTERISTIC
/begin CHARACTERISTIC REQVCMECM_SA "S.A.  for REQVCMECM" VALUE 0xFCDA55 Scalar_UBYTE 0 REQVCMECM_SA.CONVERSION 0 255 /end CHARACTERISTIC
/begin CHARACTERISTIC TSC1_C1_SA "S.A.  for TSC1_C1" VALUE 0xFCDA57 Scalar_UBYTE 0 TSC1_C1_SA.CONVERSION 0 255 /end CHARACTERISTIC
/begin CHARACTERISTIC TSC1_C2_SA "S.A.  for TSC1_C2" VALUE 0xFCDA56 Scalar_UBYTE 0 TSC1_C2_SA.CONVERSION 0 255 /end CHARACTERISTIC
/begin CHARACTERISTIC TSC1_L_SA "S.A.  for TSC1_L" VALUE 0xFCDA58 Scalar_UBYTE 0 TSC1_L_SA.CONVERSION 0 255 /end CHARACTERISTIC
/begin CHARACTERISTIC TSC1_TR_SA "S.A.  for TSC1_TR" VALUE 0xFCDA59 Scalar_UBYTE 0 TSC1_TR_SA.CONVERSION 0 255 /end CHARACTERISTIC
/begin CHARACTERISTIC afAFSTECHIO_FIN_Enable "[FIX] Fix for A/F stechiometric value  corrected by the final lambda target" VALUE 0xFC1E24 Scalar_UBYTE 0 AirSpeedDensityTDC_CM_FixEnableT 171 218 /end CHARACTERISTIC
/begin CHARACTERISTIC afAFSTECHIO_FIN_Value "[FIX] Fix for A/F stechiometric value  corrected by the final lambda target" VALUE 0xFC1E22 Scalar_UWORD 0 AirSpeedDensityTDC_CM_ufix16_En10_adm 5 30 /end CHARACTERISTIC
/begin CHARACTERISTIC afAIR_MAIN_Enable "[FIX] Fix su Aria aspirata calcolata dal debimetro (prima della correzione in transitorio0 in kg/h" VALUE 0xFC1E20 Scalar_UBYTE 0 Air_Flow_MgmTDC_CM_FixEnableT 171 218 /end CHARACTERISTIC
/begin CHARACTERISTIC afAIR_MAIN_Value "[FIX] Fix su Aria aspirata calcolata dal debimetro (prima della correzione in transitorio0 in kg/h" VALUE 0xFC1E1E Scalar_UWORD 0 Air_Flow_MgmTDC_CM_ufix16_En4_kg_h 0 4000 /end CHARACTERISTIC
/begin CHARACTERISTIC afAIR_SEC_Enable "[FIX] Fix su Aria aspirata calcolata dal debimetro (prima della correzione in transitorio0 in kg/h" VALUE 0xFC1E1C Scalar_UBYTE 0 Air_Flow_MgmTDC_CM_FixEnableT 171 218 /end CHARACTERISTIC
/begin CHARACTERISTIC afAIR_SEC_Value "[FIX] Fix su Aria aspirata calcolata dal debimetro (prima della correzione in transitorio0 in kg/h" VALUE 0xFC1E1A Scalar_UWORD 0 Air_Flow_MgmTDC_CM_ufix16_En4_kg_h 0 4000 /end CHARACTERISTIC
/begin CHARACTERISTIC afCRK_TRANS_FRZ_DIS_Enable "[FIX] Fix sulla abilitazione al freeze delle variabili per riconoscimento transitori (1 -> disabilita)" VALUE 0xFC021E Scalar_UBYTE 0 RicTrans4ms_CM_FixEnableT 171 218 /end CHARACTERISTIC
/begin CHARACTERISTIC afCRK_TRANS_FRZ_DIS_Value "[FIX] Fix sulla abilitazione al freeze delle variabili per riconoscimento transitori (1 -> disabilita)" VALUE 0xFC021D Scalar_BOOLEAN 0 RicTrans4ms_CM_boolean_adm 0 1 /end CHARACTERISTIC
/begin CHARACTERISTIC afCUR_CYL_TST_Enable "[FIX] Current Cylinder Index used to get the asResAspir (calibrate to 0 in order to avoid Unbalanced Individual Cylinder correction)" VALUE 0xFC1E18 Scalar_UBYTE 0 AirSpeedDensityTDC_CM_FixEnableT 171 218 /end CHARACTERISTIC
/begin CHARACTERISTIC afCUR_CYL_TST_Value "[FIX] Current Cylinder Index used to get the asResAspir (calibrate to 0 in order to avoid Unbalanced Individual Cylinder correction)" VALUE 0xFC1E17 Scalar_UBYTE 0 AirSpeedDensityTDC_CM_uint8_adm 0 8 /end CHARACTERISTIC
/begin CHARACTERISTIC afETASP_Enable "[FIX] Fix sul Rendimento Volumetrico" VALUE 0xFC1E16 Scalar_UBYTE 0 Air_Flow_MgmTDC_CM_FixEnableT 171 218 /end CHARACTERISTIC
/begin CHARACTERISTIC afETASP_Value "[FIX] Fix sul Rendimento Volumetrico" VALUE 0xFC1E14 Scalar_UWORD 0 Air_Flow_MgmTDC_CM_ufix16_En10_adm 0 3 /end CHARACTERISTIC
/begin CHARACTERISTIC afETSP_FARF_Enable "[FIX] Tabella Alpha-N per il calcolo del rendimento di limp_home" VALUE 0xFC1E13 Scalar_UBYTE 0 AirAlphaNTDC_CM_FixEnableT 171 218 /end CHARACTERISTIC
/begin CHARACTERISTIC afETSP_FARF_PRE_Enable "[FIX] Tabella Alpha-N per il calcolo del rendimento di limp_home" VALUE 0xFC1E12 Scalar_UBYTE 0 AirAlphaNTDC_CM_FixEnableT 171 218 /end CHARACTERISTIC
/begin CHARACTERISTIC afETSP_FARF_PRE_Value "[FIX] Tabella Alpha-N per il calcolo del rendimento di limp_home" VALUE 0xFC1E10 Scalar_UWORD 0 AirAlphaNTDC_CM_ufix16_En10_adm 0 3 /end CHARACTERISTIC
/begin CHARACTERISTIC afETSP_FARF_Value "[FIX] Tabella Alpha-N per il calcolo del rendimento di limp_home" VALUE 0xFC1E0E Scalar_UWORD 0 AirAlphaNTDC_CM_ufix16_En10_adm 0 3 /end CHARACTERISTIC
/begin CHARACTERISTIC afFLAG_END_TRANS_Enable "[FIX] Fix sul Flag Riconoscimento Fine transitori" VALUE 0xFC021C Scalar_UBYTE 0 RicTrans4ms_CM_FixEnableT 171 218 /end CHARACTERISTIC
/begin CHARACTERISTIC afFLAG_END_TRANS_Value "[FIX] Fix sul Flag Riconoscimento Fine transitori" VALUE 0xFC021B Scalar_BOOLEAN 0 RicTrans4ms_CM_boolean_adm 0 1 /end CHARACTERISTIC
/begin CHARACTERISTIC afFLAG_TRANS_Enable "[FIX] Fix sul Flag Riconoscimento transitori" VALUE 0xFC021A Scalar_UBYTE 0 RicTrans4ms_CM_FixEnableT 171 218 /end CHARACTERISTIC
/begin CHARACTERISTIC afFLAG_TRANS_Value "[FIX] Fix sul Flag Riconoscimento transitori" VALUE 0xFC0219 Scalar_BOOLEAN 0 RicTrans4ms_CM_boolean_adm 0 1 /end CHARACTERISTIC
/begin CHARACTERISTIC afKFHW_POBJ_ATT_Enable "[FIX] Vettore di filtraggio della PObj in attacco" VALUE 0xFC0218 Scalar_UBYTE 0 PressEstim4ms_CM_FixEnableT 171 218 /end CHARACTERISTIC
/begin CHARACTERISTIC afKFHW_POBJ_ATT_Value "[FIX] Vettore di filtraggio della PObj in attacco" VALUE 0xFC0216 Scalar_UWORD 0 PressEstim4ms_CM_ufix16_En15_adm 0 1 /end CHARACTERISTIC
/begin CHARACTERISTIC afKFHW_POBJ_RIL_Enable "[FIX] Vettore di filtraggio della PObj in rilascio" VALUE 0xFC0214 Scalar_UBYTE 0 PressEstim4ms_CM_FixEnableT 171 218 /end CHARACTERISTIC
/begin CHARACTERISTIC afKFHW_POBJ_RIL_Value "[FIX] Vettore di filtraggio della PObj in rilascio" VALUE 0xFC0212 Scalar_UWORD 0 PressEstim4ms_CM_ufix16_En15_adm 0 1 /end CHARACTERISTIC
/begin CHARACTERISTIC afKF_MEAN_VAL_Enable "[FIX] Costante del filtro per estrarre una buona approssimazione del delta di pressione tra le due componenti continue" VALUE 0xFC0210 Scalar_UBYTE 0 PressEstim4ms_CM_FixEnableT 171 218 /end CHARACTERISTIC
/begin CHARACTERISTIC afKF_MEAN_VAL_Value "[FIX] Costante del filtro per estrarre una buona approssimazione del delta di pressione tra le due componenti continue" VALUE 0xFC020E Scalar_UWORD 0 PressEstim4ms_CM_ufix16_En14_adm 0 1 /end CHARACTERISTIC
/begin CHARACTERISTIC afMAP4CRK_DIS_Enable "[FIX] Fix per disabilitare uso Map per fase crancking (1 -> disabilita)" VALUE 0xFC020C Scalar_UBYTE 0 PressEstim4ms_CM_FixEnableT 171 218 /end CHARACTERISTIC
/begin CHARACTERISTIC afMAP4CRK_DIS_Value "[FIX] Fix per disabilitare uso Map per fase crancking (1 -> disabilita)" VALUE 0xFC020B Scalar_BOOLEAN 0 PressEstim4ms_CM_boolean_adm 0 1 /end CHARACTERISTIC
/begin CHARACTERISTIC afMAP_Enable "[FIX] Fix sulla map per saturazione inferiore asPre" VALUE 0xFC020A Scalar_UBYTE 0 PressEstim4ms_CM_FixEnableT 171 218 /end CHARACTERISTIC
/begin CHARACTERISTIC afMAP_Value "[FIX] Fix sulla map per saturazione inferiore asPre" VALUE 0xFC0208 Scalar_UWORD 0 PressEstim4ms_CM_uint16_mbar 150 2500 /end CHARACTERISTIC
/begin CHARACTERISTIC afMASS_FLOW_EGR_OBJ_AN_Enable "[FIX] EGR requested flow rate in [kg/h] for alphaN  model." VALUE 0xFC1E0C Scalar_UBYTE 0 AirAlphaNTDC_CM_FixEnableT 171 218 /end CHARACTERISTIC
/begin CHARACTERISTIC afMASS_FLOW_EGR_OBJ_AN_Value "[FIX] EGR requested flow rate in [kg/h] for alphaN model." VALUE 0xFC1E0A Scalar_UWORD 0 AirAlphaNTDC_CM_ufix16_En4_kg_h 0 4000 /end CHARACTERISTIC
/begin CHARACTERISTIC afMASS_FLOW_EGR_OBJ_SD_Enable "[FIX] EGR requested flow rate in [kg/s] for speed density model." VALUE 0xFC1E08 Scalar_UBYTE 0 AirSpeedDensityTDC_CM_FixEnableT 171 218 /end CHARACTERISTIC
/begin CHARACTERISTIC afMASS_FLOW_EGR_OBJ_SD_Value "[FIX] EGR requested flow rate in [kg/s] for speed density model." VALUE 0xFC1E04 Scalar_FLOAT32_IEEE 0 AirSpeedDensityTDC_CM_single_kg_s 0 0.25 /end CHARACTERISTIC
/begin CHARACTERISTIC afOFF_TVALV_Enable "[FIX] Delta di temperatura rispetto alla temperatura collettore. Tvalv=(Tair+Th2o)/2+avOFF_TVALV." VALUE 0xFC1E00 Scalar_UBYTE 0 AirSpeedDensityTDC_CM_FixEnableT 171 218 /end CHARACTERISTIC
/begin CHARACTERISTIC afOFF_TVALV_Value "[FIX] Delta di temperatura rispetto alla temperatura collettore. Tvalv=(Tair+Th2o)/2+avOFF_TVALV." VALUE 0xFC1DFE Scalar_SWORD 0 AirSpeedDensityTDC_CM_int16_degC -100 100 /end CHARACTERISTIC
/begin CHARACTERISTIC afPATM_Enable "[FIX] Atmospheric pressure (absolute) for AlphaN correction" VALUE 0xFC1DFC Scalar_UBYTE 0 AirAlphaNTDC_CM_FixEnableT 171 218 /end CHARACTERISTIC
/begin CHARACTERISTIC afPATM_Value "[FIX] Atmospheric pressure (absolute) for AlphaN correction" VALUE 0xFC1DFA Scalar_UWORD 0 AirAlphaNTDC_CM_uint16_mbar 150 1150 /end CHARACTERISTIC
/begin CHARACTERISTIC afPBOOST_Enable "[FIX] Boost pressure (absolute) for AlphaN correction" VALUE 0xFC1DF8 Scalar_UBYTE 0 AirAlphaNTDC_CM_FixEnableT 171 218 /end CHARACTERISTIC
/begin CHARACTERISTIC afPBOOST_Value "[FIX] Boost pressure (absolute) for AlphaN correction" VALUE 0xFC1DF6 Scalar_UWORD 0 AirAlphaNTDC_CM_uint16_mbar 500 4000 /end CHARACTERISTIC
/begin CHARACTERISTIC afPCOLL_DELTA_MEAN_VAL_Enable "[FIX] Fix su asPcollDeltaMeanVal" VALUE 0xFC0206 Scalar_UBYTE 0 PressEstim4ms_CM_FixEnableT 171 218 /end CHARACTERISTIC
/begin CHARACTERISTIC afPCOLL_DELTA_MEAN_VAL_Value "[FIX] Fix su asPcollDeltaMeanVal" VALUE 0xFC0204 Scalar_SWORD 0 PressEstim4ms_CM_int16_mbar -2500 2500 /end CHARACTERISTIC
/begin CHARACTERISTIC afPCOLL_MEAN_VAL_DIS_Enable "[FIX] Fix per annullare l`adattamento del valor medio della pressione stimata (ON@0)" VALUE 0xFC0202 Scalar_UBYTE 0 PressEstim4ms_CM_FixEnableT 171 218 /end CHARACTERISTIC
/begin CHARACTERISTIC afPCOLL_MEAN_VAL_DIS_Value "[FIX] Fix per annullare l`adattamento del valor medio della pressione stimata (ON@0)" VALUE 0xFC0200 Scalar_SWORD 0 PressEstim4ms_CM_int16_mbar -2500 2500 /end CHARACTERISTIC
/begin CHARACTERISTIC afPRES_OBJ_GAIN_Enable "[FIX] PObj amplification factor for transient recognition" VALUE 0xFC01FE Scalar_UBYTE 0 RicTrans4ms_CM_FixEnableT 171 218 /end CHARACTERISTIC
/begin CHARACTERISTIC afPRES_OBJ_GAIN_Value "[FIX] PObj amplification factor for transient recognition" VALUE 0xFC01FC Scalar_UWORD 0 RicTrans4ms_CM_ufix16_En10_adm 0 10 /end CHARACTERISTIC
/begin CHARACTERISTIC afPRES_OBJ_OFF_Enable "[FIX] PObj offset factor for transient recognition" VALUE 0xFC01FA Scalar_UBYTE 0 RicTrans4ms_CM_FixEnableT 171 218 /end CHARACTERISTIC
/begin CHARACTERISTIC afPRES_OBJ_OFF_Value "[FIX] PObj offset factor for transient recognition" VALUE 0xFC01F8 Scalar_SWORD 0 RicTrans4ms_CM_int16_mbar -1000 1000 /end CHARACTERISTIC
/begin CHARACTERISTIC afPRE_Enable "[FIX] Fix sulla Pressione collettore stimata dal predittore di pressione" VALUE 0xFC01F6 Scalar_UBYTE 0 PressEstim4ms_CM_FixEnableT 171 218 /end CHARACTERISTIC
/begin CHARACTERISTIC afPRE_FOR_HI_CTRL_PID_Enable "[FIX] Fix per bypassare l`utilizzo continuo della pressione obiettivo in modalità High Idle Control PID" VALUE 0xFC01F5 Scalar_UBYTE 0 PressEstim4ms_CM_FixEnableT 171 218 /end CHARACTERISTIC
/begin CHARACTERISTIC afPRE_FOR_HI_CTRL_PID_Value "[FIX] Fix per bypassare l`utilizzo continuo della pressione obiettivo in modalità High Idle Control PID" VALUE 0xFC01F4 Scalar_BOOLEAN 0 PressEstim4ms_CM_boolean_adm 0 1 /end CHARACTERISTIC
/begin CHARACTERISTIC afPRE_FOR_LI_CTRL_PID_Enable "[FIX] Fix per bypassare l`utilizzo continuo della pressione obiettivo in modalità Low Idle Control PID" VALUE 0xFC01F3 Scalar_UBYTE 0 PressEstim4ms_CM_FixEnableT 171 218 /end CHARACTERISTIC
/begin CHARACTERISTIC afPRE_FOR_LI_CTRL_PID_Value "[FIX] Fix per bypassare l`utilizzo continuo della pressione obiettivo in modalità Low Idle Control PID" VALUE 0xFC01F2 Scalar_BOOLEAN 0 PressEstim4ms_CM_boolean_adm 0 1 /end CHARACTERISTIC
/begin CHARACTERISTIC afPRE_FOR_SPD_CTRL_PID_Enable "[FIX] Fix per bypassare l`utilizzo continuo della pressione obiettivo in modalità Speed Control PID" VALUE 0xFC01F1 Scalar_UBYTE 0 PressEstim4ms_CM_FixEnableT 171 218 /end CHARACTERISTIC
/begin CHARACTERISTIC afPRE_FOR_SPD_CTRL_PID_Value "[FIX] Fix per bypassare l`utilizzo continuo della pressione obiettivo in modalità Speed Control PID" VALUE 0xFC01F0 Scalar_BOOLEAN 0 PressEstim4ms_CM_boolean_adm 0 1 /end CHARACTERISTIC
/begin CHARACTERISTIC afPRE_SCARICO_Enable "[FIX] Tabella della pressione allo scarico" VALUE 0xFC1DF4 Scalar_UBYTE 0 AirSpeedDensityTDC_CM_FixEnableT 171 218 /end CHARACTERISTIC
/begin CHARACTERISTIC afPRE_SCARICO_Value "[FIX] Tabella della pressione allo scarico" VALUE 0xFC1DF2 Scalar_UWORD 0 AirSpeedDensityTDC_CM_uint16_mbar 0 3000 /end CHARACTERISTIC
/begin CHARACTERISTIC afPRE_Value "[FIX] Fix sulla Pressione collettore stimata dal predittore di pressione" VALUE 0xFC01EE Scalar_UWORD 0 PressEstim4ms_CM_uint16_mbar 0 3000 /end CHARACTERISTIC
/begin CHARACTERISTIC afP_OBJ_CORR_Enable "[FIX] Vettore di normalizzazione della differenza PObj-MAP per calcolo transitorio" VALUE 0xFC01EC Scalar_UBYTE 0 RicTrans4ms_CM_FixEnableT 171 218 /end CHARACTERISTIC
/begin CHARACTERISTIC afP_OBJ_CORR_Value "[FIX] Vettore di normalizzazione della differenza PObj-MAP per calcolo transitorio" VALUE 0xFC01EA Scalar_UWORD 0 RicTrans4ms_CM_ufix16_En4_mbar 1 250 /end CHARACTERISTIC
/begin CHARACTERISTIC afQAC_MAIN_Enable "[FIX] Fix for Fresh Air Mass Flow from MAF sensor for each Stroke" VALUE 0xFC1DF0 Scalar_UBYTE 0 Air_Flow_MgmTDC_CM_FixEnableT 171 218 /end CHARACTERISTIC
/begin CHARACTERISTIC afQAC_MAIN_Value "[FIX] Fix for Fresh Air Mass Flow from MAF sensor for each Stroke" VALUE 0xFC1DEE Scalar_UWORD 0 Air_Flow_MgmTDC_CM_ufix16_En3_mg_cc 0 8191 /end CHARACTERISTIC
/begin CHARACTERISTIC afQAC_MAP_SD_Enable "[FIX] Fix Fresh Air Mass Flow for each Stroke" VALUE 0xFC1DEC Scalar_UBYTE 0 AirSpeedDensityTDC_CM_FixEnableT 171 218 /end CHARACTERISTIC
/begin CHARACTERISTIC afQAC_MAP_SD_Value "[FIX] Fix Fresh Air Mass Flow for each Stroke" VALUE 0xFC1DEA Scalar_UWORD 0 AirSpeedDensityTDC_CM_ufix16_En3_mg_cc 0 8191 /end CHARACTERISTIC
/begin CHARACTERISTIC afQAC_PRE_SD_Enable "[FIX] Fix sulla quantità in mg dell`aria aspirata " VALUE 0xFC1DE8 Scalar_UBYTE 0 AirSpeedDensityTDC_CM_FixEnableT 171 218 /end CHARACTERISTIC
/begin CHARACTERISTIC afQAC_PRE_SD_Value "[FIX] Fix sulla quantità in mg dell`aria aspirata " VALUE 0xFC1DE6 Scalar_UWORD 0 AirSpeedDensityTDC_CM_ufix16_En3_mg_cc 0 8191 /end CHARACTERISTIC
/begin CHARACTERISTIC afQAH_MAP_SD_Enable "[FIX] Fix sulla quantità in Kg/h dell`aria aspirata" VALUE 0xFC1DE4 Scalar_UBYTE 0 AirSpeedDensityTDC_CM_FixEnableT 171 218 /end CHARACTERISTIC
/begin CHARACTERISTIC afQAH_MAP_SD_Value "[FIX] Fix sulla quantità in Kg/h dell`aria aspirata" VALUE 0xFC1DE2 Scalar_UWORD 0 AirSpeedDensityTDC_CM_ufix16_En4_Kg_h 0 4000 /end CHARACTERISTIC
/begin CHARACTERISTIC afQAH_PRE_SD_Enable "[FIX] Fix sulla quantità in Kg/h dell`aria aspirata " VALUE 0xFC1DE0 Scalar_UBYTE 0 AirSpeedDensityTDC_CM_FixEnableT 171 218 /end CHARACTERISTIC
/begin CHARACTERISTIC afQAH_PRE_SD_Value "[FIX] Fix sulla quantità in Kg/h dell`aria aspirata " VALUE 0xFC1DDE Scalar_UWORD 0 AirSpeedDensityTDC_CM_ufix16_En4_Kg_h 0 4000 /end CHARACTERISTIC
/begin CHARACTERISTIC afQASP_DIV_MAP_Enable "[FIX] Fix sul Rapporto tra la miscela aspirata e la pressione in fase di apsirazione " VALUE 0xFC1DDC Scalar_UBYTE 0 AirSpeedDensityTDC_CM_FixEnableT 171 218 /end CHARACTERISTIC
/begin CHARACTERISTIC afQASP_DIV_MAP_Value "[FIX] Fix sul Rapporto tra la miscela aspirata e la pressione in fase di apsirazione " VALUE 0xFC1DDA Scalar_UWORD 0 AirSpeedDensityTDC_CM_ufix16_En24_m_s 0 4.9650669098E-05 /end CHARACTERISTIC
/begin CHARACTERISTIC afRES_ASPIR1_Enable "[FIX] Map of the fluid dynamic resistance of the intake valves (CYL1)" VALUE 0xFC1DD8 Scalar_UBYTE 0 AirSpeedDensityTDC_CM_FixEnableT 171 218 /end CHARACTERISTIC
/begin CHARACTERISTIC afRES_ASPIR1_Value "[FIX] Map of the fluid dynamic resistance of the intake valves (CYL1)" VALUE 0xFC1DD6 Scalar_UWORD 0 AirSpeedDensityTDC_CM_uint16_bit_s_m 32 32768 /end CHARACTERISTIC
/begin CHARACTERISTIC afRES_ASPIR2_Enable "[FIX] Map of the fluid dynamic resistance of the intake valves (CYL2)" VALUE 0xFC1DD4 Scalar_UBYTE 0 AirSpeedDensityTDC_CM_FixEnableT 171 218 /end CHARACTERISTIC
/begin CHARACTERISTIC afRES_ASPIR2_Value "[FIX] Map of the fluid dynamic resistance of the intake valves (CYL2)" VALUE 0xFC1DD2 Scalar_UWORD 0 AirSpeedDensityTDC_CM_uint16_bit_s_m 32 32768 /end CHARACTERISTIC
/begin CHARACTERISTIC afRES_ASPIR3_Enable "[FIX] Map of the fluid dynamic resistance of the intake valves (CYL3)" VALUE 0xFC1DD0 Scalar_UBYTE 0 AirSpeedDensityTDC_CM_FixEnableT 171 218 /end CHARACTERISTIC
/begin CHARACTERISTIC afRES_ASPIR3_Value "[FIX] Map of the fluid dynamic resistance of the intake valves (CYL3)" VALUE 0xFC1DCE Scalar_UWORD 0 AirSpeedDensityTDC_CM_uint16_bit_s_m 32 32768 /end CHARACTERISTIC
/begin CHARACTERISTIC afRES_ASPIR4_Enable "[FIX] Map of the fluid dynamic resistance of the intake valves (CYL4)" VALUE 0xFC1DCC Scalar_UBYTE 0 AirSpeedDensityTDC_CM_FixEnableT 171 218 /end CHARACTERISTIC
/begin CHARACTERISTIC afRES_ASPIR4_Value "[FIX] Map of the fluid dynamic resistance of the intake valves (CYL4)" VALUE 0xFC1DCA Scalar_UWORD 0 AirSpeedDensityTDC_CM_uint16_bit_s_m 32 32768 /end CHARACTERISTIC
/begin CHARACTERISTIC afRES_ASPIR5_Enable "[FIX] Map of the fluid dynamic resistance of the intake valves (CYL5)" VALUE 0xFC1DC8 Scalar_UBYTE 0 AirSpeedDensityTDC_CM_FixEnableT 171 218 /end CHARACTERISTIC
/begin CHARACTERISTIC afRES_ASPIR5_Value "[FIX] Map of the fluid dynamic resistance of the intake valves (CYL5)" VALUE 0xFC1DC6 Scalar_UWORD 0 AirSpeedDensityTDC_CM_uint16_bit_s_m 32 32768 /end CHARACTERISTIC
/begin CHARACTERISTIC afRES_ASPIR6_Enable "[FIX] Map of the fluid dynamic resistance of the intake valves (CYL6)" VALUE 0xFC1DC4 Scalar_UBYTE 0 AirSpeedDensityTDC_CM_FixEnableT 171 218 /end CHARACTERISTIC
/begin CHARACTERISTIC afRES_ASPIR6_Value "[FIX] Map of the fluid dynamic resistance of the intake valves (CYL6)" VALUE 0xFC1DC2 Scalar_UWORD 0 AirSpeedDensityTDC_CM_uint16_bit_s_m 32 32768 /end CHARACTERISTIC
/begin CHARACTERISTIC afRES_ASPIR7_Enable "[FIX] Map of the fluid dynamic resistance of the intake valves (CYL7)" VALUE 0xFC1DC0 Scalar_UBYTE 0 AirSpeedDensityTDC_CM_FixEnableT 171 218 /end CHARACTERISTIC
/begin CHARACTERISTIC afRES_ASPIR7_Value "[FIX] Map of the fluid dynamic resistance of the intake valves (CYL7)" VALUE 0xFC1DBE Scalar_UWORD 0 AirSpeedDensityTDC_CM_uint16_bit_s_m 32 32768 /end CHARACTERISTIC
/begin CHARACTERISTIC afRES_ASPIR8_Enable "[FIX] Map of the fluid dynamic resistance of the intake valves (CYL8)" VALUE 0xFC1DBC Scalar_UBYTE 0 AirSpeedDensityTDC_CM_FixEnableT 171 218 /end CHARACTERISTIC
/begin CHARACTERISTIC afRES_ASPIR8_Value "[FIX] Map of the fluid dynamic resistance of the intake valves (CYL8)" VALUE 0xFC1DBA Scalar_UWORD 0 AirSpeedDensityTDC_CM_uint16_bit_s_m 32 32768 /end CHARACTERISTIC
/begin CHARACTERISTIC afRES_ASPIR_Enable "[FIX] Map of the fluid dynamic resistance of the intake valves (All Cylinders)" VALUE 0xFC1DB8 Scalar_UBYTE 0 AirSpeedDensityTDC_CM_FixEnableT 171 218 /end CHARACTERISTIC
/begin CHARACTERISTIC afRES_ASPIR_Value "[FIX] Map of the fluid dynamic resistance of the intake valves (All Cylinders)" VALUE 0xFC1DB6 Scalar_UWORD 0 AirSpeedDensityTDC_CM_uint16_bit_s_m 32 32768 /end CHARACTERISTIC
/begin CHARACTERISTIC afTBFRECATG "[FIX] Tabella di frequenze standard per diagnosi catalizzatore" VALUE 0xFC485C Scalar_UWORD 0 Cata100ms_Symbol_CM_ufix16_En7_hz 0 511.9921875 /end CHARACTERISTIC
/begin CHARACTERISTIC afTBFRECATG_EnFix "[FIX] Tabella di frequenze standard per diagnosi catalizzatore" VALUE 0xFC485A Scalar_UWORD 0 Cata100ms_Symbol_CM_FixEnableT 171 218 /end CHARACTERISTIC
/begin CHARACTERISTIC afTEMP_SCARICO_Enable "[FIX] Tabella della temperatura allo scarico in gradi Kelvin" VALUE 0xFC1DB4 Scalar_UBYTE 0 AirSpeedDensityTDC_CM_FixEnableT 171 218 /end CHARACTERISTIC
/begin CHARACTERISTIC afTEMP_SCARICO_Value "[FIX] Tabella della temperatura allo scarico in gradi Kelvin" VALUE 0xFC1DB2 Scalar_UWORD 0 AirSpeedDensityTDC_CM_uint16_degK 233 1273 /end CHARACTERISTIC
/begin AXIS_PTS akETSP_THROT "[YBK] Alpha-N eta efficiency of the throttle valve, based on the current position" 0xFC1D92 NO_INPUT_QUANTITY Lookup2D_X_UWORD 0 AirAlphaNTDC_CM_ufix16_En8__ 16 0 100 /end AXIS_PTS
/begin AXIS_PTS akETSP_THROT_PRE "[YBK] Alpha-N eta efficiency of the throttle valve, based on the current position target" 0xFC1D72 NO_INPUT_QUANTITY Lookup2D_X_UWORD 0 AirAlphaNTDC_CM_ufix16_En8__ 16 0 100 /end AXIS_PTS
/begin AXIS_PTS akKFHW_POBJ_ATT_BKP "[XBK] Vettore di filtraggio della PObj in attacco" 0xFC01E2 NO_INPUT_QUANTITY Lookup1D_X_UWORD 0 PressEstim4ms_CM_uint16_rpm 4 0 10000 /end AXIS_PTS
/begin AXIS_PTS akKFHW_POBJ_RIL_BKP "[XBK] Vettore di filtraggio della PObj in rilascio" 0xFC01DA NO_INPUT_QUANTITY Lookup1D_X_UWORD 0 PressEstim4ms_CM_uint16_rpm 4 0 10000 /end AXIS_PTS
/begin AXIS_PTS akKF_MEAN_VAL_BKP "[XBK] Costante del filtro per estrarre una buona approssimazione del delta di pressione tra le due componenti continue" 0xFC01D2 NO_INPUT_QUANTITY Lookup1D_X_UWORD 0 PressEstim4ms_CM_uint16_rpm 4 0 10000 /end AXIS_PTS
/begin AXIS_PTS akMAP_1 "[XBK] Tabella della temperatura allo scarico in gradi Kelvin" 0xFC1D52 NO_INPUT_QUANTITY Lookup2D_X_UWORD 0 AirSpeedDensityTDC_CM_uint16_mbar 16 0 3000 /end AXIS_PTS
/begin AXIS_PTS akMAP_2 "[XBK] Mappa della resistenza fluidodinamica delle valvole di aspirazione" 0xFC1D32 NO_INPUT_QUANTITY Lookup2D_X_UWORD 0 AirSpeedDensityTDC_CM_uint16_mbar 16 0 3000 /end AXIS_PTS
/begin AXIS_PTS akMAP_3 "[XBK] Tabella della pressione allo scarico" 0xFC1D12 NO_INPUT_QUANTITY Lookup2D_X_UWORD 0 AirSpeedDensityTDC_CM_uint16_mbar 16 0 3000 /end AXIS_PTS
/begin AXIS_PTS akOBJ_GAIN_BKP "[XBK] PObj amplification factor for transient recognition" 0xFC01CA NO_INPUT_QUANTITY Lookup1D_X_UWORD 0 RicTrans4ms_CM_uint16_rpm 4 0 10000 /end AXIS_PTS
/begin AXIS_PTS akOBJ_OFF_BKP "[XBK] PObj offset factor for transient recognition" 0xFC01C2 NO_INPUT_QUANTITY Lookup1D_X_UWORD 0 RicTrans4ms_CM_uint16_rpm 4 0 10000 /end AXIS_PTS
/begin AXIS_PTS akP_OBJ_BKP "[XBK] Vettore di normalizzazione della differenza PObj-MAP per calcolo transitorio" 0xFC01BA NO_INPUT_QUANTITY Lookup1D_X_UWORD 0 RicTrans4ms_CM_uint16_mbar 4 150 2500 /end AXIS_PTS
/begin AXIS_PTS akRPM_1 "[YBK] Tabella della temperatura allo scarico in gradi Kelvin" 0xFC1CF2 NO_INPUT_QUANTITY Lookup2D_X_UWORD 0 AirSpeedDensityTDC_CM_uint16_rpm 16 0 10000 /end AXIS_PTS
/begin AXIS_PTS akRPM_4 "[YBK] Mappa della resistenza fluidodinamica delle valvole di aspirazione" 0xFC1CD2 NO_INPUT_QUANTITY Lookup2D_X_UWORD 0 AirSpeedDensityTDC_CM_uint16_rpm 16 0 10000 /end AXIS_PTS
/begin AXIS_PTS akRPM_5 "[YBK] Tabella della pressione allo scarico" 0xFC1CB2 NO_INPUT_QUANTITY Lookup2D_X_UWORD 0 AirSpeedDensityTDC_CM_uint16_rpm 16 0 10000 /end AXIS_PTS
/begin AXIS_PTS akRPM_6 "[XBK] Alpha-N eta efficiency of the throttle valve, based on the current position" 0xFC1C92 NO_INPUT_QUANTITY Lookup2D_X_UWORD 0 AirAlphaNTDC_CM_uint16_rpm 16 0 10000 /end AXIS_PTS
/begin AXIS_PTS akRPM_6_PRE "[XBK] Alpha-N eta efficiency of the throttle valve, based on the current position target" 0xFC1C72 NO_INPUT_QUANTITY Lookup2D_X_UWORD 0 AirAlphaNTDC_CM_uint16_rpm 16 0 10000 /end AXIS_PTS
/begin AXIS_PTS akTH2O_1 "[XBK] Delta di temperatura rispetto alla temperatura collettore. Tvalv=(Tair+Th2o)/2+avOFF_TVALV." 0xFC1C52 NO_INPUT_QUANTITY Lookup1D_X_UWORD 0 AirSpeedDensityTDC_CM_ufix16_Bn40_degC 16 -40 140 /end AXIS_PTS
/begin MEASUREMENT asAFStechioFin "A/F stoichiometric value corrected by the final lambda target" UWORD AirSpeedDensityTDC_CM_ufix16_En10_adm 0 0 5 30 ECU_ADDRESS 0x40002022 /end MEASUREMENT
/begin CHARACTERISTIC asAIR_SENS_PRI "Definisce i sensori [asAir_Main,asAir_Sec]: [asMaf,dsQahMapSD](1), [dsQahMapSD,asMaf](2), [zsQAirDebim,dsQahMapSD](3)" VALUE 0xFC1C50 Scalar_UBYTE 0 Air_Flow_MgmTDC_CM_uint8_adm 1 3 /end CHARACTERISTIC
/begin MEASUREMENT asAirMain "Aria aspirata calcolata dal sensore principale in kg/h" UWORD Airq_CtrlMgmtTDC_CM_ufix16_En4_kg_h 0 0 0 4000 ECU_ADDRESS 0x40001E92 /end MEASUREMENT
/begin MEASUREMENT asAirSec "Aria aspirata calcolata dal sensore secondario in kg/h" UWORD Airq_CtrlMgmtTDC_CM_ufix16_En4_kg_h 0 0 0 4000 ECU_ADDRESS 0x40001E90 /end MEASUREMENT
/begin CHARACTERISTIC asBOOST_DELTA_OW "Valore del decremento dell`overshoot sulla Pboost" VALUE 0xFC01B8 Scalar_UWORD 0 RicTrans4ms_CM_ufix16_En4_adm 0 100 /end CHARACTERISTIC
/begin CHARACTERISTIC asBOOST_MAX_OW "Overshoot concesso sulla massima Pboost nel transitorio positivo" VALUE 0xFC01B6 Scalar_UBYTE 0 RicTrans4ms_CM_uint8_adm 0 100 /end CHARACTERISTIC
/begin CHARACTERISTIC asBOOST_RACC_EN "Abilita il mantenimento del valore di PBoost per la durata del transitorio" VALUE 0xFC01B5 Scalar_BOOLEAN 0 RicTrans4ms_CM_boolean_adm 0 1 /end CHARACTERISTIC
/begin CHARACTERISTIC asCORR_VEFF "Correzione del volume efficace" VALUE 0xFC1C4E Scalar_UWORD 0 AirSpeedDensityTDC_CM_ufix16_En15_adm 0 1.98999023438 /end CHARACTERISTIC
/begin MEASUREMENT asContScad "Test Point sul flag di fine transitorio per timeout" UBYTE RicTrans4ms_CM_boolean_adm 0 0 0 1 ECU_ADDRESS 0x40001E7C /end MEASUREMENT
/begin MEASUREMENT asCurCylTst "Current Cylinder Index used to get the asResAspir" UBYTE AirSpeedDensityTDC_CM_uint8_adm 0 0 0 8 ECU_ADDRESS 0x40002020 /end MEASUREMENT
/begin MEASUREMENT asDiffPres "Test Point sul flag di fine transitorio per rientro in banda" FLOAT32_IEEE RicTrans4ms_CM_single_adm 0 0 -2350 2350 ECU_ADDRESS 0x40001E78 /end MEASUREMENT
/begin MEASUREMENT asDiffReqActMin "Test Point sul flag di fine transitorio per rientro in banda" UBYTE RicTrans4ms_CM_boolean_adm 0 0 0 1 ECU_ADDRESS 0x40001E74 /end MEASUREMENT
/begin MEASUREMENT asErrSmoothCnt "Contatore per lo smoothing tra hsPcollReqDef e Map" UWORD PressEstim4ms_CM_ufix16_En10_adm 0 0 0 1 ECU_ADDRESS 0x40001E36 /end MEASUREMENT
/begin MEASUREMENT asErrSmoothCond "Enabling conditions to NOT use the smoothing between the predicted and the measured pressure in the intake manifold." UBYTE PressEstim4ms_CM_uint8_adm 0 0 0 63 ECU_ADDRESS 0x40001E34 /end MEASUREMENT
/begin MEASUREMENT asEtasp "Rendimento Volumetrico" UWORD Airq_CtrlMgmtTDC_CM_ufix16_En10_adm 0 0 0 3 ECU_ADDRESS 0x40001E8C /end MEASUREMENT
/begin MEASUREMENT asEtspFarf "[OUT] Tabella Alpha-N per il calcolo del rendimento di limp_home" UWORD AirAlphaNTDC_CM_ufix16_En10_adm 0 0 0 3 ECU_ADDRESS 0x40001EBA /end MEASUREMENT
/begin MEASUREMENT asEtspFarfPre "[OUT] Tabella Alpha-N per il calcolo del rendimento di limp_home" UWORD AirAlphaNTDC_CM_ufix16_En10_adm 0 0 0 3 ECU_ADDRESS 0x40001EB8 /end MEASUREMENT
/begin MEASUREMENT asF1F2 "ase di aspirazione" UWORD Airq_CtrlMgmtTDC_CM_uint16_degM 0 0 180 360 ECU_ADDRESS 0x40001EA0 /end MEASUREMENT
/begin CHARACTERISTIC asF1_F2 "Durata fase aspirazione" VALUE 0xFC1C4C Scalar_UWORD 0 AirSpeedDensityTDC_CM_uint16_degM 180 360 /end CHARACTERISTIC
/begin CHARACTERISTIC asFILTER_MODE "Modalità di attivazione del filtraggio PObj (1: disattivato con PTO attiva; 2: filtraggio sempre attivo; 3: filtraggio sempre disattivo)" VALUE 0xFC01B4 Scalar_UBYTE 0 PressEstim4ms_CM_uint8_adm 1 3 /end CHARACTERISTIC
/begin MEASUREMENT asFlagEndTrans "Flag Riconoscimento fine transitori" UBYTE Airq4ms_CM_boolean_adm 0 0 0 1 ECU_ADDRESS 0x40001DE6 /end MEASUREMENT
/begin MEASUREMENT asFlagTrans "Flag Riconoscimento inizio transitori" UBYTE Airq4ms_CM_boolean_adm 0 0 0 1 ECU_ADDRESS 0x40001DE7 /end MEASUREMENT
/begin MEASUREMENT asKfMeanVal "[OUT] Costante del filtro per estrarre una buona approssimazione del delta di pressione tra le due componenti continue" UWORD PressEstim4ms_CM_ufix16_En14_adm 0 0 0 1 ECU_ADDRESS 0x40001E32 /end MEASUREMENT
/begin MEASUREMENT asKfhwPobjAtt "[OUT] Vettore di filtraggio della PObj in attacco" UWORD PressEstim4ms_CM_ufix16_En15_adm 0 0 0 1 ECU_ADDRESS 0x40001E30 /end MEASUREMENT
/begin MEASUREMENT asKfhwPobjRil "[OUT] Vettore di filtraggio della PObj in rilascio" UWORD PressEstim4ms_CM_ufix16_En15_adm 0 0 0 1 ECU_ADDRESS 0x40001E2E /end MEASUREMENT
/begin CHARACTERISTIC asMAP_OFFSET "Offset sulla map per saturazione inferiore asPre" VALUE 0xFC01B2 Scalar_SWORD 0 PressEstim4ms_CM_int16_mbar -500 500 /end CHARACTERISTIC
/begin CHARACTERISTIC asMAX_DIFF_NEG_REQ "Soglia % per riconoscimento inizio transitori => solo negativi" VALUE 0xFC01B0 Scalar_SWORD 0 RicTrans4ms_CM_sfix16_En4_adm -100 100 /end CHARACTERISTIC
/begin CHARACTERISTIC asMAX_DIFF_POS_REQ "Soglia % per riconoscimento inizio transitori => solo positivi" VALUE 0xFC01AE Scalar_SWORD 0 RicTrans4ms_CM_sfix16_En4_adm -100 100 /end CHARACTERISTIC
/begin CHARACTERISTIC asMIN_DIFF_NEG_ACT "Soglia per riconoscimento fine transitori => negativi" VALUE 0xFC01AC Scalar_SWORD 0 RicTrans4ms_CM_sfix16_En4_adm -100 100 /end CHARACTERISTIC
/begin CHARACTERISTIC asMIN_DIFF_POS_ACT "Soglia per riconoscimento fine transitori => positivi" VALUE 0xFC01AA Scalar_SWORD 0 RicTrans4ms_CM_sfix16_En4_adm -100 100 /end CHARACTERISTIC
/begin CHARACTERISTIC asMOD_PRE_EN "Flag abilitazione uso aria predetta (1) o aria letta (0) per calcolo QInj" VALUE 0xFC1C4A Scalar_BOOLEAN 0 Air_Flow_MgmTDC_CM_boolean_adm 0 1 /end CHARACTERISTIC
/begin MEASUREMENT asMassFlowEGRObjSD "EGR requested flow rate in [kg/s] for speed density model." FLOAT32_IEEE AirSpeedDensityTDC_CM_single_kg_s 0 0 0 0.25 ECU_ADDRESS 0x4000201C /end MEASUREMENT
/begin MEASUREMENT asNCyl "Number of cylinder" UBYTE Airq4ms_CM_uint8_adm 0 0 2 8 ECU_ADDRESS 0x40001E7E /end MEASUREMENT
/begin CHARACTERISTIC asNUMCYL "Numero di cilindri" VALUE 0xFC1C49 Scalar_UBYTE 0 AirSpeedDensityTDC_CM_uint8_adm 2 8 /end CHARACTERISTIC
/begin CHARACTERISTIC asNUM_PMS_OFFSET "Offset in numero di PMS additivi per stabilire durata massima di una transitorio di pressione" VALUE 0xFC01A8 Scalar_UWORD 0 RicTrans4ms_CM_uint16_adm 0 100 /end CHARACTERISTIC
/begin MEASUREMENT asOffTvalv "[OUT] Delta di temperatura rispetto alla temperatura collettore. Tvalv=(Tair+Th2o)/2+avOFF_TVALV." SWORD AirSpeedDensityTDC_CM_int16_degC 0 0 -100 100 ECU_ADDRESS 0x40002018 /end MEASUREMENT
/begin MEASUREMENT asPBoostAmpli "Boost pressure amplified for the transient detection" FLOAT32_IEEE RicTrans4ms_CM_single_mbar 0 0 0 8000 ECU_ADDRESS 0x40001E70 /end MEASUREMENT
/begin MEASUREMENT asPCollPre "Predicted pressure at inlet manifold (based on target pressure from throttle valve)" UWORD PressEstim4ms_CM_uint16_mbar 0 0 0 5000 ECU_ADDRESS 0x40001E2C /end MEASUREMENT
/begin MEASUREMENT asPCollPreF "Predicted pressure at inlet manifold (after filtering/smoothing contribute)" SWORD PressEstim4ms_CM_int16_mbar 0 0 -2350 5000 ECU_ADDRESS 0x40001E2A /end MEASUREMENT
/begin CHARACTERISTIC asPOBJ_REC_EN "Flag per recovery SpeedDensity_Map: SpeedDensity_Pobj(1), AlphaN (0)" VALUE 0xFC1C48 Scalar_BOOLEAN 0 Air_Flow_MgmTDC_CM_boolean_adm 0 1 /end CHARACTERISTIC
/begin MEASUREMENT asPObjCorr "[OUT] Vettore di normalizzazione della differenza PObj-MAP per calcolo transitorio" UWORD RicTrans4ms_CM_ufix16_En4_mbar 0 0 1 250 ECU_ADDRESS 0x40001E6C /end MEASUREMENT
/begin CHARACTERISTIC asPRESOBJ_4EVER_EN "Abilitazione per usare sempre la pressione obiettivo nel predittore" VALUE 0xFC01A6 Scalar_BOOLEAN 0 PressEstim4ms_CM_boolean_adm 0 1 /end CHARACTERISTIC
/begin CHARACTERISTIC asPRES_MODE_POBJ "Scelta del tipo di filtro sulla PObj (per iniezione)" VALUE 0xFC01A5 Scalar_UBYTE 0 RicTrans4ms_CM_uint8_adm 1 6 /end CHARACTERISTIC
/begin CHARACTERISTIC asPRES_MODE_TRANS "Scelta del tipo di filtro sulla PObj (per RicTrans)" VALUE 0xFC01A4 Scalar_UBYTE 0 RicTrans4ms_CM_uint8_adm 1 6 /end CHARACTERISTIC
/begin CHARACTERISTIC asPRE_MIN "Valore minimo per asPre" VALUE 0xFC01A2 Scalar_UWORD 0 PressEstim4ms_CM_uint16_mbar 150 2500 /end CHARACTERISTIC
/begin MEASUREMENT asPasp "Pressione nel collettore di aspirazione c/o ingresso valvole (assoluta)" UWORD Airq_CtrlMgmtTDC_CM_uint16_mbar 0 0 0 3000 ECU_ADDRESS 0x40001EA2 /end MEASUREMENT
/begin MEASUREMENT asPcollDeltaMeanVal "Adaptive delta on the target collector pressure" SWORD Airq4ms_CM_int16_mbar 0 0 -2500 2500 ECU_ADDRESS 0x40001DF2 /end MEASUREMENT
/begin MEASUREMENT asPcollReqAmpliAdapt "Target pressure (incoming from throttle model) amplified in function of engine speed, for transient detection, with the adaptive contribute of asPcollDeltaMean" FLOAT32_IEEE RicTrans4ms_CM_single_mbar 0 0 0 8000 ECU_ADDRESS 0x40001E68 /end MEASUREMENT
/begin MEASUREMENT asPcollReqDefAmpl "Richiesta definitiva di pressione obiettivo amplificata nel Ctrl Farfalla f(Pcoll_Obj)" UWORD Airq4ms_CM_uint16_mbar 0 0 0 2500 ECU_ADDRESS 0x40001DEE /end MEASUREMENT
/begin MEASUREMENT asPcollReqDefAmpli "Target pressure (incoming from throttle model) amplified in function of engine speed, for transient detection." FLOAT32_IEEE RicTrans4ms_CM_single_mbar 0 0 0 8000 ECU_ADDRESS 0x40001E64 /end MEASUREMENT
/begin MEASUREMENT asPmix "Mixture NG/Air molar mass" FLOAT32_IEEE AirSpeedDensityTDC_CM_single_kg_mol 0 0 0.00518871 0.147517 ECU_ADDRESS 0x40002014 /end MEASUREMENT
/begin MEASUREMENT asPre "Pressione collettore stimata dal predittore di pressione" UWORD Airq4ms_CM_uint16_mbar 0 0 0 3000 ECU_ADDRESS 0x40001DF0 /end MEASUREMENT
/begin MEASUREMENT asPreScarico "[OUT] Tabella della pressione allo scarico" UWORD AirSpeedDensityTDC_CM_uint16_mbar 0 0 0 3000 ECU_ADDRESS 0x40002010 MATRIX_DIM 2 /end MEASUREMENT
/begin MEASUREMENT asPresObjGain "[OUT] PObj amplification factor for transient recognition" UWORD RicTrans4ms_CM_ufix16_En10_adm 0 0 0 10 ECU_ADDRESS 0x40001E60 /end MEASUREMENT
/begin MEASUREMENT asPresObjOff "[OUT] PObj offset factor for transient recognition" SWORD RicTrans4ms_CM_int16_mbar 0 0 -1000 1000 ECU_ADDRESS 0x40001E5E /end MEASUREMENT
/begin MEASUREMENT asPressErrorF "Errore sulla PObj obiettivo rispetto alla Map" SWORD PressEstim4ms_CM_int16_mbar 0 0 -2500 2500 ECU_ADDRESS 0x40001E28 /end MEASUREMENT
/begin MEASUREMENT asPsca "Pressione nel collettore di scarico (assoluta)" UWORD Airq_CtrlMgmtTDC_CM_uint16_mbar 0 0 0 3000 ECU_ADDRESS 0x40001EA4 /end MEASUREMENT
/begin CHARACTERISTIC asQAIR_TDC_REF "Unitary reference displacement" VALUE 0xFC1C46 Scalar_UWORD 0 AirAlphaNTDC_CM_ufix16_En3_mg_cc 1 5000 /end CHARACTERISTIC
/begin MEASUREMENT asQAirRead "ria letta usata per riconoscimento transitori" UWORD Airq_CtrlMgmtTDC_CM_ufix16_En4_Kg_h 0 0 0 4000 ECU_ADDRESS 0x40001E8E /end MEASUREMENT
/begin MEASUREMENT asQAirTdcRef "Unitary reference displacement, as defined by asQAIR_TDC_REF" UWORD Airq_CtrlMgmtTDC_CM_ufix16_En3_mg_cc 0 0 1 5000 ECU_ADDRESS 0x40001E8A /end MEASUREMENT
/begin MEASUREMENT asQacMain "Aria aspirata calcolata dal sensore principale in mg/cc" UWORD Airq_CtrlMgmtTDC_CM_ufix16_En3_mg_cc 0 0 0 8191 ECU_ADDRESS 0x40001E84 /end MEASUREMENT
/begin MEASUREMENT asQacMainTmp "Test Point of asQacDebTmp variable" FLOAT32_IEEE Air_Flow_MgmTDC_CM_single_mg_cc 0 0 0 8191 ECU_ADDRESS 0x40002028 /end MEASUREMENT
/begin MEASUREMENT asQacMapSD "resh Air Mass Flow for each Stroke" UWORD Airq_CtrlMgmtTDC_CM_ufix16_En3_mg_cc 0 0 0 8191 ECU_ADDRESS 0x40001E88 /end MEASUREMENT
/begin MEASUREMENT asQacPreSD "Quantità in mg/cc dell`aria aspirata" UWORD Airq_CtrlMgmtTDC_CM_ufix16_En3_mg_cc 0 0 0 8191 ECU_ADDRESS 0x40001E86 /end MEASUREMENT
/begin MEASUREMENT asQahAlphaN "Fresh air mass flow extimated by the AlphaN model, based on throttle valve efficiency for the actual position (asEtaspFarf)" UWORD Airq_CtrlMgmtTDC_CM_ufix16_En4_kg_h 0 0 0 4000 ECU_ADDRESS 0x40001E9C /end MEASUREMENT
/begin MEASUREMENT asQahAlphaNPre "Fresh air mass flow extimated by the AlphaN model, based on throttle valve efficiency for target position (asEtaspFarfPre)" UWORD Airq_CtrlMgmtTDC_CM_ufix16_En4_kg_h 0 0 0 4000 ECU_ADDRESS 0x40001E9A /end MEASUREMENT
/begin MEASUREMENT asQahMapSD "Quantità in Kg/h dell`aria aspirata calcolata a partire dalla pressione collettore" UWORD Airq_CtrlMgmtTDC_CM_ufix16_En4_Kg_h 0 0 0 4000 ECU_ADDRESS 0x40001E98 /end MEASUREMENT
/begin MEASUREMENT asQahMapSD_Rec "Init:[0]; Aria aspirata calcolata dal debimetro (prima della correzione in transitorio) in kg/h" UWORD Air_Flow_MgmTDC_CM_ufix16_En4_kg_h 0 0 0 4000 ECU_ADDRESS 0x40002026 /end MEASUREMENT
/begin MEASUREMENT asQahPreSD "Quantità in Kg/h dell`aria aspirata calcolata a partire dalla pressione predetta" UWORD Airq_CtrlMgmtTDC_CM_ufix16_En4_Kg_h 0 0 0 4000 ECU_ADDRESS 0x40001E96 /end MEASUREMENT
/begin MEASUREMENT asQahPreSD_Rec "Init:[0]; Aria aspirata calcolata da Speed density (a valle della recovery con alpha-N da Etasp obiettivo) in kg/h" UWORD Air_Flow_MgmTDC_CM_ufix16_En4_kg_h 0 0 0 4000 ECU_ADDRESS 0x40002024 /end MEASUREMENT
/begin MEASUREMENT asQaspDivMap "Rapporto tra la miscela aspirata e la pressione in fase di aspirazione" UWORD Airq_CtrlMgmtTDC_CM_ufix16_En24_m_s 0 0 0 4.9650669098E-05 ECU_ADDRESS 0x40001E82 /end MEASUREMENT
/begin MEASUREMENT asQaspDivPcoll "Ratio between the mixture and the pressure during intake phase" FLOAT32_IEEE AirSpeedDensityTDC_CM_single_m_s 0 0 0 4.9650669098E-05 ECU_ADDRESS 0x40002008 MATRIX_DIM 2 /end MEASUREMENT
/begin MEASUREMENT asQmix "Mixture NG/Air flow rate" FLOAT32_IEEE AirSpeedDensityTDC_CM_single_kg_s 0 0 0 0.25 ECU_ADDRESS 0x40002000 MATRIX_DIM 2 /end MEASUREMENT
/begin CHARACTERISTIC asRAPP_COMPRES "Rapporto di compressione" VALUE 0xFC1C44 Scalar_UWORD 0 AirSpeedDensityTDC_CM_ufix16_En8_adm 1 32 /end CHARACTERISTIC
/begin MEASUREMENT asRappComp "apporto di compressione" UWORD Airq_CtrlMgmtTDC_CM_ufix16_En8_adm 0 0 1 32 ECU_ADDRESS 0x40001E9E /end MEASUREMENT
/begin MEASUREMENT asResAspir "[OUT] Map of Fluid dynamic resistance of the intake valves (all cylinders)." UWORD AirSpeedDensityTDC_CM_uint16_bit_s_m 0 0 32 32768 ECU_ADDRESS 0x40001FFC MATRIX_DIM 2 /end MEASUREMENT
/begin MEASUREMENT asResAspir1 "[OUT] Map of Fluid dynamic resistance of the intake valves (CYL1)." UWORD AirSpeedDensityTDC_CM_uint16_bit_s_m 0 0 32 32768 ECU_ADDRESS 0x40001FF8 MATRIX_DIM 2 /end MEASUREMENT
/begin MEASUREMENT asResAspir2 "[OUT] Map of Fluid dynamic resistance of the intake valves (CYL2)." UWORD AirSpeedDensityTDC_CM_uint16_bit_s_m 0 0 32 32768 ECU_ADDRESS 0x40001FF4 MATRIX_DIM 2 /end MEASUREMENT
/begin MEASUREMENT asResAspir3 "[OUT] Map of Fluid dynamic resistance of the intake valves (CYL3)." UWORD AirSpeedDensityTDC_CM_uint16_bit_s_m 0 0 32 32768 ECU_ADDRESS 0x40001FF0 MATRIX_DIM 2 /end MEASUREMENT
/begin MEASUREMENT asResAspir4 "[OUT] Map of Fluid dynamic resistance of the intake valves (CYL4)." UWORD AirSpeedDensityTDC_CM_uint16_bit_s_m 0 0 32 32768 ECU_ADDRESS 0x40001FEC MATRIX_DIM 2 /end MEASUREMENT
/begin MEASUREMENT asResAspir5 "[OUT] Map of Fluid dynamic resistance of the intake valves (CYL5)." UWORD AirSpeedDensityTDC_CM_uint16_bit_s_m 0 0 32 32768 ECU_ADDRESS 0x40001FE8 MATRIX_DIM 2 /end MEASUREMENT
/begin MEASUREMENT asResAspir6 "[OUT] Map of Fluid dynamic resistance of the intake valves (CYL6)." UWORD AirSpeedDensityTDC_CM_uint16_bit_s_m 0 0 32 32768 ECU_ADDRESS 0x40001FE4 MATRIX_DIM 2 /end MEASUREMENT
/begin MEASUREMENT asResAspir7 "[OUT] Map of Fluid dynamic resistance of the intake valves (CYL7)." UWORD AirSpeedDensityTDC_CM_uint16_bit_s_m 0 0 32 32768 ECU_ADDRESS 0x40001FE0 MATRIX_DIM 2 /end MEASUREMENT
/begin MEASUREMENT asResAspir8 "[OUT] Map of Fluid dynamic resistance of the intake valves (CYL8)." UWORD AirSpeedDensityTDC_CM_uint16_bit_s_m 0 0 32 32768 ECU_ADDRESS 0x40001FDC MATRIX_DIM 2 /end MEASUREMENT
/begin MEASUREMENT asResAspirBG "Fluid dynamic resistance of the intake valves, before dimensional gain (BG)." UWORD AirSpeedDensityTDC_CM_uint16_bit_s_m 0 0 32 32768 ECU_ADDRESS 0x40001FD8 MATRIX_DIM 2 /end MEASUREMENT
/begin MEASUREMENT asResAspirFin "Fluid dynamic resistance of the intake valves, after dimensional gain (fin)." FLOAT32_IEEE AirSpeedDensityTDC_CM_single_1_s_m 0 0 2.98023223877E-08 3.0517578125E-05 ECU_ADDRESS 0x40001FD0 MATRIX_DIM 2 /end MEASUREMENT
/begin MEASUREMENT asStartTransitorio "Test Point sul flag di inizio transitorio" UBYTE RicTrans4ms_CM_boolean_adm 0 0 0 1 ECU_ADDRESS 0x40001E5C /end MEASUREMENT
/begin CHARACTERISTIC asTRANS_DEBOUNC_EN "Abilitazione per durata max transitori (0) o debouncing flag (1)" VALUE 0xFC01A0 Scalar_BOOLEAN 0 RicTrans4ms_CM_boolean_adm 0 1 /end CHARACTERISTIC
/begin CHARACTERISTIC asTRANS_ERROR_PRE "Numero di passi per raccordo tra PObj e Map" VALUE 0xFC019E Scalar_UWORD 0 PressEstim4ms_CM_uint16_adm 1 1000 /end CHARACTERISTIC
/begin CHARACTERISTIC asTRANS_POS_NEG "Abilitazione per trattare in maniera asimmetrica i transitori (1 solo positivi, 0 entrambi)" VALUE 0xFC019C Scalar_BOOLEAN 0 RicTrans4ms_CM_boolean_adm 0 1 /end CHARACTERISTIC
/begin MEASUREMENT asTValv "Temperatura ingresso valvole" UWORD AirSpeedDensityTDC_CM_uint16_degK 0 0 233 503 ECU_ADDRESS 0x40001FCC /end MEASUREMENT
/begin MEASUREMENT asTbfrecatg "[OUT] Tabella di frequenze standard per diagnosi catalizzatore" UWORD Cata100ms_Symbol_CM_ufix16_En7_hz 0 0 0 511.9921875 ECU_ADDRESS 0x400027DE /end MEASUREMENT
/begin MEASUREMENT asTempScarico "[OUT] Tabella della temperatura allo scarico in gradi Kelvin" UWORD AirSpeedDensityTDC_CM_uint16_degK 0 0 233 1273 ECU_ADDRESS 0x40001FC8 MATRIX_DIM 2 /end MEASUREMENT
/begin MEASUREMENT asTimePhase "urata apertura valvole di aspirazione" UWORD Airq_CtrlMgmtTDC_CM_ufix16_En16_s 0 0 0.00299072265625 0.5 ECU_ADDRESS 0x40001E80 /end MEASUREMENT
/begin MEASUREMENT asTransDiff "Test Point sul flag di fine transitorio per rientro in banda" SLONG RicTrans4ms_CM_sfix32_En9_adm 0 0 -100 100 ECU_ADDRESS 0x40001E58 /end MEASUREMENT
/begin MEASUREMENT asTransUp "Positive transient flag identificator" UBYTE Airq4ms_CM_boolean_adm 0 0 0 1 ECU_ADDRESS 0x40001DE5 /end MEASUREMENT
/begin MEASUREMENT asTransUpTmp "Positive transient flag identificator (inner feedback)" UBYTE RicTrans4ms_CM_boolean_adm 0 0 0 1 ECU_ADDRESS 0x40001E54 /end MEASUREMENT
/begin CHARACTERISTIC asVC "Abilitazione Volume efficace per VVA " VALUE 0xFC1C42 Scalar_UWORD 0 AirSpeedDensityTDC_CM_ufix16_En20_m_3 0 0.0003 /end CHARACTERISTIC
/begin MEASUREMENT asVCylEff "ylindrata effettiva unitaria" UWORD Airq_CtrlMgmtTDC_CM_ufix16_En4_cc 0 0 0 4095 ECU_ADDRESS 0x40001E94 /end MEASUREMENT
/begin CHARACTERISTIC asVEFF "Correzione del volume efficace" VALUE 0xFC1C41 Scalar_UBYTE 0 AirSpeedDensityTDC_CM_ufix8_En14_m_3 0 0.00250244140625 /end CHARACTERISTIC
/begin CHARACTERISTIC asVEFF_VVA_EN "Abilitazione Volume efficace per VVA " VALUE 0xFC1C40 Scalar_BOOLEAN 0 AirSpeedDensityTDC_CM_boolean_adm 0 1 /end CHARACTERISTIC
/begin CHARACTERISTIC atETSP_FARF "Alpha-N eta efficiency of the throttle valve, based on the current position" MAP 0xFC1A40 Lookup2D_UWORD 0 AirAlphaNTDC_CM_ufix16_En10_adm 0 3
 /begin AXIS_DESCR COM_AXIS NO_INPUT_QUANTITY AirAlphaNTDC_CM_ufix16_En8__ 16 0 100 AXIS_PTS_REF akETSP_THROT /end AXIS_DESCR
 /begin AXIS_DESCR COM_AXIS NO_INPUT_QUANTITY AirAlphaNTDC_CM_uint16_rpm 16 0 10000 AXIS_PTS_REF akRPM_6 /end AXIS_DESCR
/end CHARACTERISTIC
/begin CHARACTERISTIC atETSP_FARF_PRE "Alpha-N eta efficiency of the throttle valve, based on the current position target" MAP 0xFC1840 Lookup2D_UWORD 0 AirAlphaNTDC_CM_ufix16_En10_adm 0 3
 /begin AXIS_DESCR COM_AXIS NO_INPUT_QUANTITY AirAlphaNTDC_CM_ufix16_En8__ 16 0 100 AXIS_PTS_REF akETSP_THROT_PRE /end AXIS_DESCR
 /begin AXIS_DESCR COM_AXIS NO_INPUT_QUANTITY AirAlphaNTDC_CM_uint16_rpm 16 0 10000 AXIS_PTS_REF akRPM_6_PRE /end AXIS_DESCR
/end CHARACTERISTIC
/begin CHARACTERISTIC atPRE_SCARICO "Tabella della pressione allo scarico" MAP 0xFC1640 Lookup2D_UWORD 0 AirSpeedDensityTDC_CM_uint16_mbar 0 3000
 /begin AXIS_DESCR COM_AXIS NO_INPUT_QUANTITY AirSpeedDensityTDC_CM_uint16_rpm 16 0 10000 AXIS_PTS_REF akRPM_5 /end AXIS_DESCR
 /begin AXIS_DESCR COM_AXIS NO_INPUT_QUANTITY AirSpeedDensityTDC_CM_uint16_mbar 16 0 3000 AXIS_PTS_REF akMAP_3 /end AXIS_DESCR
/end CHARACTERISTIC
/begin CHARACTERISTIC atRES_ASPIR "Map of the fluid dynamic resistance of the intake valves (All Cylinders)." MAP 0xFC1440 Lookup2D_UWORD 0 AirSpeedDensityTDC_CM_uint16_bit_s_m 32 32768
 /begin AXIS_DESCR COM_AXIS NO_INPUT_QUANTITY AirSpeedDensityTDC_CM_uint16_rpm 16 0 10000 AXIS_PTS_REF akRPM_4 /end AXIS_DESCR
 /begin AXIS_DESCR COM_AXIS NO_INPUT_QUANTITY AirSpeedDensityTDC_CM_uint16_mbar 16 0 3000 AXIS_PTS_REF akMAP_2 /end AXIS_DESCR
/end CHARACTERISTIC
/begin CHARACTERISTIC atRES_ASPIR1 "Map of the fluid dynamic resistance of the intake valves (CYL1)." MAP 0xFC1240 Lookup2D_UWORD 0 AirSpeedDensityTDC_CM_uint16_bit_s_m 32 32768
 /begin AXIS_DESCR COM_AXIS NO_INPUT_QUANTITY AirSpeedDensityTDC_CM_uint16_rpm 16 0 10000 AXIS_PTS_REF akRPM_4 /end AXIS_DESCR
 /begin AXIS_DESCR COM_AXIS NO_INPUT_QUANTITY AirSpeedDensityTDC_CM_uint16_mbar 16 0 3000 AXIS_PTS_REF akMAP_2 /end AXIS_DESCR
/end CHARACTERISTIC
/begin CHARACTERISTIC atRES_ASPIR2 "Map of the fluid dynamic resistance of the intake valves (CYL2)." MAP 0xFC1040 Lookup2D_UWORD 0 AirSpeedDensityTDC_CM_uint16_bit_s_m 32 32768
 /begin AXIS_DESCR COM_AXIS NO_INPUT_QUANTITY AirSpeedDensityTDC_CM_uint16_rpm 16 0 10000 AXIS_PTS_REF akRPM_4 /end AXIS_DESCR
 /begin AXIS_DESCR COM_AXIS NO_INPUT_QUANTITY AirSpeedDensityTDC_CM_uint16_mbar 16 0 3000 AXIS_PTS_REF akMAP_2 /end AXIS_DESCR
/end CHARACTERISTIC
/begin CHARACTERISTIC atRES_ASPIR3 "Map of the fluid dynamic resistance of the intake valves (CYL3)." MAP 0xFC0E40 Lookup2D_UWORD 0 AirSpeedDensityTDC_CM_uint16_bit_s_m 32 32768
 /begin AXIS_DESCR COM_AXIS NO_INPUT_QUANTITY AirSpeedDensityTDC_CM_uint16_rpm 16 0 10000 AXIS_PTS_REF akRPM_4 /end AXIS_DESCR
 /begin AXIS_DESCR COM_AXIS NO_INPUT_QUANTITY AirSpeedDensityTDC_CM_uint16_mbar 16 0 3000 AXIS_PTS_REF akMAP_2 /end AXIS_DESCR
/end CHARACTERISTIC
/begin CHARACTERISTIC atRES_ASPIR4 "Map of the fluid dynamic resistance of the intake valves (CYL4)." MAP 0xFC0C40 Lookup2D_UWORD 0 AirSpeedDensityTDC_CM_uint16_bit_s_m 32 32768
 /begin AXIS_DESCR COM_AXIS NO_INPUT_QUANTITY AirSpeedDensityTDC_CM_uint16_rpm 16 0 10000 AXIS_PTS_REF akRPM_4 /end AXIS_DESCR
 /begin AXIS_DESCR COM_AXIS NO_INPUT_QUANTITY AirSpeedDensityTDC_CM_uint16_mbar 16 0 3000 AXIS_PTS_REF akMAP_2 /end AXIS_DESCR
/end CHARACTERISTIC
/begin CHARACTERISTIC atRES_ASPIR5 "Map of the fluid dynamic resistance of the intake valves (CYL5)." MAP 0xFC0A40 Lookup2D_UWORD 0 AirSpeedDensityTDC_CM_uint16_bit_s_m 32 32768
 /begin AXIS_DESCR COM_AXIS NO_INPUT_QUANTITY AirSpeedDensityTDC_CM_uint16_rpm 16 0 10000 AXIS_PTS_REF akRPM_4 /end AXIS_DESCR
 /begin AXIS_DESCR COM_AXIS NO_INPUT_QUANTITY AirSpeedDensityTDC_CM_uint16_mbar 16 0 3000 AXIS_PTS_REF akMAP_2 /end AXIS_DESCR
/end CHARACTERISTIC
/begin CHARACTERISTIC atRES_ASPIR6 "Map of the fluid dynamic resistance of the intake valves (CYL6)." MAP 0xFC0840 Lookup2D_UWORD 0 AirSpeedDensityTDC_CM_uint16_bit_s_m 32 32768
 /begin AXIS_DESCR COM_AXIS NO_INPUT_QUANTITY AirSpeedDensityTDC_CM_uint16_rpm 16 0 10000 AXIS_PTS_REF akRPM_4 /end AXIS_DESCR
 /begin AXIS_DESCR COM_AXIS NO_INPUT_QUANTITY AirSpeedDensityTDC_CM_uint16_mbar 16 0 3000 AXIS_PTS_REF akMAP_2 /end AXIS_DESCR
/end CHARACTERISTIC
/begin CHARACTERISTIC atRES_ASPIR7 "Map of the fluid dynamic resistance of the intake valves (CYL7)." MAP 0xFC0640 Lookup2D_UWORD 0 AirSpeedDensityTDC_CM_uint16_bit_s_m 32 32768
 /begin AXIS_DESCR COM_AXIS NO_INPUT_QUANTITY AirSpeedDensityTDC_CM_uint16_rpm 16 0 10000 AXIS_PTS_REF akRPM_4 /end AXIS_DESCR
 /begin AXIS_DESCR COM_AXIS NO_INPUT_QUANTITY AirSpeedDensityTDC_CM_uint16_mbar 16 0 3000 AXIS_PTS_REF akMAP_2 /end AXIS_DESCR
/end CHARACTERISTIC
/begin CHARACTERISTIC atRES_ASPIR8 "Map of the fluid dynamic resistance of the intake valves (CYL8)." MAP 0xFC0440 Lookup2D_UWORD 0 AirSpeedDensityTDC_CM_uint16_bit_s_m 32 32768
 /begin AXIS_DESCR COM_AXIS NO_INPUT_QUANTITY AirSpeedDensityTDC_CM_uint16_rpm 16 0 10000 AXIS_PTS_REF akRPM_4 /end AXIS_DESCR
 /begin AXIS_DESCR COM_AXIS NO_INPUT_QUANTITY AirSpeedDensityTDC_CM_uint16_mbar 16 0 3000 AXIS_PTS_REF akMAP_2 /end AXIS_DESCR
/end CHARACTERISTIC
/begin CHARACTERISTIC atTBFRECATG "Tabella di frequenze standard per diagnosi catalizzatore" MAP 0xFC4970 Lookup2DSF_UWORD 0 Cata100ms_Symbol_CM_ufix16_En7_hz 0 511.9921875
 /begin AXIS_DESCR COM_AXIS NO_INPUT_QUANTITY Cata100ms_Symbol_CM_uint16_adm 5 0 4 AXIS_PTS_REF okZONE_GIRI1 /end AXIS_DESCR
 /begin AXIS_DESCR COM_AXIS NO_INPUT_QUANTITY Cata100ms_Symbol_CM_uint16_adm 6 0 5 AXIS_PTS_REF okZONE_QAC_PMS1 /end AXIS_DESCR
/end CHARACTERISTIC
/begin CHARACTERISTIC atTEMP_SCARICO "Tabella della temperatura allo scarico in gradi Kelvin" MAP 0xFC0240 Lookup2D_UWORD 0 AirSpeedDensityTDC_CM_uint16_degK 233 1273
 /begin AXIS_DESCR COM_AXIS NO_INPUT_QUANTITY AirSpeedDensityTDC_CM_uint16_rpm 16 0 10000 AXIS_PTS_REF akRPM_1 /end AXIS_DESCR
 /begin AXIS_DESCR COM_AXIS NO_INPUT_QUANTITY AirSpeedDensityTDC_CM_uint16_mbar 16 0 3000 AXIS_PTS_REF akMAP_1 /end AXIS_DESCR
/end CHARACTERISTIC
/begin CHARACTERISTIC avKFHW_POBJ_ATT "Vettore di filtraggio della PObj in attacco" CURVE 0xFC0194 Lookup1D_UWORD 0 PressEstim4ms_CM_ufix16_En15_adm 0 1
 /begin AXIS_DESCR COM_AXIS NO_INPUT_QUANTITY PressEstim4ms_CM_uint16_rpm 4 0 10000 AXIS_PTS_REF akKFHW_POBJ_ATT_BKP /end AXIS_DESCR
/end CHARACTERISTIC
/begin CHARACTERISTIC avKFHW_POBJ_RIL "Vettore di filtraggio della PObj in rilascio" CURVE 0xFC018C Lookup1D_UWORD 0 PressEstim4ms_CM_ufix16_En15_adm 0 1
 /begin AXIS_DESCR COM_AXIS NO_INPUT_QUANTITY PressEstim4ms_CM_uint16_rpm 4 0 10000 AXIS_PTS_REF akKFHW_POBJ_RIL_BKP /end AXIS_DESCR
/end CHARACTERISTIC
/begin CHARACTERISTIC avKF_MEAN_VAL "Costante del filtro per estrarre una buona approssimazione del delta di pressione tra le due componenti continue" CURVE 0xFC0184 Lookup1D_UWORD 0 PressEstim4ms_CM_ufix16_En14_adm 0 1
 /begin AXIS_DESCR COM_AXIS NO_INPUT_QUANTITY PressEstim4ms_CM_uint16_rpm 4 0 10000 AXIS_PTS_REF akKF_MEAN_VAL_BKP /end AXIS_DESCR
/end CHARACTERISTIC
/begin CHARACTERISTIC avOFF_TVALV "Delta di temperatura rispetto alla temperatura collettore. Tvalv=(Tair+Th2o)/2+avOFF_TVALV." CURVE 0xFC0220 Lookup1D_WORD 0 AirSpeedDensityTDC_CM_int16_degC -100 100
 /begin AXIS_DESCR COM_AXIS NO_INPUT_QUANTITY AirSpeedDensityTDC_CM_ufix16_Bn40_degC 16 -40 140 AXIS_PTS_REF akTH2O_1 /end AXIS_DESCR
/end CHARACTERISTIC
/begin CHARACTERISTIC avPRES_OBJ_GAIN "PObj amplification factor for transient recognition" CURVE 0xFC017C Lookup1D_UWORD 0 RicTrans4ms_CM_ufix16_En10_adm 0 10
 /begin AXIS_DESCR COM_AXIS NO_INPUT_QUANTITY RicTrans4ms_CM_uint16_rpm 4 0 10000 AXIS_PTS_REF akOBJ_GAIN_BKP /end AXIS_DESCR
/end CHARACTERISTIC
/begin CHARACTERISTIC avPRES_OBJ_OFF "PObj offset factor for transient recognition" CURVE 0xFC0174 Lookup1D_WORD 0 RicTrans4ms_CM_int16_mbar -1000 1000
 /begin AXIS_DESCR COM_AXIS NO_INPUT_QUANTITY RicTrans4ms_CM_uint16_rpm 4 0 10000 AXIS_PTS_REF akOBJ_OFF_BKP /end AXIS_DESCR
/end CHARACTERISTIC
/begin CHARACTERISTIC avP_OBJ_CORR "Vettore di normalizzazione della differenza PObj-MAP per calcolo transitorio" CURVE 0xFC016C Lookup1D_UWORD 0 RicTrans4ms_CM_ufix16_En4_mbar 1 250
 /begin AXIS_DESCR COM_AXIS NO_INPUT_QUANTITY RicTrans4ms_CM_uint16_mbar 4 150 2500 AXIS_PTS_REF akP_OBJ_BKP /end AXIS_DESCR
/end CHARACTERISTIC
/begin CHARACTERISTIC bfENGINE_TYPE_Enable "[FIX] Engine type configuration Fix" VALUE 0xFC2C8E Scalar_UBYTE 0 EngineTypeInit_CM_FixEnableT 171 218 /end CHARACTERISTIC
/begin CHARACTERISTIC bfENGINE_TYPE_Value "[FIX] Engine type configuration Fix" VALUE 0xFC2C8D Scalar_UBYTE 0 EngineTypeInit_CM_uint8_adm 0 7 /end CHARACTERISTIC
/begin MEASUREMENT bs2LHDuty "Lambda heater PWM command after the recovery (LHR2)" UWORD Ctit_LambdaHeater100ms_CM_uint16__ 0 0 0 100 ECU_ADDRESS 0x4000186A /end MEASUREMENT
/begin MEASUREMENT bs2LHR_DiagStatus "Lambda Heater post cat diagnostic status (Driver Value)" UBYTE eDiagStatus.Conversion 0 0 0 255 ECU_ADDRESS 0x4000186C /end MEASUREMENT
/begin MEASUREMENT bsAF_E2PROM "Valore della variabile qsAFstechio inizializzata con il valore di E2PROM ed aggiornata ad ogni chiamata della funzione InjTDC" UWORD bsAF_E2PROM.Conversion 0 0 5 30 ECU_ADDRESS 0x40001D96 /end MEASUREMENT
/begin MEASUREMENT bsAF_E2PROM_Valid "Flag that indicates if the AFStechio value in E2PROM is valid" UBYTE bsAF_E2PROM_Valid.Conversion 0 0 0 1 ECU_ADDRESS 0x40001D95 /end MEASUREMENT
/begin MEASUREMENT bsALTERNATE_FUEL_Tx_Enable "Abilitazione messaggio J1939 - ALTERNATE_FUEL" UBYTE J1939dl_Tx100ms_CM_boolean_adm 0 0 0 1 ECU_ADDRESS 0x40001951 /end MEASUREMENT
/begin MEASUREMENT bsALTERNATE_FUEL_Tx_Msg "ALTERNATE_FUEL Tx Can message" UBYTE J1939dl_Tx100ms_CM_uint8_adm 0 0 0 255 ECU_ADDRESS 0x1000 MATRIX_DIM 8 /end MEASUREMENT
/begin CHARACTERISTIC bsANGLE_PHASE_EVT "Angle of PHASE Event" VALUE 0xFC00AE __UWORD_Z 0 bsANGLE_PHASE_EVT.Conversion 0 719.9 /end CHARACTERISTIC
/begin CHARACTERISTIC bsANGLE_TDC_1 "Angle of TDC 1" VALUE 0xFC00BE __UWORD_Z 0 bsANGLE_TDC_1.Conversion 0 719.9 /end CHARACTERISTIC
/begin CHARACTERISTIC bsANGLE_TDC_2 "Angle of TDC 2" VALUE 0xFC00BC __UWORD_Z 0 bsANGLE_TDC_2.Conversion 0 719.9 /end CHARACTERISTIC
/begin CHARACTERISTIC bsANGLE_TDC_3 "Angle of TDC 3" VALUE 0xFC00BA __UWORD_Z 0 bsANGLE_TDC_3.Conversion 0 719.9 /end CHARACTERISTIC
/begin CHARACTERISTIC bsANGLE_TDC_4 "Angle of TDC 4" VALUE 0xFC00B8 __UWORD_Z 0 bsANGLE_TDC_4.Conversion 0 719.9 /end CHARACTERISTIC
/begin CHARACTERISTIC bsANGLE_TDC_5 "Angle of TDC 5" VALUE 0xFC00B6 __UWORD_Z 0 bsANGLE_TDC_5.Conversion 0 719.9 /end CHARACTERISTIC
/begin CHARACTERISTIC bsANGLE_TDC_6 "Angle of TDC 6" VALUE 0xFC00B4 __UWORD_Z 0 bsANGLE_TDC_6.Conversion 0 719.9 /end CHARACTERISTIC
/begin CHARACTERISTIC bsANGLE_TDC_7 "Angle of TDC 7" VALUE 0xFC00B2 __UWORD_Z 0 bsANGLE_TDC_7.Conversion 0 719.9 /end CHARACTERISTIC
/begin CHARACTERISTIC bsANGLE_TDC_8 "Angle of TDC 8" VALUE 0xFC00B0 __UWORD_Z 0 bsANGLE_TDC_8.Conversion 0 719.9 /end CHARACTERISTIC
/begin CHARACTERISTIC bsAUTO_MISF_GEN "Misfire automatic generator enable fix (0-off,1-on)" VALUE 0xFC0090 __UBYTE_Z 0 bsAUTO_MISF_GEN.Conversion 0 1 /end CHARACTERISTIC
/begin MEASUREMENT bsActDiagComp "Active Diagnosis Component id" UBYTE bsActDiagComp.Conversion 0 0 0 1 ECU_ADDRESS 0x4000196F /end MEASUREMENT
/begin MEASUREMENT bsActDiagStat "Stato raggiunto dalla diagnosi attiva " UBYTE bsActDiagStat.Conversion 0 0 0 255 ECU_ADDRESS 0x40001970 /end MEASUREMENT
/begin MEASUREMENT bsActDiagStopped "Stop Active Diagnosis request" UBYTE bsActDiagStopped.Conversion 0 0 0 1 ECU_ADDRESS 0x4000196E /end MEASUREMENT
/begin MEASUREMENT bsActDiagUsrReq "Richiesta servizio di diagnosi attiva componente" UBYTE bsActDiagUsrReq.Conversion 0 0 0 1 ECU_ADDRESS 0x40001971 /end MEASUREMENT
/begin MEASUREMENT bsAirCondReq "Air Conditioner request - (AirCondReq_ID)" UBYTE bsAirCondReq.Conversion 0 0 0 1 ECU_ADDRESS 0x400018E2 /end MEASUREMENT
/begin MEASUREMENT bsAnmPwrOff "Error Flag: Wrong shutdown last trip (1-present. 0-not present)" UBYTE bsAnmPwrOff.Conversion 0 0 0 1 ECU_ADDRESS 0x400015D4 /end MEASUREMENT
/begin MEASUREMENT bsAnmPwrOffCnt "Wrong shutdown last trip counter" ULONG bsAnmPwrOffCnt.Conversion 0 0 0 4294967295 ECU_ADDRESS 0x400015D0 /end MEASUREMENT
/begin MEASUREMENT bsApplType "Tipo di applicazione: TF_APPL=1; TE_APPL=2; TM_APPL=3;" UBYTE ConfInit_CM_uint8_adm 0 0 0 202 ECU_ADDRESS 0x400015CA /end MEASUREMENT
/begin MEASUREMENT bsBc2Edc1ErrFlag "Bc2Edc1 msg Error Flag" UBYTE bsBc2Edc1ErrFlag.Conversion 0 0 0 1 ECU_ADDRESS 0x40001964 /end MEASUREMENT
/begin MEASUREMENT bsBc2Edc2ErrFlag "Bc2Edc2 msg Error Flag" UBYTE bsBc2Edc2ErrFlag.Conversion 0 0 0 1 ECU_ADDRESS 0x40001965 /end MEASUREMENT
/begin MEASUREMENT bsBrakePed1 "Breake pedal switch 1 - (BrakePedSw1_ID)" UBYTE bsBrakePed1.Conversion 0 0 0 1 ECU_ADDRESS 0x400018E1 /end MEASUREMENT
/begin MEASUREMENT bsBrakePed2 "Breake pedal switch 2 - (BrakePedSw2_ID)" UBYTE bsBrakePed2.Conversion 0 0 0 1 ECU_ADDRESS 0x400018E0 /end MEASUREMENT
/begin CHARACTERISTIC bsCAM_EDGE_TYPE "Edge for CAM tooth detection " VALUE 0xFC00CE __UBYTE_Z 0 bsCAM_EDGE_TYPE.Conversion 0 255 /end CHARACTERISTIC
/begin CHARACTERISTIC bsCAM_LEVEL "CAM sync is performed using edges or just by level (one tooth cam) " VALUE 0xFC00D0 __UBYTE_Z 0 bsCAM_LEVEL.Conversion 0 255 /end CHARACTERISTIC
/begin CHARACTERISTIC bsCAM_SYNCH_ALT_TYPE "Spare (Sync) CAM tooth is in normal phase [0-360[ or in alternate phase [360-720[ " VALUE 0xFC00CF __UBYTE_Z 0 bsCAM_SYNCH_ALT_TYPE.Conversion 0 255 /end CHARACTERISTIC
/begin CHARACTERISTIC bsCAM_TOOTH_0 "Intake cam tooth SPARE (0) position (related to crankshaft angle)" VALUE 0xFC00C0 __UWORD_Z 0 bsCAM_TOOTH_0.Conversion 0 720 /end CHARACTERISTIC
/begin CHARACTERISTIC bsCAM_TOOTH_1 "Intake cam tooth 1 position (related to crankshaft angle)" VALUE 0xFC00C2 __UWORD_Z 0 bsCAM_TOOTH_1.Conversion 0 720 /end CHARACTERISTIC
/begin CHARACTERISTIC bsCAM_TOOTH_2 "Intake cam tooth 2 position (related to crankshaft angle)" VALUE 0xFC00C4 __UWORD_Z 0 bsCAM_TOOTH_2.Conversion 0 720 /end CHARACTERISTIC
/begin CHARACTERISTIC bsCAM_TOOTH_3 "Intake cam tooth 3 position (related to crankshaft angle)" VALUE 0xFC00C6 __UWORD_Z 0 bsCAM_TOOTH_3.Conversion 0 720 /end CHARACTERISTIC
/begin CHARACTERISTIC bsCAM_TOOTH_4 "Intake cam tooth 4 position (related to crankshaft angle)" VALUE 0xFC00C8 __UWORD_Z 0 bsCAM_TOOTH_4.Conversion 0 720 /end CHARACTERISTIC
/begin CHARACTERISTIC bsCAM_TOOTH_5 "Intake cam tooth 5 position (related to crankshaft angle)" VALUE 0xFC00CA __UWORD_Z 0 bsCAM_TOOTH_5.Conversion 0 720 /end CHARACTERISTIC
/begin CHARACTERISTIC bsCAM_TOOTH_6 "Intake cam tooth 6 position (related to crankshaft angle)" VALUE 0xFC00CC __UWORD_Z 0 bsCAM_TOOTH_6.Conversion 0 720 /end CHARACTERISTIC
/begin MEASUREMENT bsCAN1_DiagStatus "CAN A diagnostic status " UBYTE eDiagStatus.Conversion 0 0 0 255 ECU_ADDRESS 0x4000158B /end MEASUREMENT
/begin MEASUREMENT bsCAN2_DiagStatus "CAN B diagnostic status " UBYTE eDiagStatus.Conversion 0 0 0 255 ECU_ADDRESS 0x4000158A /end MEASUREMENT
/begin MEASUREMENT bsCAN3_DiagStatus "CAN C diagnostic status " UBYTE eDiagStatus.Conversion 0 0 0 255 ECU_ADDRESS 0x40001589 /end MEASUREMENT
/begin MEASUREMENT bsCAN4_DiagStatus "CAN D diagnostic status " UBYTE eDiagStatus.Conversion 0 0 0 255 ECU_ADDRESS 0x40001588 /end MEASUREMENT
/begin MEASUREMENT bsCCVS_Tx_Enable "Abilitazione messaggio J1939 - CCVS" UBYTE J1939dl_Tx100ms_CM_boolean_adm 0 0 0 1 ECU_ADDRESS 0x40001950 /end MEASUREMENT
/begin MEASUREMENT bsCCVS_Tx_Msg "ALTERNATE_FUEL Tx Can message" UBYTE J1939dl_Tx100ms_CM_uint8_adm 0 0 0 255 ECU_ADDRESS 0x1000 MATRIX_DIM 8 /end MEASUREMENT
/begin MEASUREMENT bsCODELStatus "Code lamp status towards Diagnosis (DM)" UBYTE Lamp100ms_CM_uint8_adm 0 0 0 3 ECU_ADDRESS 0x40001C2B /end MEASUREMENT
/begin MEASUREMENT bsCOILx_DiagStatus "Coil X complementary diagnostic status (Driver Value from eMGS)" UBYTE eDiagStatus.Conversion 0 0 0 255 ECU_ADDRESS 0x400017FD /end MEASUREMENT
/begin CHARACTERISTIC bsCRANK_EDGE_TYPE "Edge for CRANK tooth detection " VALUE 0xFC00D6 __UBYTE_Z 0 bsCRANK_EDGE_TYPE.Conversion 0 255 /end CHARACTERISTIC
/begin CHARACTERISTIC bsCRANK_MISS_TOOTH "Number of missing tooth in the GAP of the crankshaft wheel" VALUE 0xFC00D7 __UBYTE_Z 0 bsCRANK_MISS_TOOTH.Conversion 2 7 /end CHARACTERISTIC
/begin MEASUREMENT bsCamAngleOffset "Cam Tooth offset with respect reference position" SWORD bsCamAngleOffset.Conversion 0 0 -120 120 ECU_ADDRESS 0x4000187A /end MEASUREMENT
/begin MEASUREMENT bsCamPulse "Number of cam pulse (relative to teeth number)" UBYTE bsCamPulse.Conversion 0 0 0 255 ECU_ADDRESS 0x4000187C /end MEASUREMENT
/begin MEASUREMENT bsCcvsErrFlag "Ccvs msg Error Flag" UBYTE bsCcvsErrFlag.Conversion 0 0 0 1 ECU_ADDRESS 0x40001969 /end MEASUREMENT
/begin MEASUREMENT bsChBPFRetCode "API_setKnockBPF return code of the desired sensor channel" UBYTE bsChBPFRetCode.Conversion 0 0 0 5 ECU_ADDRESS 0x40001750 MATRIX_DIM 2 /end MEASUREMENT
/begin MEASUREMENT bsClutch "Clutch pedal switch - (ClutchPedSw_ID)" UBYTE bsClutch.Conversion 0 0 0 1 ECU_ADDRESS 0x400018DF /end MEASUREMENT
/begin MEASUREMENT bsCntIdxMisf "Vector to Count generated misfiring TDCs" UWORD bsCntIdxMisf.Conversion 0 0 0 1000 ECU_ADDRESS 0x400015F0 MATRIX_DIM 8 /end MEASUREMENT
/begin MEASUREMENT bsCodeLamp "Code lamp request from diagnosis manager" UBYTE bsCodeLamp.Conversion 0 0 0 1 ECU_ADDRESS 0x40001846 /end MEASUREMENT
/begin MEASUREMENT bsCountPostCatHeaterRst "Contatore Reset PostCatHeater" UBYTE bsCountPostCatHeaterRst.Conversion 0 0 0 255 ECU_ADDRESS 0x40001B3E /end MEASUREMENT
/begin MEASUREMENT bsCountPreCatHeaterRst "Contatore Reset PreCatHeater" UBYTE bsCountPreCatHeaterRst.Conversion 0 0 0 255 ECU_ADDRESS 0x40001B3F /end MEASUREMENT
/begin MEASUREMENT bsCountThrRst "Contatore Reset Throttle" UWORD bsCountThrRst.Conversion 0 0 0 65535 ECU_ADDRESS 0x40001B40 /end MEASUREMENT
/begin MEASUREMENT bsCounter100ms "Loop Counter incrementato ad ogni esecuzione del task a 100ms" ULONG bsCounter100ms.Conversion 0 0 0 4294967295 ECU_ADDRESS 0x400018F0 /end MEASUREMENT
/begin MEASUREMENT bsCounter10ms "Loop Counter incrementato ad ogni esecuzione del task a 10ms" ULONG bsCounter10ms.Conversion 0 0 0 4294967295 ECU_ADDRESS 0x400018F8 /end MEASUREMENT
/begin MEASUREMENT bsCounter1ms "Loop Counter incrementato ad ogni esecuzione del task a 1ms" ULONG bsCounter1ms.Conversion 0 0 0 4294967295 ECU_ADDRESS 0x40001904 /end MEASUREMENT
/begin MEASUREMENT bsCounter1s "Loop Counter incrementato ad ogni esecuzione del task a 1 sec" ULONG bsCounter1s.Conversion 0 0 0 4294967295 ECU_ADDRESS 0x400018E8 /end MEASUREMENT
/begin MEASUREMENT bsCounter2ms "Loop Counter incrementato ad ogni esecuzione del task a 2ms" ULONG bsCounter2ms.Conversion 0 0 0 4294967295 ECU_ADDRESS 0x400018FC /end MEASUREMENT
/begin MEASUREMENT bsCounter4ms "Loop Counter incrementato ad ogni esecuzione del task a 4ms" ULONG bsCounter4ms.Conversion 0 0 0 4294967295 ECU_ADDRESS 0x40001900 /end MEASUREMENT
/begin MEASUREMENT bsCounter50ms "Loop Counter incrementato ad ogni esecuzione del task a 50ms" ULONG bsCounter50ms.Conversion 0 0 0 4294967295 ECU_ADDRESS 0x400018F4 /end MEASUREMENT
/begin MEASUREMENT bsCounterTDC "Loop Counter incrementato ad ogni esecuzione del task a TDC" ULONG bsCounterTDC.Conversion 0 0 0 4294967295 ECU_ADDRESS 0x400018EC /end MEASUREMENT
/begin MEASUREMENT bsCrkPhase "Fase nel modo crank" UBYTE DiagSym4ms_CM_uint8_adm 0 0 0 255 ECU_ADDRESS 0x40001BDE /end MEASUREMENT
/begin MEASUREMENT bsCurCyl "Current Cylinder Idx" UBYTE bsCurCyl.Conversion 0 0 0 7 ECU_ADDRESS 0x40001878 /end MEASUREMENT
/begin MEASUREMENT bsCylSensRetCode "API_setKnockCylinderSensor return code of current cylinder" UBYTE bsCylSensRetCode.Conversion 0 0 0 5 ECU_ADDRESS 0x400017BC MATRIX_DIM 8 /end MEASUREMENT
/begin MEASUREMENT bsCylWinRetCode "API_setKnockCylinderSensor return code of current cylinder" UBYTE bsCylWinRetCode.Conversion 0 0 0 5 ECU_ADDRESS 0x40001794 MATRIX_DIM 8 /end MEASUREMENT
/begin MEASUREMENT bsCylinderPreGain "BPF PreGain in function of current cylinder" UBYTE bsCylinderPreGain.Conversion 0 0 0 2 ECU_ADDRESS 0x400017EC MATRIX_DIM 8 /end MEASUREMENT
/begin MEASUREMENT bsDD1_Tx_Enable "Abilitazione messaggio J1939 - DD1" UBYTE J1939dl_Tx1s_CM_boolean_adm 0 0 0 1 ECU_ADDRESS 0x40001941 /end MEASUREMENT
/begin MEASUREMENT bsDD1_Tx_Msg "DD1 Tx Can message" UBYTE J1939dl_Tx1s_CM_uint8_adm 0 0 0 255 ECU_ADDRESS 0x1000 MATRIX_DIM 8 /end MEASUREMENT
/begin MEASUREMENT bsDLCC1_Tx_Enable "Abilitazione messaggio J1939 - DLCC1" UBYTE J1939dl_Tx1s_CM_boolean_adm 0 0 0 1 ECU_ADDRESS 0x40001947 /end MEASUREMENT
/begin MEASUREMENT bsDLCC1_Tx_Msg "DLCC1 Tx Can message" UBYTE J1939dl_Tx1s_CM_uint8_adm 0 0 0 255 ECU_ADDRESS 0x1000 MATRIX_DIM 8 /end MEASUREMENT
/begin MEASUREMENT bsDLCC2_Tx_Enable "Abilitazione messaggio J1939 - DLCC2" UBYTE J1939dl_Tx1s_CM_boolean_adm 0 0 0 1 ECU_ADDRESS 0x40001946 /end MEASUREMENT
/begin MEASUREMENT bsDLCC2_Tx_Msg "DLCC2 Tx Can message" UBYTE J1939dl_Tx1s_CM_uint8_adm 0 0 0 255 ECU_ADDRESS 0x1000 MATRIX_DIM 8 /end MEASUREMENT
/begin MEASUREMENT bsDiagElQSStat "Stato diagnosi ElQS" UBYTE bsDiagElQSStat.Conversion 0 0 0 255 ECU_ADDRESS 0x40001BDF /end MEASUREMENT
/begin MEASUREMENT bsDigInSpare2 "Spare request 2 - (Not assigned)" UBYTE bsDigInSpare2.Conversion 0 0 0 1 ECU_ADDRESS 0x400018DE /end MEASUREMENT
/begin MEASUREMENT bsDigInSpare3 "Spare request 3 - (Not assigned)" UBYTE bsDigInSpare3.Conversion 0 0 0 1 ECU_ADDRESS 0x400018DD /end MEASUREMENT
/begin MEASUREMENT bsDirSignal "Comando direzione throttle body (THROTTLE_HB)" UBYTE bsDirSignal.Conversion 0 0 0 1 ECU_ADDRESS 0x40001843 /end MEASUREMENT
/begin MEASUREMENT bsDisSignal "Comando disabilitazione throttle body (THROTTLE_HB)" UBYTE bsDisSignal.Conversion 0 0 0 1 ECU_ADDRESS 0x40001842 /end MEASUREMENT
/begin MEASUREMENT bsDoorsOpen "Door open switch - (EngBrk_DoorSw_ID)" UBYTE bsDoorsOpen.Conversion 0 0 0 1 ECU_ADDRESS 0x400018DC /end MEASUREMENT
/begin MEASUREMENT bsDurataTDC "Durata del TDC" ULONG bsDurataTDC.Conversion 0 0 0 130000 ECU_ADDRESS 0x40001884 /end MEASUREMENT
/begin MEASUREMENT bsECM2EPR_Tx_Enable "Enabling J1939 CAN Msg - ECM2EPR" UBYTE J1939dl_Tx4ms_CM_boolean_adm 0 0 0 1 ECU_ADDRESS 0x40001956 /end MEASUREMENT
/begin MEASUREMENT bsECM2EPR_Tx_Msg "ECM2EPR Tx Can message" UBYTE J1939dl_Tx4ms_CM_uint8_adm 0 0 0 255 ECU_ADDRESS 0x1000 MATRIX_DIM 8 /end MEASUREMENT
/begin MEASUREMENT bsECU2TURBO_Tx_Enable "Enabling CAN PVT Msg - ECU2TURBO" UBYTE CanPvt_Tx4ms_CM_boolean_adm 0 0 0 1 ECU_ADDRESS 0x4000190F /end MEASUREMENT
/begin MEASUREMENT bsECU2TURBO_Tx_Msg "ECU2TURBO Tx Can message" UBYTE CanPvt_Tx4ms_CM_uint8_adm 0 0 0 255 ECU_ADDRESS 0x1000 MATRIX_DIM 8 /end MEASUREMENT
/begin MEASUREMENT bsEDC2BC_Tx_Enable "Abilitazione messaggio J1939 - EDC2BC" UBYTE J1939dl_Tx50ms_CM_boolean_adm 0 0 0 1 ECU_ADDRESS 0x40001955 /end MEASUREMENT
/begin MEASUREMENT bsEDC2BC_Tx_Msg "EDC2BC Tx Can message" UBYTE J1939dl_Tx50ms_CM_uint8_adm 0 0 0 255 ECU_ADDRESS 0x1000 MATRIX_DIM 8 /end MEASUREMENT
/begin MEASUREMENT bsEEC1_Tx_Enable "Abilitazione messaggio J1939 - EEC1" UBYTE J1939dl_Tx4ms_CM_boolean_adm 0 0 0 1 ECU_ADDRESS 0x40001957 /end MEASUREMENT
/begin MEASUREMENT bsEEC1_Tx_Msg "EEC1 Tx Can message" UBYTE J1939dl_Tx4ms_CM_uint8_adm 0 0 0 255 ECU_ADDRESS 0x1000 MATRIX_DIM 8 /end MEASUREMENT
/begin MEASUREMENT bsEEC2_Tx_Enable "Abilitazione messaggio J1939 - EEC2" UBYTE J1939dl_Tx50ms_CM_boolean_adm 0 0 0 1 ECU_ADDRESS 0x40001954 /end MEASUREMENT
/begin MEASUREMENT bsEEC2_Tx_Msg "EEC2 Tx Can message" UBYTE J1939dl_Tx50ms_CM_uint8_adm 0 0 0 255 ECU_ADDRESS 0x1000 MATRIX_DIM 8 /end MEASUREMENT
/begin MEASUREMENT bsEEC3_Tx_Enable "Abilitazione messaggio J1939 - EEC3" UBYTE J1939dl_Tx100ms_CM_boolean_adm 0 0 0 1 ECU_ADDRESS 0x4000194C /end MEASUREMENT
/begin MEASUREMENT bsEEC3_Tx_Msg "EEC3 Tx Can message" UBYTE J1939dl_Tx100ms_CM_uint8_adm 0 0 0 255 ECU_ADDRESS 0x1000 MATRIX_DIM 8 /end MEASUREMENT
/begin MEASUREMENT bsEFL_P2_Tx_Enable "Abilitazione messaggio J1939 - ELF/P2 Engine Fluid Level/Pressure 2" UBYTE J1939dl_Tx100ms_CM_boolean_adm 0 0 0 1 ECU_ADDRESS 0x40001943 /end MEASUREMENT
/begin MEASUREMENT bsEFL_P2_Tx_Msg "EFL/P2 Tx Can message" UBYTE J1939dl_Tx100ms_CM_uint8_adm 0 0 0 255 ECU_ADDRESS 0x1000 MATRIX_DIM 8 /end MEASUREMENT
/begin MEASUREMENT bsEFL_Tx_Enable "Abilitazione messaggio J1939 - FLUID_LEVEL_PRESS" UBYTE J1939dl_Tx100ms_CM_boolean_adm 0 0 0 1 ECU_ADDRESS 0x4000194F /end MEASUREMENT
/begin MEASUREMENT bsEFL_Tx_Msg "EFL Tx Can message" UBYTE J1939dl_Tx100ms_CM_uint8_adm 0 0 0 255 ECU_ADDRESS 0x1000 MATRIX_DIM 8 /end MEASUREMENT
/begin MEASUREMENT bsEGR_DiagStatus "EGR valve diagnostic status (Driver Value)" UBYTE eDiagStatus.Conversion 0 0 0 255 ECU_ADDRESS 0x40001840 /end MEASUREMENT
/begin MEASUREMENT bsENGBRK_DiagStatus "Engine Brake diagnostic status (Driver Value)" UBYTE eDiagStatus.Conversion 0 0 0 255 ECU_ADDRESS 0x4000185E /end MEASUREMENT
/begin MEASUREMENT bsENG_CONF_Tx_Enable "Abilitazione messaggio J1939 - ENG_CONF" UBYTE J1939dl_Tx1s_CM_boolean_adm 0 0 0 1 ECU_ADDRESS 0x4000195B /end MEASUREMENT
/begin MEASUREMENT bsENG_CONF_Tx_Msg "ENG_CONF Tx Can message Multipacket" UBYTE J1939dl_Tx1s_CM_uint8_adm 0 0 0 255 ECU_ADDRESS 0x1000 MATRIX_DIM 32 /end MEASUREMENT
/begin MEASUREMENT bsENG_HOURS_Tx_Enable "Abilitazione messaggio J1939 - ENG HOURS" UBYTE J1939dl_Tx100ms_CM_boolean_adm 0 0 0 1 ECU_ADDRESS 0x4000194E /end MEASUREMENT
/begin MEASUREMENT bsENG_HOURS_Tx_Msg "ENG_CONF Tx Can message ENG_HOURS" UBYTE J1939dl_Tx100ms_CM_uint8_adm 0 0 0 255 ECU_ADDRESS 0x1000 MATRIX_DIM 8 /end MEASUREMENT
/begin MEASUREMENT bsENG_TEMP_Tx_Enable "Abilitazione messaggio J1939 - ENG_TEMP" UBYTE J1939dl_Tx1s_CM_boolean_adm 0 0 0 1 ECU_ADDRESS 0x4000195A /end MEASUREMENT
/begin MEASUREMENT bsENG_TEMP_Tx_Msg "ENG_TEMP Tx Can message" UBYTE J1939dl_Tx1s_CM_uint8_adm 0 0 0 255 ECU_ADDRESS 0x1000 MATRIX_DIM 8 /end MEASUREMENT
/begin MEASUREMENT bsEPMErrorStatus "EPM phase error status" UBYTE bsEPMErrorStatus.Conversion 0 0 0 3 ECU_ADDRESS 0x4000187D /end MEASUREMENT
/begin MEASUREMENT bsEPMStatus "EPM phase status" UBYTE bsEPMStatus.Conversion 0 0 0 5 ECU_ADDRESS 0x4000187E /end MEASUREMENT
/begin MEASUREMENT bsEPR2ECMErrFlag "EPR2ECM msg Error Flag" UBYTE bsEPR2ECMErrFlag.Conversion 0 0 0 1 ECU_ADDRESS 0x40001968 /end MEASUREMENT
/begin MEASUREMENT bsERC1_ER_Tx_Enable "Abilitazione messaggio J1939 - ERC1_ER" UBYTE J1939dl_Tx1s_CM_boolean_adm 0 0 0 1 ECU_ADDRESS 0x40001959 /end MEASUREMENT
/begin MEASUREMENT bsERC1_ER_Tx_Msg "ERC1_ER Tx Can message" UBYTE J1939dl_Tx1s_CM_uint8_adm 0 0 0 255 ECU_ADDRESS 0x1000 MATRIX_DIM 8 /end MEASUREMENT
/begin MEASUREMENT bsET2_Tx_Enable "Abilitazione messaggio J1939 - ET2" UBYTE J1939dl_Tx1s_CM_boolean_adm 0 0 0 1 ECU_ADDRESS 0x40001949 /end MEASUREMENT
/begin MEASUREMENT bsET2_Tx_Msg "ET2 Tx Can message" UBYTE J1939dl_Tx1s_CM_uint8_adm 0 0 0 255 ECU_ADDRESS 0x1000 MATRIX_DIM 8 /end MEASUREMENT
/begin MEASUREMENT bsEVR_DiagStatus "Tank EV diagnostic status" UBYTE eDiagStatus.Conversion 0 0 0 255 ECU_ADDRESS 0x40001854 /end MEASUREMENT
/begin MEASUREMENT bsEVRel "CNG electrovalves relay command after the recovery" UBYTE Evrc4ms_CM_boolean_adm 0 0 0 1 ECU_ADDRESS 0x40001853 /end MEASUREMENT
/begin MEASUREMENT bsEcuTempBit "Valore in bit della temperatura a bordo ECU su 10bit (EcuTemp_IA)" UWORD bsEcuTempBit.Conversion 0 0 0 1024 ECU_ADDRESS 0x4000188E /end MEASUREMENT
/begin MEASUREMENT bsEepromResetThr "Flag that indicates if a reset by external tool is requested for EEPROM Throttle parameters" UBYTE bsEepromResetThr.Conversion 0 0 0 1 ECU_ADDRESS 0x40001D94 /end MEASUREMENT
/begin MEASUREMENT bsEepromState "Stato Eeprom" UBYTE bsEepromState.Conversion 0 0 0 1 ECU_ADDRESS 0x40001DD6 /end MEASUREMENT
/begin MEASUREMENT bsEgrCmdEnable "Enable H-Bridge driver for Epr valve" UBYTE EgrMgm4ms_CM_boolean_adm 0 0 0 1 ECU_ADDRESS 0x40001864 /end MEASUREMENT
/begin MEASUREMENT bsEgrDeltaPBit "Raw bit value of Egr delta pressure scaled on 10bit (EgrDeltaPres_IA)" UWORD bsEgrDeltaPBit.Conversion 0 0 0 1024 ECU_ADDRESS 0x40001898 /end MEASUREMENT
/begin MEASUREMENT bsEgrDir "EGR Duty Cycle direction (on H-Bridge)" UBYTE EgrMgm4ms_CM_boolean_adm 0 0 0 1 ECU_ADDRESS 0x4000185F /end MEASUREMENT
/begin MEASUREMENT bsEgrDuty "EGR Duty Cycle (for H-Bridge)" UWORD EgrMgm4ms_CM_ufix16_En3__ 0 0 0 100 ECU_ADDRESS 0x40001860 /end MEASUREMENT
/begin MEASUREMENT bsEgrFreq "Command frequency for H-Bridge EGR valve" UWORD EgrMgm4ms_CM_ufix16_S10_Hz 0 0 0 10000 ECU_ADDRESS 0x40001862 /end MEASUREMENT
/begin MEASUREMENT bsEgrHighPreBit "Raw bit value of Egr high pressure (at EGR valve inlet) scaled on 10bit (ExhPres_IA)" UWORD bsEgrHighPreBit.Conversion 0 0 0 1024 ECU_ADDRESS 0x40001896 /end MEASUREMENT
/begin MEASUREMENT bsEgrPosBit "EGR valve position sensor feedback, scaled on 10bit (EgrPos_IA)" UWORD bsEgrPosBit.Conversion 0 0 0 1024 ECU_ADDRESS 0x400018B0 /end MEASUREMENT
/begin MEASUREMENT bsEngBrkDuty "Engine Brake actuator command duty cycle" UWORD Egbrk50ms_CM_ufix16_En4__ 0 0 0 100 ECU_ADDRESS 0x4000185A /end MEASUREMENT
/begin MEASUREMENT bsEngBrkFreq "Engine Brake actuator frequence" UWORD Egbrk50ms_CM_ufix16_S10_Hz 0 0 0 10000 ECU_ADDRESS 0x4000185C /end MEASUREMENT
/begin MEASUREMENT bsEngBrkReq "Engine Brake switch - (EngBrk_DoorSw_ID)" UBYTE bsEngBrkReq.Conversion 0 0 0 1 ECU_ADDRESS 0x400018DB /end MEASUREMENT
/begin MEASUREMENT bsEngMode_GOBD "Modo motore (for GOBD FF)" UBYTE DiagSym100ms_CM_uint8_adm 0 0 0 4 ECU_ADDRESS 0x40001C27 /end MEASUREMENT
/begin MEASUREMENT bsEngStarted "Segnale motore in movimento (riconoscimento primi 10 denti smot)" UBYTE bsEngStarted.Conversion 0 0 0 1 ECU_ADDRESS 0x4000188A /end MEASUREMENT
/begin MEASUREMENT bsEngState_GOBD "Stato motore in uscita da StateFlow (for GOBD FF)" UBYTE DiagSym100ms_CM_uint8_adm 0 0 0 6 ECU_ADDRESS 0x40001C28 /end MEASUREMENT
/begin MEASUREMENT bsEngineType "Engine configuration Code" UBYTE ConfInit_CM_eCONF_adm 0 0 0 8 ECU_ADDRESS 0x400015C9 /end MEASUREMENT
/begin MEASUREMENT bsEnvParDay_GOBD "Parametro ambientale (giorno) dervato dal msg CAN Rx TimeDate" UBYTE DiagSym100ms_CM_ufix8_En2_day 0 0 0 31.75 ECU_ADDRESS 0x40001C1D /end MEASUREMENT
/begin MEASUREMENT bsEnvParHours_GOBD "Informazione (TimeDate) oraria da utilizzare come Parametro Ambientale per la Diagnosi" UBYTE DiagSym100ms_CM_uint8_hour 0 0 0 23 ECU_ADDRESS 0x40001C1C /end MEASUREMENT
/begin MEASUREMENT bsEnvParMinutes_GOBD "nformazione (TimeDate) dei minuti primi da utilizzare come Parametro Ambientale per la Diagnosi" UBYTE DiagSym100ms_CM_uint8_min 0 0 0 59 ECU_ADDRESS 0x40001C1B /end MEASUREMENT
/begin MEASUREMENT bsEnvParMonth_GOBD "nformazione (TimeDate) del mese da utilizzare come Parametro Ambientale per la Diagnosi" UBYTE DiagSym100ms_CM_uint8_month 0 0 1 12 ECU_ADDRESS 0x40001C1E /end MEASUREMENT
/begin MEASUREMENT bsEnvParSeconds_GOBD "nformazione (TimeDate) dei secondi da utilizzare come Parametro Ambientale per la Diagnosi" UBYTE DiagSym100ms_CM_ufix8_En2_sec 0 0 0 59.75 ECU_ADDRESS 0x40001C1A /end MEASUREMENT
/begin MEASUREMENT bsEnvParYear_GOBD "Parametro ambientale (anno) derivato dal msg CAN Rx TimeDate (rispetto al 1985)" UBYTE DiagSym100ms_CM_ufix8_B1985_year 0 0 1985 2235 ECU_ADDRESS 0x40001C1F /end MEASUREMENT
/begin MEASUREMENT bsEqadcCh "Eqadc Channel in function of current cylinder" UBYTE bsEqadcCh.Conversion 0 0 0 1 ECU_ADDRESS 0x400017F4 MATRIX_DIM 8 /end MEASUREMENT
/begin MEASUREMENT bsEtc1ErrFlag "Etc1 msg Error Flag" UBYTE bsEtc1ErrFlag.Conversion 0 0 0 1 ECU_ADDRESS 0x4000195F /end MEASUREMENT
/begin MEASUREMENT bsEtc2ErrFlag "Etc2 msg Error Flag" UBYTE bsEtc2ErrFlag.Conversion 0 0 0 1 ECU_ADDRESS 0x40001967 /end MEASUREMENT
/begin MEASUREMENT bsEtsErrorSval "Flag to indicate the ClearDTC request trough UDS or DM routines (used by ADAT2 diagnosis)" UBYTE bsEtsErrorSval.Conversion 0 0 0 1 ECU_ADDRESS 0x40001D50 /end MEASUREMENT
/begin MEASUREMENT bsFAN1_DiagStatus "FAN1 diagnostic status (Driver Value)" UBYTE eDiagStatus.Conversion 0 0 0 255 ECU_ADDRESS 0x400016FD /end MEASUREMENT
/begin MEASUREMENT bsFAN2_DiagStatus "FAN2 diagnostic status" UBYTE eDiagStatus.Conversion 0 0 0 255 ECU_ADDRESS 0x400016FC /end MEASUREMENT
/begin MEASUREMENT bsFFAbsLoad "Freeze Frame: Carico assoluto" UWORD DiagSym100ms_CM_ufix16_Sp392__ 0 0 0 25689.72 ECU_ADDRESS 0x40001C04 /end MEASUREMENT
/begin MEASUREMENT bsFFAdvance "Freeze Frame: Anticipo accensione" UBYTE DiagSym100ms_CM_ufix8_En1_Bn64_degree 0 0 -64 63.5 ECU_ADDRESS 0x40001C0F /end MEASUREMENT
/begin MEASUREMENT bsFFBoostCtrlSt "Freeze Frame: Boost Control Status (1-NO Closed loop and NO Recovery; 2-Closed loop; 3-NO Closed loop " UBYTE DiagSym100ms_CM_uint8_adm 0 0 0 255 ECU_ADDRESS 0x40001BFE /end MEASUREMENT
/begin MEASUREMENT bsFFCLoad "Freeze Frame: Carico calcolato" UBYTE DiagSym100ms_CM_ufix8_Sp392__ 0 0 0 99.96 ECU_ADDRESS 0x40001C18 /end MEASUREMENT
/begin MEASUREMENT bsFFCmdEqRatio "Freeze Frame: A\\F Ratio" UWORD DiagSym100ms_CM_ufix16_S3p05en5_adm 0 0 0 1.9988175 ECU_ADDRESS 0x40001C02 /end MEASUREMENT
/begin MEASUREMENT bsFFDrvPedPerc "Freeze Frame: Richiesta del driver riscalata sui valori autoadattativi" UBYTE DiagSym100ms_CM_ufix8_Sp39215686274509803__ 0 0 0 100 ECU_ADDRESS 0x40001BF7 /end MEASUREMENT
/begin MEASUREMENT bsFFEngTrqMode_DM4 "DM4 Byte: 6 Engine Torque Mode (SPN 899) See SAE J1939-71" UBYTE DiagSym100ms_CM_uint8_adm 0 0 0 15 ECU_ADDRESS 0x40001BE9 /end MEASUREMENT
/begin MEASUREMENT bsFFFInj "Freeze Frame: Representative fuel injection timing, beginning of first main injection" UWORD DiagSym100ms_CM_ufix16_En7_Bn210_deg 0 0 -210 301.99 ECU_ADDRESS 0x40001BEE /end MEASUREMENT
/begin MEASUREMENT bsFFFlsySt "Freeze Frame: Stato della Fuel System (bit 0-->OL, 1-->CL, 2-->OL-Drive, 3-->OL-Fault, 4-->CL-Fault)" UBYTE DiagSym100ms_CM_uint8_adm 0 0 0 31 ECU_ADDRESS 0x40001C19 /end MEASUREMENT
/begin MEASUREMENT bsFFFuelLev "Freeze Frame: Fuel Level" UBYTE DiagSym100ms_CM_ufix8_Sp39215686274509803__ 0 0 0 100 ECU_ADDRESS 0x40001BF6 /end MEASUREMENT
/begin MEASUREMENT bsFFLoad_DM4 "DM4  Byte: 10 Engine % Load (SPN 92) See SAE J1939-71" UBYTE DiagSym100ms_CM_uint8__ 0 0 0 125 ECU_ADDRESS 0x40001BE5 /end MEASUREMENT
/begin MEASUREMENT bsFFLongFlTrim "Freeze Frame: Correzione autoadattativà controllo titolo" UBYTE DiagSym100ms_CM_ufix8_Sp78125_Bn100__ 0 0 -100 99.21875 ECU_ADDRESS 0x40001C15 /end MEASUREMENT
/begin MEASUREMENT bsFFMap "Freeze Frame: Pressione aria assoluta" UBYTE DiagSym100ms_CM_uint8_kPa 0 0 0 255 ECU_ADDRESS 0x40001C14 /end MEASUREMENT
/begin MEASUREMENT bsFFP6RefEngCmu "Freeze Frame: Reference engine maximum torque" UWORD DiagSym100ms_CM_uint16_N_m 0 0 0 65535 ECU_ADDRESS 0x40001BF0 /end MEASUREMENT
/begin MEASUREMENT bsFFPAtm "Freeze Frame: Pressione Atmosferica" UBYTE DiagSym100ms_CM_uint8_kPa 0 0 0 255 ECU_ADDRESS 0x40001C08 /end MEASUREMENT
/begin MEASUREMENT bsFFPBoost "Freeze Frame: Boost pressure" UWORD DiagSym100ms_CM_ufix16_Sp031250476844434272_kPa 0 0 0 2048 ECU_ADDRESS 0x40001BF4 /end MEASUREMENT
/begin MEASUREMENT bsFFPBoostSup "Freeze Frame: Support of boost pressure data (stub to 7)" UBYTE DiagSym100ms_CM_uint8_adm 0 0 0 255 ECU_ADDRESS 0x40001BFD /end MEASUREMENT
/begin MEASUREMENT bsFFPBoost_DM4 "DM4  Byte: 7 Boost (SPN 102) See SAE J1939-71" UBYTE DiagSym100ms_CM_ufix8_E1_kPa 0 0 0 500 ECU_ADDRESS 0x40001BE8 /end MEASUREMENT
/begin MEASUREMENT bsFFPRail "Freeze Frame: Pressione metano nel rail" UWORD DiagSym100ms_CM_ufix16_S10_kPa 0 0 0 655350 ECU_ADDRESS 0x40001C0A /end MEASUREMENT
/begin MEASUREMENT bsFFPdlPerfReq "Freeze Frame: Driver demand Engine Torque" UBYTE DiagSym100ms_CM_ufix8_Bn125__ 0 0 -125 130 ECU_ADDRESS 0x40001BF9 /end MEASUREMENT
/begin MEASUREMENT bsFFPercCmuIstAbs "Freeze Frame: Actual engine torque" UBYTE DiagSym100ms_CM_ufix8_Bn125__ 0 0 -125 130 ECU_ADDRESS 0x40001BFA /end MEASUREMENT
/begin MEASUREMENT bsFFPercWGDirect "Freeze Frame: Wastegate valve position" UBYTE DiagSym100ms_CM_ufix8_Sp39215686274509803__ 0 0 0 100 ECU_ADDRESS 0x40001BFF /end MEASUREMENT
/begin MEASUREMENT bsFFPtoStatusA "Freeze Frame: Stato della PTO A" UBYTE DiagSym100ms_CM_uint8_adm 0 0 0 255 ECU_ADDRESS 0x40001BFC /end MEASUREMENT
/begin MEASUREMENT bsFFPtoStatusB "Freeze Frame: Stato della PTO B" UBYTE DiagSym100ms_CM_uint8_adm 0 0 0 255 ECU_ADDRESS 0x40001BFB /end MEASUREMENT
/begin MEASUREMENT bsFFRifPress "Freeze Frame: Boost pressure target" UWORD DiagSym100ms_CM_ufix16_Sp031250476844434272_kPa 0 0 0 2048 ECU_ADDRESS 0x40001BF2 /end MEASUREMENT
/begin MEASUREMENT bsFFRpm "Freeze Frame: Giri motore" UWORD DiagSym100ms_CM_ufix16_En2_rpm 0 0 0 16383.75 ECU_ADDRESS 0x40001C12 /end MEASUREMENT
/begin MEASUREMENT bsFFRpm_DM4 "DM4 Byte: 8/9 Engine Speed (SPN 190) (LSB) See SAE J1939-71" UWORD DiagSym100ms_CM_ufix16_En3_rpm 0 0 0 8031.875 ECU_ADDRESS 0x40001BE6 /end MEASUREMENT
/begin MEASUREMENT bsFFShortFlTrim "Freeze Frame: KO2 Controllo titolo" UBYTE DiagSym100ms_CM_ufix8_Sp78125_Bn100__ 0 0 -100 99.21875 ECU_ADDRESS 0x40001C16 /end MEASUREMENT
/begin MEASUREMENT bsFFStatus "Freeze Frame: Stato del freeze frame" UBYTE DiagSym100ms_CM_uint8_adm 0 0 0 255 ECU_ADDRESS 0x40001C00 /end MEASUREMENT
/begin MEASUREMENT bsFFTAir "Freeze Frame: Temperatura aria aspirata" UBYTE DiagSym100ms_CM_ufix8_Bn40_degC 0 0 -40 215 ECU_ADDRESS 0x40001C0E /end MEASUREMENT
/begin MEASUREMENT bsFFTKat "Freeze Frame: Catalyst temperature" UWORD DiagSym100ms_CM_ufix16_Sp1_Bn40_degC 0 0 -40 6513.5 ECU_ADDRESS 0x40001BEC /end MEASUREMENT
/begin MEASUREMENT bsFFTOil "Freeze Frame: Oil temperature" UBYTE DiagSym100ms_CM_ufix8_Bn40_degC 0 0 -40 215 ECU_ADDRESS 0x40001BF8 /end MEASUREMENT
/begin MEASUREMENT bsFFTh2o "Freeze Frame: Temperatura acqua" UBYTE DiagSym100ms_CM_ufix8_Bn40_degC 0 0 -40 215 ECU_ADDRESS 0x40001C17 /end MEASUREMENT
/begin MEASUREMENT bsFFTh2o_DM4 "DM4 Byte: 11 Engine coolant temperature (SPN 110) See SAE J1939-71" UBYTE DiagSym100ms_CM_ufix8_Bn40__ 0 0 -40 210 ECU_ADDRESS 0x40001BE4 /end MEASUREMENT
/begin MEASUREMENT bsFFTimeEngStart "Freeze Frame: Tempo trascorso dall avviamento del motore" UWORD DiagSym100ms_CM_uint16_s 0 0 0 65535 ECU_ADDRESS 0x40001C0C /end MEASUREMENT
/begin MEASUREMENT bsFFVBatt "reeze Frame: Tensione batteria" UWORD DiagSym100ms_CM_ufix16_Sp001_V 0 0 0 65.535 ECU_ADDRESS 0x40001C06 /end MEASUREMENT
/begin MEASUREMENT bsFFVehSpd "Freeze Frame: Velocità veicolo" UBYTE DiagSym100ms_CM_uint8_km_h 0 0 0 255 ECU_ADDRESS 0x40001C10 /end MEASUREMENT
/begin MEASUREMENT bsFFVehSpd_DM4 "DM4 Byte: 12/13 Vehicle Speed (SPN 84) (LSB) See SAE J1939-71" UWORD DiagSym100ms_CM_ufix16_En8_km_h 0 0 0 250.996 ECU_ADDRESS 0x40001BE2 /end MEASUREMENT
/begin MEASUREMENT bsFFWupCntTotE2P "Freeze Frame:  Number of warm up since recorded OBD information was last cleared " UWORD bsFFWupCntTotE2P.Conversion 0 0 0 255 ECU_ADDRESS 0x40001BEA /end MEASUREMENT
/begin CHARACTERISTIC bsFUEL_CONS_RESET "Reset counters for Fuel Level Consumption function" VALUE 0xFC00AC __UBYTE_Z 0 bsFUEL_CONS_RESET.Conversion 0 1 /end CHARACTERISTIC
/begin MEASUREMENT bsFan1Duty "PWM command related to FAN1" UWORD FanCool100ms_CM_ufix16_En3__ 0 0 0 100 ECU_ADDRESS 0x400016F6 /end MEASUREMENT
/begin MEASUREMENT bsFan1Freq "Frequency of PWM command related to FAN1" UWORD FanCool100ms_CM_ufix16_S10_Hz 0 0 0 10000 ECU_ADDRESS 0x400016F4 /end MEASUREMENT
/begin MEASUREMENT bsFan1Period "Primary Fan sensor " ULONG bsFan1Period.Conversion 0 0 0 4294967290 ECU_ADDRESS 0x400016F8 /end MEASUREMENT
/begin MEASUREMENT bsFan1PulseCnt "FAN1 sensor feedback pulse counter" UWORD bsFan1PulseCnt.Conversion 0 0 0 65535 ECU_ADDRESS 0x400016F2 /end MEASUREMENT
/begin MEASUREMENT bsFan2Cmd "Digital ON/OFF command related to FAN2" UBYTE FanCool100ms_CM_boolean_adm 0 0 0 1 ECU_ADDRESS 0x400016F0 /end MEASUREMENT
/begin MEASUREMENT bsFaseOk "Engine Timing Ok - EPM automata in PHASED state" UBYTE bsFaseOk.Conversion 0 0 0 1 ECU_ADDRESS 0x40001880 /end MEASUREMENT
/begin MEASUREMENT bsFinj "Injection Timing offset (in degrees with EOAP event as reference)" UWORD bsFinj.Conversion 0 0 0 720 ECU_ADDRESS 0x40001832 /end MEASUREMENT
/begin MEASUREMENT bsFirstFlag100ms "Flag che indica la prima esecuzione del task 100ms (First Execution -> Flag=True) " UBYTE bsFirstFlag100ms.Conversion 0 0 0 1 ECU_ADDRESS 0x4000190A /end MEASUREMENT
/begin MEASUREMENT bsFirstFlag10ms "Flag che indica la prima esecuzione del task 10ms (First Execution -> Flag=True) " UBYTE bsFirstFlag10ms.Conversion 0 0 0 1 ECU_ADDRESS 0x4000190C /end MEASUREMENT
/begin MEASUREMENT bsFirstFlag1s "Flag che indica la prima esecuzione del task 1sec (First Execution -> Flag=True) " UBYTE bsFirstFlag1s.Conversion 0 0 0 1 ECU_ADDRESS 0x40001908 /end MEASUREMENT
/begin MEASUREMENT bsFirstFlag2ms "Flag che indica la prima esecuzione del task 2ms (First Execution -> Flag=True) " UBYTE bsFirstFlag2ms.Conversion 0 0 0 1 ECU_ADDRESS 0x4000190D /end MEASUREMENT
/begin MEASUREMENT bsFirstFlag4ms "Flag che indica la prima esecuzione del task 4ms (First Execution -> Flag=True) " UBYTE bsFirstFlag4ms.Conversion 0 0 0 1 ECU_ADDRESS 0x4000190E /end MEASUREMENT
/begin MEASUREMENT bsFirstFlag50ms "Flag che indica la prima esecuzione del task 50ms (First Execution -> Flag=True) " UBYTE bsFirstFlag50ms.Conversion 0 0 0 1 ECU_ADDRESS 0x4000190B /end MEASUREMENT
/begin MEASUREMENT bsFirstFlagTDC "Flag che indica la prima esecuzione del task TDC (First Execution -> Flag=True) " UBYTE bsFirstFlagTDC.Conversion 0 0 0 1 ECU_ADDRESS 0x40001909 /end MEASUREMENT
/begin MEASUREMENT bsFuelConsReset "Reset request for Fuel Consumption counters" UBYTE bsFuelConsReset.Conversion 0 0 0 1 ECU_ADDRESS 0x400016FE /end MEASUREMENT
/begin MEASUREMENT bsFuelLevIndDC "Duty Cylce of PWM fuel level indicator command (DumpValve_OF)" UWORD bsFuelLevIndDC.Conversion 0 0 0 100 ECU_ADDRESS 0x40001700 /end MEASUREMENT
/begin MEASUREMENT bsFuelLevIndFreq "Frequency of PWM fuel level indicator command (DumpValve_OF)" UWORD bsFuelLevIndFreq.Conversion 0 0 0 10000 ECU_ADDRESS 0x40001702 /end MEASUREMENT
/begin MEASUREMENT bsFuelLevLowLamp "Low Fuel level indicator command - (WarnLamp_OD)" UBYTE bsFuelLevLowLamp.Conversion 0 0 0 1 ECU_ADDRESS 0x400016FF /end MEASUREMENT
/begin MEASUREMENT bsFuelTotConsHREe "Total amount of consumed fuel (Eeprom Write) " FLOAT32_IEEE bsFuelTotConsHREe.Conversion_Copy1 0 0 0 2105540607.5 ECU_ADDRESS 0x40001DB8 /end MEASUREMENT
/begin MEASUREMENT bsGainCoef "BPF Gain Stage coefficient of current cylinder" ULONG bsGainCoef.Conversion 0 0 -1 0.999999880791 ECU_ADDRESS 0x400017CC MATRIX_DIM 8 /end MEASUREMENT
/begin MEASUREMENT bsGlobReq_Ram "Richiesta apprendimanto completo in RAM" UBYTE bsGlobReq_Ram.Conversion 0 0 0 1 ECU_ADDRESS 0x40001DD7 /end MEASUREMENT
/begin MEASUREMENT bsGlobalLrnReq "Richiesta apprendimanto completo (Eprom Write)" UBYTE bsGlobalLrnReq.Conversion 0 0 0 1 ECU_ADDRESS 0x40001DD0 /end MEASUREMENT
/begin CHARACTERISTIC bsHBRIDGE_OL_DIAG_ENABLE "Enable Open Load special diagnosis routine (for relative HBRIDGE instance: 0-Throttle, 1-Egr)" VAL_BLK 0xFC0088 __UBYTE_Z 0 bsHBRIDGE_OL_DIAG_ENABLE.Conversion 0 1 MATRIX_DIM 2 /end CHARACTERISTIC
/begin MEASUREMENT bsHDSECU1_Tx_Enable "Abilitazione messaggio J1939 - HDSECU1" UBYTE J1939dl_Tx50ms_CM_boolean_adm 0 0 0 1 ECU_ADDRESS 0x40001953 /end MEASUREMENT
/begin MEASUREMENT bsHDSECU1_Tx_Msg "HDSECU1 Tx Can message" UBYTE J1939dl_Tx50ms_CM_uint8_adm 0 0 0 255 ECU_ADDRESS 0x1000 MATRIX_DIM 8 /end MEASUREMENT
/begin MEASUREMENT bsHDSECU2_Tx_Enable "Abilitazione messaggio J1939 - HDSECU2" UBYTE J1939dl_Tx50ms_CM_boolean_adm 0 0 0 1 ECU_ADDRESS 0x40001952 /end MEASUREMENT
/begin MEASUREMENT bsHDSECU2_Tx_Msg "HDSECU2 Tx Can message" UBYTE J1939dl_Tx50ms_CM_uint8_adm 0 0 0 255 ECU_ADDRESS 0x1000 MATRIX_DIM 8 /end MEASUREMENT
/begin MEASUREMENT bsHpfCoeff "BPF HPF Stage coefficient" ULONG bsHpfCoeff.Conversion 0 0 -1 0.999999880791 ECU_ADDRESS 0x40001708 MATRIX_DIM 9 /end MEASUREMENT
/begin MEASUREMENT bsIMMOLStatus "Immobilizer lamp status towards Diagnosis (DM)" UBYTE Lamp100ms_CM_uint8_adm 0 0 0 3 ECU_ADDRESS 0x40001C2C /end MEASUREMENT
/begin MEASUREMENT bsINJx_DiagStatus "Injector X diagnostic status (Driver Value from eMGS)" UBYTE eDiagStatus.Conversion 0 0 0 255 ECU_ADDRESS 0x4000181E /end MEASUREMENT
/begin MEASUREMENT bsINLETCOND_Tx_Enable "Abilitazione messaggio J1939 - INLETCOND" UBYTE J1939dl_Tx100ms_CM_boolean_adm 0 0 0 1 ECU_ADDRESS 0x4000194D /end MEASUREMENT
/begin MEASUREMENT bsINLETCOND_Tx_Msg "INLETCOND Tx Can message" UBYTE J1939dl_Tx100ms_CM_uint8_adm 0 0 0 255 ECU_ADDRESS 0x1000 MATRIX_DIM 8 /end MEASUREMENT
/begin MEASUREMENT bsIdleAcc "Idle Accellerator position switch - (AccIdleSw_ID)" UBYTE bsIdleAcc.Conversion 0 0 0 1 ECU_ADDRESS 0x400018DA /end MEASUREMENT
/begin MEASUREMENT bsImmoLamp "Immo lamp request from diagnosis manager" UBYTE bsImmoLamp.Conversion 0 0 0 1 ECU_ADDRESS 0x40001845 /end MEASUREMENT
/begin MEASUREMENT bsInjFastDecayTime "Fast decay transition (from peak to hold phase) time." UWORD Injt_SetParameters4ms_CM_uint16_us 0 0 0 2000 ECU_ADDRESS 0x40001836 /end MEASUREMENT
/begin MEASUREMENT bsInjHoldCurrent "Injector Hold current target applied" UWORD Injt_SetParameters4ms_CM_uint16_mA 0 0 200 8200 ECU_ADDRESS 0x4000183A /end MEASUREMENT
/begin MEASUREMENT bsInjPeakCurrent "Injector Peak current target applied" UWORD Injt_SetParameters4ms_CM_uint16_mA 0 0 1000 8200 ECU_ADDRESS 0x4000183C /end MEASUREMENT
/begin MEASUREMENT bsInjPeakTime "Duration of peak phase applied" UWORD Injt_SetParameters4ms_CM_uint16_us 0 0 200 8200 ECU_ADDRESS 0x40001838 /end MEASUREMENT
/begin MEASUREMENT bsInjStopFlg "Flag Iniezione stoppata (0 Iniezione abilitata, 1 Iniezione disabilitata (CutOff o TInj=0))" UBYTE bsInjStopFlg.Conversion 0 0 0 1 ECU_ADDRESS 0x40001834 /end MEASUREMENT
/begin CHARACTERISTIC bsKEY_SW_HIGH "Higher threshold related to bsVBPW to define if Diagnostic Managers shall operate (according with bsVBPWStatus)" VALUE 0xFC008C __UWORD_Z 0 bsKEY_SW_HIGH.Conversion 0 36404.4942 /end CHARACTERISTIC
/begin CHARACTERISTIC bsKEY_SW_LOW "Lower threshold related to bsVBPW to define if Diagnostic Managers shall operate (according with bsVBPWStatus)" VALUE 0xFC008A __UWORD_Z 0 bsKEY_SW_LOW.Conversion 0 36404.4942 /end CHARACTERISTIC
/begin MEASUREMENT bsKey "Key-On switch - (KeySw_ID)" UBYTE bsKey.Conversion 0 0 0 1 ECU_ADDRESS 0x400018CE /end MEASUREMENT
/begin MEASUREMENT bsKeyEngStart "Key in egnine start request position - (StartKeySw_IA > 3500mV)" UBYTE bsKeyEngStart.Conversion 0 0 0 1 ECU_ADDRESS 0x400018D9 /end MEASUREMENT
/begin MEASUREMENT bsKickDown "Kick Down Accellerator position switch - (AccKickDownSw_ID)" UBYTE bsKickDown.Conversion 0 0 0 1 ECU_ADDRESS 0x400018D7 /end MEASUREMENT
/begin MEASUREMENT bsLFC1_Tx_Enable "Abilitazione messaggio J1939 - LFC1" UBYTE J1939dl_Tx1s_CM_boolean_adm 0 0 0 1 ECU_ADDRESS 0x40001942 /end MEASUREMENT
/begin MEASUREMENT bsLFC1_Tx_Msg "LFC1 Tx Can message" UBYTE J1939dl_Tx1s_CM_uint8_adm 0 0 0 255 ECU_ADDRESS 0x1000 MATRIX_DIM 8 /end MEASUREMENT
/begin MEASUREMENT bsLFE1_Tx_Enable "Abilitazione messaggio J1939 - LFE1" UBYTE J1939dl_Tx100ms_CM_boolean_adm 0 0 0 1 ECU_ADDRESS 0x40001945 /end MEASUREMENT
/begin MEASUREMENT bsLFE1_Tx_Msg "LFE1 Tx Can message" UBYTE J1939dl_Tx100ms_CM_uint8_adm 0 0 0 255 ECU_ADDRESS 0x1000 MATRIX_DIM 8 /end MEASUREMENT
/begin MEASUREMENT bsLHDuty "Lambda heater PWM command after the recovery" UWORD Ctit_LambdaHeater100ms_CM_uint16__ 0 0 0 100 ECU_ADDRESS 0x40001866 /end MEASUREMENT
/begin MEASUREMENT bsLHR_DiagStatus "Lambda Heater pre cat diagnostic status (Driver Value)" UBYTE eDiagStatus.Conversion 0 0 0 255 ECU_ADDRESS 0x40001868 /end MEASUREMENT
/begin MEASUREMENT bsLambdaPostBit "Valore in bit della sonda lambda post-catalizzatore su 16bit differenziali (-2.56 : 2.56) [V] (PostCatHego_IA)" UWORD bsLambdaPostBit.Conversion 0 0 0 16380 ECU_ADDRESS 0x400018C0 /end MEASUREMENT
/begin MEASUREMENT bsLambdaPreBit "Valore in bit della sonda lambda pre-catalizzatore su 16bit differenziali (-2.56 : 2.56) [V] (PreCatHego_IA)" UWORD bsLambdaPreBit.Conversion 0 0 0 16380 ECU_ADDRESS 0x400018C2 /end MEASUREMENT
/begin MEASUREMENT bsLoadEn "Init:[FALSE]; Loads actuation enable " UBYTE bsLoadEn.Conversion 0 0 0 1 ECU_ADDRESS 0x400018E4 /end MEASUREMENT
/begin MEASUREMENT bsLpfCoeff "BPF LPF Stage coefficient" ULONG bsLpfCoeff.Conversion 0 0 -1 0.999999880791 ECU_ADDRESS 0x4000172C MATRIX_DIM 9 /end MEASUREMENT
/begin MEASUREMENT bsMAirReqEn "Flag di attivazione della strategia di richiesta apertura variabile delle valvole di aspirazione" UBYTE ConfInit_CM_boolean_adm 0 0 0 1 ECU_ADDRESS 0x400015C8 /end MEASUREMENT
/begin MEASUREMENT bsMILCmd "Comando MIL (after Recovery) to BSWL" UBYTE Lamp100ms_CM_boolean_adm 0 0 0 1 ECU_ADDRESS 0x40001848 /end MEASUREMENT
/begin MEASUREMENT bsMILStatus "MIL status towards Diagnosis (DM)" UBYTE Lamp100ms_CM_uint8_adm 0 0 0 3 ECU_ADDRESS 0x40001C2E /end MEASUREMENT
/begin MEASUREMENT bsMIL_DiagStatus "Driver diagnosis related to Malfunction Indicator Lamp. (Digital Out)" UBYTE eDiagStatus.Conversion 0 0 0 255 ECU_ADDRESS 0x4000184A /end MEASUREMENT
/begin CHARACTERISTIC bsMISF_TDC "Vector to select at which TDCs generate misfire" VAL_BLK 0xFC0094 __UBYTE_Z 0 bsMISF_TDC.Conversion 0 1 MATRIX_DIM 8 /end CHARACTERISTIC
/begin CHARACTERISTIC bsMISF_TDC_NUMBER "Vector to select how much TDCs generate misfire" VAL_BLK 0xFC009C __UWORD_Z 0 bsMISF_TDC_NUMBER.Conversion 0 1000 MATRIX_DIM 8 /end CHARACTERISTIC
/begin MEASUREMENT bsMVS_Tx_Enable "Abilitazione messaggio J1939 - MVS" UBYTE J1939dl_Tx1s_CM_boolean_adm 0 0 0 1 ECU_ADDRESS 0x4000194A /end MEASUREMENT
/begin MEASUREMENT bsMVS_Tx_Msg "MVS Tx Can message" UBYTE J1939dl_Tx1s_CM_uint8_adm 0 0 0 255 ECU_ADDRESS 0x1000 MATRIX_DIM 8 /end MEASUREMENT
/begin MEASUREMENT bsMapBit "Valore in bit della pressione nel collettore di aspirazione (assoluta) su 10bit (ManPres_IA)" UWORD bsMapBit.Conversion 0 0 0 1024 ECU_ADDRESS 0x400018CC /end MEASUREMENT
/begin MEASUREMENT bsMedocOkG "Flag to indicate the validity of the Flywheel Correction coefficients" UBYTE bsMedocOkG.Conversion 0 0 0 1 ECU_ADDRESS 0x40001C3C /end MEASUREMENT
/begin MEASUREMENT bsMilLamp "Mil request from diagnosis manager" UBYTE bsMilLamp.Conversion 0 0 0 1 ECU_ADDRESS 0x40001849 /end MEASUREMENT
/begin MEASUREMENT bsMilStatusCAN "Stato lampada MIL" UBYTE J1939dl_Tx50ms_CM_uint8_adm 0 0 0 3 ECU_ADDRESS 0x40001940 /end MEASUREMENT
/begin MEASUREMENT bsNIdleAcc "Not_in_Idle Accellerator position switch - (AccKickDownSw_ID)" UBYTE bsNIdleAcc.Conversion 0 0 0 1 ECU_ADDRESS 0x400018D8 /end MEASUREMENT
/begin MEASUREMENT bsNUMCYL "Number of cylinders for current application" UBYTE bsNUMCYL.Conversion 0 0 0 255 ECU_ADDRESS 0x4000187F /end MEASUREMENT
/begin MEASUREMENT bsNextCyl "Next (in fire order) Cylinder Idx" UBYTE bsNextCyl.Conversion 0 0 0 7 ECU_ADDRESS 0x40001876 /end MEASUREMENT
/begin MEASUREMENT bsNextCylCompl "Complementary Cylinder Idx cof the Next (in fire order) Cylinder Idx" UBYTE bsNextCylCompl.Conversion 0 0 0 7 ECU_ADDRESS 0x40001875 /end MEASUREMENT
/begin MEASUREMENT bsNextTdcIdx "Next (in fire order) TDC Idx" UBYTE bsNextTdcIdx.Conversion 0 0 0 7 ECU_ADDRESS 0x40001877 /end MEASUREMENT
/begin MEASUREMENT bsNextTdcIdxCompl "Complementary TDC Idx of the Next (in fire order) TDC Idx" UBYTE bsNextTdcIdxCompl.Conversion 0 0 0 7 ECU_ADDRESS 0x40001874 /end MEASUREMENT
/begin MEASUREMENT bsNoProgInjCutoff "Selettore per abilitare la programmazione dell\'iniezione durante un cut-off (1 bypass di engine mode != CUT-OFF)" UBYTE bsNoProgInjCutoff.Conversion 0 0 0 1 ECU_ADDRESS 0x40001835 /end MEASUREMENT
/begin MEASUREMENT bsNumRifor "Numero di rifornimenti effettuati(Eeprom Write) " UWORD bsNumRifor.Conversion 0 0 0 65535 ECU_ADDRESS 0x40001DA0 /end MEASUREMENT
/begin MEASUREMENT bsNumRiforE2PROM "Numero di rifornimenti effettuati (Eeprom Read Value) " UWORD bsNumRiforE2PROM.Conversion 0 0 0 65535 ECU_ADDRESS 0x40001DBC /end MEASUREMENT
/begin MEASUREMENT bsOff "CruiseControl/PTO OFF switch - (DigIn2_MflvOn_ID)" UBYTE bsOff.Conversion 0 0 0 1 ECU_ADDRESS 0x400018D6 /end MEASUREMENT
/begin MEASUREMENT bsPAtmBit "Valore in bit della pressione atmosferica (assoluta) a bordo ECU su 10bit (AirPres_IA)" UWORD bsPAtmBit.Conversion 0 0 0 1024 ECU_ADDRESS 0x400018A4 /end MEASUREMENT
/begin MEASUREMENT bsPBoostBit "Valore in bit della pressione di sovralimentazione (assoluta) su 10bit (BoostPres_IA)" UWORD bsPBoostBit.Conversion 0 0 0 1024 ECU_ADDRESS 0x400018CA /end MEASUREMENT
/begin MEASUREMENT bsPOilBit "Valore in bit della pressione olio (assoluta) su 10bit (OilPres_IA)" UWORD bsPOilBit.Conversion 0 0 0 1024 ECU_ADDRESS 0x400018A8 /end MEASUREMENT
/begin MEASUREMENT bsPROPB_0A_Tx_Enable "Abilitazione messaggio J1939 - PropB_0A" UBYTE bsPROPB_0A_Tx_Enable.Conversion 0 0 0 1 ECU_ADDRESS 0x40001944 /end MEASUREMENT
/begin MEASUREMENT bsPRVCmd "CNG pressure reducing valve command after the recovery" UBYTE Prvc4ms_CM_boolean_adm 0 0 0 1 ECU_ADDRESS 0x40001851 /end MEASUREMENT
/begin MEASUREMENT bsPRV_DiagStatus "Pressure Regulator EV diagnostic status" UBYTE eDiagStatus.Conversion 0 0 0 255 ECU_ADDRESS 0x40001852 /end MEASUREMENT
/begin MEASUREMENT bsPRailBit "Valore in bit della pressione metano nel rail (assoluta) su 10bit (RailPres_IA)" UWORD bsPRailBit.Conversion 0 0 0 1024 ECU_ADDRESS 0x400018C8 /end MEASUREMENT
/begin MEASUREMENT bsPTank "Pressione metano bombole (relativa) (Eeprom Write)" UWORD bsPTank.Conversion 0 0 0 262.14 ECU_ADDRESS 0x40001D98 /end MEASUREMENT
/begin MEASUREMENT bsPTankBit "Valore in bit della pressione metano bombole (relativa) su 10bit (TankPres_IA)" UWORD bsPTankBit.Conversion 0 0 0 1024 ECU_ADDRESS 0x400018B6 /end MEASUREMENT
/begin MEASUREMENT bsPTankE2PROM "Pressione metano bombole (relativa) (Eeprom Read Value)" UWORD bsPTankE2PROM.Conversion 0 0 0 262.14 ECU_ADDRESS 0x40001DB4 /end MEASUREMENT
/begin CHARACTERISTIC bsPULL0_AccIdleSw_ID "HW pull-up configuration PULL0_AccIdleSw_ID (1 = OFF:pull-up inserted /0 = ON:pull-up NOT inserted)" VALUE 0xFC0020 __UBYTE_Z 0 bsPULL0_AccIdleSw_ID.Conversion 0 255 /end CHARACTERISTIC
/begin CHARACTERISTIC bsPULL10_AirCondReq_ID "HW pull-up configuration PULL10_AirCondReq_ID (1 = OFF:pull-up inserted / 0 = ON:pull-up NOT inserted)" VALUE 0xFC002A __UBYTE_Z 0 bsPULL10_AirCondReq_ID.Conversion 0 255 /end CHARACTERISTIC
/begin CHARACTERISTIC bsPULL11_DigIn1_MflvOn_ID "HW pull-up configuration PULL11_DigIn1_MflvOn_ID (1 = OFF:pull-up inserted / 0 = ON:pull-up NOT inserted)" VALUE 0xFC002B __UBYTE_Z 0 bsPULL11_DigIn1_MflvOn_ID.Conversion 0 255 /end CHARACTERISTIC
/begin CHARACTERISTIC bsPULL12_DigIn2_MflvOff_ID "HW pull-up configuration PULL12_DigIn2_MflvOff_ID (1 = OFF:pull-up inserted / 0 = ON:pull-up NOT inserted)" VALUE 0xFC002C __UBYTE_Z 0 bsPULL12_DigIn2_MflvOff_ID.Conversion 0 255 /end CHARACTERISTIC
/begin CHARACTERISTIC bsPULL13_DigIn3_MflvP_ID "HW pull-up configuration PULL13_DigIn3_MflvP_ID (1 = OFF:pull-up inserted / 0 = ON:pull-up NOT inserted)" VALUE 0xFC002D __UBYTE_Z 0 bsPULL13_DigIn3_MflvP_ID.Conversion 0 255 /end CHARACTERISTIC
/begin CHARACTERISTIC bsPULL14_DigIn4_MflvM_ID "HW pull-up configuration PULL14_DigIn4_MflvM_ID (1 = OFF:pull-up inserted / 0 = ON:pull-up NOT inserted)" VALUE 0xFC002E __UBYTE_Z 0 bsPULL14_DigIn4_MflvM_ID.Conversion 0 255 /end CHARACTERISTIC
/begin CHARACTERISTIC bsPULL15_AuxKeyReq_ID "HW pull-up configuration PULL15_AuxKeyReq_ID (1 = OFF:pull-up inserted / 0 = ON:pull-up NOT inserted)" VALUE 0xFC002F __UBYTE_Z 0 bsPULL15_AuxKeyReq_ID.Conversion 0 255 /end CHARACTERISTIC
/begin CHARACTERISTIC bsPULL1_AccKickDownSw_ID "HW pull-up configuration PULL1_AccKickDownSw_ID (1 = OFF:pull-up inserted / 0 = ON:pull-up NOT inserted)" VALUE 0xFC0021 __UBYTE_Z 0 bsPULL1_AccKickDownSw_ID.Conversion 0 255 /end CHARACTERISTIC
/begin CHARACTERISTIC bsPULL2_BrakePedSw1_ID "HW pull-up configuration PULL2_BrakePedSw1_ID (1 = OFF:pull-up inserted / 0 = ON:pull-up NOT inserted)" VALUE 0xFC0022 __UBYTE_Z 0 bsPULL2_BrakePedSw1_ID.Conversion 0 255 /end CHARACTERISTIC
/begin CHARACTERISTIC bsPULL3_BrakePedSw2_ID "HW pull-up configuration PULL3_BrakePedSw2_ID (1 = OFF:pull-up inserted / 0 = ON:pull-up NOT inserted)" VALUE 0xFC0023 __UBYTE_Z 0 bsPULL3_BrakePedSw2_ID.Conversion 0 255 /end CHARACTERISTIC
/begin CHARACTERISTIC bsPULL4_ClutchPedSw_ID "HW pull-up configuration PULL4_ClutchPedSw_ID (1 = OFF:pull-up inserted / 0 = ON:pull-up NOT inserted)" VALUE 0xFC0024 __UBYTE_Z 0 bsPULL4_ClutchPedSw_ID.Conversion 0 255 /end CHARACTERISTIC
/begin CHARACTERISTIC bsPULL5_EngBrk_DoorSw_ID "HW pull-up configuration PULL5_EngBrk_DoorSw_ID (1 = OFF:pull-up inserted / 0 = ON:pull-up NOT inserted)" VALUE 0xFC0025 __UBYTE_Z 0 bsPULL5_EngBrk_DoorSw_ID.Conversion 0 255 /end CHARACTERISTIC
/begin CHARACTERISTIC bsPULL6_NeutralSw_ID "HW pull-up configuration PULL6_NeutralSw_ID (1 = OFF:pull-up inserted / 0 = ON:pull-up NOT inserted)" VALUE 0xFC0026 __UBYTE_Z 0 bsPULL6_NeutralSw_ID.Conversion 0 255 /end CHARACTERISTIC
/begin CHARACTERISTIC bsPULL7_ParkBrk_LimSw_ID "HW pull-up configuration PULL7_ParkBrk_LimSw_ID (1 = OFF:pull-up inserted / 0 = ON:pull-up NOT inserted)" VALUE 0xFC0027 __UBYTE_Z 0 bsPULL7_ParkBrk_LimSw_ID.Conversion 0 255 /end CHARACTERISTIC
/begin CHARACTERISTIC bsPULL8_StartAuxReq_ID "HW pull-up configuration PULL8_StartAuxReq_ID (1 = OFF:pull-up inserted / 0 = ON:pull-up NOT inserted)" VALUE 0xFC0028 __UBYTE_Z 0 bsPULL8_StartAuxReq_ID.Conversion 0 255 /end CHARACTERISTIC
/begin CHARACTERISTIC bsPULL9_StopAuxReq_ID "HW pull-up configuration PULL9_StopAuxReq_ID (1 = OFF:pull-up inserted / 0 = ON:pull-up NOT inserted)" VALUE 0xFC0029 __UBYTE_Z 0 bsPULL9_StopAuxReq_ID.Conversion 0 255 /end CHARACTERISTIC
/begin MEASUREMENT bsPWR_DiagStatus "Power relay diagnostic status" UBYTE eDiagStatus.Conversion 0 0 0 255 ECU_ADDRESS 0x40001858 /end MEASUREMENT
/begin MEASUREMENT bsPWRel "Power relay command after the recovery" UBYTE Pwrl4ms_CM_boolean_adm 0 0 0 1 ECU_ADDRESS 0x40001857 /end MEASUREMENT
/begin MEASUREMENT bsParkBrk "Parking brake switch - (ParkBrk_LimSw_ID)" UBYTE bsParkBrk.Conversion 0 0 0 1 ECU_ADDRESS 0x400018D5 /end MEASUREMENT
/begin MEASUREMENT bsPercCmuIstAbs_GOBD "Attuale percentuale Assoluta (rif. a esCmu_Max_AbsOut) di Coppia Erogata dal motore (for GOBD FF)" UBYTE DiagSym100ms_CM_ufix8_En1__ 0 0 0 100 ECU_ADDRESS 0x40001C25 /end MEASUREMENT
/begin MEASUREMENT bsPercCmuReqMgm_GOBD "Richiesta (percentuale di Coppia Erogata) da VCM (obiettivo di giri o di coppia) verso HDS (for GOBD FF)" UBYTE DiagSym100ms_CM_uint8__ 0 0 0 100 ECU_ADDRESS 0x40001C29 /end MEASUREMENT
/begin MEASUREMENT bsPotenzAcc2Bit "Valore in bit del potenziometro acceleratore su 10bit (AccPed2_IA)" UWORD bsPotenzAcc2Bit.Conversion 0 0 0 1024 ECU_ADDRESS 0x400018BC /end MEASUREMENT
/begin MEASUREMENT bsPotenzAccBit "Valore in bit del potenziometro acceleratore su 10bit (AccPed1_IA)" UWORD bsPotenzAccBit.Conversion 0 0 0 1024 ECU_ADDRESS 0x400018BE /end MEASUREMENT
/begin MEASUREMENT bsPotenzThr2Bit "Valore in bit della posizione di apertura farfalla su potenziometro secondario su 10bit (ThrottlePos2_IA)" UWORD bsPotenzThr2Bit.Conversion 0 0 0 1024 ECU_ADDRESS 0x400018B8 /end MEASUREMENT
/begin MEASUREMENT bsPotenzThrBit "Valore in bit della posizione di apertura farfalla su potenziometro principale su 10bit (ThrottlePos1_IA)" UWORD bsPotenzThrBit.Conversion 0 0 0 1024 ECU_ADDRESS 0x400018BA /end MEASUREMENT
/begin MEASUREMENT bsPowerOn "Init:[FALSE]; Power latch configured when TRUE, Power latch requested when transition is from TRUE to FALSE " UBYTE bsPowerOn.Conversion 0 0 0 1 ECU_ADDRESS 0x400018E3 /end MEASUREMENT
/begin MEASUREMENT bsPropB_0A_Tx_Enable "Abilitazione messaggio J1939 - PropB_0A" UBYTE J1939dl_Tx100ms_CM_boolean_adm 0 0 0 1 ECU_ADDRESS 0x1000 /end MEASUREMENT
/begin MEASUREMENT bsPropB_0A_Tx_Msg "PropB_0A Tx Can message" UBYTE J1939dl_Tx100ms_CM_uint8_adm 0 0 0 255 ECU_ADDRESS 0x1000 MATRIX_DIM 8 /end MEASUREMENT
/begin MEASUREMENT bsPwrOffCnt "Total shutdown counter" ULONG bsPwrOffCnt.Conversion 0 0 0 4294967295 ECU_ADDRESS 0x400015CC /end MEASUREMENT
/begin MEASUREMENT bsQAirDebimBit "Valore in bit della portata aria aspirata da debimetro su 10bit (AirMassFlow_IA)" UWORD bsQAirDebimBit.Conversion 0 0 0 1024 ECU_ADDRESS 0x400018B2 /end MEASUREMENT
/begin MEASUREMENT bsREDLCmd "Comando RED (after Recovery) to BSWL" UBYTE Lamp100ms_CM_boolean_adm 0 0 0 1 ECU_ADDRESS 0x4000184B /end MEASUREMENT
/begin MEASUREMENT bsREDLStatus "RED lamp status lamp status towards Diagnosis (DM)" UBYTE Lamp100ms_CM_uint8_adm 0 0 0 3 ECU_ADDRESS 0x40001C2F /end MEASUREMENT
/begin MEASUREMENT bsREDL_DiagStatus "Driver diagnosis related to Red Lamp. (Digital Out)" UBYTE eDiagStatus.Conversion 0 0 0 255 ECU_ADDRESS 0x4000184D /end MEASUREMENT
/begin MEASUREMENT bsRET_CONF_Tx_Enable "Abilitazione messaggio J1939 - RET_CONF" UBYTE J1939dl_Tx1s_CM_boolean_adm 0 0 0 1 ECU_ADDRESS 0x40001958 /end MEASUREMENT
/begin MEASUREMENT bsRET_CONF_Tx_Msg "RET_CONF Tx Can message (Multipacket)" UBYTE J1939dl_Tx1s_CM_uint8_adm 0 0 0 255 ECU_ADDRESS 0x1000 MATRIX_DIM 24 /end MEASUREMENT
/begin MEASUREMENT bsRPM "Velocità di rotazione motore in giri al minuto" UWORD bsRPM.Conversion 0 0 0 65535 ECU_ADDRESS 0x40001888 /end MEASUREMENT
/begin MEASUREMENT bsRPM_GOBD "Engine speed (for GOBD FF)" UBYTE DiagSym100ms_CM_ufix8_S40_rpm 0 0 0 10000 ECU_ADDRESS 0x40001C2A /end MEASUREMENT
/begin MEASUREMENT bsRec50 "Status recovery Rec50 " UBYTE bsRec50.Conversion 0 0 0 1 ECU_ADDRESS 0x4000196B /end MEASUREMENT
/begin MEASUREMENT bsRedLamp "Red lamp request from diagnosis manager" UBYTE bsRedLamp.Conversion 0 0 0 1 ECU_ADDRESS 0x4000184C /end MEASUREMENT
/begin MEASUREMENT bsResume "CruiseControl/PTO RESUME switch - (DigIn1_MflvOn_ID)" UBYTE bsResume.Conversion 0 0 0 1 ECU_ADDRESS 0x400018D4 /end MEASUREMENT
/begin MEASUREMENT bsRifornE2PROM "Flag di indicazione di avvenuto rifornimento (Eeprom Read Value)" UBYTE bsRifornE2PROM.Conversion 0 0 0 1 ECU_ADDRESS 0x40001DBE /end MEASUREMENT
/begin MEASUREMENT bsRifornimento "Flag di indicazione di avvenuto rifornimento(Eeprom Write)" UBYTE bsRifornimento.Conversion 0 0 0 1 ECU_ADDRESS 0x40001DA2 /end MEASUREMENT
/begin MEASUREMENT bsSEP1_Tx_Enable "Abilitazione messaggio J1939 - SEP1" UBYTE J1939dl_Tx1s_CM_boolean_adm 0 0 0 1 ECU_ADDRESS 0x40001948 /end MEASUREMENT
/begin MEASUREMENT bsSEP1_Tx_Msg "SEP1 Tx Can message" UBYTE J1939dl_Tx1s_CM_uint8_adm 0 0 0 255 ECU_ADDRESS 0x1000 MATRIX_DIM 8 /end MEASUREMENT
/begin MEASUREMENT bsSHUTDOWN_Tx_Enable "Abilitazione messaggio J1939 - SHUTDOWN" UBYTE J1939dl_Tx1s_CM_boolean_adm 0 0 0 1 ECU_ADDRESS 0x4000195C /end MEASUREMENT
/begin MEASUREMENT bsSHUTDOWN_Tx_Msg "SHUTDOWN Tx Can message" UBYTE J1939dl_Tx1s_CM_uint8_adm 0 0 0 255 ECU_ADDRESS 0x1000 MATRIX_DIM 8 /end MEASUREMENT
/begin MEASUREMENT bsSRI "SRI  Signal Rectified Integral" FLOAT32_IEEE bsSRI.Conversion 0 0 0 10000000000 ECU_ADDRESS 0x40001774 MATRIX_DIM 8 /end MEASUREMENT
/begin MEASUREMENT bsSTR_DiagStatus "Starter relay diagnostic status" UBYTE eDiagStatus.Conversion 0 0 0 255 ECU_ADDRESS 0x40001856 /end MEASUREMENT
/begin MEASUREMENT bsSTRel "Starter relay command after the recovery" UBYTE Crkc4ms_CM_boolean_adm 0 0 0 1 ECU_ADDRESS 0x40001855 /end MEASUREMENT
/begin MEASUREMENT bsSaf3AdDriftErr "Safety MCU Drift on AD flag" UBYTE bsSaf3AdDriftErr.Conversion 0 0 0 1 ECU_ADDRESS 0x400015C7 /end MEASUREMENT
/begin MEASUREMENT bsSaf3AdErr "AD Safety Error present" UBYTE bsSaf3AdErr.Conversion 0 0 0 1 ECU_ADDRESS 0x4000159A /end MEASUREMENT
/begin MEASUREMENT bsSaf3CheckCfgMCUErr "MCU configuration error present" UBYTE bsSaf3CheckCfgMCUErr.Conversion 0 0 0 1 ECU_ADDRESS 0x4000159B /end MEASUREMENT
/begin MEASUREMENT bsSaf3CheckCfgSBCErr "SBC configuration error present" UBYTE bsSaf3CheckCfgSBCErr.Conversion 0 0 0 1 ECU_ADDRESS 0x4000159C /end MEASUREMENT
/begin MEASUREMENT bsSaf3CheckSBCErr "Error present into check of SBC FSM" UBYTE bsSaf3CheckSBCErr.Conversion 0 0 0 1 ECU_ADDRESS 0x400015A3 /end MEASUREMENT
/begin MEASUREMENT bsSaf3ChecksumFlashErr "Safety Check on Flash checksum Error " UBYTE bsSaf3ChecksumFlashErr.Conversion 0 0 0 1 ECU_ADDRESS 0x400015C6 /end MEASUREMENT
/begin MEASUREMENT bsSaf3ChipTemp1 "Temperature of chip " SWORD bsSaf3ChipTemp1.Conversion 0 0 -40 150 ECU_ADDRESS 0x400015A8 /end MEASUREMENT
/begin MEASUREMENT bsSaf3ChipTemp2 "Temperature of chip " SWORD bsSaf3ChipTemp2.Conversion 0 0 -40 150 ECU_ADDRESS 0x400015A6 /end MEASUREMENT
/begin MEASUREMENT bsSaf3DebugErr "SBC is into debug mode, safety error present" UBYTE bsSaf3DebugErr.Conversion 0 0 0 1 ECU_ADDRESS 0x400015A4 /end MEASUREMENT
/begin MEASUREMENT bsSaf3EccEventAllCnt "Number of 1bit Error from ECC" ULONG bsSaf3EccEventAllCnt.Conversion 0 0 0 4294967295 ECU_ADDRESS 0x400015B4 /end MEASUREMENT
/begin MEASUREMENT bsSaf3EccEventCnt "Number of 1bit Error from ECC in the trip" ULONG bsSaf3EccEventCnt.Conversion 0 0 0 65535 ECU_ADDRESS 0x400015B0 /end MEASUREMENT
/begin MEASUREMENT bsSaf3EccStartCheckErr "Ecc checked at start-up failed" UBYTE bsSaf3EccStartCheckErr.Conversion 0 0 0 1 ECU_ADDRESS 0x400015AF /end MEASUREMENT
/begin MEASUREMENT bsSaf3FccuReactionNum "Nunmber of FCCU reset" UWORD bsSaf3FccuReactionNum.Conversion 0 0 0 65535 ECU_ADDRESS 0x400015A0 /end MEASUREMENT
/begin MEASUREMENT bsSaf3IrcOscErr "IRC frequency out of range" UBYTE bsSaf3IrcOscErr.Conversion 0 0 0 1 ECU_ADDRESS 0x400015A2 /end MEASUREMENT
/begin MEASUREMENT bsSaf3LastFccErr "Safety FCCU last reset error" UBYTE bsSaf3LastFccErr.Conversion 0 0 0 255 ECU_ADDRESS 0x400015AE /end MEASUREMENT
/begin MEASUREMENT bsSaf3LbistErr "Logic Built In Self Test error MCU" UBYTE bsSaf3LbistErr.Conversion 0 0 0 1 ECU_ADDRESS 0x40001597 /end MEASUREMENT
/begin MEASUREMENT bsSaf3LoadEnErr "Safety path cross test error" UBYTE bsSaf3LoadEnErr.Conversion 0 0 0 1 ECU_ADDRESS 0x400015AA /end MEASUREMENT
/begin MEASUREMENT bsSaf3LoadEnSample0 "Safety path cross test sampling 0" UBYTE bsSaf3LoadEnSample0.Conversion 0 0 0 1 ECU_ADDRESS 0x40001599 /end MEASUREMENT
/begin MEASUREMENT bsSaf3LoadEnSample1 "Safety path cross test sampling 1" UBYTE bsSaf3LoadEnSample1.Conversion 0 0 0 1 ECU_ADDRESS 0x40001593 /end MEASUREMENT
/begin MEASUREMENT bsSaf3LoadEnSample2 "Safety path cross test sampling 2" UBYTE bsSaf3LoadEnSample2.Conversion 0 0 0 1 ECU_ADDRESS 0x40001592 /end MEASUREMENT
/begin MEASUREMENT bsSaf3LoadEnSample3 "Safety path cross test sampling 3" UBYTE bsSaf3LoadEnSample3.Conversion 0 0 0 1 ECU_ADDRESS 0x40001591 /end MEASUREMENT
/begin MEASUREMENT bsSaf3LoadEna "Init:[TRUE]; Flag che indica che la safety ha staccato i carichi " UBYTE bsSaf3LoadEna.Conversion 0 0 0 1 ECU_ADDRESS 0x40001590 /end MEASUREMENT
/begin MEASUREMENT bsSaf3MbistErr "Memory Built In Self Test error MCU" UBYTE bsSaf3MbistErr.Conversion 0 0 0 1 ECU_ADDRESS 0x40001598 /end MEASUREMENT
/begin MEASUREMENT bsSaf3PmcBandGapErr "Safety PMC BandGap error" UBYTE bsSaf3PmcBandGapErr.Conversion 0 0 0 1 ECU_ADDRESS 0x400015AC /end MEASUREMENT
/begin MEASUREMENT bsSaf3PmcSelfTestErr "Safety PMC monitoring Self Test Error" UBYTE bsSaf3PmcSelfTestErr.Conversion 0 0 0 1 ECU_ADDRESS 0x400015AD /end MEASUREMENT
/begin MEASUREMENT bsSaf3PwrOnVect "Safety III Level - Safety PowerOn test vector result " UWORD Saf3Init_CM_uint16_adm 0 0 0 65535 ECU_ADDRESS 0x4000158E /end MEASUREMENT
/begin MEASUREMENT bsSaf3RTFiltVect "Safety III Level - Safety Run-Time Filtered test vector result " UBYTE Saf3_50ms_CM_uint8_adm 0 0 0 255 ECU_ADDRESS 0x4000158D /end MEASUREMENT
/begin MEASUREMENT bsSaf3RTImmVect "Safety III Level - Safety Run-Time Immediate test vector result " UBYTE Saf3_50ms_CM_uint8_adm 0 0 0 255 ECU_ADDRESS 0x4000158C /end MEASUREMENT
/begin MEASUREMENT bsSaf3ResetErr "Safety SBC reset request error" UBYTE bsSaf3ResetErr.Conversion 0 0 0 1 ECU_ADDRESS 0x400015AB /end MEASUREMENT
/begin MEASUREMENT bsSaf3SBCFaultErr "SBC Reset or SafePath pin error" UBYTE bsSaf3SBCFaultErr.Conversion 0 0 0 1 ECU_ADDRESS 0x400015A5 /end MEASUREMENT
/begin MEASUREMENT bsSaf3SBCWdErrCnt "Counter of Wd error counter" UBYTE bsSaf3SBCWdErrCnt.Conversion 0 0 0 1 ECU_ADDRESS 0x4000159E /end MEASUREMENT
/begin MEASUREMENT bsSaf3StackFree "Stack Size free .1%" UWORD bsSaf3StackFree.Conversion 0 0 0 100 ECU_ADDRESS 0x400015B8 /end MEASUREMENT
/begin MEASUREMENT bsSaf3VpreUnderVoltageErr "Under Voltage present on Vpre" UBYTE bsSaf3VpreUnderVoltageErr.Conversion 0 0 0 1 ECU_ADDRESS 0x4000159D /end MEASUREMENT
/begin MEASUREMENT bsSaf3eMGS0BistErr "RAM Built In Self Test error eMGS0 Injection" UBYTE bsSaf3eMGS0BistErr.Conversion 0 0 0 1 ECU_ADDRESS 0x40001596 /end MEASUREMENT
/begin MEASUREMENT bsSaf3eMGS1BistErr "RAM Built In Self Test error eMGS1 Injection" UBYTE bsSaf3eMGS1BistErr.Conversion 0 0 0 1 ECU_ADDRESS 0x40001595 /end MEASUREMENT
/begin MEASUREMENT bsSaf3eMGS2BistErr "RAM Built In Self Test error eMGS2 Hbridge" UBYTE bsSaf3eMGS2BistErr.Conversion 0 0 0 1 ECU_ADDRESS 0x40001594 /end MEASUREMENT
/begin MEASUREMENT bsSaf3eMgs0CodeErr "Safety MC33816 0 Internal RAM code Error" UBYTE bsSaf3eMgs0CodeErr.Conversion 0 0 0 1 ECU_ADDRESS 0x400015C5 /end MEASUREMENT
/begin MEASUREMENT bsSaf3eMgs0CodeLoadErr "Safety MC33816 0 Internal RAM code Error (start-up)" UBYTE bsSaf3eMgs0CodeLoadErr.Conversion 0 0 0 1 ECU_ADDRESS 0x400015C2 /end MEASUREMENT
/begin MEASUREMENT bsSaf3eMgs0Err "Safety MC33816 0 Internal error (Clock, Temp, Voltage, Code)" UBYTE bsSaf3eMgs0Err.Conversion 0 0 0 1 ECU_ADDRESS 0x400015BF /end MEASUREMENT
/begin MEASUREMENT bsSaf3eMgs0Wrn "Safety MC33816 0 Internal error (External clock)" UBYTE bsSaf3eMgs0Wrn.Conversion 0 0 0 1 ECU_ADDRESS 0x400015BC /end MEASUREMENT
/begin MEASUREMENT bsSaf3eMgs1CodeErr "Safety MC33816 1 Internal RAM code Error" UBYTE bsSaf3eMgs1CodeErr.Conversion 0 0 0 1 ECU_ADDRESS 0x400015C4 /end MEASUREMENT
/begin MEASUREMENT bsSaf3eMgs1CodeLoadErr "Safety MC33816 1 Internal RAM code Error (start-up)" UBYTE bsSaf3eMgs1CodeLoadErr.Conversion 0 0 0 1 ECU_ADDRESS 0x400015C1 /end MEASUREMENT
/begin MEASUREMENT bsSaf3eMgs1Err "Safety MC33816 1 Internal error (Clock, Temp, Voltage, Code)" UBYTE bsSaf3eMgs1Err.Conversion 0 0 0 1 ECU_ADDRESS 0x400015BE /end MEASUREMENT
/begin MEASUREMENT bsSaf3eMgs1Wrn "Safety MC33816 1 Internal error (External clock)" UBYTE bsSaf3eMgs1Wrn.Conversion 0 0 0 1 ECU_ADDRESS 0x400015BB /end MEASUREMENT
/begin MEASUREMENT bsSaf3eMgs2CodeErr "Safety MC33816 2 Internal RAM code Error" UBYTE bsSaf3eMgs2CodeErr.Conversion 0 0 0 1 ECU_ADDRESS 0x400015C3 /end MEASUREMENT
/begin MEASUREMENT bsSaf3eMgs2CodeLoadErr "Safety MC33816 2 Internal RAM code Error (start-up)" UBYTE bsSaf3eMgs2CodeLoadErr.Conversion 0 0 0 1 ECU_ADDRESS 0x400015C0 /end MEASUREMENT
/begin MEASUREMENT bsSaf3eMgs2Err "Safety MC33816 2 Internal error (Clock, Temp, Voltage, Code)" UBYTE bsSaf3eMgs2Err.Conversion 0 0 0 1 ECU_ADDRESS 0x400015BD /end MEASUREMENT
/begin MEASUREMENT bsSaf3eMgs2Wrn "Safety MC33816 2 Internal error (External clock)" UBYTE bsSaf3eMgs2Wrn.Conversion 0 0 0 1 ECU_ADDRESS 0x400015BA /end MEASUREMENT
/begin AXIS_PTS okZONE_GIRI1 "[YBK] Tabella di frequenze standard per diagnosi catalizzatore" 0xFC4868 NO_INPUT_QUANTITY Lookup2D_X_UWORD 0 Cata100ms_Symbol_CM_uint16_adm 5 0 4 /end AXIS_PTS
/begin AXIS_PTS okZONE_QAC_PMS1 "[XBK] Tabella di frequenze standard per diagnosi catalizzatore" 0xFC492E NO_INPUT_QUANTITY Lookup2D_X_UWORD 0 Cata100ms_Symbol_CM_uint16_adm 6 0 5 /end AXIS_PTS
/begin COMPU_METHOD AirAlphaNTDC_CM_FixEnableT "Enumerated data type: FixEnableT" TAB_VERB "%0.6" "" COMPU_TAB_REF VTAB_FOR_AirAlphaNTDC_CM_FixEnableT /end COMPU_METHOD
/begin COMPU_METHOD AirAlphaNTDC_CM_ufix16_En10_adm "Q = V*1024.000000" RAT_FUNC "%12.10" "adm" COEFFS 0 1024 0 0 0 1 /end COMPU_METHOD
/begin COMPU_METHOD AirAlphaNTDC_CM_ufix16_En3_mg_cc "Q = V*8.000000" RAT_FUNC "%7.3" "mg/cc" COEFFS 0 8 0 0 0 1 /end COMPU_METHOD
/begin COMPU_METHOD AirAlphaNTDC_CM_ufix16_En4_kg_h "Q = V*16.000000" RAT_FUNC "%8.4" "kg/h" COEFFS 0 16 0 0 0 1 /end COMPU_METHOD
/begin COMPU_METHOD AirAlphaNTDC_CM_ufix16_En8__ "Q = V*256.000000" RAT_FUNC "%11.8" "%" COEFFS 0 256 0 0 0 1 /end COMPU_METHOD
/begin COMPU_METHOD AirAlphaNTDC_CM_uint16_mbar "Q = V" RAT_FUNC "%5.0" "mbar" COEFFS 0 1 0 0 0 1 /end COMPU_METHOD
/begin COMPU_METHOD AirAlphaNTDC_CM_uint16_rpm "Q = V" RAT_FUNC "%5.0" "rpm" COEFFS 0 1 0 0 0 1 /end COMPU_METHOD
/begin COMPU_METHOD AirSpeedDensityTDC_CM_FixEnableT "Enumerated data type: FixEnableT" TAB_VERB "%0.6" "" COMPU_TAB_REF VTAB_FOR_AirSpeedDensityTDC_CM_FixEnableT /end COMPU_METHOD
/begin COMPU_METHOD AirSpeedDensityTDC_CM_boolean_adm "Q = V" RAT_FUNC "%1.0" "adm" COEFFS 0 1 0 0 0 1 /end COMPU_METHOD
/begin COMPU_METHOD AirSpeedDensityTDC_CM_int16_degC "Q = V" RAT_FUNC "%5.0" "degC" COEFFS 0 1 0 0 0 1 /end COMPU_METHOD
/begin COMPU_METHOD AirSpeedDensityTDC_CM_single_1_s_m "Q = V" RAT_FUNC "%8.6" "1/s*m" COEFFS 0 1 0 0 0 1 /end COMPU_METHOD
/begin COMPU_METHOD AirSpeedDensityTDC_CM_single_kg_mol "Q = V" RAT_FUNC "%8.6" "kg/mol" COEFFS 0 1 0 0 0 1 /end COMPU_METHOD
/begin COMPU_METHOD AirSpeedDensityTDC_CM_single_kg_s "Q = V" RAT_FUNC "%8.6" "kg/s" COEFFS 0 1 0 0 0 1 /end COMPU_METHOD
/begin COMPU_METHOD AirSpeedDensityTDC_CM_single_m_s "Q = V" RAT_FUNC "%8.6" "m*s" COEFFS 0 1 0 0 0 1 /end COMPU_METHOD
/begin COMPU_METHOD AirSpeedDensityTDC_CM_ufix16_Bn40_degC "Q = (V+40.000000)/1.000000" RAT_FUNC "%0.6" "degC" COEFFS 0 1 40 0 0 1 /end COMPU_METHOD
/begin COMPU_METHOD AirSpeedDensityTDC_CM_ufix16_En10_adm "Q = V*1024.000000" RAT_FUNC "%12.10" "adm" COEFFS 0 1024 0 0 0 1 /end COMPU_METHOD
/begin COMPU_METHOD AirSpeedDensityTDC_CM_ufix16_En15_adm "Q = V*32768.000000" RAT_FUNC "%16.15" "adm" COEFFS 0 32768 0 0 0 1 /end COMPU_METHOD
/begin COMPU_METHOD AirSpeedDensityTDC_CM_ufix16_En20_m_3 "Q = V*1048576.000000" RAT_FUNC "%21.16" "m^3" COEFFS 0 1048576 0 0 0 1 /end COMPU_METHOD
/begin COMPU_METHOD AirSpeedDensityTDC_CM_ufix16_En24_m_s "Q = V*16777216.000000" RAT_FUNC "%21.16" "m*s" COEFFS 0 16777216 0 0 0 1 /end COMPU_METHOD
/begin COMPU_METHOD AirSpeedDensityTDC_CM_ufix16_En3_mg_cc "Q = V*8.000000" RAT_FUNC "%7.3" "mg/cc" COEFFS 0 8 0 0 0 1 /end COMPU_METHOD
/begin COMPU_METHOD AirSpeedDensityTDC_CM_ufix16_En4_Kg_h "Q = V*16.000000" RAT_FUNC "%8.4" "Kg/h" COEFFS 0 16 0 0 0 1 /end COMPU_METHOD
/begin COMPU_METHOD AirSpeedDensityTDC_CM_ufix16_En8_adm "Q = V*256.000000" RAT_FUNC "%11.8" "adm" COEFFS 0 256 0 0 0 1 /end COMPU_METHOD
/begin COMPU_METHOD AirSpeedDensityTDC_CM_ufix8_En14_m_3 "Q = V*16384.000000" RAT_FUNC "%22.14" "m^3" COEFFS 0 16384 0 0 0 1 /end COMPU_METHOD
/begin COMPU_METHOD AirSpeedDensityTDC_CM_uint16_bit_s_m "Q = V" RAT_FUNC "%5.0" "bit/s*m" COEFFS 0 1 0 0 0 1 /end COMPU_METHOD
/begin COMPU_METHOD AirSpeedDensityTDC_CM_uint16_degK "Q = V" RAT_FUNC "%5.0" "degK" COEFFS 0 1 0 0 0 1 /end COMPU_METHOD
/begin COMPU_METHOD AirSpeedDensityTDC_CM_uint16_degM "Q = V" RAT_FUNC "%5.0" "degM" COEFFS 0 1 0 0 0 1 /end COMPU_METHOD
/begin COMPU_METHOD AirSpeedDensityTDC_CM_uint16_mbar "Q = V" RAT_FUNC "%5.0" "mbar" COEFFS 0 1 0 0 0 1 /end COMPU_METHOD
/begin COMPU_METHOD AirSpeedDensityTDC_CM_uint16_rpm "Q = V" RAT_FUNC "%5.0" "rpm" COEFFS 0 1 0 0 0 1 /end COMPU_METHOD
/begin COMPU_METHOD AirSpeedDensityTDC_CM_uint8_adm "Q = V" RAT_FUNC "%3.0" "adm" COEFFS 0 1 0 0 0 1 /end COMPU_METHOD
/begin COMPU_METHOD Air_Flow_MgmTDC_CM_FixEnableT "Enumerated data type: FixEnableT" TAB_VERB "%0.6" "" COMPU_TAB_REF VTAB_FOR_Air_Flow_MgmTDC_CM_FixEnableT /end COMPU_METHOD
/begin COMPU_METHOD Air_Flow_MgmTDC_CM_boolean_adm "Q = V" RAT_FUNC "%1.0" "adm" COEFFS 0 1 0 0 0 1 /end COMPU_METHOD
/begin COMPU_METHOD Air_Flow_MgmTDC_CM_single_mg_cc "Q = V" RAT_FUNC "%8.6" "mg/cc" COEFFS 0 1 0 0 0 1 /end COMPU_METHOD
/begin COMPU_METHOD Air_Flow_MgmTDC_CM_ufix16_En10_adm "Q = V*1024.000000" RAT_FUNC "%12.10" "adm" COEFFS 0 1024 0 0 0 1 /end COMPU_METHOD
/begin COMPU_METHOD Air_Flow_MgmTDC_CM_ufix16_En3_mg_cc "Q = V*8.000000" RAT_FUNC "%7.3" "mg/cc" COEFFS 0 8 0 0 0 1 /end COMPU_METHOD
/begin COMPU_METHOD Air_Flow_MgmTDC_CM_ufix16_En4_kg_h "Q = V*16.000000" RAT_FUNC "%8.4" "kg/h" COEFFS 0 16 0 0 0 1 /end COMPU_METHOD
/begin COMPU_METHOD Air_Flow_MgmTDC_CM_uint8_adm "Q = V" RAT_FUNC "%3.0" "adm" COEFFS 0 1 0 0 0 1 /end COMPU_METHOD
/begin COMPU_METHOD Airq4ms_CM_boolean_adm "Q = V" RAT_FUNC "%1.0" "adm" COEFFS 0 1 0 0 0 1 /end COMPU_METHOD
/begin COMPU_METHOD Airq4ms_CM_int16_mbar "Q = V" RAT_FUNC "%5.0" "mbar" COEFFS 0 1 0 0 0 1 /end COMPU_METHOD
/begin COMPU_METHOD Airq4ms_CM_uint16_mbar "Q = V" RAT_FUNC "%5.0" "mbar" COEFFS 0 1 0 0 0 1 /end COMPU_METHOD
/begin COMPU_METHOD Airq4ms_CM_uint8_adm "Q = V" RAT_FUNC "%3.0" "adm" COEFFS 0 1 0 0 0 1 /end COMPU_METHOD
/begin COMPU_METHOD Airq_CtrlMgmtTDC_CM_ufix16_En10_adm "Q = V*1024.000000" RAT_FUNC "%12.10" "adm" COEFFS 0 1024 0 0 0 1 /end COMPU_METHOD
/begin COMPU_METHOD Airq_CtrlMgmtTDC_CM_ufix16_En16_s "Q = V*65536.000000" RAT_FUNC "%21.16" "s" COEFFS 0 65536 0 0 0 1 /end COMPU_METHOD
/begin COMPU_METHOD Airq_CtrlMgmtTDC_CM_ufix16_En24_m_s "Q = V*16777216.000000" RAT_FUNC "%21.16" "m*s" COEFFS 0 16777216 0 0 0 1 /end COMPU_METHOD
/begin COMPU_METHOD Airq_CtrlMgmtTDC_CM_ufix16_En3_mg_cc "Q = V*8.000000" RAT_FUNC "%7.3" "mg/cc" COEFFS 0 8 0 0 0 1 /end COMPU_METHOD
/begin COMPU_METHOD Airq_CtrlMgmtTDC_CM_ufix16_En4_Kg_h "Q = V*16.000000" RAT_FUNC "%8.4" "Kg/h" COEFFS 0 16 0 0 0 1 /end COMPU_METHOD
/begin COMPU_METHOD Airq_CtrlMgmtTDC_CM_ufix16_En4_cc "Q = V*16.000000" RAT_FUNC "%8.4" "cc" COEFFS 0 16 0 0 0 1 /end COMPU_METHOD
/begin COMPU_METHOD Airq_CtrlMgmtTDC_CM_ufix16_En4_kg_h "Q = V*16.000000" RAT_FUNC "%8.4" "kg/h" COEFFS 0 16 0 0 0 1 /end COMPU_METHOD
/begin COMPU_METHOD Airq_CtrlMgmtTDC_CM_ufix16_En8_adm "Q = V*256.000000" RAT_FUNC "%11.8" "adm" COEFFS 0 256 0 0 0 1 /end COMPU_METHOD
/begin COMPU_METHOD Airq_CtrlMgmtTDC_CM_uint16_degM "Q = V" RAT_FUNC "%5.0" "degM" COEFFS 0 1 0 0 0 1 /end COMPU_METHOD
/begin COMPU_METHOD Airq_CtrlMgmtTDC_CM_uint16_mbar "Q = V" RAT_FUNC "%5.0" "mbar" COEFFS 0 1 0 0 0 1 /end COMPU_METHOD
/begin COMPU_METHOD Airq_CtrlMgmtTDC_CM_uint8_adm "Q = V" RAT_FUNC "%3.0" "adm" COEFFS 0 1 0 0 0 1 /end COMPU_METHOD
/begin COMPU_METHOD Apre100ms_CM_tKeyState_adm "Enumerated data type: tKeyState" TAB_VERB "%0.6" "adm" COMPU_TAB_REF VTAB_FOR_Apre100ms_CM_tKeyState_adm /end COMPU_METHOD
/begin COMPU_METHOD AutoTDC_CM_ufix16_Bn40_degC "Q = (V+40.000000)/1.000000" RAT_FUNC "%0.6" "degC" COEFFS 0 1 40 0 0 1 /end COMPU_METHOD
/begin COMPU_METHOD Auto_DiagLineADAT2_4ms_CM_eEGST_adm "Enumerated data type: eEGST" TAB_VERB "%0.6" "adm" COMPU_TAB_REF VTAB_FOR_Auto_DiagLineADAT2_4ms_CM_eEGST_adm /end COMPU_METHOD
/begin COMPU_METHOD Batt4ms_CM_eEGMD_adm "Enumerated data type: eEGMD" TAB_VERB "%0.6" "adm" COMPU_TAB_REF VTAB_FOR_Batt4ms_CM_eEGMD_adm /end COMPU_METHOD
/begin COMPU_METHOD Batt4ms_CM_eEGST_adm "Enumerated data type: eEGST" TAB_VERB "%0.6" "adm" COMPU_TAB_REF VTAB_FOR_Batt4ms_CM_eEGST_adm /end COMPU_METHOD
/begin COMPU_METHOD Batt4ms_CM_tKeyState_adm "Enumerated data type: tKeyState" TAB_VERB "%0.6" "adm" COMPU_TAB_REF VTAB_FOR_Batt4ms_CM_tKeyState_adm /end COMPU_METHOD
/begin COMPU_METHOD Boost_CtrlMgmt50ms_CM_eEGST_adm "Enumerated data type: eEGST" TAB_VERB "%0.6" "adm" COMPU_TAB_REF VTAB_FOR_Boost_CtrlMgmt50ms_CM_eEGST_adm /end COMPU_METHOD
/begin COMPU_METHOD Boost_CtrlMgmt50ms_CM_ufix16_Bn40_degC "Q = (V+40.000000)/1.000000" RAT_FUNC "%0.6" "degC" COEFFS 0 1 40 0 0 1 /end COMPU_METHOD
/begin COMPU_METHOD Boost_CtrlMgmt50ms_CM_ufix16_En10_adm "Q = V*1024.000000" RAT_FUNC "%12.10" "adm" COEFFS 0 1024 0 0 0 1 /end COMPU_METHOD
/begin COMPU_METHOD Boost_CtrlMgmt50ms_CM_ufix16_En4_Kg_h "Q = V*16.000000" RAT_FUNC "%8.4" "Kg/h" COEFFS 0 16 0 0 0 1 /end COMPU_METHOD
/begin COMPU_METHOD Boost_CtrlMgmt50ms_CM_ufix16_En4_cc "Q = V*16.000000" RAT_FUNC "%8.4" "cc" COEFFS 0 16 0 0 0 1 /end COMPU_METHOD
/begin COMPU_METHOD Boost_CtrlMgmt50ms_CM_ufix16_En8_adm "Q = V*256.000000" RAT_FUNC "%11.8" "adm" COEFFS 0 256 0 0 0 1 /end COMPU_METHOD
/begin COMPU_METHOD Bpre4ms_CM_tKeyState_adm "Enumerated data type: tKeyState" TAB_VERB "%0.6" "adm" COMPU_TAB_REF VTAB_FOR_Bpre4ms_CM_tKeyState_adm /end COMPU_METHOD
/begin COMPU_METHOD Bpre4ms_CM_uint16_mbar "Q = V" RAT_FUNC "%5.0" "mbar" COEFFS 0 1 0 0 0 1 /end COMPU_METHOD
/begin COMPU_METHOD CCVS_SA.CONVERSION "1:1" RAT_FUNC "%5.0" "" COEFFS 0 1 0 0 0 1 /end COMPU_METHOD
/begin COMPU_METHOD CanPvt_Tx4ms_CM_boolean_adm "Q = V" RAT_FUNC "%1.0" "adm" COEFFS 0 1 0 0 0 1 /end COMPU_METHOD
/begin COMPU_METHOD CanPvt_Tx4ms_CM_ufix16_En3__ "Q = V*8.000000" RAT_FUNC "%7.3" "%" COEFFS 0 8 0 0 0 1 /end COMPU_METHOD
/begin COMPU_METHOD CanPvt_Tx4ms_CM_uint8_adm "Q = V" RAT_FUNC "%3.0" "adm" COEFFS 0 1 0 0 0 1 /end COMPU_METHOD
/begin COMPU_METHOD Cata100ms_Symbol_CM_FixEnableT "Enumerated data type: FixEnableT" TAB_VERB "%0.6" "" COMPU_TAB_REF VTAB_FOR_Cata100ms_Symbol_CM_FixEnableT /end COMPU_METHOD
/begin COMPU_METHOD Cata100ms_Symbol_CM_ufix16_En7_hz "Q = V*128.000000" RAT_FUNC "%10.7" "hz" COEFFS 0 128 0 0 0 1 /end COMPU_METHOD
/begin COMPU_METHOD Cata100ms_Symbol_CM_uint16_adm "Q = V" RAT_FUNC "%5.0" "adm" COEFFS 0 1 0 0 0 1 /end COMPU_METHOD
/begin COMPU_METHOD Catt100ms_CM_eEGST_adm "Enumerated data type: eEGST" TAB_VERB "%0.6" "adm" COMPU_TAB_REF VTAB_FOR_Catt100ms_CM_eEGST_adm /end COMPU_METHOD
/begin COMPU_METHOD Catt100ms_CM_tKeyState_adm "Enumerated data type: tKeyState" TAB_VERB "%0.6" "adm" COMPU_TAB_REF VTAB_FOR_Catt100ms_CM_tKeyState_adm /end COMPU_METHOD
/begin COMPU_METHOD ConfInit_CM_boolean_adm "Q = V" RAT_FUNC "%1.0" "adm" COEFFS 0 1 0 0 0 1 /end COMPU_METHOD
/begin COMPU_METHOD ConfInit_CM_eCONF_adm "Enumerated data type: eCONF" TAB_VERB "%0.6" "adm" COMPU_TAB_REF VTAB_FOR_ConfInit_CM_eCONF_adm /end COMPU_METHOD
/begin COMPU_METHOD ConfInit_CM_uint8_adm "Q = V" RAT_FUNC "%3.0" "adm" COEFFS 0 1 0 0 0 1 /end COMPU_METHOD
/begin COMPU_METHOD Coot100ms_CM_tKeyState_adm "Enumerated data type: tKeyState" TAB_VERB "%0.6" "adm" COMPU_TAB_REF VTAB_FOR_Coot100ms_CM_tKeyState_adm /end COMPU_METHOD
/begin COMPU_METHOD Crkc4ms_CM_boolean_adm "Q = V" RAT_FUNC "%1.0" "adm" COEFFS 0 1 0 0 0 1 /end COMPU_METHOD
/begin COMPU_METHOD Crkc4ms_CM_eEGST_adm "Enumerated data type: eEGST" TAB_VERB "%0.6" "adm" COMPU_TAB_REF VTAB_FOR_Crkc4ms_CM_eEGST_adm /end COMPU_METHOD
/begin COMPU_METHOD Crkc4ms_CM_tKeyState_adm "Enumerated data type: tKeyState" TAB_VERB "%0.6" "adm" COMPU_TAB_REF VTAB_FOR_Crkc4ms_CM_tKeyState_adm /end COMPU_METHOD
/begin COMPU_METHOD Crkc4ms_CM_ufix16_Bn40_degC "Q = (V+40.000000)/1.000000" RAT_FUNC "%0.6" "degC" COEFFS 0 1 40 0 0 1 /end COMPU_METHOD
/begin COMPU_METHOD Ctit_LambdaCtrlTDC_CM_eEGMD_adm "Enumerated data type: eEGMD" TAB_VERB "%0.6" "adm" COMPU_TAB_REF VTAB_FOR_Ctit_LambdaCtrlTDC_CM_eEGMD_adm /end COMPU_METHOD
/begin COMPU_METHOD Ctit_LambdaCtrlTDC_CM_eEGST_adm "Enumerated data type: eEGST" TAB_VERB "%0.6" "adm" COMPU_TAB_REF VTAB_FOR_Ctit_LambdaCtrlTDC_CM_eEGST_adm /end COMPU_METHOD
/begin COMPU_METHOD Ctit_LambdaCtrlTDC_CM_ufix16_En10_adm "Q = V*1024.000000" RAT_FUNC "%12.10" "adm" COEFFS 0 1024 0 0 0 1 /end COMPU_METHOD
/begin COMPU_METHOD Ctit_LambdaCtrlTDC_CM_uint16_mbar "Q = V" RAT_FUNC "%5.0" "mbar" COEFFS 0 1 0 0 0 1 /end COMPU_METHOD
/begin COMPU_METHOD Ctit_LambdaHeater100ms_CM_ufix16_Bn40_degC "Q = (V+40.000000)/1.000000" RAT_FUNC "%0.6" "degC" COEFFS 0 1 40 0 0 1 /end COMPU_METHOD
/begin COMPU_METHOD Ctit_LambdaHeater100ms_CM_ufix16_En10_adm "Q = V*1024.000000" RAT_FUNC "%12.10" "adm" COEFFS 0 1024 0 0 0 1 /end COMPU_METHOD
/begin COMPU_METHOD Ctit_LambdaHeater100ms_CM_uint16__ "Q = V" RAT_FUNC "%5.0" "%" COEFFS 0 1 0 0 0 1 /end COMPU_METHOD
/begin COMPU_METHOD Ctit_LambdaPreDiag4ms_CM_eEGST_adm "Enumerated data type: eEGST" TAB_VERB "%0.6" "adm" COMPU_TAB_REF VTAB_FOR_Ctit_LambdaPreDiag4ms_CM_eEGST_adm /end COMPU_METHOD
/begin COMPU_METHOD Ctit_UEGOHeater4ms_CM_eEGMD_adm "Enumerated data type: eEGMD" TAB_VERB "%0.6" "adm" COMPU_TAB_REF VTAB_FOR_Ctit_UEGOHeater4ms_CM_eEGMD_adm /end COMPU_METHOD
/begin COMPU_METHOD Ctit_UEGOHeater4ms_CM_ufix16_Bn40_degC "Q = (V+40.000000)/1.000000" RAT_FUNC "%0.6" "degC" COEFFS 0 1 40 0 0 1 /end COMPU_METHOD
/begin COMPU_METHOD Ctit_UEGOHeater4ms_CM_ufix16_S50_mV "Q = V/50.000000" RAT_FUNC "%0.6" "mV" COEFFS 0 1 0 0 0 50 /end COMPU_METHOD
/begin COMPU_METHOD Dcat_Diagnosis100ms_CM_eEGMD_adm "Enumerated data type: eEGMD" TAB_VERB "%0.6" "adm" COMPU_TAB_REF VTAB_FOR_Dcat_Diagnosis100ms_CM_eEGMD_adm /end COMPU_METHOD
/begin COMPU_METHOD Dcat_Diagnosis100ms_CM_sfix16_Sp01__ "Q = V*100.000000" RAT_FUNC "%0.6" "%" COEFFS 0 100 0 0 0 1 /end COMPU_METHOD
/begin COMPU_METHOD DiagSym100ms_CM_ufix16_En2_rpm "Q = V*4.000000" RAT_FUNC "%7.2" "rpm" COEFFS 0 4 0 0 0 1 /end COMPU_METHOD
/begin COMPU_METHOD DiagSym100ms_CM_ufix16_En3_rpm "Q = V*8.000000" RAT_FUNC "%7.3" "rpm" COEFFS 0 8 0 0 0 1 /end COMPU_METHOD
/begin COMPU_METHOD DiagSym100ms_CM_ufix16_En7_Bn210_deg "Q = (V+210.000000)*128.000000" RAT_FUNC "%0.6" "deg" COEFFS 0 128 26880 0 0 1 /end COMPU_METHOD
/begin COMPU_METHOD DiagSym100ms_CM_ufix16_En8_km_h "Q = V*256.000000" RAT_FUNC "%11.8" "km/h" COEFFS 0 256 0 0 0 1 /end COMPU_METHOD
/begin COMPU_METHOD DiagSym100ms_CM_ufix16_S10_kPa "Q = V/10.000000" RAT_FUNC "%0.6" "kPa" COEFFS 0 1 0 0 0 10 /end COMPU_METHOD
/begin COMPU_METHOD DiagSym100ms_CM_ufix16_S3p05en5_adm "Q = V*32786.885246" RAT_FUNC "%0.6" "adm" COEFFS 0 32786.885246 0 0 0 1 /end COMPU_METHOD
/begin COMPU_METHOD DiagSym100ms_CM_ufix16_Sp001_V "Q = V*1000.000000" RAT_FUNC "%0.6" "V" COEFFS 0 1000 0 0 0 1 /end COMPU_METHOD
/begin COMPU_METHOD DiagSym100ms_CM_ufix16_Sp031250476844434272_kPa "Q = V*31.999512" RAT_FUNC "%0.6" "kPa" COEFFS 0 31.999512 0 0 0 1 /end COMPU_METHOD
/begin COMPU_METHOD DiagSym100ms_CM_ufix16_Sp1_Bn40_degC "Q = (V+40.000000)*10.000000" RAT_FUNC "%0.6" "degC" COEFFS 0 10 400 0 0 1 /end COMPU_METHOD
/begin COMPU_METHOD DiagSym100ms_CM_ufix16_Sp392__ "Q = V*2.551020" RAT_FUNC "%0.6" "%" COEFFS 0 2.55102 0 0 0 1 /end COMPU_METHOD
/begin COMPU_METHOD DiagSym100ms_CM_ufix8_B1985_year "Q = (V-1985.000000)/1.000000" RAT_FUNC "%0.6" "year" COEFFS 0 1 -1985 0 0 1 /end COMPU_METHOD
/begin COMPU_METHOD DiagSym100ms_CM_ufix8_Bn125__ "Q = (V+125.000000)/1.000000" RAT_FUNC "%0.6" "%" COEFFS 0 1 125 0 0 1 /end COMPU_METHOD
/begin COMPU_METHOD DiagSym100ms_CM_ufix8_Bn40__ "Q = (V+40.000000)/1.000000" RAT_FUNC "%0.6" "%" COEFFS 0 1 40 0 0 1 /end COMPU_METHOD
/begin COMPU_METHOD DiagSym100ms_CM_ufix8_Bn40_degC "Q = (V+40.000000)/1.000000" RAT_FUNC "%0.6" "degC" COEFFS 0 1 40 0 0 1 /end COMPU_METHOD
/begin COMPU_METHOD DiagSym100ms_CM_ufix8_E1_kPa "Q = V/2.000000" RAT_FUNC "%3.0" "kPa" COEFFS 0 1 0 0 0 2 /end COMPU_METHOD
/begin COMPU_METHOD DiagSym100ms_CM_ufix8_En1_Bn64_degree "Q = (V+64.000000)*2.000000" RAT_FUNC "%0.6" "degree" COEFFS 0 2 128 0 0 1 /end COMPU_METHOD
/begin COMPU_METHOD DiagSym100ms_CM_ufix8_En1__ "Q = V*2.000000" RAT_FUNC "%4.1" "%" COEFFS 0 2 0 0 0 1 /end COMPU_METHOD
/begin COMPU_METHOD DiagSym100ms_CM_ufix8_En2_day "Q = V*4.000000" RAT_FUNC "%4.2" "day" COEFFS 0 4 0 0 0 1 /end COMPU_METHOD
/begin COMPU_METHOD DiagSym100ms_CM_ufix8_En2_sec "Q = V*4.000000" RAT_FUNC "%4.2" "sec" COEFFS 0 4 0 0 0 1 /end COMPU_METHOD
/begin COMPU_METHOD DiagSym100ms_CM_ufix8_S40_rpm "Q = V/40.000000" RAT_FUNC "%0.6" "rpm" COEFFS 0 1 0 0 0 40 /end COMPU_METHOD
/begin COMPU_METHOD DiagSym100ms_CM_ufix8_Sp39215686274509803__ "Q = V*2.550000" RAT_FUNC "%0.6" "%" COEFFS 0 2.55 0 0 0 1 /end COMPU_METHOD
/begin COMPU_METHOD DiagSym100ms_CM_ufix8_Sp392__ "Q = V*2.551020" RAT_FUNC "%0.6" "%" COEFFS 0 2.55102 0 0 0 1 /end COMPU_METHOD
/begin COMPU_METHOD DiagSym100ms_CM_ufix8_Sp78125_Bn100__ "Q = (V+100.000000)*1.280000" RAT_FUNC "%0.6" "%" COEFFS 0 1.28 128 0 0 1 /end COMPU_METHOD
/begin COMPU_METHOD DiagSym100ms_CM_uint16_N_m "Q = V" RAT_FUNC "%5.0" "N*m" COEFFS 0 1 0 0 0 1 /end COMPU_METHOD
/begin COMPU_METHOD DiagSym100ms_CM_uint16_s "Q = V" RAT_FUNC "%5.0" "s" COEFFS 0 1 0 0 0 1 /end COMPU_METHOD
/begin COMPU_METHOD DiagSym100ms_CM_uint8__ "Q = V" RAT_FUNC "%3.0" "%" COEFFS 0 1 0 0 0 1 /end COMPU_METHOD
/begin COMPU_METHOD DiagSym100ms_CM_uint8_adm "Q = V" RAT_FUNC "%3.0" "adm" COEFFS 0 1 0 0 0 1 /end COMPU_METHOD
/begin COMPU_METHOD DiagSym100ms_CM_uint8_hour "Q = V" RAT_FUNC "%3.0" "hour" COEFFS 0 1 0 0 0 1 /end COMPU_METHOD
/begin COMPU_METHOD DiagSym100ms_CM_uint8_kPa "Q = V" RAT_FUNC "%3.0" "kPa" COEFFS 0 1 0 0 0 1 /end COMPU_METHOD
/begin COMPU_METHOD DiagSym100ms_CM_uint8_km_h "Q = V" RAT_FUNC "%3.0" "km/h" COEFFS 0 1 0 0 0 1 /end COMPU_METHOD
/begin COMPU_METHOD DiagSym100ms_CM_uint8_min "Q = V" RAT_FUNC "%3.0" "min" COEFFS 0 1 0 0 0 1 /end COMPU_METHOD
/begin COMPU_METHOD DiagSym100ms_CM_uint8_month "Q = V" RAT_FUNC "%3.0" "month" COEFFS 0 1 0 0 0 1 /end COMPU_METHOD
/begin COMPU_METHOD DiagSym4ms_CM_uint8_adm "Q = V" RAT_FUNC "%3.0" "adm" COEFFS 0 1 0 0 0 1 /end COMPU_METHOD
/begin COMPU_METHOD Egbrk50ms_CM_ufix16_En4__ "Q = V*16.000000" RAT_FUNC "%8.4" "%" COEFFS 0 16 0 0 0 1 /end COMPU_METHOD
/begin COMPU_METHOD Egbrk50ms_CM_ufix16_S10_Hz "Q = V/10.000000" RAT_FUNC "%0.6" "Hz" COEFFS 0 1 0 0 0 10 /end COMPU_METHOD
/begin COMPU_METHOD EgrMgm4ms_CM_boolean_adm "Q = V" RAT_FUNC "%1.0" "adm" COEFFS 0 1 0 0 0 1 /end COMPU_METHOD
/begin COMPU_METHOD EgrMgm4ms_CM_ufix16_En3__ "Q = V*8.000000" RAT_FUNC "%7.3" "%" COEFFS 0 8 0 0 0 1 /end COMPU_METHOD
/begin COMPU_METHOD EgrMgm4ms_CM_ufix16_S10_Hz "Q = V/10.000000" RAT_FUNC "%0.6" "Hz" COEFFS 0 1 0 0 0 10 /end COMPU_METHOD
/begin COMPU_METHOD EngineTypeInit_CM_FixEnableT "Enumerated data type: FixEnableT" TAB_VERB "%0.6" "" COMPU_TAB_REF VTAB_FOR_EngineTypeInit_CM_FixEnableT /end COMPU_METHOD
/begin COMPU_METHOD EngineTypeInit_CM_uint8_adm "Q = V" RAT_FUNC "%3.0" "adm" COEFFS 0 1 0 0 0 1 /end COMPU_METHOD
/begin COMPU_METHOD Evrc4ms_CM_boolean_adm "Q = V" RAT_FUNC "%1.0" "adm" COEFFS 0 1 0 0 0 1 /end COMPU_METHOD
/begin COMPU_METHOD FanCool100ms_CM_boolean_adm "Q = V" RAT_FUNC "%1.0" "adm" COEFFS 0 1 0 0 0 1 /end COMPU_METHOD
/begin COMPU_METHOD FanCool100ms_CM_ufix16_En3__ "Q = V*8.000000" RAT_FUNC "%7.3" "%" COEFFS 0 8 0 0 0 1 /end COMPU_METHOD
/begin COMPU_METHOD FanCool100ms_CM_ufix16_S10_Hz "Q = V/10.000000" RAT_FUNC "%0.6" "Hz" COEFFS 0 1 0 0 0 10 /end COMPU_METHOD
/begin COMPU_METHOD GSEC_usrRecEnable.Conversion "" LINEAR "%.3" "adm" COEFFS_LINEAR 1 0 /end COMPU_METHOD
/begin COMPU_METHOD Injt_SetParameters4ms_CM_uint16_mA "Q = V" RAT_FUNC "%5.0" "mA" COEFFS 0 1 0 0 0 1 /end COMPU_METHOD
/begin COMPU_METHOD Injt_SetParameters4ms_CM_uint16_us "Q = V" RAT_FUNC "%5.0" "us" COEFFS 0 1 0 0 0 1 /end COMPU_METHOD
/begin COMPU_METHOD J1939_TxDisable_AltFuel.CONVERSION "1:1" RAT_FUNC "%1.0" "" COEFFS 0 1 0 0 0 1 /end COMPU_METHOD
/begin COMPU_METHOD J1939_TxDisable_CcvsTx.CONVERSION "1:1" RAT_FUNC "%1.0" "" COEFFS 0 1 0 0 0 1 /end COMPU_METHOD
/begin COMPU_METHOD J1939_TxDisable_Dm1.CONVERSION "1:1" RAT_FUNC "%1.0" "" COEFFS 0 1 0 0 0 1 /end COMPU_METHOD
/begin COMPU_METHOD J1939_TxDisable_Dm4.CONVERSION "1:1" RAT_FUNC "%1.0" "" COEFFS 0 1 0 0 0 1 /end COMPU_METHOD
/begin COMPU_METHOD J1939_TxDisable_Edc2Bc.CONVERSION "1:1" RAT_FUNC "%1.0" "" COEFFS 0 1 0 0 0 1 /end COMPU_METHOD
/begin COMPU_METHOD J1939_TxDisable_Eec1.CONVERSION "1:1" RAT_FUNC "%1.0" "" COEFFS 0 1 0 0 0 1 /end COMPU_METHOD
/begin COMPU_METHOD J1939_TxDisable_Eec2.CONVERSION "1:1" RAT_FUNC "%1.0" "" COEFFS 0 1 0 0 0 1 /end COMPU_METHOD
/begin COMPU_METHOD J1939_TxDisable_Eec3.CONVERSION "1:1" RAT_FUNC "%1.0" "" COEFFS 0 1 0 0 0 1 /end COMPU_METHOD
/begin COMPU_METHOD J1939_TxDisable_EngConf.CONVERSION "1:1" RAT_FUNC "%1.0" "" COEFFS 0 1 0 0 0 1 /end COMPU_METHOD
/begin COMPU_METHOD J1939_TxDisable_EngHours.CONVERSION "1:1" RAT_FUNC "%1.0" "" COEFFS 0 1 0 0 0 1 /end COMPU_METHOD
/begin COMPU_METHOD J1939_TxDisable_EngTemp.CONVERSION "1:1" RAT_FUNC "%1.0" "" COEFFS 0 1 0 0 0 1 /end COMPU_METHOD
/begin COMPU_METHOD J1939_TxDisable_Erc1Er.CONVERSION "1:1" RAT_FUNC "%1.0" "" COEFFS 0 1 0 0 0 1 /end COMPU_METHOD
/begin COMPU_METHOD J1939_TxDisable_FluidPress.CONVERSION "1:1" RAT_FUNC "%1.0" "" COEFFS 0 1 0 0 0 1 /end COMPU_METHOD
/begin COMPU_METHOD J1939_TxDisable_InLetCond.CONVERSION "1:1" RAT_FUNC "%1.0" "" COEFFS 0 1 0 0 0 1 /end COMPU_METHOD
/begin COMPU_METHOD J1939_TxDisable_PgnRequestAck.CONVERSION "1:1" RAT_FUNC "%1.0" "" COEFFS 0 1 0 0 0 1 /end COMPU_METHOD
/begin COMPU_METHOD J1939_TxDisable_RetConf.CONVERSION "1:1" RAT_FUNC "%1.0" "" COEFFS 0 1 0 0 0 1 /end COMPU_METHOD
/begin COMPU_METHOD J1939_TxDisable_Shutdown.CONVERSION "1:1" RAT_FUNC "%1.0" "" COEFFS 0 1 0 0 0 1 /end COMPU_METHOD
/begin COMPU_METHOD J1939_bBc2Edc1Absent.CONVERSION "1:1" RAT_FUNC "%1.0" "" COEFFS 0 1 0 0 0 1 /end COMPU_METHOD
/begin COMPU_METHOD J1939_bBc2Edc2Absent.CONVERSION "1:1" RAT_FUNC "%1.0" "" COEFFS 0 1 0 0 0 1 /end COMPU_METHOD
/begin COMPU_METHOD J1939_bCCVSAbsent.CONVERSION "1:1" RAT_FUNC "%1.0" "" COEFFS 0 1 0 0 0 1 /end COMPU_METHOD
/begin COMPU_METHOD J1939_bEtc1Absent.CONVERSION "1:1" RAT_FUNC "%1.0" "" COEFFS 0 1 0 0 0 1 /end COMPU_METHOD
/begin COMPU_METHOD J1939_bEtc2Absent.CONVERSION "1:1" RAT_FUNC "%1.0" "" COEFFS 0 1 0 0 0 1 /end COMPU_METHOD
/begin COMPU_METHOD J1939_bTco1Absent.CONVERSION "1:1" RAT_FUNC "%1.0" "" COEFFS 0 1 0 0 0 1 /end COMPU_METHOD
/begin COMPU_METHOD J1939_bTimeDateAbsent.CONVERSION "1:1" RAT_FUNC "%1.0" "" COEFFS 0 1 0 0 0 1 /end COMPU_METHOD
/begin COMPU_METHOD J1939_bTsc1C1Absent.CONVERSION "1:1" RAT_FUNC "%1.0" "" COEFFS 0 1 0 0 0 1 /end COMPU_METHOD
/begin COMPU_METHOD J1939_bTsc1C2Absent.CONVERSION "1:1" RAT_FUNC "%1.0" "" COEFFS 0 1 0 0 0 1 /end COMPU_METHOD
/begin COMPU_METHOD J1939_bTsc1LAbsent.CONVERSION "1:1" RAT_FUNC "%1.0" "" COEFFS 0 1 0 0 0 1 /end COMPU_METHOD
/begin COMPU_METHOD J1939_bTsc1TRAbsent.CONVERSION "1:1" RAT_FUNC "%1.0" "" COEFFS 0 1 0 0 0 1 /end COMPU_METHOD
/begin COMPU_METHOD J1939_bUssAbsent.CONVERSION "1:1" RAT_FUNC "%1.0" "" COEFFS 0 1 0 0 0 1 /end COMPU_METHOD
/begin COMPU_METHOD J1939_bVcm2EcmAbsent.CONVERSION "1:1" RAT_FUNC "%1.0" "" COEFFS 0 1 0 0 0 1 /end COMPU_METHOD
/begin COMPU_METHOD J1939dl_Tx100ms_CM_boolean_adm "Q = V" RAT_FUNC "%1.0" "adm" COEFFS 0 1 0 0 0 1 /end COMPU_METHOD
/begin COMPU_METHOD J1939dl_Tx100ms_CM_uint8_adm "Q = V" RAT_FUNC "%3.0" "adm" COEFFS 0 1 0 0 0 1 /end COMPU_METHOD
/begin COMPU_METHOD J1939dl_Tx1s_CM_boolean_adm "Q = V" RAT_FUNC "%1.0" "adm" COEFFS 0 1 0 0 0 1 /end COMPU_METHOD
/begin COMPU_METHOD J1939dl_Tx1s_CM_uint8_adm "Q = V" RAT_FUNC "%3.0" "adm" COEFFS 0 1 0 0 0 1 /end COMPU_METHOD
/begin COMPU_METHOD J1939dl_Tx4ms_CM_boolean_adm "Q = V" RAT_FUNC "%1.0" "adm" COEFFS 0 1 0 0 0 1 /end COMPU_METHOD
/begin COMPU_METHOD J1939dl_Tx4ms_CM_uint8_adm "Q = V" RAT_FUNC "%3.0" "adm" COEFFS 0 1 0 0 0 1 /end COMPU_METHOD
/begin COMPU_METHOD J1939dl_Tx50ms_CM_boolean_adm "Q = V" RAT_FUNC "%1.0" "adm" COEFFS 0 1 0 0 0 1 /end COMPU_METHOD
/begin COMPU_METHOD J1939dl_Tx50ms_CM_uint8_adm "Q = V" RAT_FUNC "%3.0" "adm" COEFFS 0 1 0 0 0 1 /end COMPU_METHOD
/begin COMPU_METHOD Lamp100ms_CM_boolean_adm "Q = V" RAT_FUNC "%1.0" "adm" COEFFS 0 1 0 0 0 1 /end COMPU_METHOD
/begin COMPU_METHOD Lamp100ms_CM_uint8_adm "Q = V" RAT_FUNC "%3.0" "adm" COEFFS 0 1 0 0 0 1 /end COMPU_METHOD
/begin COMPU_METHOD MEAS.CONVERSION "1:1" RAT_FUNC "%1.0" "" COEFFS 0 1 0 0 0 1 /end COMPU_METHOD
/begin COMPU_METHOD MEAS_ENABLE_RESET.CONVERSION "" TAB_VERB "%3.1" "" COMPU_TAB_REF EnableResetTable /end COMPU_METHOD
/begin COMPU_METHOD OsTaskDisableAPI.CONVERSION "1:1" RAT_FUNC "%1.0" "" COEFFS 0 1 0 0 0 1 /end COMPU_METHOD
/begin COMPU_METHOD PressEstim4ms_CM_FixEnableT "Enumerated data type: FixEnableT" TAB_VERB "%0.6" "" COMPU_TAB_REF VTAB_FOR_PressEstim4ms_CM_FixEnableT /end COMPU_METHOD
/begin COMPU_METHOD PressEstim4ms_CM_boolean_adm "Q = V" RAT_FUNC "%1.0" "adm" COEFFS 0 1 0 0 0 1 /end COMPU_METHOD
/begin COMPU_METHOD PressEstim4ms_CM_int16_mbar "Q = V" RAT_FUNC "%5.0" "mbar" COEFFS 0 1 0 0 0 1 /end COMPU_METHOD
/begin COMPU_METHOD PressEstim4ms_CM_ufix16_En10_adm "Q = V*1024.000000" RAT_FUNC "%12.10" "adm" COEFFS 0 1024 0 0 0 1 /end COMPU_METHOD
/begin COMPU_METHOD PressEstim4ms_CM_ufix16_En14_adm "Q = V*16384.000000" RAT_FUNC "%15.14" "adm" COEFFS 0 16384 0 0 0 1 /end COMPU_METHOD
/begin COMPU_METHOD PressEstim4ms_CM_ufix16_En15_adm "Q = V*32768.000000" RAT_FUNC "%16.15" "adm" COEFFS 0 32768 0 0 0 1 /end COMPU_METHOD
/begin COMPU_METHOD PressEstim4ms_CM_uint16_adm "Q = V" RAT_FUNC "%5.0" "adm" COEFFS 0 1 0 0 0 1 /end COMPU_METHOD
/begin COMPU_METHOD PressEstim4ms_CM_uint16_mbar "Q = V" RAT_FUNC "%5.0" "mbar" COEFFS 0 1 0 0 0 1 /end COMPU_METHOD
/begin COMPU_METHOD PressEstim4ms_CM_uint16_rpm "Q = V" RAT_FUNC "%5.0" "rpm" COEFFS 0 1 0 0 0 1 /end COMPU_METHOD
/begin COMPU_METHOD PressEstim4ms_CM_uint8_adm "Q = V" RAT_FUNC "%3.0" "adm" COEFFS 0 1 0 0 0 1 /end COMPU_METHOD
/begin COMPU_METHOD Prvc4ms_CM_boolean_adm "Q = V" RAT_FUNC "%1.0" "adm" COEFFS 0 1 0 0 0 1 /end COMPU_METHOD
/begin COMPU_METHOD Pwrl4ms_CM_boolean_adm "Q = V" RAT_FUNC "%1.0" "adm" COEFFS 0 1 0 0 0 1 /end COMPU_METHOD
/begin COMPU_METHOD REQVCMECM_SA.CONVERSION "1:1" RAT_FUNC "%5.0" "" COEFFS 0 1 0 0 0 1 /end COMPU_METHOD
/begin COMPU_METHOD RicTrans4ms_CM_FixEnableT "Enumerated data type: FixEnableT" TAB_VERB "%0.6" "" COMPU_TAB_REF VTAB_FOR_RicTrans4ms_CM_FixEnableT /end COMPU_METHOD
/begin COMPU_METHOD RicTrans4ms_CM_boolean_adm "Q = V" RAT_FUNC "%1.0" "adm" COEFFS 0 1 0 0 0 1 /end COMPU_METHOD
/begin COMPU_METHOD RicTrans4ms_CM_int16_mbar "Q = V" RAT_FUNC "%5.0" "mbar" COEFFS 0 1 0 0 0 1 /end COMPU_METHOD
/begin COMPU_METHOD RicTrans4ms_CM_sfix16_En4_adm "Q = V*16.000000" RAT_FUNC "%8.4" "adm" COEFFS 0 16 0 0 0 1 /end COMPU_METHOD
/begin COMPU_METHOD RicTrans4ms_CM_sfix32_En9_adm "Q = V*512.000000" RAT_FUNC "%16.9" "adm" COEFFS 0 512 0 0 0 1 /end COMPU_METHOD
/begin COMPU_METHOD RicTrans4ms_CM_single_adm "Q = V" RAT_FUNC "%8.6" "adm" COEFFS 0 1 0 0 0 1 /end COMPU_METHOD
/begin COMPU_METHOD RicTrans4ms_CM_single_mbar "Q = V" RAT_FUNC "%8.6" "mbar" COEFFS 0 1 0 0 0 1 /end COMPU_METHOD
/begin COMPU_METHOD RicTrans4ms_CM_ufix16_En10_adm "Q = V*1024.000000" RAT_FUNC "%12.10" "adm" COEFFS 0 1024 0 0 0 1 /end COMPU_METHOD
/begin COMPU_METHOD RicTrans4ms_CM_ufix16_En4_adm "Q = V*16.000000" RAT_FUNC "%8.4" "adm" COEFFS 0 16 0 0 0 1 /end COMPU_METHOD
/begin COMPU_METHOD RicTrans4ms_CM_ufix16_En4_mbar "Q = V*16.000000" RAT_FUNC "%8.4" "mbar" COEFFS 0 16 0 0 0 1 /end COMPU_METHOD
/begin COMPU_METHOD RicTrans4ms_CM_uint16_adm "Q = V" RAT_FUNC "%5.0" "adm" COEFFS 0 1 0 0 0 1 /end COMPU_METHOD
/begin COMPU_METHOD RicTrans4ms_CM_uint16_mbar "Q = V" RAT_FUNC "%5.0" "mbar" COEFFS 0 1 0 0 0 1 /end COMPU_METHOD
/begin COMPU_METHOD RicTrans4ms_CM_uint16_rpm "Q = V" RAT_FUNC "%5.0" "rpm" COEFFS 0 1 0 0 0 1 /end COMPU_METHOD
/begin COMPU_METHOD RicTrans4ms_CM_uint8_adm "Q = V" RAT_FUNC "%3.0" "adm" COEFFS 0 1 0 0 0 1 /end COMPU_METHOD
/begin COMPU_METHOD Saf3Init_CM_uint16_adm "Q = V" RAT_FUNC "%5.0" "adm" COEFFS 0 1 0 0 0 1 /end COMPU_METHOD
/begin COMPU_METHOD Saf3_50ms_CM_uint8_adm "Q = V" RAT_FUNC "%3.0" "adm" COEFFS 0 1 0 0 0 1 /end COMPU_METHOD
/begin COMPU_METHOD TSC1_C1_SA.CONVERSION "1:1" RAT_FUNC "%5.0" "" COEFFS 0 1 0 0 0 1 /end COMPU_METHOD
/begin COMPU_METHOD TSC1_C2_SA.CONVERSION "1:1" RAT_FUNC "%5.0" "" COEFFS 0 1 0 0 0 1 /end COMPU_METHOD
/begin COMPU_METHOD TSC1_L_SA.CONVERSION "1:1" RAT_FUNC "%5.0" "" COEFFS 0 1 0 0 0 1 /end COMPU_METHOD
/begin COMPU_METHOD TSC1_TR_SA.CONVERSION "1:1" RAT_FUNC "%5.0" "" COEFFS 0 1 0 0 0 1 /end COMPU_METHOD
/begin COMPU_METHOD bsAF_E2PROM.Conversion "" LINEAR "%.3" "adm" COEFFS_LINEAR 0.0009765625 0 /end COMPU_METHOD
/begin COMPU_METHOD bsAF_E2PROM_Valid.Conversion "" LINEAR "%.3" "adm" COEFFS_LINEAR 1 0 /end COMPU_METHOD
/begin COMPU_METHOD bsANGLE_PHASE_EVT.Conversion "" LINEAR "%.3" "deg" COEFFS_LINEAR 0.1 0 /end COMPU_METHOD
/begin COMPU_METHOD bsANGLE_TDC_1.Conversion "" LINEAR "%.3" "deg" COEFFS_LINEAR 0.1 0 /end COMPU_METHOD
/begin COMPU_METHOD bsANGLE_TDC_2.Conversion "" LINEAR "%.3" "deg" COEFFS_LINEAR 0.1 0 /end COMPU_METHOD
/begin COMPU_METHOD bsANGLE_TDC_3.Conversion "" LINEAR "%.3" "deg" COEFFS_LINEAR 0.1 0 /end COMPU_METHOD
/begin COMPU_METHOD bsANGLE_TDC_4.Conversion "" LINEAR "%.3" "deg" COEFFS_LINEAR 0.1 0 /end COMPU_METHOD
/begin COMPU_METHOD bsANGLE_TDC_5.Conversion "" LINEAR "%.3" "deg" COEFFS_LINEAR 0.1 0 /end COMPU_METHOD
/begin COMPU_METHOD bsANGLE_TDC_6.Conversion "" LINEAR "%.3" "deg" COEFFS_LINEAR 0.1 0 /end COMPU_METHOD
/begin COMPU_METHOD bsANGLE_TDC_7.Conversion "" LINEAR "%.3" "deg" COEFFS_LINEAR 0.1 0 /end COMPU_METHOD
/begin COMPU_METHOD bsANGLE_TDC_8.Conversion "" LINEAR "%.3" "deg" COEFFS_LINEAR 0.1 0 /end COMPU_METHOD
/begin COMPU_METHOD bsAUTO_MISF_GEN.Conversion "" LINEAR "%.3" "adm" COEFFS_LINEAR 1 0 /end COMPU_METHOD
/begin COMPU_METHOD bsActDiagComp.Conversion "" LINEAR "%.3" "adm" COEFFS_LINEAR 1 0 /end COMPU_METHOD
/begin COMPU_METHOD bsActDiagStat.Conversion "" LINEAR "%.3" "adm" COEFFS_LINEAR 1 0 /end COMPU_METHOD
/begin COMPU_METHOD bsActDiagStopped.Conversion "" LINEAR "%.3" "adm" COEFFS_LINEAR 1 0 /end COMPU_METHOD
/begin COMPU_METHOD bsActDiagUsrReq.Conversion "" LINEAR "%.3" "adm" COEFFS_LINEAR 1 0 /end COMPU_METHOD
/begin COMPU_METHOD bsAirCondReq.Conversion "" LINEAR "%.3" "adm" COEFFS_LINEAR 1 0 /end COMPU_METHOD
/begin COMPU_METHOD bsAnmPwrOff.Conversion "" LINEAR "%.3" "adm" COEFFS_LINEAR 1 0 /end COMPU_METHOD
/begin COMPU_METHOD bsAnmPwrOffCnt.Conversion "" LINEAR "%.3" "times" COEFFS_LINEAR 1 0 /end COMPU_METHOD
/begin COMPU_METHOD bsBc2Edc1ErrFlag.Conversion "" LINEAR "%.3" "adm" COEFFS_LINEAR 1 0 /end COMPU_METHOD
/begin COMPU_METHOD bsBc2Edc2ErrFlag.Conversion "" LINEAR "%.3" "adm" COEFFS_LINEAR 1 0 /end COMPU_METHOD
/begin COMPU_METHOD bsBrakePed1.Conversion "" LINEAR "%.3" "adm" COEFFS_LINEAR 1 0 /end COMPU_METHOD
/begin COMPU_METHOD bsBrakePed2.Conversion "" LINEAR "%.3" "adm" COEFFS_LINEAR 1 0 /end COMPU_METHOD
/begin COMPU_METHOD bsCAM_EDGE_TYPE.Conversion "" TAB_VERB "%.0" "" COMPU_TAB_REF bsCAM_EDGE_TYPE.Conversion /end COMPU_METHOD
/begin COMPU_METHOD bsCAM_LEVEL.Conversion "" TAB_VERB "%.0" "" COMPU_TAB_REF bsCAM_LEVEL.Conversion /end COMPU_METHOD
/begin COMPU_METHOD bsCAM_SYNCH_ALT_TYPE.Conversion "" TAB_VERB "%.0" "" COMPU_TAB_REF bsCAM_SYNCH_ALT_TYPE.Conversion /end COMPU_METHOD
/begin COMPU_METHOD bsCAM_TOOTH_0.Conversion "" LINEAR "%.3" "Deg" COEFFS_LINEAR 0.1 0 /end COMPU_METHOD
/begin COMPU_METHOD bsCAM_TOOTH_1.Conversion "" LINEAR "%.3" "Deg" COEFFS_LINEAR 0.1 0 /end COMPU_METHOD
/begin COMPU_METHOD bsCAM_TOOTH_2.Conversion "" LINEAR "%.3" "Deg" COEFFS_LINEAR 0.1 0 /end COMPU_METHOD
/begin COMPU_METHOD bsCAM_TOOTH_3.Conversion "" LINEAR "%.3" "Deg" COEFFS_LINEAR 0.1 0 /end COMPU_METHOD
/begin COMPU_METHOD bsCAM_TOOTH_4.Conversion "" LINEAR "%.3" "Deg" COEFFS_LINEAR 0.1 0 /end COMPU_METHOD
/begin COMPU_METHOD bsCAM_TOOTH_5.Conversion "" LINEAR "%.3" "Deg" COEFFS_LINEAR 0.1 0 /end COMPU_METHOD
/begin COMPU_METHOD bsCAM_TOOTH_6.Conversion "" LINEAR "%.3" "Deg" COEFFS_LINEAR 0.1 0 /end COMPU_METHOD
/begin COMPU_METHOD bsCRANK_EDGE_TYPE.Conversion "" TAB_VERB "%.0" "" COMPU_TAB_REF bsCRANK_EDGE_TYPE.Conversion /end COMPU_METHOD
/begin COMPU_METHOD bsCRANK_MISS_TOOTH.Conversion "" LINEAR "%.3" "Tooth" COEFFS_LINEAR 1 0 /end COMPU_METHOD
/begin COMPU_METHOD bsCamAngleOffset.Conversion "" LINEAR "%.3" "Deg" COEFFS_LINEAR 0.1 0 /end COMPU_METHOD
/begin COMPU_METHOD bsCamPulse.Conversion "" LINEAR "%.3" "adm" COEFFS_LINEAR 1 0 /end COMPU_METHOD
/begin COMPU_METHOD bsCcvsErrFlag.Conversion "" LINEAR "%.3" "adm" COEFFS_LINEAR 1 0 /end COMPU_METHOD
/begin COMPU_METHOD bsChBPFRetCode.Conversion "" TAB_VERB "%.0" "" COMPU_TAB_REF bsChBPFRetCode.Conversion /end COMPU_METHOD
/begin COMPU_METHOD bsClutch.Conversion "" LINEAR "%.3" "adm" COEFFS_LINEAR 1 0 /end COMPU_METHOD
/begin COMPU_METHOD bsCntIdxMisf.Conversion "" LINEAR "%.3" "adm" COEFFS_LINEAR 1 0 /end COMPU_METHOD
/begin COMPU_METHOD bsCodeLamp.Conversion "" LINEAR "%.3" "adm" COEFFS_LINEAR 1 0 /end COMPU_METHOD
/begin COMPU_METHOD bsCountPostCatHeaterRst.Conversion "" LINEAR "%.3" "adm" COEFFS_LINEAR 1 0 /end COMPU_METHOD
/begin COMPU_METHOD bsCountPreCatHeaterRst.Conversion "" LINEAR "%.3" "adm" COEFFS_LINEAR 1 0 /end COMPU_METHOD
/begin COMPU_METHOD bsCountThrRst.Conversion "" LINEAR "%.3" "adm" COEFFS_LINEAR 1 0 /end COMPU_METHOD
/begin COMPU_METHOD bsCounter100ms.Conversion "" LINEAR "%.3" "adm" COEFFS_LINEAR 1 0 /end COMPU_METHOD
/begin COMPU_METHOD bsCounter10ms.Conversion "" LINEAR "%.3" "adm" COEFFS_LINEAR 1 0 /end COMPU_METHOD
/begin COMPU_METHOD bsCounter1ms.Conversion "" LINEAR "%.3" "adm" COEFFS_LINEAR 1 0 /end COMPU_METHOD
/begin COMPU_METHOD bsCounter1s.Conversion "" LINEAR "%.3" "adm" COEFFS_LINEAR 1 0 /end COMPU_METHOD
/begin COMPU_METHOD bsCounter2ms.Conversion "" LINEAR "%.3" "adm" COEFFS_LINEAR 1 0 /end COMPU_METHOD
/begin COMPU_METHOD bsCounter4ms.Conversion "" LINEAR "%.3" "adm" COEFFS_LINEAR 1 0 /end COMPU_METHOD
/begin COMPU_METHOD bsCounter50ms.Conversion "" LINEAR "%.3" "adm" COEFFS_LINEAR 1 0 /end COMPU_METHOD
/begin COMPU_METHOD bsCounterTDC.Conversion "" LINEAR "%.3" "adm" COEFFS_LINEAR 1 0 /end COMPU_METHOD
/begin COMPU_METHOD bsCurCyl.Conversion "" LINEAR "%.3" "adm" COEFFS_LINEAR 1 0 /end COMPU_METHOD
/begin COMPU_METHOD bsCylSensRetCode.Conversion "" TAB_VERB "%.0" "" COMPU_TAB_REF bsCylSensRetCode.Conversion /end COMPU_METHOD
/begin COMPU_METHOD bsCylWinRetCode.Conversion "" TAB_VERB "%.0" "" COMPU_TAB_REF bsCylWinRetCode.Conversion /end COMPU_METHOD
/begin COMPU_METHOD bsCylinderPreGain.Conversion "" TAB_VERB "%.0" "" COMPU_TAB_REF bsCylinderPreGain.Conversion /end COMPU_METHOD
/begin COMPU_METHOD bsDiagElQSStat.Conversion "" LINEAR "%.3" "adm" COEFFS_LINEAR 1 0 /end COMPU_METHOD
/begin COMPU_METHOD bsDigInSpare2.Conversion "" LINEAR "%.3" "adm" COEFFS_LINEAR 1 0 /end COMPU_METHOD
/begin COMPU_METHOD bsDigInSpare3.Conversion "" LINEAR "%.3" "adm" COEFFS_LINEAR 1 0 /end COMPU_METHOD
/begin COMPU_METHOD bsDirSignal.Conversion "" LINEAR "%.3" "adm" COEFFS_LINEAR 1 0 /end COMPU_METHOD
/begin COMPU_METHOD bsDisSignal.Conversion "" LINEAR "%.3" "adm" COEFFS_LINEAR 1 0 /end COMPU_METHOD
/begin COMPU_METHOD bsDoorsOpen.Conversion "" LINEAR "%.3" "adm" COEFFS_LINEAR 1 0 /end COMPU_METHOD
/begin COMPU_METHOD bsDurataTDC.Conversion "" LINEAR "%.3" "us" COEFFS_LINEAR 1 0 /end COMPU_METHOD
/begin COMPU_METHOD bsEPMErrorStatus.Conversion "" TAB_VERB "%.0" "" COMPU_TAB_REF bsEPMErrorStatus.Conversion /end COMPU_METHOD
/begin COMPU_METHOD bsEPMStatus.Conversion "" TAB_VERB "%.0" "" COMPU_TAB_REF bsEPMStatus.Conversion /end COMPU_METHOD
/begin COMPU_METHOD bsEPR2ECMErrFlag.Conversion "" LINEAR "%.3" "adm" COEFFS_LINEAR 1 0 /end COMPU_METHOD
/begin COMPU_METHOD bsEcuTempBit.Conversion "" LINEAR "%.3" "bit" COEFFS_LINEAR 1 0 /end COMPU_METHOD
/begin COMPU_METHOD bsEepromResetThr.Conversion "" LINEAR "%.3" "adm" COEFFS_LINEAR 1 0 /end COMPU_METHOD
/begin COMPU_METHOD bsEepromState.Conversion "" LINEAR "%.3" "adm" COEFFS_LINEAR 1 0 /end COMPU_METHOD
/begin COMPU_METHOD bsEgrDeltaPBit.Conversion "" LINEAR "%.3" "bit" COEFFS_LINEAR 1 0 /end COMPU_METHOD
/begin COMPU_METHOD bsEgrHighPreBit.Conversion "" LINEAR "%.3" "bit" COEFFS_LINEAR 1 0 /end COMPU_METHOD
/begin COMPU_METHOD bsEgrPosBit.Conversion "" LINEAR "%.3" "bit" COEFFS_LINEAR 1 0 /end COMPU_METHOD
/begin COMPU_METHOD bsEngBrkReq.Conversion "" LINEAR "%.3" "adm" COEFFS_LINEAR 1 0 /end COMPU_METHOD
/begin COMPU_METHOD bsEngStarted.Conversion "" LINEAR "%.3" "adm" COEFFS_LINEAR 1 0 /end COMPU_METHOD
/begin COMPU_METHOD bsEqadcCh.Conversion "" TAB_VERB "%.0" "" COMPU_TAB_REF bsEqadcCh.Conversion /end COMPU_METHOD
/begin COMPU_METHOD bsEtc1ErrFlag.Conversion "" LINEAR "%.3" "adm" COEFFS_LINEAR 1 0 /end COMPU_METHOD
/begin COMPU_METHOD bsEtc2ErrFlag.Conversion "" LINEAR "%.3" "adm" COEFFS_LINEAR 1 0 /end COMPU_METHOD
/begin COMPU_METHOD bsEtsErrorSval.Conversion "" LINEAR "%.3" "adm" COEFFS_LINEAR 1 0 /end COMPU_METHOD
/begin COMPU_METHOD bsFFWupCntTotE2P.Conversion "" LINEAR "%.3" "times" COEFFS_LINEAR 1 0 /end COMPU_METHOD
/begin COMPU_METHOD bsFUEL_CONS_RESET.Conversion "" LINEAR "%.3" "adm" COEFFS_LINEAR 1 0 /end COMPU_METHOD
/begin COMPU_METHOD bsFan1Period.Conversion "" LINEAR "%.3" "us" COEFFS_LINEAR 1 0 /end COMPU_METHOD
/begin COMPU_METHOD bsFan1PulseCnt.Conversion "" LINEAR "%.3" "adm" COEFFS_LINEAR 1 0 /end COMPU_METHOD
/begin COMPU_METHOD bsFaseOk.Conversion "" LINEAR "%.3" "adm" COEFFS_LINEAR 1 0 /end COMPU_METHOD
/begin COMPU_METHOD bsFinj.Conversion "" LINEAR "%.3" "degree" COEFFS_LINEAR 0.0625 0 /end COMPU_METHOD
/begin COMPU_METHOD bsFirstFlag100ms.Conversion "" LINEAR "%.3" "adm" COEFFS_LINEAR 1 0 /end COMPU_METHOD
/begin COMPU_METHOD bsFirstFlag10ms.Conversion "" LINEAR "%.3" "adm" COEFFS_LINEAR 1 0 /end COMPU_METHOD
/begin COMPU_METHOD bsFirstFlag1s.Conversion "" LINEAR "%.3" "adm" COEFFS_LINEAR 1 0 /end COMPU_METHOD
/begin COMPU_METHOD bsFirstFlag2ms.Conversion "" LINEAR "%.3" "adm" COEFFS_LINEAR 1 0 /end COMPU_METHOD
/begin COMPU_METHOD bsFirstFlag4ms.Conversion "" LINEAR "%.3" "adm" COEFFS_LINEAR 1 0 /end COMPU_METHOD
/begin COMPU_METHOD bsFirstFlag50ms.Conversion "" LINEAR "%.3" "adm" COEFFS_LINEAR 1 0 /end COMPU_METHOD
/begin COMPU_METHOD bsFirstFlagTDC.Conversion "" LINEAR "%.3" "adm" COEFFS_LINEAR 1 0 /end COMPU_METHOD
/begin COMPU_METHOD bsFuelConsReset.Conversion "" LINEAR "%.3" "adm" COEFFS_LINEAR 1 0 /end COMPU_METHOD
/begin COMPU_METHOD bsFuelLevIndDC.Conversion "" LINEAR "%.3" "%" COEFFS_LINEAR 0.0625 0 /end COMPU_METHOD
/begin COMPU_METHOD bsFuelLevIndFreq.Conversion "" LINEAR "%.3" "Hz" COEFFS_LINEAR 10 0 /end COMPU_METHOD
/begin COMPU_METHOD bsFuelLevLowLamp.Conversion "" LINEAR "%.3" "adm" COEFFS_LINEAR 1 0 /end COMPU_METHOD
/begin COMPU_METHOD bsFuelTotConsHREe.Conversion_Copy1 "" LINEAR "%.3" "l" COEFFS_LINEAR 1E-06 0 /end COMPU_METHOD
/begin COMPU_METHOD bsGainCoef.Conversion "" LINEAR "%.3" "adm" COEFFS_LINEAR 1.19209289551E-07 -1 /end COMPU_METHOD
/begin COMPU_METHOD bsGlobReq_Ram.Conversion "" LINEAR "%.3" "adm" COEFFS_LINEAR 1 0 /end COMPU_METHOD
/begin COMPU_METHOD bsGlobalLrnReq.Conversion "" LINEAR "%.3" "adm" COEFFS_LINEAR 1 0 /end COMPU_METHOD
/begin COMPU_METHOD bsHBRIDGE_OL_DIAG_ENABLE.Conversion "" LINEAR "%.3" "adm" COEFFS_LINEAR 1 0 /end COMPU_METHOD
/begin COMPU_METHOD bsHpfCoeff.Conversion "" LINEAR "%.3" "adm" COEFFS_LINEAR 1.19209289551E-07 -1 /end COMPU_METHOD
/begin COMPU_METHOD bsIdleAcc.Conversion "" LINEAR "%.3" "adm" COEFFS_LINEAR 1 0 /end COMPU_METHOD
/begin COMPU_METHOD bsImmoLamp.Conversion "" LINEAR "%.3" "adm" COEFFS_LINEAR 1 0 /end COMPU_METHOD
/begin COMPU_METHOD bsInjStopFlg.Conversion "" LINEAR "%.3" "adm" COEFFS_LINEAR 1 0 /end COMPU_METHOD
/begin COMPU_METHOD bsKEY_SW_HIGH.Conversion "" LINEAR "%.3" "mV" COEFFS_LINEAR 0.56179775 0 /end COMPU_METHOD
/begin COMPU_METHOD bsKEY_SW_LOW.Conversion "" LINEAR "%.3" "mV" COEFFS_LINEAR 0.56179775 0 /end COMPU_METHOD
/begin COMPU_METHOD bsKey.Conversion "" LINEAR "%.3" "adm" COEFFS_LINEAR 1 0 /end COMPU_METHOD
/begin COMPU_METHOD bsKeyEngStart.Conversion "" LINEAR "%.3" "adm" COEFFS_LINEAR 1 0 /end COMPU_METHOD
/begin COMPU_METHOD bsKickDown.Conversion "" LINEAR "%.3" "adm" COEFFS_LINEAR 1 0 /end COMPU_METHOD
/begin COMPU_METHOD bsLambdaPostBit.Conversion "" LINEAR "%.3" "bit" COEFFS_LINEAR 1 0 /end COMPU_METHOD
/begin COMPU_METHOD bsLambdaPreBit.Conversion "" LINEAR "%.3" "bit" COEFFS_LINEAR 1 0 /end COMPU_METHOD
/begin COMPU_METHOD bsLoadEn.Conversion "" LINEAR "%.3" "adm" COEFFS_LINEAR 1 0 /end COMPU_METHOD
/begin COMPU_METHOD bsLpfCoeff.Conversion "" LINEAR "%.3" "adm" COEFFS_LINEAR 1.19209289551E-07 -1 /end COMPU_METHOD
/begin COMPU_METHOD bsMISF_TDC.Conversion "" LINEAR "%.3" "adm" COEFFS_LINEAR 1 0 /end COMPU_METHOD
/begin COMPU_METHOD bsMISF_TDC_NUMBER.Conversion "" LINEAR "%.3" "adm" COEFFS_LINEAR 1 0 /end COMPU_METHOD
/begin COMPU_METHOD bsMapBit.Conversion "" LINEAR "%.3" "bit" COEFFS_LINEAR 1 0 /end COMPU_METHOD
/begin COMPU_METHOD bsMedocOkG.Conversion "" LINEAR "%.3" "adm" COEFFS_LINEAR 1 0 /end COMPU_METHOD
/begin COMPU_METHOD bsMilLamp.Conversion "" LINEAR "%.3" "adm" COEFFS_LINEAR 1 0 /end COMPU_METHOD
/begin COMPU_METHOD bsNIdleAcc.Conversion "" LINEAR "%.3" "adm" COEFFS_LINEAR 1 0 /end COMPU_METHOD
/begin COMPU_METHOD bsNUMCYL.Conversion "" LINEAR "%.3" "adm" COEFFS_LINEAR 1 0 /end COMPU_METHOD
/begin COMPU_METHOD bsNextCyl.Conversion "" LINEAR "%.3" "adm" COEFFS_LINEAR 1 0 /end COMPU_METHOD
/begin COMPU_METHOD bsNextCylCompl.Conversion "" LINEAR "%.3" "adm" COEFFS_LINEAR 1 0 /end COMPU_METHOD
/begin COMPU_METHOD bsNextTdcIdx.Conversion "" LINEAR "%.3" "adm" COEFFS_LINEAR 1 0 /end COMPU_METHOD
/begin COMPU_METHOD bsNextTdcIdxCompl.Conversion "" LINEAR "%.3" "adm" COEFFS_LINEAR 1 0 /end COMPU_METHOD
/begin COMPU_METHOD bsNoProgInjCutoff.Conversion "" LINEAR "%.3" "adm" COEFFS_LINEAR 1 0 /end COMPU_METHOD
/begin COMPU_METHOD bsNumRifor.Conversion "" LINEAR "%.3" "times" COEFFS_LINEAR 1 0 /end COMPU_METHOD
/begin COMPU_METHOD bsNumRiforE2PROM.Conversion "" LINEAR "%.3" "times" COEFFS_LINEAR 1 0 /end COMPU_METHOD
/begin COMPU_METHOD bsOff.Conversion "" LINEAR "%.3" "adm" COEFFS_LINEAR 1 0 /end COMPU_METHOD
/begin COMPU_METHOD bsPAtmBit.Conversion "" LINEAR "%.3" "bit" COEFFS_LINEAR 1 0 /end COMPU_METHOD
/begin COMPU_METHOD bsPBoostBit.Conversion "" LINEAR "%.3" "bit" COEFFS_LINEAR 1 0 /end COMPU_METHOD
/begin COMPU_METHOD bsPOilBit.Conversion "" LINEAR "%.3" "bit" COEFFS_LINEAR 1 0 /end COMPU_METHOD
/begin COMPU_METHOD bsPROPB_0A_Tx_Enable.Conversion "" LINEAR "%.3" "adm" COEFFS_LINEAR 1 0 /end COMPU_METHOD
/begin COMPU_METHOD bsPRailBit.Conversion "" LINEAR "%.3" "bit" COEFFS_LINEAR 1 0 /end COMPU_METHOD
/begin COMPU_METHOD bsPTank.Conversion "" LINEAR "%.3" "bar" COEFFS_LINEAR 0.004 0 /end COMPU_METHOD
/begin COMPU_METHOD bsPTankBit.Conversion "" LINEAR "%.3" "bit" COEFFS_LINEAR 1 0 /end COMPU_METHOD
/begin COMPU_METHOD bsPTankE2PROM.Conversion "" LINEAR "%.3" "bar" COEFFS_LINEAR 0.004 0 /end COMPU_METHOD
/begin COMPU_METHOD bsPULL0_AccIdleSw_ID.Conversion "" TAB_VERB "%.0" "" COMPU_TAB_REF bsPULL0_AccIdleSw_ID.Conversion /end COMPU_METHOD
/begin COMPU_METHOD bsPULL10_AirCondReq_ID.Conversion "" TAB_VERB "%.0" "" COMPU_TAB_REF bsPULL10_AirCondReq_ID.Conversion /end COMPU_METHOD
/begin COMPU_METHOD bsPULL11_DigIn1_MflvOn_ID.Conversion "" TAB_VERB "%.0" "" COMPU_TAB_REF bsPULL11_DigIn1_MflvOn_ID.Conversion /end COMPU_METHOD
/begin COMPU_METHOD bsPULL12_DigIn2_MflvOff_ID.Conversion "" TAB_VERB "%.0" "" COMPU_TAB_REF bsPULL12_DigIn2_MflvOff_ID.Conversion /end COMPU_METHOD
/begin COMPU_METHOD bsPULL13_DigIn3_MflvP_ID.Conversion "" TAB_VERB "%.0" "" COMPU_TAB_REF bsPULL13_DigIn3_MflvP_ID.Conversion /end COMPU_METHOD
/begin COMPU_METHOD bsPULL14_DigIn4_MflvM_ID.Conversion "" TAB_VERB "%.0" "" COMPU_TAB_REF bsPULL14_DigIn4_MflvM_ID.Conversion /end COMPU_METHOD
/begin COMPU_METHOD bsPULL15_AuxKeyReq_ID.Conversion "" TAB_VERB "%.0" "" COMPU_TAB_REF bsPULL15_AuxKeyReq_ID.Conversion /end COMPU_METHOD
/begin COMPU_METHOD bsPULL1_AccKickDownSw_ID.Conversion "" TAB_VERB "%.0" "" COMPU_TAB_REF bsPULL1_AccKickDownSw_ID.Conversion /end COMPU_METHOD
/begin COMPU_METHOD bsPULL2_BrakePedSw1_ID.Conversion "" TAB_VERB "%.0" "" COMPU_TAB_REF bsPULL2_BrakePedSw1_ID.Conversion /end COMPU_METHOD
/begin COMPU_METHOD bsPULL3_BrakePedSw2_ID.Conversion "" TAB_VERB "%.0" "" COMPU_TAB_REF bsPULL3_BrakePedSw2_ID.Conversion /end COMPU_METHOD
/begin COMPU_METHOD bsPULL4_ClutchPedSw_ID.Conversion "" TAB_VERB "%.0" "" COMPU_TAB_REF bsPULL4_ClutchPedSw_ID.Conversion /end COMPU_METHOD
/begin COMPU_METHOD bsPULL5_EngBrk_DoorSw_ID.Conversion "" TAB_VERB "%.0" "" COMPU_TAB_REF bsPULL5_EngBrk_DoorSw_ID.Conversion /end COMPU_METHOD
/begin COMPU_METHOD bsPULL6_NeutralSw_ID.Conversion "" TAB_VERB "%.0" "" COMPU_TAB_REF bsPULL6_NeutralSw_ID.Conversion /end COMPU_METHOD
/begin COMPU_METHOD bsPULL7_ParkBrk_LimSw_ID.Conversion "" TAB_VERB "%.0" "" COMPU_TAB_REF bsPULL7_ParkBrk_LimSw_ID.Conversion /end COMPU_METHOD
/begin COMPU_METHOD bsPULL8_StartAuxReq_ID.Conversion "" TAB_VERB "%.0" "" COMPU_TAB_REF bsPULL8_StartAuxReq_ID.Conversion /end COMPU_METHOD
/begin COMPU_METHOD bsPULL9_StopAuxReq_ID.Conversion "" TAB_VERB "%.0" "" COMPU_TAB_REF bsPULL9_StopAuxReq_ID.Conversion /end COMPU_METHOD
/begin COMPU_METHOD bsParkBrk.Conversion "" LINEAR "%.3" "adm" COEFFS_LINEAR 1 0 /end COMPU_METHOD
/begin COMPU_METHOD bsPotenzAcc2Bit.Conversion "" LINEAR "%.3" "bit" COEFFS_LINEAR 1 0 /end COMPU_METHOD
/begin COMPU_METHOD bsPotenzAccBit.Conversion "" LINEAR "%.3" "bit" COEFFS_LINEAR 1 0 /end COMPU_METHOD
/begin COMPU_METHOD bsPotenzThr2Bit.Conversion "" LINEAR "%.3" "bit" COEFFS_LINEAR 1 0 /end COMPU_METHOD
/begin COMPU_METHOD bsPotenzThrBit.Conversion "" LINEAR "%.3" "bit" COEFFS_LINEAR 1 0 /end COMPU_METHOD
/begin COMPU_METHOD bsPowerOn.Conversion "" LINEAR "%.3" "adm" COEFFS_LINEAR 1 0 /end COMPU_METHOD
/begin COMPU_METHOD bsPwrOffCnt.Conversion "" LINEAR "%.3" "times" COEFFS_LINEAR 1 0 /end COMPU_METHOD
/begin COMPU_METHOD bsQAirDebimBit.Conversion "" LINEAR "%.3" "bit" COEFFS_LINEAR 1 0 /end COMPU_METHOD
/begin COMPU_METHOD bsRPM.Conversion "" LINEAR "%.3" "rpm" COEFFS_LINEAR 1 0 /end COMPU_METHOD
/begin COMPU_METHOD bsRec50.Conversion "" LINEAR "%.3" "adm" COEFFS_LINEAR 1 0 /end COMPU_METHOD
/begin COMPU_METHOD bsRedLamp.Conversion "" LINEAR "%.3" "adm" COEFFS_LINEAR 1 0 /end COMPU_METHOD
/begin COMPU_METHOD bsResume.Conversion "" LINEAR "%.3" "adm" COEFFS_LINEAR 1 0 /end COMPU_METHOD
/begin COMPU_METHOD bsRifornE2PROM.Conversion "" LINEAR "%.3" "adm" COEFFS_LINEAR 1 0 /end COMPU_METHOD
/begin COMPU_METHOD bsRifornimento.Conversion "" LINEAR "%.3" "adm" COEFFS_LINEAR 1 0 /end COMPU_METHOD
/begin COMPU_METHOD bsSRI.Conversion "" LINEAR "%.3" "uV" COEFFS_LINEAR 1 0 /end COMPU_METHOD
/begin COMPU_METHOD bsSaf3AdDriftErr.Conversion "" LINEAR "%.3" "adm" COEFFS_LINEAR 1 0 /end COMPU_METHOD
/begin COMPU_METHOD bsSaf3AdErr.Conversion "" LINEAR "%.3" "adm" COEFFS_LINEAR 1 0 /end COMPU_METHOD
/begin COMPU_METHOD bsSaf3CheckCfgMCUErr.Conversion "" LINEAR "%.3" "adm" COEFFS_LINEAR 1 0 /end COMPU_METHOD
/begin COMPU_METHOD bsSaf3CheckCfgSBCErr.Conversion "" LINEAR "%.3" "adm" COEFFS_LINEAR 1 0 /end COMPU_METHOD
/begin COMPU_METHOD bsSaf3CheckSBCErr.Conversion "" LINEAR "%.3" "adm" COEFFS_LINEAR 1 0 /end COMPU_METHOD
/begin COMPU_METHOD bsSaf3ChecksumFlashErr.Conversion "" LINEAR "%.3" "adm" COEFFS_LINEAR 1 0 /end COMPU_METHOD
/begin COMPU_METHOD bsSaf3ChipTemp1.Conversion "" LINEAR "%.3" "degC" COEFFS_LINEAR 1 0 /end COMPU_METHOD
/begin COMPU_METHOD bsSaf3ChipTemp2.Conversion "" LINEAR "%.3" "degC" COEFFS_LINEAR 1 0 /end COMPU_METHOD
/begin COMPU_METHOD bsSaf3DebugErr.Conversion "" LINEAR "%.3" "adm" COEFFS_LINEAR 1 0 /end COMPU_METHOD
/begin COMPU_METHOD bsSaf3EccEventAllCnt.Conversion "" LINEAR "%.3" "adm" COEFFS_LINEAR 1 0 /end COMPU_METHOD
/begin COMPU_METHOD bsSaf3EccEventCnt.Conversion "" LINEAR "%.3" "adm" COEFFS_LINEAR 1 0 /end COMPU_METHOD
/begin COMPU_METHOD bsSaf3EccStartCheckErr.Conversion "" LINEAR "%.3" "adm" COEFFS_LINEAR 1 0 /end COMPU_METHOD
/begin COMPU_METHOD bsSaf3FccuReactionNum.Conversion "" LINEAR "%.3" " " COEFFS_LINEAR 1 0 /end COMPU_METHOD
/begin COMPU_METHOD bsSaf3IrcOscErr.Conversion "" LINEAR "%.3" "adm" COEFFS_LINEAR 1 0 /end COMPU_METHOD
/begin COMPU_METHOD bsSaf3LastFccErr.Conversion "" TAB_VERB "%.0" "" COMPU_TAB_REF bsSaf3LastFccErr.Conversion /end COMPU_METHOD
/begin COMPU_METHOD bsSaf3LbistErr.Conversion "" LINEAR "%.3" "adm" COEFFS_LINEAR 1 0 /end COMPU_METHOD
/begin COMPU_METHOD bsSaf3LoadEnErr.Conversion "" LINEAR "%.3" "adm" COEFFS_LINEAR 1 0 /end COMPU_METHOD
/begin COMPU_METHOD bsSaf3LoadEnSample0.Conversion "" LINEAR "%.3" "adm" COEFFS_LINEAR 1 0 /end COMPU_METHOD
/begin COMPU_METHOD bsSaf3LoadEnSample1.Conversion "" LINEAR "%.3" "adm" COEFFS_LINEAR 1 0 /end COMPU_METHOD
/begin COMPU_METHOD bsSaf3LoadEnSample2.Conversion "" LINEAR "%.3" "adm" COEFFS_LINEAR 1 0 /end COMPU_METHOD
/begin COMPU_METHOD bsSaf3LoadEnSample3.Conversion "" LINEAR "%.3" "adm" COEFFS_LINEAR 1 0 /end COMPU_METHOD
/begin COMPU_METHOD bsSaf3LoadEna.Conversion "" LINEAR "%.3" "adm" COEFFS_LINEAR 1 0 /end COMPU_METHOD
/begin COMPU_METHOD bsSaf3MbistErr.Conversion "" LINEAR "%.3" "adm" COEFFS_LINEAR 1 0 /end COMPU_METHOD
/begin COMPU_METHOD bsSaf3PmcBandGapErr.Conversion "" LINEAR "%.3" "adm" COEFFS_LINEAR 1 0 /end COMPU_METHOD
/begin COMPU_METHOD bsSaf3PmcSelfTestErr.Conversion "" LINEAR "%.3" "adm" COEFFS_LINEAR 1 0 /end COMPU_METHOD
/begin COMPU_METHOD bsSaf3ResetErr.Conversion "" LINEAR "%.3" "adm" COEFFS_LINEAR 1 0 /end COMPU_METHOD
/begin COMPU_METHOD bsSaf3SBCFaultErr.Conversion "" LINEAR "%.3" "adm" COEFFS_LINEAR 1 0 /end COMPU_METHOD
/begin COMPU_METHOD bsSaf3SBCWdErrCnt.Conversion "" LINEAR "%.3" "adm" COEFFS_LINEAR 1 0 /end COMPU_METHOD
/begin COMPU_METHOD bsSaf3StackFree.Conversion "" LINEAR "%.3" "%" COEFFS_LINEAR 0.1 0 /end COMPU_METHOD
/begin COMPU_METHOD bsSaf3VpreUnderVoltageErr.Conversion "" LINEAR "%.3" "adm" COEFFS_LINEAR 1 0 /end COMPU_METHOD
/begin COMPU_METHOD bsSaf3eMGS0BistErr.Conversion "" LINEAR "%.3" "adm" COEFFS_LINEAR 1 0 /end COMPU_METHOD
/begin COMPU_METHOD bsSaf3eMGS1BistErr.Conversion "" LINEAR "%.3" "adm" COEFFS_LINEAR 1 0 /end COMPU_METHOD
/begin COMPU_METHOD bsSaf3eMGS2BistErr.Conversion "" LINEAR "%.3" "adm" COEFFS_LINEAR 1 0 /end COMPU_METHOD
/begin COMPU_METHOD bsSaf3eMgs0CodeErr.Conversion "" LINEAR "%.3" "adm" COEFFS_LINEAR 1 0 /end COMPU_METHOD
/begin COMPU_METHOD bsSaf3eMgs0CodeLoadErr.Conversion "" LINEAR "%.3" "adm" COEFFS_LINEAR 1 0 /end COMPU_METHOD
/begin COMPU_METHOD bsSaf3eMgs0Err.Conversion "" LINEAR "%.3" "adm" COEFFS_LINEAR 1 0 /end COMPU_METHOD
/begin COMPU_METHOD bsSaf3eMgs0Wrn.Conversion "" LINEAR "%.3" "adm" COEFFS_LINEAR 1 0 /end COMPU_METHOD
/begin COMPU_METHOD bsSaf3eMgs1CodeErr.Conversion "" LINEAR "%.3" "adm" COEFFS_LINEAR 1 0 /end COMPU_METHOD
/begin COMPU_METHOD bsSaf3eMgs1CodeLoadErr.Conversion "" LINEAR "%.3" "adm" COEFFS_LINEAR 1 0 /end COMPU_METHOD
/begin COMPU_METHOD bsSaf3eMgs1Err.Conversion "" LINEAR "%.3" "adm" COEFFS_LINEAR 1 0 /end COMPU_METHOD
/begin COMPU_METHOD bsSaf3eMgs1Wrn.Conversion "" LINEAR "%.3" "adm" COEFFS_LINEAR 1 0 /end COMPU_METHOD
/begin COMPU_METHOD bsSaf3eMgs2CodeErr.Conversion "" LINEAR "%.3" "adm" COEFFS_LINEAR 1 0 /end COMPU_METHOD
/begin COMPU_METHOD bsSaf3eMgs2CodeLoadErr.Conversion "" LINEAR "%.3" "adm" COEFFS_LINEAR 1 0 /end COMPU_METHOD
/begin COMPU_METHOD bsSaf3eMgs2Err.Conversion "" LINEAR "%.3" "adm" COEFFS_LINEAR 1 0 /end COMPU_METHOD
/begin COMPU_METHOD bsSaf3eMgs2Wrn.Conversion "" LINEAR "%.3" "adm" COEFFS_LINEAR 1 0 /end COMPU_METHOD
/begin COMPU_METHOD eDiagStatus.Conversion "" TAB_VERB "%.0" "" COMPU_TAB_REF eDiagStatus.Conversion /end COMPU_METHOD
/begin COMPU_VTAB EnableResetTable "" TAB_VERB 2 0 "Disabled" 1 "Enabled" DEFAULT_VALUE "" /end COMPU_VTAB
/begin COMPU_VTAB VTAB_FOR_AirAlphaNTDC_CM_FixEnableT "Enumerated data type: FixEnableT" TAB_VERB 2 171 "Enable" 218 "Disable" /end COMPU_VTAB
/begin COMPU_VTAB VTAB_FOR_AirSpeedDensityTDC_CM_FixEnableT "Enumerated data type: FixEnableT" TAB_VERB 2 171 "Enable" 218 "Disable" /end COMPU_VTAB
/begin COMPU_VTAB VTAB_FOR_Air_Flow_MgmTDC_CM_FixEnableT "Enumerated data type: FixEnableT" TAB_VERB 2 171 "Enable" 218 "Disable" /end COMPU_VTAB
/begin COMPU_VTAB VTAB_FOR_Apre100ms_CM_tKeyState_adm "Enumerated data type: tKeyState" TAB_VERB 2 0 "KEY_OFF" 1 "KEY_ON" /end COMPU_VTAB
/begin COMPU_VTAB VTAB_FOR_Auto_DiagLineADAT2_4ms_CM_eEGST_adm "Enumerated data type: eEGST" TAB_VERB 7 0 "POWER_ON" 1 "WAIT" 2 "RUN" 3 "POWER_LATCH" 4 "POWER_OFF" 5 "SHUTDOWN" 6 "ACTDIAG_WAIT" /end COMPU_VTAB
/begin COMPU_VTAB VTAB_FOR_Batt4ms_CM_eEGMD_adm "Enumerated data type: eEGMD" TAB_VERB 5 0 "NOT_DETERM" 1 "CRANK" 2 "IDLE" 3 "NORMAL" 4 "CUT_OFF" /end COMPU_VTAB
/begin COMPU_VTAB VTAB_FOR_Batt4ms_CM_eEGST_adm "Enumerated data type: eEGST" TAB_VERB 7 0 "POWER_ON" 1 "WAIT" 2 "RUN" 3 "POWER_LATCH" 4 "POWER_OFF" 5 "SHUTDOWN" 6 "ACTDIAG_WAIT" /end COMPU_VTAB
/begin COMPU_VTAB VTAB_FOR_Batt4ms_CM_tKeyState_adm "Enumerated data type: tKeyState" TAB_VERB 2 0 "KEY_OFF" 1 "KEY_ON" /end COMPU_VTAB
/begin COMPU_VTAB VTAB_FOR_Boost_CtrlMgmt50ms_CM_eEGST_adm "Enumerated data type: eEGST" TAB_VERB 7 0 "POWER_ON" 1 "WAIT" 2 "RUN" 3 "POWER_LATCH" 4 "POWER_OFF" 5 "SHUTDOWN" 6 "ACTDIAG_WAIT" /end COMPU_VTAB
/begin COMPU_VTAB VTAB_FOR_Bpre4ms_CM_tKeyState_adm "Enumerated data type: tKeyState" TAB_VERB 2 0 "KEY_OFF" 1 "KEY_ON" /end COMPU_VTAB
/begin COMPU_VTAB VTAB_FOR_Cata100ms_Symbol_CM_FixEnableT "Enumerated data type: FixEnableT" TAB_VERB 2 171 "Enable" 218 "Disable" /end COMPU_VTAB
/begin COMPU_VTAB VTAB_FOR_Catt100ms_CM_eEGST_adm "Enumerated data type: eEGST" TAB_VERB 7 0 "POWER_ON" 1 "WAIT" 2 "RUN" 3 "POWER_LATCH" 4 "POWER_OFF" 5 "SHUTDOWN" 6 "ACTDIAG_WAIT" /end COMPU_VTAB
/begin COMPU_VTAB VTAB_FOR_Catt100ms_CM_tKeyState_adm "Enumerated data type: tKeyState" TAB_VERB 2 0 "KEY_OFF" 1 "KEY_ON" /end COMPU_VTAB
/begin COMPU_VTAB VTAB_FOR_ConfInit_CM_eCONF_adm "Enumerated data type: eCONF" TAB_VERB 9 0 "NONE" 1 "F2G" 2 "NEF" 3 "F2G_C9" 4 "CINA_S01" 5 "CINA_W01" 6 "CINA_Y01" 7 "RUSSIA_T01" 8 "ENGINES" /end COMPU_VTAB
/begin COMPU_VTAB VTAB_FOR_Coot100ms_CM_tKeyState_adm "Enumerated data type: tKeyState" TAB_VERB 2 0 "KEY_OFF" 1 "KEY_ON" /end COMPU_VTAB
/begin COMPU_VTAB VTAB_FOR_Crkc4ms_CM_eEGST_adm "Enumerated data type: eEGST" TAB_VERB 7 0 "POWER_ON" 1 "WAIT" 2 "RUN" 3 "POWER_LATCH" 4 "POWER_OFF" 5 "SHUTDOWN" 6 "ACTDIAG_WAIT" /end COMPU_VTAB
/begin COMPU_VTAB VTAB_FOR_Crkc4ms_CM_tKeyState_adm "Enumerated data type: tKeyState" TAB_VERB 2 0 "KEY_OFF" 1 "KEY_ON" /end COMPU_VTAB
/begin COMPU_VTAB VTAB_FOR_Ctit_LambdaCtrlTDC_CM_eEGMD_adm "Enumerated data type: eEGMD" TAB_VERB 5 0 "NOT_DETERM" 1 "CRANK" 2 "IDLE" 3 "NORMAL" 4 "CUT_OFF" /end COMPU_VTAB
/begin COMPU_VTAB VTAB_FOR_Ctit_LambdaCtrlTDC_CM_eEGST_adm "Enumerated data type: eEGST" TAB_VERB 8 0 "POWER_ON" 1 "WAIT" 2 "RUN" 3 "POWER_LATCH" 4 "POWER_OFF" 5 "SHUTDOWN" 6 "ACTDIAG_WAIT" 7 "SAFETY_CHECK" /end COMPU_VTAB
/begin COMPU_VTAB VTAB_FOR_Ctit_LambdaPreDiag4ms_CM_eEGST_adm "Enumerated data type: eEGST" TAB_VERB 7 0 "POWER_ON" 1 "WAIT" 2 "RUN" 3 "POWER_LATCH" 4 "POWER_OFF" 5 "SHUTDOWN" 6 "ACTDIAG_WAIT" /end COMPU_VTAB
/begin COMPU_VTAB VTAB_FOR_Ctit_UEGOHeater4ms_CM_eEGMD_adm "Enumerated data type: eEGMD" TAB_VERB 5 0 "NOT_DETERM" 1 "CRANK" 2 "IDLE" 3 "NORMAL" 4 "CUT_OFF" /end COMPU_VTAB
/begin COMPU_VTAB VTAB_FOR_Dcat_Diagnosis100ms_CM_eEGMD_adm "Enumerated data type: eEGMD" TAB_VERB 5 0 "NOT_DETERM" 1 "CRANK" 2 "IDLE" 3 "NORMAL" 4 "CUT_OFF" /end COMPU_VTAB
/begin COMPU_VTAB VTAB_FOR_EngineTypeInit_CM_FixEnableT "Enumerated data type: FixEnableT" TAB_VERB 2 171 "Enable" 218 "Disable" /end COMPU_VTAB
/begin COMPU_VTAB VTAB_FOR_PressEstim4ms_CM_FixEnableT "Enumerated data type: FixEnableT" TAB_VERB 2 171 "Enable" 218 "Disable" /end COMPU_VTAB
/begin COMPU_VTAB VTAB_FOR_RicTrans4ms_CM_FixEnableT "Enumerated data type: FixEnableT" TAB_VERB 2 171 "Enable" 218 "Disable" /end COMPU_VTAB
/begin COMPU_VTAB bsCAM_EDGE_TYPE.Conversion "" TAB_VERB 4 0 "M_RISING_EDGE" 1 "M_FALLING_EDGE" 2 "M_BOTH_EDGES" 3 "M_NO_EDGE" /end COMPU_VTAB
/begin COMPU_VTAB bsCAM_LEVEL.Conversion "" TAB_VERB 2 0 "EDGES" 1 "LEVEL" /end COMPU_VTAB
/begin COMPU_VTAB bsCAM_SYNCH_ALT_TYPE.Conversion "" TAB_VERB 2 0 "ALTERNATE" 1 "NORMAL" /end COMPU_VTAB
/begin COMPU_VTAB bsCRANK_EDGE_TYPE.Conversion "" TAB_VERB 2 0 "M_RISING_EDGE" 1 "M_FALLING_EDGE" /end COMPU_VTAB
/begin COMPU_VTAB bsChBPFRetCode.Conversion "" TAB_VERB 6 0 "KNOCK_RET_OK_MBSL" 1 "KNOCK_REQUEST_ERROR_MBSL" 2 "KNOCK_CHANNEL_ERROR_MBSL" 3 "KNOCK_PARAMETER_ERROR_MBSL" 4 "KNOCK_DELAYED_MBSL" 5 "KNOCK_WINDOW_ERROR_MBSL" /end COMPU_VTAB
/begin COMPU_VTAB bsCylSensRetCode.Conversion "" TAB_VERB 6 0 "KNOCK_RET_OK_MBSL" 1 "KNOCK_REQUEST_ERROR_MBSL" 2 "KNOCK_CHANNEL_ERROR_MBSL" 3 "KNOCK_PARAMETER_ERROR_MBSL" 4 "KNOCK_DELAYED_MBSL" 5 "KNOCK_WINDOW_ERROR_MBSL" /end COMPU_VTAB
/begin COMPU_VTAB bsCylWinRetCode.Conversion "" TAB_VERB 6 0 "KNOCK_RET_OK_MBSL" 1 "KNOCK_REQUEST_ERROR_MBSL" 2 "KNOCK_CHANNEL_ERROR_MBSL" 3 "KNOCK_PARAMETER_ERROR_MBSL" 4 "KNOCK_DELAYED_MBSL" 5 "KNOCK_WINDOW_ERROR_MBSL" /end COMPU_VTAB
/begin COMPU_VTAB bsCylinderPreGain.Conversion "" TAB_VERB 3 0 "KNOCK_PREGAIN_1" 1 "KNOCK_PREGAIN_2" 2 "KNOCK_PREGAIN_4" /end COMPU_VTAB
/begin COMPU_VTAB bsEPMErrorStatus.Conversion "" TAB_VERB 4 0 "NO_ERROR" 1 "PHASED_ERROR" 2 "TOOTH_ERROR" 3 "ZERO_TOOTH_ERROR" /end COMPU_VTAB
/begin COMPU_VTAB bsEPMStatus.Conversion "" TAB_VERB 6 0 "NOSYNCH" 1 "PRESYNCH" 2 "SYNCH" 3 "PHASED" 4 "STOPPED" 5 "PHASED_ERROR" /end COMPU_VTAB
/begin COMPU_VTAB bsEqadcCh.Conversion "" TAB_VERB 2 0 "EQADC_DAN_A0" 1 "EQADC_DAN_A1" /end COMPU_VTAB
/begin COMPU_VTAB bsPULL0_AccIdleSw_ID.Conversion "" TAB_VERB 2 0 "ON" 1 "OFF" /end COMPU_VTAB
/begin COMPU_VTAB bsPULL10_AirCondReq_ID.Conversion "" TAB_VERB 2 0 "ON" 1 "OFF" /end COMPU_VTAB
/begin COMPU_VTAB bsPULL11_DigIn1_MflvOn_ID.Conversion "" TAB_VERB 2 0 "ON" 1 "OFF" /end COMPU_VTAB
/begin COMPU_VTAB bsPULL12_DigIn2_MflvOff_ID.Conversion "" TAB_VERB 2 0 "ON" 1 "OFF" /end COMPU_VTAB
/begin COMPU_VTAB bsPULL13_DigIn3_MflvP_ID.Conversion "" TAB_VERB 2 0 "ON" 1 "OFF" /end COMPU_VTAB
/begin COMPU_VTAB bsPULL14_DigIn4_MflvM_ID.Conversion "" TAB_VERB 2 0 "ON" 1 "OFF" /end COMPU_VTAB
/begin COMPU_VTAB bsPULL15_AuxKeyReq_ID.Conversion "" TAB_VERB 2 0 "ON" 1 "OFF" /end COMPU_VTAB
/begin COMPU_VTAB bsPULL1_AccKickDownSw_ID.Conversion "" TAB_VERB 2 0 "ON" 1 "OFF" /end COMPU_VTAB
/begin COMPU_VTAB bsPULL2_BrakePedSw1_ID.Conversion "" TAB_VERB 2 0 "ON" 1 "OFF" /end COMPU_VTAB
/begin COMPU_VTAB bsPULL3_BrakePedSw2_ID.Conversion "" TAB_VERB 2 0 "ON" 1 "OFF" /end COMPU_VTAB
/begin COMPU_VTAB bsPULL4_ClutchPedSw_ID.Conversion "" TAB_VERB 2 0 "ON" 1 "OFF" /end COMPU_VTAB
/begin COMPU_VTAB bsPULL5_EngBrk_DoorSw_ID.Conversion "" TAB_VERB 2 0 "ON" 1 "OFF" /end COMPU_VTAB
/begin COMPU_VTAB bsPULL6_NeutralSw_ID.Conversion "" TAB_VERB 2 0 "ON" 1 "OFF" /end COMPU_VTAB
/begin COMPU_VTAB bsPULL7_ParkBrk_LimSw_ID.Conversion "" TAB_VERB 2 0 "ON" 1 "OFF" /end COMPU_VTAB
/begin COMPU_VTAB bsPULL8_StartAuxReq_ID.Conversion "" TAB_VERB 2 0 "ON" 1 "OFF" /end COMPU_VTAB
/begin COMPU_VTAB bsPULL9_StopAuxReq_ID.Conversion "" TAB_VERB 2 0 "ON" 1 "OFF" /end COMPU_VTAB
/begin COMPU_VTAB bsSaf3LastFccErr.Conversion "" TAB_VERB 47 0 "NO_ERROR" 1 "TEMP_ERROR" 2 "LVD_ERROR" 3 "HVD_ERROR" 4 "DPMC_SELF_TEST" 5 "MEMORY_DCF_SAFETY_ERR" 6 "SSCM_XFER_ERR" 7 "STCU_UF" 8 "STCU_RF" 9 "STCU_LMBIST_USR_ERR" 10 "SPURIOUS_DEBUG_SSCM_ACTIVATION" 11 "RCCU_0" 12 "RCCU_1" 13 "WDRS_DBRC0" 14 "WDRS_DBRC1" 15 "SWTRS0" 16 "SWTRS1" 17 "SWTINT0" 18 "FLASH_INIT" 19 "SSCM_INIT" 20 " PER_CE" 21 "PER_UCE" 22 "FLS_CE" 23 "FLS_UCE" 24 "PLL_0" 25 "PLL_1" 26 "CMU_0_OSC" 27 "CMU_0_PLL" 28 "CMU_COMP" 29 "CMU_OTHER" 30 "EDC_ECC_FLASH" 31 "EDC_ECC_FLASH_C" 32 "ENC_ERR_FLASH" 33 "ADDR_FDBK_ERR_FLASH_C" 34 "XBAR_TRANSACTION_MONITOR" 35 "ADDR_FDBK_ERR_PRAM_RAM_LWB_ERR" 36 "SSCM_PASS_ECC_ERR" 37 "EDC_ERR_PRAM" 38 "DFT1" 39 "DFT2" 40 "DFT3" 41 "DFT4" 42 "SAFETY_CORE_MACHINE_CHECK_EXCEPTION" 43 "LOCKSTEP_MODE" 44 "ERROR_IN_ERR" 46 "ERM_CE" 47 "ERM_UCE" /end COMPU_VTAB
/begin COMPU_VTAB eDiagStatus.Conversion "" TAB_VERB 27 0 "DIAG_STATUS_OK" 1 "DIAG_GENERIC_FAULT" 2 "DIAG_SHORT_GND" 3 "DIAG_SHORT_VCC" 4 "DIAG_SHORT_OVER_LOAD" 5 "DIAG_SHORT_HS_VCC" 6 "DIAG_SHORT_LS_VCC" 7 "DIAG_SHORT_HS_GND" 8 "DIAG_SHORT_LS_GND" 9 "DIAG_SHORT_HS_LS" 10 "DIAG_SHORT_HS_LS_GND" 11 "DIAG_SHORT_HS_LS_VCC" 12 "DIAG_OPEN_LOAD" 13 "DIAG_SHORT_GND_OR_OPEN_LOAD" 14 "DIAG_SHORT_VCC_OR_OPEN_LOAD" 15 "DIAG_OPEN_SECONDARY" 16 "DIAG_OVER_LOAD" 17 "DIAG_OVER_LOAD_LS" 18 "DIAG_OVER_LOAD_HS" 19 "DIAG_OVER_CURRENT" 20 "DIAG_POWER_SUPPLY_FAIL" 21 "DIAG_TEMPERATURE_FAULT" 22 "DIAG_TEMPERATURE_WARNING" 23 "DIAG_CURRENT_LIMITATION" 24 "DIAG_UNDERVOLTAGE" 25 "DIAG_LOAD_ENABLE" 26 "DIAG_BUS_OFF" /end COMPU_VTAB
/begin RECORD_LAYOUT Lookup1D_UWORD FNC_VALUES 1 UWORD COLUMN_DIR DIRECT /end RECORD_LAYOUT
/begin RECORD_LAYOUT Lookup1D_WORD FNC_VALUES 1 SWORD COLUMN_DIR DIRECT /end RECORD_LAYOUT
/begin RECORD_LAYOUT Lookup1D_X_UWORD AXIS_PTS_X 1 UWORD INDEX_INCR DIRECT /end RECORD_LAYOUT
/begin RECORD_LAYOUT Lookup2DSF_UWORD FNC_VALUES 1 UWORD ROW_DIR DIRECT /end RECORD_LAYOUT
/begin RECORD_LAYOUT Lookup2D_UWORD FNC_VALUES 1 UWORD COLUMN_DIR DIRECT /end RECORD_LAYOUT
/begin RECORD_LAYOUT Lookup2D_X_UWORD AXIS_PTS_X 1 UWORD INDEX_INCR DIRECT /end RECORD_LAYOUT
/begin RECORD_LAYOUT Scalar_BOOLEAN FNC_VALUES 1 UBYTE COLUMN_DIR DIRECT /end RECORD_LAYOUT
/begin RECORD_LAYOUT Scalar_FLOAT32_IEEE FNC_VALUES 1 FLOAT32_IEEE COLUMN_DIR DIRECT /end RECORD_LAYOUT
/begin RECORD_LAYOUT Scalar_SWORD FNC_VALUES 1 SWORD COLUMN_DIR DIRECT /end RECORD_LAYOUT
/begin RECORD_LAYOUT Scalar_UBYTE FNC_VALUES 1 UBYTE COLUMN_DIR DIRECT /end RECORD_LAYOUT
/begin RECORD_LAYOUT Scalar_UWORD FNC_VALUES 1 UWORD COLUMN_DIR DIRECT /end RECORD_LAYOUT
/begin RECORD_LAYOUT __UBYTE_Z FNC_VALUES 1 UBYTE ROW_DIR DIRECT /end RECORD_LAYOUT
/begin RECORD_LAYOUT __UWORD_Z FNC_VALUES 1 UWORD ROW_DIR DIRECT /end RECORD_LAYOUT
/end MODULE
/end PROJECT
