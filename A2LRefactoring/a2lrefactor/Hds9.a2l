ASAP2_VERSION 1 70
/begin PROJECT XCPonCANFD "Generated for ETAS and Vector "
/begin MODULE XCPonCANFD "Generated for ETAS and Vector "
/begin MOD_COMMON "XCPonCANFD" BYTE_ORDER MSB_FIRST ALIGNMENT_BYTE 1 ALIGNMENT_WORD 2 ALIGNMENT_LONG 4 ALIGNMENT_FLOAT32_IEEE 4 ALIGNMENT_FLOAT64_IEEE 8 ALIGNMENT_INT64 8 /end MOD_COMMON
/begin MEASUREMENT bsScaleFactor "BPF Gain Stage scale factor of current cylinder" UBYTE bsScaleFactor.Conversion 0 0 0 4 ECU_ADDRESS 0x400017C4 MATRIX_DIM 8 /end MEASUREMENT
/begin MEASUREMENT bsScaleHpf "BPF HPF Stage scale factor" UBYTE bsScaleHpf.Conversion 0 0 0 4 ECU_ADDRESS 0x40001704 /end MEASUREMENT
/begin MEASUREMENT bsScaleLpf "BPF LPF Stage scale factor" UBYTE bsScaleLpf.Conversion 0 0 0 4 ECU_ADDRESS 0x40001705 /end MEASUREMENT
/begin MEASUREMENT bsSetMinus "CruiseControl/PTO MINUS switch - (DigIn4_MflvOn_ID)" UBYTE bsSetMinus.Conversion 0 0 0 1 ECU_ADDRESS 0x400018D3 /end MEASUREMENT
/begin MEASUREMENT bsSetPlus "CruiseControl/PTO PLUS switch - (DigIn3_MflvOn_ID)" UBYTE bsSetPlus.Conversion 0 0 0 1 ECU_ADDRESS 0x400018D2 /end MEASUREMENT
/begin MEASUREMENT bsStartAccDecCbt "Remote engine start request or cabin tilt start switch - (StartAuxReq_ID)" UBYTE bsStartAccDecCbt.Conversion 0 0 0 1 ECU_ADDRESS 0x400018D1 /end MEASUREMENT
/begin MEASUREMENT bsStopCbt "Remote engine stop request or cabin tilt stop switch - (StopAuxReq_ID)" UBYTE bsStopCbt.Conversion 0 0 0 1 ECU_ADDRESS 0x400018D0 /end MEASUREMENT
/begin MEASUREMENT bsT6Vect "Elapsed time between two consecutive crankshaft tooth, expressed in [us]" UWORD bsT6Vect.Conversion 0 0 0 10000 ECU_ADDRESS 0x40001600 MATRIX_DIM 120 /end MEASUREMENT
/begin MEASUREMENT bsTAirBit "Valore in bit della temperatura aria su 10bit (ManTemp_IA)" UWORD bsTAirBit.Conversion 0 0 0 1024 ECU_ADDRESS 0x400018AC /end MEASUREMENT
/begin MEASUREMENT bsTBoostBit "Raw bit value of Boost temperature scaled on 10bit (BoostTemp_IA)" UWORD bsTBoostBit.Conversion 0 0 0 1024 ECU_ADDRESS 0x4000189E /end MEASUREMENT
/begin MEASUREMENT bsTEgrCoolerBit "Raw bit value of Egr Cooler temperature scaled on 10bit (EgrCoolerTemp_IA)" UWORD bsTEgrCoolerBit.Conversion 0 0 0 1024 ECU_ADDRESS 0x4000189A /end MEASUREMENT
/begin MEASUREMENT bsTExhBit "Valore in bit della temperatura gas allo scarico (Exhaust) su 10bit (ExhTemp_IA)" UWORD bsTExhBit.Conversion 0 0 0 1024 ECU_ADDRESS 0x400018A0 /end MEASUREMENT
/begin MEASUREMENT bsTH2OLStatus "Th2o lamp status towards Diagnosis (DM)" UBYTE Lamp100ms_CM_uint8_adm 0 0 0 3 ECU_ADDRESS 0x40001C2D /end MEASUREMENT
/begin MEASUREMENT bsTHR_DiagStatus "Throttle diagnostic status (Driver Value)" UBYTE eDiagStatus.Conversion 0 0 0 255 ECU_ADDRESS 0x40001841 /end MEASUREMENT
/begin MEASUREMENT bsTInjPostDiag "Tempo di iniezione valle di diagnosi e recovery" UWORD bsTInjPostDiag.Conversion 0 0 0 65520 ECU_ADDRESS 0x40001830 /end MEASUREMENT
/begin MEASUREMENT bsTKLOnDTime "Engine run time with STC2 diagnosis confirmed, since the last transition." ULONG bsTKLOnDTime.Conversion 0 0 0 429496729.5 ECU_ADDRESS 0x40001D40 /end MEASUREMENT
/begin MEASUREMENT bsTKLOnDTimeOld "Engine run time with STC2 diagnosis confirmed, since the last transition, stored in EEPROM in the last trip." ULONG bsTKLOnDTimeOld.Conversion 0 0 0 429496729.5 ECU_ADDRESS 0x40001D48 /end MEASUREMENT
/begin MEASUREMENT bsTKLOnTime "Total engine run time with STC2 diagnosis confirmed." ULONG bsTKLOnTime.Conversion 0 0 0 429496729.5 ECU_ADDRESS 0x40001D44 /end MEASUREMENT
/begin MEASUREMENT bsTKLOnTimeOld "Total engine run time with STC2 diagnosis confirmed, stored in EEPROM in the last trip." ULONG bsTKLOnTimeOld.Conversion 0 0 0 429496729.5 ECU_ADDRESS 0x40001D4C /end MEASUREMENT
/begin MEASUREMENT bsTKatBit "Valore in bit della temperatura catalizzatore su 10bit (CatTemp_IA)" UWORD bsTKatBit.Conversion 0 0 0 1024 ECU_ADDRESS 0x400018A2 /end MEASUREMENT
/begin MEASUREMENT bsTMAFBit "Raw bit value of MAF (Mass Air Flow) integrated temperature scaled on 10bit (AirTemp_IA)" UWORD bsTMAFBit.Conversion 0 0 0 1024 ECU_ADDRESS 0x4000189C /end MEASUREMENT
/begin CHARACTERISTIC bsTOOTH_HOLE_PES "Pulses from the CrS hole (at 0°) to the  Phase Event Set (PES)( in the range of [0, 360[° )" VALUE 0xFC00D2 __UWORD_Z 0 bsTOOTH_HOLE_PES.Conversion 0 7 /end CHARACTERISTIC
/begin CHARACTERISTIC bsTOOTH_PES_PEA "Pulses from the Phase Event Set (PES) to the Phase Event Alternate (PEA)" VALUE 0xFC00D4 __UWORD_Z 0 bsTOOTH_PES_PEA.Conversion 0 7 /end CHARACTERISTIC
/begin MEASUREMENT bsTOilBit "Valore in bit della temperatura olio su 10bit (OilTemp_IA)" UWORD bsTOilBit.Conversion 0 0 0 1024 ECU_ADDRESS 0x400018AA /end MEASUREMENT
/begin MEASUREMENT bsTRailBit "Valore in bit della temperatura metano nel rail su 10bit (RailTemp_IA)" UWORD bsTRailBit.Conversion 0 0 0 1024 ECU_ADDRESS 0x400018A6 /end MEASUREMENT
/begin MEASUREMENT bsTaskKey "Check First time key on and key off" UBYTE Digin4ms_CM_boolean_adm 0 0 0 1 ECU_ADDRESS 0x400018E5 /end MEASUREMENT
/begin MEASUREMENT bsTco1ErrFlag "Tco1 msg Error Flag" UBYTE bsTco1ErrFlag.Conversion 0 0 0 1 ECU_ADDRESS 0x40001963 /end MEASUREMENT
/begin MEASUREMENT bsTdcIdx "Current TDC Idx" UBYTE bsTdcIdx.Conversion 0 0 0 7 ECU_ADDRESS 0x40001879 /end MEASUREMENT
/begin MEASUREMENT bsTh2o "Fase nel modo crank" UWORD DiagSym4ms_CM_ufix16_Bn40_adm 0 0 -40 140 ECU_ADDRESS 0x40001BDC /end MEASUREMENT
/begin MEASUREMENT bsTh2oBit "Valore in bit della temperatura acqua su 10bit (CoolantTemp_IA)" UWORD bsTh2oBit.Conversion 0 0 0 1024 ECU_ADDRESS 0x400018AE /end MEASUREMENT
/begin MEASUREMENT bsTh2oLamp "Th2o lamp request from diagnosis manager" UBYTE bsTh2oLamp.Conversion 0 0 0 1 ECU_ADDRESS 0x40001847 /end MEASUREMENT
/begin MEASUREMENT bsTh2o_GOBD "Temperatura acqua motore (for GOBD FF)" UBYTE DiagSym100ms_CM_ufix8_Bn40_degC 0 0 -40 140 ECU_ADDRESS 0x40001C26 /end MEASUREMENT
/begin MEASUREMENT bsThrotPwmSignal "Duty Cylce of PWM throttle body command (THROTTLE_HB)" UWORD bsThrotPwmSignal.Conversion 0 0 0 100 ECU_ADDRESS 0x4000183E /end MEASUREMENT
/begin MEASUREMENT bsThrottleEnable "[INIT=FALSE] Abilitazione throttle body" UBYTE bsThrottleEnable.Conversion 0 0 0 1 ECU_ADDRESS 0x40001844 /end MEASUREMENT
/begin MEASUREMENT bsTimeDateErrFlag "TimeDate msg Error Flag" UBYTE bsTimeDateErrFlag.Conversion 0 0 0 1 ECU_ADDRESS 0x4000196A /end MEASUREMENT
/begin MEASUREMENT bsTimeDateFlag_GOBD "RX TIMEDATE Message available (for GOBD FF)" UBYTE DiagSym100ms_CM_boolean_adm 0 0 0 1 ECU_ADDRESS 0x40001C24 /end MEASUREMENT
/begin MEASUREMENT bsTotEngHours "Accumulated time of operation of engine (Eeprom write)" ULONG bsTotEngHours.Conversion 0 0 0 210554064 ECU_ADDRESS 0x40001DAC /end MEASUREMENT
/begin MEASUREMENT bsTotEngHoursE2prom "Accumulated time of operation of engine (Eeprom read value)" ULONG bsTotEngHoursE2prom.Conversion 0 0 0 210554064 ECU_ADDRESS 0x40001DC8 /end MEASUREMENT
/begin MEASUREMENT bsTotEngMinutes "Accumulated time of operation of engine in minutes (Eeprom write)" ULONG bsTotEngMinutes.Conversion 0 0 0 4294967295 ECU_ADDRESS 0x40001DA8 /end MEASUREMENT
/begin MEASUREMENT bsTotEngMinutesE2prom "Accumulated time of operation of engine (Eeprom read value)" ULONG bsTotEngMinutesE2prom.Conversion 0 0 0 4294967295 ECU_ADDRESS 0x40001DC4 /end MEASUREMENT
/begin MEASUREMENT bsTotEngRevol "Accumulated time of operation engine (Eeprom write) " ULONG bsTotEngRevol.Conversion 0 0 0 4294967040 ECU_ADDRESS 0x40001DB0 /end MEASUREMENT
/begin MEASUREMENT bsTotEngRevolE2prom "Accumulated time of operation engine (Eeprom read value)" ULONG bsTotEngRevolE2prom.Conversion 0 0 0 4294967040 ECU_ADDRESS 0x40001DCC /end MEASUREMENT
/begin MEASUREMENT bsTotWorkedMinutes "Accumulated ECU working time (Eeprom write)" ULONG bsTotWorkedMinutes.Conversion 0 0 0 4294967295 ECU_ADDRESS 0x40001DA4 /end MEASUREMENT
/begin MEASUREMENT bsTotWorkedMinutesE2prom "Accumulated ECU working time (Eeprom read value)" ULONG bsTotWorkedMinutesE2prom.Conversion 0 0 0 4294967295 ECU_ADDRESS 0x40001DC0 /end MEASUREMENT
/begin MEASUREMENT bsTsc1Ctrl1ErrFlag "Tsc1Ctrl1 msg Error Flag" UBYTE bsTsc1Ctrl1ErrFlag.Conversion 0 0 0 1 ECU_ADDRESS 0x40001960 /end MEASUREMENT
/begin MEASUREMENT bsTsc1Ctrl2ErrFlag "Tsc1Ctrl2 msg Error Flag" UBYTE bsTsc1Ctrl2ErrFlag.Conversion 0 0 0 1 ECU_ADDRESS 0x4000195E /end MEASUREMENT
/begin MEASUREMENT bsTsc1LErrFlag "Tsc1 msg Error Flag" UBYTE bsTsc1LErrFlag.Conversion 0 0 0 1 ECU_ADDRESS 0x40001961 /end MEASUREMENT
/begin MEASUREMENT bsTsc1RetErrFlag "Tsc1Ret msg Error Flag" UBYTE bsTsc1RetErrFlag.Conversion 0 0 0 1 ECU_ADDRESS 0x4000195D /end MEASUREMENT
/begin MEASUREMENT bsTurbo2EcuErrFlag "TURBO 2 ECU msg Error Flag" UBYTE bsTurbo2EcuErrFlag.Conversion 0 0 0 1 ECU_ADDRESS 0x40001910 /end MEASUREMENT
/begin MEASUREMENT bsUHR_DiagStatus "UEGO heater diagnostic status" UBYTE eDiagStatus.Conversion 0 0 0 255 ECU_ADDRESS 0x400015DC /end MEASUREMENT
/begin MEASUREMENT bsUSSErrFlag "USS msg Error Flag" UBYTE bsUSSErrFlag.Conversion 0 0 0 1 ECU_ADDRESS 0x40001962 /end MEASUREMENT
/begin MEASUREMENT bsUegoForceStart "Flag that indicates request from UDS for starting UEGO heating" UBYTE bsUegoForceStart.Conversion 0 0 0 1 ECU_ADDRESS 0x400015E0 /end MEASUREMENT
/begin MEASUREMENT bsUegoHeaterDC "UEGO Heater PWM duty cycle" UWORD Ctit_UEGOHeater4ms_CM_uint16_adm 0 0 0 65535 ECU_ADDRESS 0x400015DE /end MEASUREMENT
/begin MEASUREMENT bsUegoInRunning "Flag that indicates if the UEGO Driver is in Running Mode" UBYTE bsUegoInRunning.Conversion 0 0 0 1 ECU_ADDRESS 0x400015E1 /end MEASUREMENT
/begin MEASUREMENT bsUegoIp "Current Ip normalized read by cj135 on linear UEGO sensor (LSU 4.9)" UWORD bsUegoIp.Conversion 0 0 -3 3 ECU_ADDRESS 0x400015E6 /end MEASUREMENT
/begin MEASUREMENT bsUegoIpOk "Flag that indicates the validity of the UEGO Ip Current Value" UBYTE bsUegoIpOk.Conversion 0 0 0 1 ECU_ADDRESS 0x400015E2 /end MEASUREMENT
/begin MEASUREMENT bsUegoRawIp "Current Ip normalized read by cj135 on linear UEGO sensor (LSU 4.9) without aging and thermal compensation" UWORD bsUegoRawIp.Conversion 0 0 -3 3 ECU_ADDRESS 0x400015E4 /end MEASUREMENT
/begin MEASUREMENT bsUegoRie "UEGO heater resistance" FLOAT32_IEEE bsUegoRie.Conversion 0 0 0 1000000 ECU_ADDRESS 0x400015EC /end MEASUREMENT
/begin MEASUREMENT bsUegoRieTarget "UEGO heater target resistance" UWORD bsUegoRieTarget.Conversion 0 0 51 1023 ECU_ADDRESS 0x400015E8 /end MEASUREMENT
/begin MEASUREMENT bsUego_DiagStatus "UEGO sensor diagnostic status (Driver and sensor)" UBYTE eDiagStatus.Conversion 0 0 0 255 ECU_ADDRESS 0x400015DD /end MEASUREMENT
/begin MEASUREMENT bsVBPWBit "Valore in bit della tensione valle relay carichi su 10bit (DirPwrSply_IA)" UWORD bsVBPWBit.Conversion 0 0 0 1024 ECU_ADDRESS 0x400018C6 /end MEASUREMENT
/begin MEASUREMENT bsVBPWStatus "Check if bsVBPWBit is inside diagnostic work range (bsKEY_SW_LOW:bsKEY_SW_HIGH)[V] status flag (1 = in range) " UBYTE bsVBPWStatus.Conversion 0 0 0 1 ECU_ADDRESS 0x400018C4 /end MEASUREMENT
/begin CHARACTERISTIC bsVBPW_STATUS_COUNTER "Higher threshold related to bsVBPW to define if Diagnostic Managers shall operate (according with bsVBPWStatus)" VALUE 0xFC008E __UWORD_Z 0 bsVBPW_STATUS_COUNTER.Conversion 0 8000 /end CHARACTERISTIC
/begin MEASUREMENT bsVBattBit "Valore in bit della tensione batteria diretta su 10bit (DirPwrSply_IA)" UWORD bsVBattBit.Conversion 0 0 0 1024 ECU_ADDRESS 0x400018B4 /end MEASUREMENT
/begin MEASUREMENT bsVEP1_Tx_Enable "Abilitazione messaggio J1939 - VEP1" UBYTE J1939dl_Tx1s_CM_boolean_adm 0 0 0 1 ECU_ADDRESS 0x4000194B /end MEASUREMENT
/begin MEASUREMENT bsVEP1_Tx_Msg "VEP1 Tx Can message" UBYTE J1939dl_Tx1s_CM_uint8_adm 0 0 0 255 ECU_ADDRESS 0x1000 MATRIX_DIM 8 /end MEASUREMENT
/begin MEASUREMENT bsVS1Bit "Valore in bit della linea di alimentazione sensori Voltage Supplier 1 (assoluta) su 10bit (SensSply1_IA)" UWORD bsVS1Bit.Conversion 0 0 0 1024 ECU_ADDRESS 0x40001894 /end MEASUREMENT
/begin MEASUREMENT bsVS2Bit "Valore in bit della linea di alimentazione sensori Voltage Supplier 2 (assoluta) su 10bit (SensSply2_IA)" UWORD bsVS2Bit.Conversion 0 0 0 1024 ECU_ADDRESS 0x40001892 /end MEASUREMENT
/begin MEASUREMENT bsVS3Bit "Valore in bit della linea di alimentazione sensori Voltage Supplier 3 (assoluta) su 10bit (SensSply3_IA)" UWORD bsVS3Bit.Conversion 0 0 0 1024 ECU_ADDRESS 0x40001890 /end MEASUREMENT
/begin MEASUREMENT bsV_Nlp "Tensione NLP letta sul potenziometro principale e fornita dal blocco di self learning (EpromWrite)" UWORD bsV_Nlp.Conversion 0 0 0 5 ECU_ADDRESS 0x40001DD2 /end MEASUREMENT
/begin MEASUREMENT bsV_Nlp_Ram "Tensione NLP in RAM" UWORD bsV_Nlp_Ram.Conversion 0 0 0 5 ECU_ADDRESS 0x40001DDA /end MEASUREMENT
/begin MEASUREMENT bsV_Uma "Tensione UMA letta sul potenziometro principale e fornita dal blocco di self learning (EpromWrite)" UWORD bsV_Uma.Conversion 0 0 0 5 ECU_ADDRESS 0x40001DD4 /end MEASUREMENT
/begin MEASUREMENT bsV_Uma_Ram "Tensione UMA in RAM" UWORD bsV_Uma_Ram.Conversion 0 0 0 5 ECU_ADDRESS 0x40001DD8 /end MEASUREMENT
/begin MEASUREMENT bsVcm2EcmErrFlag "Vcm2Ecm msg Error Flag" UBYTE bsVcm2EcmErrFlag.Conversion 0 0 0 1 ECU_ADDRESS 0x40001966 /end MEASUREMENT
/begin MEASUREMENT bsVehSpeedLim "Speed limiter request switch - (NeutralSw_ID)" UBYTE bsVehSpeedLim.Conversion 0 0 0 1 ECU_ADDRESS 0x400018CF /end MEASUREMENT
/begin MEASUREMENT bsVehSpeedSens "Velocita\' veicolo [da sensore]" UWORD bsVehSpeedSens.Conversion 0 0 0 65535 ECU_ADDRESS 0x4000188C /end MEASUREMENT
/begin MEASUREMENT bsWGTDuty "Duty Cylce of PWM Waste gate turbo command (Turbo_OF)" UWORD bsWGTDuty.Conversion 0 0 0 100 ECU_ADDRESS 0x4000186E /end MEASUREMENT
/begin MEASUREMENT bsWGT_DiagStatus "Waste gate turbo diagnostic status (Driver Value)" UBYTE eDiagStatus.Conversion 0 0 0 255 ECU_ADDRESS 0x40001870 /end MEASUREMENT
/begin MEASUREMENT bsWRNLCmd "Comando Warning lamp (after Recovery) to BSWL" UBYTE Lamp100ms_CM_boolean_adm 0 0 0 1 ECU_ADDRESS 0x4000184E /end MEASUREMENT
/begin MEASUREMENT bsWRNLStatus "Warning lamp status towards Diagnosis (DM)" UBYTE Lamp100ms_CM_uint8_adm 0 0 0 3 ECU_ADDRESS 0x40001C30 /end MEASUREMENT
/begin MEASUREMENT bsWRNL_DiagStatus "Driver diagnosis related to Warning Lamp. (Digital Out)" UBYTE eDiagStatus.Conversion 0 0 0 255 ECU_ADDRESS 0x40001850 /end MEASUREMENT
/begin MEASUREMENT bsWinAdv "Advance with respect to TDC, for each cylinder, for the starting angle of the knock integration window" SWORD bsWinAdv.Conversion 0 0 -60 60 ECU_ADDRESS 0x4000179C MATRIX_DIM 8 /end MEASUREMENT
/begin MEASUREMENT bsWinLength "Starting angle for the filtering window, for knock detection" UWORD bsWinLength.Conversion 0 0 0 119.9 ECU_ADDRESS 0x400017AC MATRIX_DIM 8 /end MEASUREMENT
/begin MEASUREMENT bsWinStartAngle "Starting angle for the filtering window, for knock detection" ULONG bsWinStartAngle.Conversion 0 0 0 719.9 ECU_ADDRESS 0x40001754 MATRIX_DIM 8 /end MEASUREMENT
/begin MEASUREMENT bsWorkedMinutes "CPU worked minutes counter" ULONG bsWorkedMinutes.Conversion 0 0 0 4294967295 ECU_ADDRESS 0x400015D8 /end MEASUREMENT
/begin MEASUREMENT bsWorkedTime_GOBD "Total working minutes (since last flahsing) for GOBD FF" ULONG DiagSym100ms_CM_uint32_min 0 0 0 4294967295 ECU_ADDRESS 0x40001C20 /end MEASUREMENT
/begin MEASUREMENT bsWrnLamp "Warning lamp request from diagnosis manager" UBYTE bsWrnLamp.Conversion 0 0 0 1 ECU_ADDRESS 0x4000184F /end MEASUREMENT
/begin CHARACTERISTIC bs_DiagMgmCan1_THR "Counter threshold above which the FcanA diagnosis is no more reset" VALUE 0xFC007C __UWORD_Z 0 bs_DiagMgmCan1_THR.Conversion 0 65000 /end CHARACTERISTIC
/begin CHARACTERISTIC bs_DiagMgmCan2_THR "Counter threshold above which the FcanB diagnosis is no more reset" VALUE 0xFC007E __UWORD_Z 0 bs_DiagMgmCan2_THR.Conversion 0 65000 /end CHARACTERISTIC
/begin CHARACTERISTIC bs_DiagMgmCan3_THR "Counter threshold above which the FcanC diagnosis is no more reset" VALUE 0xFC0080 __UWORD_Z 0 bs_DiagMgmCan3_THR.Conversion 0 65000 /end CHARACTERISTIC
/begin CHARACTERISTIC bs_DiagMgmCan4_THR "Counter threshold above which the FcanD diagnosis is no more reset" VALUE 0xFC0082 __UWORD_Z 0 bs_DiagMgmCan4_THR.Conversion 0 65000 /end CHARACTERISTIC
/begin CHARACTERISTIC bs_DiagMgm_AcClutch_PresRed_THR "Counter threshold above which the AcClutch_PresRed diagnosis is no more reset" VALUE 0xFC0066 __UWORD_Z 0 bs_DiagMgm_AcClutch_PresRed_THR.Conversion 0 65000 /end CHARACTERISTIC
/begin CHARACTERISTIC bs_DiagMgm_BlowBy_THR "Counter threshold above which the BlowBy diagnosis is no more reset" VALUE 0xFC0052 __UWORD_Z 0 bs_DiagMgm_BlowBy_THR.Conversion 0 65000 /end CHARACTERISTIC
/begin CHARACTERISTIC bs_DiagMgm_DumpValve_THR "Counter threshold above which the DumpValve diagnosis is no more reset" VALUE 0xFC0054 __UWORD_Z 0 bs_DiagMgm_DumpValve_THR.Conversion 0 65000 /end CHARACTERISTIC
/begin CHARACTERISTIC bs_DiagMgm_EPMGEN_CAM_THR "Counter threshold above which the EPMGEN_CAM diagnosis is no more reset" VALUE 0xFC0070 __UWORD_Z 0 bs_DiagMgm_EPMGEN_CAM_THR.Conversion 0 65000 /end CHARACTERISTIC
/begin CHARACTERISTIC bs_DiagMgm_EPMGEN_CRK_THR "Counter threshold above which the EPMGEN_CRK diagnosis is no more reset" VALUE 0xFC0072 __UWORD_Z 0 bs_DiagMgm_EPMGEN_CRK_THR.Conversion 0 65000 /end CHARACTERISTIC
/begin CHARACTERISTIC bs_DiagMgm_EngBrake_THR "Counter threshold above which the EngBrake diagnosis is no more reset" VALUE 0xFC0056 __UWORD_Z 0 bs_DiagMgm_EngBrake_THR.Conversion 0 65000 /end CHARACTERISTIC
/begin CHARACTERISTIC bs_DiagMgm_Fan1_THR "Counter threshold above which the Fan1 diagnosis is no more reset" VALUE 0xFC006A __UWORD_Z 0 bs_DiagMgm_Fan1_THR.Conversion 0 65000 /end CHARACTERISTIC
/begin CHARACTERISTIC bs_DiagMgm_Fan2_THR "Counter threshold above which the Fan2 diagnosis is no more reset" VALUE 0xFC0068 __UWORD_Z 0 bs_DiagMgm_Fan2_THR.Conversion 0 65000 /end CHARACTERISTIC
/begin CHARACTERISTIC bs_DiagMgm_FuelPumpHs_THR "Counter threshold above which the FuelPumpHs diagnosis is no more reset" VALUE 0xFC00DE __UWORD_Z 0 bs_DiagMgm_FuelPumpHs_THR.Conversion 0 65000 /end CHARACTERISTIC
/begin CHARACTERISTIC bs_DiagMgm_FuelPumpLs_THR "Counter threshold above which the FuelPumpLs diagnosis is no more reset" VALUE 0xFC0058 __UWORD_Z 0 bs_DiagMgm_FuelPumpLs_THR.Conversion 0 65000 /end CHARACTERISTIC
/begin CHARACTERISTIC bs_DiagMgm_HBridgeCmdxx_THR "Counter threshold above which the HBridgeCmdxx diagnosis is no more reset" VAL_BLK 0xFC0078 __UWORD_Z 0 bs_DiagMgm_HBridgeCmdxx_THR.Conversion 0 65000 MATRIX_DIM 2 /end CHARACTERISTIC
/begin CHARACTERISTIC bs_DiagMgm_IgnCmdxx_THR "Counter threshold above which the Ignition diagnosis is no more reset" VAL_BLK 0xFC0030 __UWORD_Z 0 bs_DiagMgm_IgnCmdxx_THR.Conversion 0 65000 MATRIX_DIM 8 /end CHARACTERISTIC
/begin CHARACTERISTIC bs_DiagMgm_InjCmdxx_THR "Counter threshold above which the Injection diagnosis is no more reset" VAL_BLK 0xFC0040 __UWORD_Z 0 bs_DiagMgm_InjCmdxx_THR.Conversion 0 65000 MATRIX_DIM 8 /end CHARACTERISTIC
/begin CHARACTERISTIC bs_DiagMgm_LoadRelay_THR "Counter threshold above which the LoadRelay diagnosis is no more reset" VALUE 0xFC00D8 __UWORD_Z 0 bs_DiagMgm_LoadRelay_THR.Conversion 0 65000 /end CHARACTERISTIC
/begin CHARACTERISTIC bs_DiagMgm_Mil_THR "Counter threshold above which the Mil diagnosis is no more reset" VALUE 0xFC0060 __UWORD_Z 0 bs_DiagMgm_Mil_THR.Conversion 0 65000 /end CHARACTERISTIC
/begin CHARACTERISTIC bs_DiagMgm_PostCatHeater_THR "Counter threshold above which the PostCatHeater diagnosis is no more reset" VALUE 0xFC0076 __UWORD_Z 0 bs_DiagMgm_PostCatHeater_THR.Conversion 0 65000 /end CHARACTERISTIC
/begin CHARACTERISTIC bs_DiagMgm_PreCatHeater_THR "Counter threshold above which the PreCatHeater diagnosis is no more reset" VALUE 0xFC00DA __UWORD_Z 0 bs_DiagMgm_PreCatHeater_THR.Conversion 0 65000 /end CHARACTERISTIC
/begin CHARACTERISTIC bs_DiagMgm_PresRegValve_THR "Counter threshold above which the PresRegValve diagnosis is no more reset" VALUE 0xFC006E __UWORD_Z 0 bs_DiagMgm_PresRegValve_THR.Conversion 0 65000 /end CHARACTERISTIC
/begin CHARACTERISTIC bs_DiagMgm_RedLamp_THR "Counter threshold above which the RedLamp diagnosis is no more reset" VALUE 0xFC0062 __UWORD_Z 0 bs_DiagMgm_RedLamp_THR.Conversion 0 65000 /end CHARACTERISTIC
/begin CHARACTERISTIC bs_DiagMgm_Rpm_THR "Counter threshold above which the Rpm diagnosis is no more reset" VALUE 0xFC006C __UWORD_Z 0 bs_DiagMgm_Rpm_THR.Conversion 0 65000 /end CHARACTERISTIC
/begin CHARACTERISTIC bs_DiagMgm_StarterHs_THR "Counter threshold above which the StarterHs diagnosis is no more reset" VALUE 0xFC00DC __UWORD_Z 0 bs_DiagMgm_StarterHs_THR.Conversion 0 65000 /end CHARACTERISTIC
/begin CHARACTERISTIC bs_DiagMgm_StarterLs_THR "Counter threshold above which the StarterLs diagnosis is no more reset" VALUE 0xFC0050 __UWORD_Z 0 bs_DiagMgm_StarterLs_THR.Conversion 0 65000 /end CHARACTERISTIC
/begin CHARACTERISTIC bs_DiagMgm_TankValve1_THR "Counter threshold above which the TankValve1 diagnosis is no more reset" VALUE 0xFC005C __UWORD_Z 0 bs_DiagMgm_TankValve1_THR.Conversion 0 65000 /end CHARACTERISTIC
/begin CHARACTERISTIC bs_DiagMgm_TankValve2_THR "Counter threshold above which the TankValve2 diagnosis is no more reset" VALUE 0xFC005E __UWORD_Z 0 bs_DiagMgm_TankValve2_THR.Conversion 0 65000 /end CHARACTERISTIC
/begin CHARACTERISTIC bs_DiagMgm_Turbo_THR "Counter threshold above which the Turbo diagnosis is no more reset" VALUE 0xFC005A __UWORD_Z 0 bs_DiagMgm_Turbo_THR.Conversion 0 65000 /end CHARACTERISTIC
/begin CHARACTERISTIC bs_DiagMgm_UegoHeater_THR "Counter threshold above which the UegoHeater diagnosis is no more reset" VALUE 0xFC0074 __UWORD_Z 0 bs_DiagMgm_UegoHeater_THR.Conversion 0 65000 /end CHARACTERISTIC
/begin CHARACTERISTIC bs_DiagMgm_UegoSensor_THR "Counter threshold above which the Uego Signals/Sensor diagnosis is no more reset" VALUE 0xFC0084 __UWORD_Z 0 bs_DiagMgm_UegoSensor_THR.Conversion 0 65000 /end CHARACTERISTIC
/begin CHARACTERISTIC bs_DiagMgm_WarnLamp_THR "Counter threshold above which the WarnLamp diagnosis is no more reset" VALUE 0xFC0064 __UWORD_Z 0 bs_DiagMgm_WarnLamp_THR.Conversion 0 65000 /end CHARACTERISTIC
/begin MEASUREMENT bvAdvCOILx[0] "Ignition Timing offset (in degrees with TDC event as reference)" SWORD bvAdvCOILx.Conversion 0 0 -20 60 ECU_ADDRESS 0x4000180E SYMBOL_LINK "bvAdvCOILx" 0 /end MEASUREMENT
/begin MEASUREMENT bvAdvCOILx[1] "Ignition Timing offset (in degrees with TDC event as reference)" SWORD bvAdvCOILx.Conversion 0 0 -20 60 ECU_ADDRESS 0x40001810 SYMBOL_LINK "bvAdvCOILx" 2 /end MEASUREMENT
/begin MEASUREMENT bvAdvCOILx[2] "Ignition Timing offset (in degrees with TDC event as reference)" SWORD bvAdvCOILx.Conversion 0 0 -20 60 ECU_ADDRESS 0x40001812 SYMBOL_LINK "bvAdvCOILx" 4 /end MEASUREMENT
/begin MEASUREMENT bvAdvCOILx[3] "Ignition Timing offset (in degrees with TDC event as reference)" SWORD bvAdvCOILx.Conversion 0 0 -20 60 ECU_ADDRESS 0x40001814 SYMBOL_LINK "bvAdvCOILx" 6 /end MEASUREMENT
/begin MEASUREMENT bvAdvCOILx[4] "Ignition Timing offset (in degrees with TDC event as reference)" SWORD bvAdvCOILx.Conversion 0 0 -20 60 ECU_ADDRESS 0x40001816 SYMBOL_LINK "bvAdvCOILx" 8 /end MEASUREMENT
/begin MEASUREMENT bvAdvCOILx[5] "Ignition Timing offset (in degrees with TDC event as reference)" SWORD bvAdvCOILx.Conversion 0 0 -20 60 ECU_ADDRESS 0x40001818 SYMBOL_LINK "bvAdvCOILx" 10 /end MEASUREMENT
/begin MEASUREMENT bvAdvCOILx[6] "Ignition Timing offset (in degrees with TDC event as reference)" SWORD bvAdvCOILx.Conversion 0 0 -20 60 ECU_ADDRESS 0x4000181A SYMBOL_LINK "bvAdvCOILx" 12 /end MEASUREMENT
/begin MEASUREMENT bvAdvCOILx[7] "Ignition Timing offset (in degrees with TDC event as reference)" SWORD bvAdvCOILx.Conversion 0 0 -20 60 ECU_ADDRESS 0x4000181C SYMBOL_LINK "bvAdvCOILx" 14 /end MEASUREMENT
/begin MEASUREMENT bvCOILx_DwTime[0] "Ignition Dwell time duration" UWORD bvCOILx_DwTime.Conversion 0 0 0 6000 ECU_ADDRESS 0x400017FE SYMBOL_LINK "bvCOILx_DwTime" 0 /end MEASUREMENT
/begin MEASUREMENT bvCOILx_DwTime[1] "Ignition Dwell time duration" UWORD bvCOILx_DwTime.Conversion 0 0 0 6000 ECU_ADDRESS 0x40001800 SYMBOL_LINK "bvCOILx_DwTime" 2 /end MEASUREMENT
/begin MEASUREMENT bvCOILx_DwTime[2] "Ignition Dwell time duration" UWORD bvCOILx_DwTime.Conversion 0 0 0 6000 ECU_ADDRESS 0x40001802 SYMBOL_LINK "bvCOILx_DwTime" 4 /end MEASUREMENT
/begin MEASUREMENT bvCOILx_DwTime[3] "Ignition Dwell time duration" UWORD bvCOILx_DwTime.Conversion 0 0 0 6000 ECU_ADDRESS 0x40001804 SYMBOL_LINK "bvCOILx_DwTime" 6 /end MEASUREMENT
/begin MEASUREMENT bvCOILx_DwTime[4] "Ignition Dwell time duration" UWORD bvCOILx_DwTime.Conversion 0 0 0 6000 ECU_ADDRESS 0x40001806 SYMBOL_LINK "bvCOILx_DwTime" 8 /end MEASUREMENT
/begin MEASUREMENT bvCOILx_DwTime[5] "Ignition Dwell time duration" UWORD bvCOILx_DwTime.Conversion 0 0 0 6000 ECU_ADDRESS 0x40001808 SYMBOL_LINK "bvCOILx_DwTime" 10 /end MEASUREMENT
/begin MEASUREMENT bvCOILx_DwTime[6] "Ignition Dwell time duration" UWORD bvCOILx_DwTime.Conversion 0 0 0 6000 ECU_ADDRESS 0x4000180A SYMBOL_LINK "bvCOILx_DwTime" 12 /end MEASUREMENT
/begin MEASUREMENT bvCOILx_DwTime[7] "Ignition Dwell time duration" UWORD bvCOILx_DwTime.Conversion 0 0 0 6000 ECU_ADDRESS 0x4000180C SYMBOL_LINK "bvCOILx_DwTime" 14 /end MEASUREMENT
/begin MEASUREMENT bvEcuTCntEE[0] "Numero di occorrenze per classe di temperatura (da 1 a 8) (Eeprom Read Value)" ULONG bvEcuTCntEE.Conversion 0 0 0 4294967040 ECU_ADDRESS 0x40001D74 SYMBOL_LINK "bvEcuTCntEE" 0 /end MEASUREMENT
/begin MEASUREMENT bvEcuTCntEE[1] "Numero di occorrenze per classe di temperatura (da 1 a 8) (Eeprom Read Value)" ULONG bvEcuTCntEE.Conversion 0 0 0 4294967040 ECU_ADDRESS 0x40001D78 SYMBOL_LINK "bvEcuTCntEE" 4 /end MEASUREMENT
/begin MEASUREMENT bvEcuTCntEE[2] "Numero di occorrenze per classe di temperatura (da 1 a 8) (Eeprom Read Value)" ULONG bvEcuTCntEE.Conversion 0 0 0 4294967040 ECU_ADDRESS 0x40001D7C SYMBOL_LINK "bvEcuTCntEE" 8 /end MEASUREMENT
/begin MEASUREMENT bvEcuTCntEE[3] "Numero di occorrenze per classe di temperatura (da 1 a 8) (Eeprom Read Value)" ULONG bvEcuTCntEE.Conversion 0 0 0 4294967040 ECU_ADDRESS 0x40001D80 SYMBOL_LINK "bvEcuTCntEE" 12 /end MEASUREMENT
/begin MEASUREMENT bvEcuTCntEE[4] "Numero di occorrenze per classe di temperatura (da 1 a 8) (Eeprom Read Value)" ULONG bvEcuTCntEE.Conversion 0 0 0 4294967040 ECU_ADDRESS 0x40001D84 SYMBOL_LINK "bvEcuTCntEE" 16 /end MEASUREMENT
/begin MEASUREMENT bvEcuTCntEE[5] "Numero di occorrenze per classe di temperatura (da 1 a 8) (Eeprom Read Value)" ULONG bvEcuTCntEE.Conversion 0 0 0 4294967040 ECU_ADDRESS 0x40001D88 SYMBOL_LINK "bvEcuTCntEE" 20 /end MEASUREMENT
/begin MEASUREMENT bvEcuTCntEE[6] "Numero di occorrenze per classe di temperatura (da 1 a 8) (Eeprom Read Value)" ULONG bvEcuTCntEE.Conversion 0 0 0 4294967040 ECU_ADDRESS 0x40001D8C SYMBOL_LINK "bvEcuTCntEE" 24 /end MEASUREMENT
/begin MEASUREMENT bvEcuTCntEE[7] "Numero di occorrenze per classe di temperatura (da 1 a 8) (Eeprom Read Value)" ULONG bvEcuTCntEE.Conversion 0 0 0 4294967040 ECU_ADDRESS 0x40001D90 SYMBOL_LINK "bvEcuTCntEE" 28 /end MEASUREMENT
/begin MEASUREMENT bvEcuTCnt[0] "Numero di occorrenze per classe di temperatura (da 1 a 8) (Eeprom Write)" ULONG bvEcuTCnt.Conversion 0 0 0 4294967040 ECU_ADDRESS 0x40001D54 SYMBOL_LINK "bvEcuTCnt" 0 /end MEASUREMENT
/begin MEASUREMENT bvEcuTCnt[1] "Numero di occorrenze per classe di temperatura (da 1 a 8) (Eeprom Write)" ULONG bvEcuTCnt.Conversion 0 0 0 4294967040 ECU_ADDRESS 0x40001D58 SYMBOL_LINK "bvEcuTCnt" 4 /end MEASUREMENT
/begin MEASUREMENT bvEcuTCnt[2] "Numero di occorrenze per classe di temperatura (da 1 a 8) (Eeprom Write)" ULONG bvEcuTCnt.Conversion 0 0 0 4294967040 ECU_ADDRESS 0x40001D5C SYMBOL_LINK "bvEcuTCnt" 8 /end MEASUREMENT
/begin MEASUREMENT bvEcuTCnt[3] "Numero di occorrenze per classe di temperatura (da 1 a 8) (Eeprom Write)" ULONG bvEcuTCnt.Conversion 0 0 0 4294967040 ECU_ADDRESS 0x40001D60 SYMBOL_LINK "bvEcuTCnt" 12 /end MEASUREMENT
/begin MEASUREMENT bvEcuTCnt[4] "Numero di occorrenze per classe di temperatura (da 1 a 8) (Eeprom Write)" ULONG bvEcuTCnt.Conversion 0 0 0 4294967040 ECU_ADDRESS 0x40001D64 SYMBOL_LINK "bvEcuTCnt" 16 /end MEASUREMENT
/begin MEASUREMENT bvEcuTCnt[5] "Numero di occorrenze per classe di temperatura (da 1 a 8) (Eeprom Write)" ULONG bvEcuTCnt.Conversion 0 0 0 4294967040 ECU_ADDRESS 0x40001D68 SYMBOL_LINK "bvEcuTCnt" 20 /end MEASUREMENT
/begin MEASUREMENT bvEcuTCnt[6] "Numero di occorrenze per classe di temperatura (da 1 a 8) (Eeprom Write)" ULONG bvEcuTCnt.Conversion 0 0 0 4294967040 ECU_ADDRESS 0x40001D6C SYMBOL_LINK "bvEcuTCnt" 24 /end MEASUREMENT
/begin MEASUREMENT bvEcuTCnt[7] "Numero di occorrenze per classe di temperatura (da 1 a 8) (Eeprom Write)" ULONG bvEcuTCnt.Conversion 0 0 0 4294967040 ECU_ADDRESS 0x40001D70 SYMBOL_LINK "bvEcuTCnt" 28 /end MEASUREMENT
/begin CHARACTERISTIC bvIgnPhysicalChannel "Ignition physical channel (relative to cylinder) for programming ignition" VAL_BLK 0xFC0018 __UBYTE_Z 0 bvIgnPhysicalChannel.Conversion 0 255 MATRIX_DIM 8 /end CHARACTERISTIC
/begin CHARACTERISTIC bvInjPhysicalChannel "Injection physical channel (relative to cylinder) for programming injection" VAL_BLK 0xFC0010 __UBYTE_Z 0 bvInjPhysicalChannel.Conversion 0 255 MATRIX_DIM 8 /end CHARACTERISTIC
/begin MEASUREMENT bvTINJx[0] "Tempo di iniezione valle di diagnosi e recovery" UWORD bvTINJx.Conversion 0 0 0 65520 ECU_ADDRESS 0x40001820 SYMBOL_LINK "bvTINJx" 0 /end MEASUREMENT
/begin MEASUREMENT bvTINJx[1] "Tempo di iniezione valle di diagnosi e recovery" UWORD bvTINJx.Conversion 0 0 0 65520 ECU_ADDRESS 0x40001822 SYMBOL_LINK "bvTINJx" 2 /end MEASUREMENT
/begin MEASUREMENT bvTINJx[2] "Tempo di iniezione valle di diagnosi e recovery" UWORD bvTINJx.Conversion 0 0 0 65520 ECU_ADDRESS 0x40001824 SYMBOL_LINK "bvTINJx" 4 /end MEASUREMENT
/begin MEASUREMENT bvTINJx[3] "Tempo di iniezione valle di diagnosi e recovery" UWORD bvTINJx.Conversion 0 0 0 65520 ECU_ADDRESS 0x40001826 SYMBOL_LINK "bvTINJx" 6 /end MEASUREMENT
/begin MEASUREMENT bvTINJx[4] "Tempo di iniezione valle di diagnosi e recovery" UWORD bvTINJx.Conversion 0 0 0 65520 ECU_ADDRESS 0x40001828 SYMBOL_LINK "bvTINJx" 8 /end MEASUREMENT
/begin MEASUREMENT bvTINJx[5] "Tempo di iniezione valle di diagnosi e recovery" UWORD bvTINJx.Conversion 0 0 0 65520 ECU_ADDRESS 0x4000182A SYMBOL_LINK "bvTINJx" 10 /end MEASUREMENT
/begin MEASUREMENT bvTINJx[6] "Tempo di iniezione valle di diagnosi e recovery" UWORD bvTINJx.Conversion 0 0 0 65520 ECU_ADDRESS 0x4000182C SYMBOL_LINK "bvTINJx" 12 /end MEASUREMENT
/begin MEASUREMENT bvTINJx[7] "Tempo di iniezione valle di diagnosi e recovery" UWORD bvTINJx.Conversion 0 0 0 65520 ECU_ADDRESS 0x4000182E SYMBOL_LINK "bvTINJx" 14 /end MEASUREMENT
/begin MEASUREMENT bvVcoMdc1GEE[0] "FlyWheelDyssimmetriesCorrection stored in EEPROM (1G)" FLOAT32_IEEE bvVcoMdc1GEE.Conversion 0 0 -0.1 0.1 ECU_ADDRESS 0x40001D20 SYMBOL_LINK "bvVcoMdc1GEE" 0 /end MEASUREMENT
/begin MEASUREMENT bvVcoMdc1GEE[1] "FlyWheelDyssimmetriesCorrection stored in EEPROM (1G)" FLOAT32_IEEE bvVcoMdc1GEE.Conversion 0 0 -0.1 0.1 ECU_ADDRESS 0x40001D24 SYMBOL_LINK "bvVcoMdc1GEE" 4 /end MEASUREMENT
/begin MEASUREMENT bvVcoMdc1GEE[2] "FlyWheelDyssimmetriesCorrection stored in EEPROM (1G)" FLOAT32_IEEE bvVcoMdc1GEE.Conversion 0 0 -0.1 0.1 ECU_ADDRESS 0x40001D28 SYMBOL_LINK "bvVcoMdc1GEE" 8 /end MEASUREMENT
/begin MEASUREMENT bvVcoMdc1GEE[3] "FlyWheelDyssimmetriesCorrection stored in EEPROM (1G)" FLOAT32_IEEE bvVcoMdc1GEE.Conversion 0 0 -0.1 0.1 ECU_ADDRESS 0x40001D2C SYMBOL_LINK "bvVcoMdc1GEE" 12 /end MEASUREMENT
/begin MEASUREMENT bvVcoMdc1GEE[4] "FlyWheelDyssimmetriesCorrection stored in EEPROM (1G)" FLOAT32_IEEE bvVcoMdc1GEE.Conversion 0 0 -0.1 0.1 ECU_ADDRESS 0x40001D30 SYMBOL_LINK "bvVcoMdc1GEE" 16 /end MEASUREMENT
/begin MEASUREMENT bvVcoMdc1GEE[5] "FlyWheelDyssimmetriesCorrection stored in EEPROM (1G)" FLOAT32_IEEE bvVcoMdc1GEE.Conversion 0 0 -0.1 0.1 ECU_ADDRESS 0x40001D34 SYMBOL_LINK "bvVcoMdc1GEE" 20 /end MEASUREMENT
/begin MEASUREMENT bvVcoMdc1GEE[6] "FlyWheelDyssimmetriesCorrection stored in EEPROM (1G)" FLOAT32_IEEE bvVcoMdc1GEE.Conversion 0 0 -0.1 0.1 ECU_ADDRESS 0x40001D38 SYMBOL_LINK "bvVcoMdc1GEE" 24 /end MEASUREMENT
/begin MEASUREMENT bvVcoMdc1GEE[7] "FlyWheelDyssimmetriesCorrection stored in EEPROM (1G)" FLOAT32_IEEE bvVcoMdc1GEE.Conversion 0 0 -0.1 0.1 ECU_ADDRESS 0x40001D3C SYMBOL_LINK "bvVcoMdc1GEE" 28 /end MEASUREMENT
/begin MEASUREMENT bvVcoMdc2GEE[0] "FlyWheelDyssimmetriesCorrection stored in EEPROM (2G)" FLOAT32_IEEE bvVcoMdc2GEE.Conversion 0 0 -0.1 0.1 ECU_ADDRESS 0x40001D00 SYMBOL_LINK "bvVcoMdc2GEE" 0 /end MEASUREMENT
/begin MEASUREMENT bvVcoMdc2GEE[1] "FlyWheelDyssimmetriesCorrection stored in EEPROM (2G)" FLOAT32_IEEE bvVcoMdc2GEE.Conversion 0 0 -0.1 0.1 ECU_ADDRESS 0x40001D04 SYMBOL_LINK "bvVcoMdc2GEE" 4 /end MEASUREMENT
/begin MEASUREMENT bvVcoMdc2GEE[2] "FlyWheelDyssimmetriesCorrection stored in EEPROM (2G)" FLOAT32_IEEE bvVcoMdc2GEE.Conversion 0 0 -0.1 0.1 ECU_ADDRESS 0x40001D08 SYMBOL_LINK "bvVcoMdc2GEE" 8 /end MEASUREMENT
/begin MEASUREMENT bvVcoMdc2GEE[3] "FlyWheelDyssimmetriesCorrection stored in EEPROM (2G)" FLOAT32_IEEE bvVcoMdc2GEE.Conversion 0 0 -0.1 0.1 ECU_ADDRESS 0x40001D0C SYMBOL_LINK "bvVcoMdc2GEE" 12 /end MEASUREMENT
/begin MEASUREMENT bvVcoMdc2GEE[4] "FlyWheelDyssimmetriesCorrection stored in EEPROM (2G)" FLOAT32_IEEE bvVcoMdc2GEE.Conversion 0 0 -0.1 0.1 ECU_ADDRESS 0x40001D10 SYMBOL_LINK "bvVcoMdc2GEE" 16 /end MEASUREMENT
/begin MEASUREMENT bvVcoMdc2GEE[5] "FlyWheelDyssimmetriesCorrection stored in EEPROM (2G)" FLOAT32_IEEE bvVcoMdc2GEE.Conversion 0 0 -0.1 0.1 ECU_ADDRESS 0x40001D14 SYMBOL_LINK "bvVcoMdc2GEE" 20 /end MEASUREMENT
/begin MEASUREMENT bvVcoMdc2GEE[6] "FlyWheelDyssimmetriesCorrection stored in EEPROM (2G)" FLOAT32_IEEE bvVcoMdc2GEE.Conversion 0 0 -0.1 0.1 ECU_ADDRESS 0x40001D18 SYMBOL_LINK "bvVcoMdc2GEE" 24 /end MEASUREMENT
/begin MEASUREMENT bvVcoMdc2GEE[7] "FlyWheelDyssimmetriesCorrection stored in EEPROM (2G)" FLOAT32_IEEE bvVcoMdc2GEE.Conversion 0 0 -0.1 0.1 ECU_ADDRESS 0x40001D1C SYMBOL_LINK "bvVcoMdc2GEE" 28 /end MEASUREMENT
/begin MEASUREMENT bvVcoMdc3GEE[0] "FlyWheelDyssimmetriesCorrection stored in EEPROM (3G)" FLOAT32_IEEE bvVcoMdc3GEE.Conversion 0 0 -0.1 0.1 ECU_ADDRESS 0x40001CE0 SYMBOL_LINK "bvVcoMdc3GEE" 0 /end MEASUREMENT
/begin MEASUREMENT bvVcoMdc3GEE[1] "FlyWheelDyssimmetriesCorrection stored in EEPROM (3G)" FLOAT32_IEEE bvVcoMdc3GEE.Conversion 0 0 -0.1 0.1 ECU_ADDRESS 0x40001CE4 SYMBOL_LINK "bvVcoMdc3GEE" 4 /end MEASUREMENT
/begin MEASUREMENT bvVcoMdc3GEE[2] "FlyWheelDyssimmetriesCorrection stored in EEPROM (3G)" FLOAT32_IEEE bvVcoMdc3GEE.Conversion 0 0 -0.1 0.1 ECU_ADDRESS 0x40001CE8 SYMBOL_LINK "bvVcoMdc3GEE" 8 /end MEASUREMENT
/begin MEASUREMENT bvVcoMdc3GEE[3] "FlyWheelDyssimmetriesCorrection stored in EEPROM (3G)" FLOAT32_IEEE bvVcoMdc3GEE.Conversion 0 0 -0.1 0.1 ECU_ADDRESS 0x40001CEC SYMBOL_LINK "bvVcoMdc3GEE" 12 /end MEASUREMENT
/begin MEASUREMENT bvVcoMdc3GEE[4] "FlyWheelDyssimmetriesCorrection stored in EEPROM (3G)" FLOAT32_IEEE bvVcoMdc3GEE.Conversion 0 0 -0.1 0.1 ECU_ADDRESS 0x40001CF0 SYMBOL_LINK "bvVcoMdc3GEE" 16 /end MEASUREMENT
/begin MEASUREMENT bvVcoMdc3GEE[5] "FlyWheelDyssimmetriesCorrection stored in EEPROM (3G)" FLOAT32_IEEE bvVcoMdc3GEE.Conversion 0 0 -0.1 0.1 ECU_ADDRESS 0x40001CF4 SYMBOL_LINK "bvVcoMdc3GEE" 20 /end MEASUREMENT
/begin MEASUREMENT bvVcoMdc3GEE[6] "FlyWheelDyssimmetriesCorrection stored in EEPROM (3G)" FLOAT32_IEEE bvVcoMdc3GEE.Conversion 0 0 -0.1 0.1 ECU_ADDRESS 0x40001CF8 SYMBOL_LINK "bvVcoMdc3GEE" 24 /end MEASUREMENT
/begin MEASUREMENT bvVcoMdc3GEE[7] "FlyWheelDyssimmetriesCorrection stored in EEPROM (3G)" FLOAT32_IEEE bvVcoMdc3GEE.Conversion 0 0 -0.1 0.1 ECU_ADDRESS 0x40001CFC SYMBOL_LINK "bvVcoMdc3GEE" 28 /end MEASUREMENT
/begin MEASUREMENT bvVcoMdc4GEE[0] "FlyWheelDyssimmetriesCorrection stored in EEPROM (4G)" FLOAT32_IEEE bvVcoMdc4GEE.Conversion 0 0 -0.1 0.1 ECU_ADDRESS 0x40001CC0 SYMBOL_LINK "bvVcoMdc4GEE" 0 /end MEASUREMENT
/begin MEASUREMENT bvVcoMdc4GEE[1] "FlyWheelDyssimmetriesCorrection stored in EEPROM (4G)" FLOAT32_IEEE bvVcoMdc4GEE.Conversion 0 0 -0.1 0.1 ECU_ADDRESS 0x40001CC4 SYMBOL_LINK "bvVcoMdc4GEE" 4 /end MEASUREMENT
/begin MEASUREMENT bvVcoMdc4GEE[2] "FlyWheelDyssimmetriesCorrection stored in EEPROM (4G)" FLOAT32_IEEE bvVcoMdc4GEE.Conversion 0 0 -0.1 0.1 ECU_ADDRESS 0x40001CC8 SYMBOL_LINK "bvVcoMdc4GEE" 8 /end MEASUREMENT
/begin MEASUREMENT bvVcoMdc4GEE[3] "FlyWheelDyssimmetriesCorrection stored in EEPROM (4G)" FLOAT32_IEEE bvVcoMdc4GEE.Conversion 0 0 -0.1 0.1 ECU_ADDRESS 0x40001CCC SYMBOL_LINK "bvVcoMdc4GEE" 12 /end MEASUREMENT
/begin MEASUREMENT bvVcoMdc4GEE[4] "FlyWheelDyssimmetriesCorrection stored in EEPROM (4G)" FLOAT32_IEEE bvVcoMdc4GEE.Conversion 0 0 -0.1 0.1 ECU_ADDRESS 0x40001CD0 SYMBOL_LINK "bvVcoMdc4GEE" 16 /end MEASUREMENT
/begin MEASUREMENT bvVcoMdc4GEE[5] "FlyWheelDyssimmetriesCorrection stored in EEPROM (4G)" FLOAT32_IEEE bvVcoMdc4GEE.Conversion 0 0 -0.1 0.1 ECU_ADDRESS 0x40001CD4 SYMBOL_LINK "bvVcoMdc4GEE" 20 /end MEASUREMENT
/begin MEASUREMENT bvVcoMdc4GEE[6] "FlyWheelDyssimmetriesCorrection stored in EEPROM (4G)" FLOAT32_IEEE bvVcoMdc4GEE.Conversion 0 0 -0.1 0.1 ECU_ADDRESS 0x40001CD8 SYMBOL_LINK "bvVcoMdc4GEE" 24 /end MEASUREMENT
/begin MEASUREMENT bvVcoMdc4GEE[7] "FlyWheelDyssimmetriesCorrection stored in EEPROM (4G)" FLOAT32_IEEE bvVcoMdc4GEE.Conversion 0 0 -0.1 0.1 ECU_ADDRESS 0x40001CDC SYMBOL_LINK "bvVcoMdc4GEE" 28 /end MEASUREMENT
/begin MEASUREMENT bvVcoMdc5GEE[0] "FlyWheelDyssimmetriesCorrection stored in EEPROM (5G)" FLOAT32_IEEE bvVcoMdc5GEE.Conversion 0 0 -0.1 0.1 ECU_ADDRESS 0x40001CA0 SYMBOL_LINK "bvVcoMdc5GEE" 0 /end MEASUREMENT
/begin MEASUREMENT bvVcoMdc5GEE[1] "FlyWheelDyssimmetriesCorrection stored in EEPROM (5G)" FLOAT32_IEEE bvVcoMdc5GEE.Conversion 0 0 -0.1 0.1 ECU_ADDRESS 0x40001CA4 SYMBOL_LINK "bvVcoMdc5GEE" 4 /end MEASUREMENT
/begin MEASUREMENT bvVcoMdc5GEE[2] "FlyWheelDyssimmetriesCorrection stored in EEPROM (5G)" FLOAT32_IEEE bvVcoMdc5GEE.Conversion 0 0 -0.1 0.1 ECU_ADDRESS 0x40001CA8 SYMBOL_LINK "bvVcoMdc5GEE" 8 /end MEASUREMENT
/begin MEASUREMENT bvVcoMdc5GEE[3] "FlyWheelDyssimmetriesCorrection stored in EEPROM (5G)" FLOAT32_IEEE bvVcoMdc5GEE.Conversion 0 0 -0.1 0.1 ECU_ADDRESS 0x40001CAC SYMBOL_LINK "bvVcoMdc5GEE" 12 /end MEASUREMENT
/begin MEASUREMENT bvVcoMdc5GEE[4] "FlyWheelDyssimmetriesCorrection stored in EEPROM (5G)" FLOAT32_IEEE bvVcoMdc5GEE.Conversion 0 0 -0.1 0.1 ECU_ADDRESS 0x40001CB0 SYMBOL_LINK "bvVcoMdc5GEE" 16 /end MEASUREMENT
/begin MEASUREMENT bvVcoMdc5GEE[5] "FlyWheelDyssimmetriesCorrection stored in EEPROM (5G)" FLOAT32_IEEE bvVcoMdc5GEE.Conversion 0 0 -0.1 0.1 ECU_ADDRESS 0x40001CB4 SYMBOL_LINK "bvVcoMdc5GEE" 20 /end MEASUREMENT
/begin MEASUREMENT bvVcoMdc5GEE[6] "FlyWheelDyssimmetriesCorrection stored in EEPROM (5G)" FLOAT32_IEEE bvVcoMdc5GEE.Conversion 0 0 -0.1 0.1 ECU_ADDRESS 0x40001CB8 SYMBOL_LINK "bvVcoMdc5GEE" 24 /end MEASUREMENT
/begin MEASUREMENT bvVcoMdc5GEE[7] "FlyWheelDyssimmetriesCorrection stored in EEPROM (5G)" FLOAT32_IEEE bvVcoMdc5GEE.Conversion 0 0 -0.1 0.1 ECU_ADDRESS 0x40001CBC SYMBOL_LINK "bvVcoMdc5GEE" 28 /end MEASUREMENT
/begin MEASUREMENT bvVcoMdc6GEE[0] "FlyWheelDyssimmetriesCorrection stored in EEPROM (6G)" FLOAT32_IEEE bvVcoMdc6GEE.Conversion 0 0 -0.1 0.1 ECU_ADDRESS 0x40001C80 SYMBOL_LINK "bvVcoMdc6GEE" 0 /end MEASUREMENT
/begin MEASUREMENT bvVcoMdc6GEE[1] "FlyWheelDyssimmetriesCorrection stored in EEPROM (6G)" FLOAT32_IEEE bvVcoMdc6GEE.Conversion 0 0 -0.1 0.1 ECU_ADDRESS 0x40001C84 SYMBOL_LINK "bvVcoMdc6GEE" 4 /end MEASUREMENT
/begin MEASUREMENT bvVcoMdc6GEE[2] "FlyWheelDyssimmetriesCorrection stored in EEPROM (6G)" FLOAT32_IEEE bvVcoMdc6GEE.Conversion 0 0 -0.1 0.1 ECU_ADDRESS 0x40001C88 SYMBOL_LINK "bvVcoMdc6GEE" 8 /end MEASUREMENT
/begin MEASUREMENT bvVcoMdc6GEE[3] "FlyWheelDyssimmetriesCorrection stored in EEPROM (6G)" FLOAT32_IEEE bvVcoMdc6GEE.Conversion 0 0 -0.1 0.1 ECU_ADDRESS 0x40001C8C SYMBOL_LINK "bvVcoMdc6GEE" 12 /end MEASUREMENT
/begin MEASUREMENT bvVcoMdc6GEE[4] "FlyWheelDyssimmetriesCorrection stored in EEPROM (6G)" FLOAT32_IEEE bvVcoMdc6GEE.Conversion 0 0 -0.1 0.1 ECU_ADDRESS 0x40001C90 SYMBOL_LINK "bvVcoMdc6GEE" 16 /end MEASUREMENT
/begin MEASUREMENT bvVcoMdc6GEE[5] "FlyWheelDyssimmetriesCorrection stored in EEPROM (6G)" FLOAT32_IEEE bvVcoMdc6GEE.Conversion 0 0 -0.1 0.1 ECU_ADDRESS 0x40001C94 SYMBOL_LINK "bvVcoMdc6GEE" 20 /end MEASUREMENT
/begin MEASUREMENT bvVcoMdc6GEE[6] "FlyWheelDyssimmetriesCorrection stored in EEPROM (6G)" FLOAT32_IEEE bvVcoMdc6GEE.Conversion 0 0 -0.1 0.1 ECU_ADDRESS 0x40001C98 SYMBOL_LINK "bvVcoMdc6GEE" 24 /end MEASUREMENT
/begin MEASUREMENT bvVcoMdc6GEE[7] "FlyWheelDyssimmetriesCorrection stored in EEPROM (6G)" FLOAT32_IEEE bvVcoMdc6GEE.Conversion 0 0 -0.1 0.1 ECU_ADDRESS 0x40001C9C SYMBOL_LINK "bvVcoMdc6GEE" 28 /end MEASUREMENT
/begin MEASUREMENT bvVcoMdc7GEE[0] "FlyWheelDyssimmetriesCorrection stored in EEPROM (7G)" FLOAT32_IEEE bvVcoMdc7GEE.Conversion 0 0 -0.1 0.1 ECU_ADDRESS 0x40001C60 SYMBOL_LINK "bvVcoMdc7GEE" 0 /end MEASUREMENT
/begin MEASUREMENT bvVcoMdc7GEE[1] "FlyWheelDyssimmetriesCorrection stored in EEPROM (7G)" FLOAT32_IEEE bvVcoMdc7GEE.Conversion 0 0 -0.1 0.1 ECU_ADDRESS 0x40001C64 SYMBOL_LINK "bvVcoMdc7GEE" 4 /end MEASUREMENT
/begin MEASUREMENT bvVcoMdc7GEE[2] "FlyWheelDyssimmetriesCorrection stored in EEPROM (7G)" FLOAT32_IEEE bvVcoMdc7GEE.Conversion 0 0 -0.1 0.1 ECU_ADDRESS 0x40001C68 SYMBOL_LINK "bvVcoMdc7GEE" 8 /end MEASUREMENT
/begin MEASUREMENT bvVcoMdc7GEE[3] "FlyWheelDyssimmetriesCorrection stored in EEPROM (7G)" FLOAT32_IEEE bvVcoMdc7GEE.Conversion 0 0 -0.1 0.1 ECU_ADDRESS 0x40001C6C SYMBOL_LINK "bvVcoMdc7GEE" 12 /end MEASUREMENT
/begin MEASUREMENT bvVcoMdc7GEE[4] "FlyWheelDyssimmetriesCorrection stored in EEPROM (7G)" FLOAT32_IEEE bvVcoMdc7GEE.Conversion 0 0 -0.1 0.1 ECU_ADDRESS 0x40001C70 SYMBOL_LINK "bvVcoMdc7GEE" 16 /end MEASUREMENT
/begin MEASUREMENT bvVcoMdc7GEE[5] "FlyWheelDyssimmetriesCorrection stored in EEPROM (7G)" FLOAT32_IEEE bvVcoMdc7GEE.Conversion 0 0 -0.1 0.1 ECU_ADDRESS 0x40001C74 SYMBOL_LINK "bvVcoMdc7GEE" 20 /end MEASUREMENT
/begin MEASUREMENT bvVcoMdc7GEE[6] "FlyWheelDyssimmetriesCorrection stored in EEPROM (7G)" FLOAT32_IEEE bvVcoMdc7GEE.Conversion 0 0 -0.1 0.1 ECU_ADDRESS 0x40001C78 SYMBOL_LINK "bvVcoMdc7GEE" 24 /end MEASUREMENT
/begin MEASUREMENT bvVcoMdc7GEE[7] "FlyWheelDyssimmetriesCorrection stored in EEPROM (7G)" FLOAT32_IEEE bvVcoMdc7GEE.Conversion 0 0 -0.1 0.1 ECU_ADDRESS 0x40001C7C SYMBOL_LINK "bvVcoMdc7GEE" 28 /end MEASUREMENT
/begin MEASUREMENT bvVcoMdc8GEE[0] "FlyWheelDyssimmetriesCorrection stored in EEPROM (8G)" FLOAT32_IEEE bvVcoMdc8GEE.Conversion 0 0 -0.1 0.1 ECU_ADDRESS 0x40001C40 SYMBOL_LINK "bvVcoMdc8GEE" 0 /end MEASUREMENT
/begin MEASUREMENT bvVcoMdc8GEE[1] "FlyWheelDyssimmetriesCorrection stored in EEPROM (8G)" FLOAT32_IEEE bvVcoMdc8GEE.Conversion 0 0 -0.1 0.1 ECU_ADDRESS 0x40001C44 SYMBOL_LINK "bvVcoMdc8GEE" 4 /end MEASUREMENT
/begin MEASUREMENT bvVcoMdc8GEE[2] "FlyWheelDyssimmetriesCorrection stored in EEPROM (8G)" FLOAT32_IEEE bvVcoMdc8GEE.Conversion 0 0 -0.1 0.1 ECU_ADDRESS 0x40001C48 SYMBOL_LINK "bvVcoMdc8GEE" 8 /end MEASUREMENT
/begin MEASUREMENT bvVcoMdc8GEE[3] "FlyWheelDyssimmetriesCorrection stored in EEPROM (8G)" FLOAT32_IEEE bvVcoMdc8GEE.Conversion 0 0 -0.1 0.1 ECU_ADDRESS 0x40001C4C SYMBOL_LINK "bvVcoMdc8GEE" 12 /end MEASUREMENT
/begin MEASUREMENT bvVcoMdc8GEE[4] "FlyWheelDyssimmetriesCorrection stored in EEPROM (8G)" FLOAT32_IEEE bvVcoMdc8GEE.Conversion 0 0 -0.1 0.1 ECU_ADDRESS 0x40001C50 SYMBOL_LINK "bvVcoMdc8GEE" 16 /end MEASUREMENT
/begin MEASUREMENT bvVcoMdc8GEE[5] "FlyWheelDyssimmetriesCorrection stored in EEPROM (8G)" FLOAT32_IEEE bvVcoMdc8GEE.Conversion 0 0 -0.1 0.1 ECU_ADDRESS 0x40001C54 SYMBOL_LINK "bvVcoMdc8GEE" 20 /end MEASUREMENT
/begin MEASUREMENT bvVcoMdc8GEE[6] "FlyWheelDyssimmetriesCorrection stored in EEPROM (8G)" FLOAT32_IEEE bvVcoMdc8GEE.Conversion 0 0 -0.1 0.1 ECU_ADDRESS 0x40001C58 SYMBOL_LINK "bvVcoMdc8GEE" 24 /end MEASUREMENT
/begin MEASUREMENT bvVcoMdc8GEE[7] "FlyWheelDyssimmetriesCorrection stored in EEPROM (8G)" FLOAT32_IEEE bvVcoMdc8GEE.Conversion 0 0 -0.1 0.1 ECU_ADDRESS 0x40001C5C SYMBOL_LINK "bvVcoMdc8GEE" 28 /end MEASUREMENT
/begin CHARACTERISTIC cfACTUAL_POS_Enable "[FIX]  Fix on the Actual position (0-100%) communicated by TURBO CONTROLLER" VALUE 0xFC2C1A Scalar_UBYTE 0 TURBO2ECU_Rx_4ms_CM_FixEnableT 171 218 /end CHARACTERISTIC
/begin CHARACTERISTIC cfACTUAL_POS_Value "[FIX]  Fix on the Actual position (0-100%) communicated by TURBO CONTROLLER" VALUE 0xFC2C18 Scalar_UWORD 0 TURBO2ECU_Rx_4ms_CM_ufix16_Sp1_deg 0 100 /end CHARACTERISTIC
/begin CHARACTERISTIC cfACT_GEAR_RATIO_Enable "[FIX] Fix sul rapporto al cambio attualmente in uso (solo per cambio automatico)" VALUE 0xFC82A6 Scalar_UBYTE 0 ETC2_Rx_100ms_CM_FixEnableT 171 218 /end CHARACTERISTIC
/begin CHARACTERISTIC cfACT_GEAR_RATIO_Value "[FIX] Fix sul rapporto al cambio attualmente in uso (solo per cambio automatico)" VALUE 0xFC82A4 Scalar_UWORD 0 ETC2_Rx_100ms_CM_ufix16_En10_adm 0 62.7490234375 /end CHARACTERISTIC
/begin CHARACTERISTIC cfACT_MAX_RET_PER_TQ_Enable "[FIX] Fix su PATCH VCM" VALUE 0xFC8484 Scalar_UBYTE 0 ERC1_ER_Tx_1s_CM_FixEnableT 171 218 /end CHARACTERISTIC
/begin CHARACTERISTIC cfACT_MAX_RET_PER_TQ_Value "[FIX] Fix su PATCH VCM" VALUE 0xFC8483 Scalar_UBYTE 0 ERC1_ER_Tx_1s_CM_ufix8_Bn125__ -125 125 /end CHARACTERISTIC
/begin CHARACTERISTIC cfACT_RET_PER_TQ_Enable "[FIX] Fix su PATCH VCM" VALUE 0xFC8482 Scalar_UBYTE 0 ERC1_ER_Tx_1s_CM_FixEnableT 171 218 /end CHARACTERISTIC
/begin CHARACTERISTIC cfACT_RET_PER_TQ_Value "[FIX] Fix su PATCH VCM" VALUE 0xFC8481 Scalar_UBYTE 0 ERC1_ER_Tx_1s_CM_ufix8_Bn125__ -125 125 /end CHARACTERISTIC
/begin CHARACTERISTIC cfAPPL_VEH_SPEED_LIM_Enable "[FIX] Limite applicato di Velocità veicolo da inviare via CAN" VALUE 0xFC8480 Scalar_UBYTE 0 MVS_Tx_1s_CM_FixEnableT 171 218 /end CHARACTERISTIC
/begin CHARACTERISTIC cfAPPL_VEH_SPEED_LIM_Value "[FIX] Limite applicato di Velocità veicolo da inviare via CAN" VALUE 0xFC847F Scalar_UBYTE 0 MVS_Tx_1s_CM_uint8_km_h 0 250 /end CHARACTERISTIC
/begin CHARACTERISTIC cfAVV_INHIBIT_Enable "[FIX] Fix su Inhibit Avviamento" VALUE 0xFC84AA Scalar_UBYTE 0 EEC1_Tx_4ms_CM_FixEnableT 171 218 /end CHARACTERISTIC
/begin CHARACTERISTIC cfAVV_INHIBIT_Value "[FIX] Fix su Inhibit Avviamento" VALUE 0xFC84A9 Scalar_BOOLEAN 0 EEC1_Tx_4ms_CM_boolean_adm 0 1 /end CHARACTERISTIC
/begin CHARACTERISTIC cfBAT_FAIL_HIGH_Enable "[FIX] Fix on Bat High Fail Diagnosis Uego Sensor (01-Fail 00-No Fail)" VALUE 0xFC8366 Scalar_UBYTE 0 USS_Rx_50ms_CM_FixEnableT 171 218 /end CHARACTERISTIC
/begin CHARACTERISTIC cfBAT_FAIL_HIGH_Value "[FIX] Fix on Bat High Fail Diagnosis Uego Sensor (01-Fail 00-No Fail)" VALUE 0xFC8365 Scalar_BOOLEAN 0 USS_Rx_50ms_CM_boolean_adm 0 1 /end CHARACTERISTIC
/begin CHARACTERISTIC cfBAT_FAIL_LOW_Enable "[FIX] Fix on Bat Low Fail Diagnosis Uego Sensor (01-Fail 00-No Fail)" VALUE 0xFC8364 Scalar_UBYTE 0 USS_Rx_50ms_CM_FixEnableT 171 218 /end CHARACTERISTIC
/begin CHARACTERISTIC cfBAT_FAIL_LOW_Value "[FIX] Fix on Bat Low Fail Diagnosis Uego Sensor (01-Fail 00-No Fail)" VALUE 0xFC8363 Scalar_BOOLEAN 0 USS_Rx_50ms_CM_boolean_adm 0 1 /end CHARACTERISTIC
/begin CHARACTERISTIC cfBAT_POT_Enable "[FIX] SPN 168 - Battery Potential - Power Input 1" VALUE 0xFC847E Scalar_UBYTE 0 VEP1_Tx_1s_CM_FixEnableT 171 218 /end CHARACTERISTIC
/begin CHARACTERISTIC cfBAT_POT_Value "[FIX] SPN 168 - Battery Potential - Power Input 1" VALUE 0xFC847C Scalar_UWORD 0 VEP1_Tx_1s_CM_ufix16_Sp05_V 0 3212.75 /end CHARACTERISTIC
/begin CHARACTERISTIC cfBRAKE_Enable "[FIX] Fix sullo switch freno (ricevuto da CAN)" VALUE 0xFC82A2 Scalar_UBYTE 0 CCVS_Rx_100ms_CM_FixEnableT 171 218 /end CHARACTERISTIC
/begin CHARACTERISTIC cfBRAKE_SWITCH_TX_Enable "[FIX] Fix su \"Brake Switch\" (Tx to CAN)" VALUE 0xFC83C6 Scalar_UBYTE 0 CCVS_Tx_100ms_CM_FixEnableT 171 218 /end CHARACTERISTIC
/begin CHARACTERISTIC cfBRAKE_SWITCH_TX_Value "[FIX] Fix su \"Brake Switch\" (Tx to CAN)" VALUE 0xFC83C5 Scalar_BOOLEAN 0 CCVS_Tx_100ms_CM_boolean_adm 0 1 /end CHARACTERISTIC
/begin CHARACTERISTIC cfBRAKE_Value "[FIX] Fix sullo switch freno (ricevuto da CAN)" VALUE 0xFC82A1 Scalar_BOOLEAN 0 CCVS_Rx_100ms_CM_boolean_adm 0 1 /end CHARACTERISTIC
/begin CHARACTERISTIC cfCAN_FAIL_Enable "[FIX] Fix on Can Comunication Fail Diagnosis Uego Sensor (01-Fail 00-No Fail)" VALUE 0xFC8362 Scalar_UBYTE 0 USS_Rx_50ms_CM_FixEnableT 171 218 /end CHARACTERISTIC
/begin CHARACTERISTIC cfCAN_FAIL_Value "[FIX] Fix on Can Comunication Fail Diagnosis Uego Sensor (01-Fail 00-No Fail)" VALUE 0xFC8361 Scalar_BOOLEAN 0 USS_Rx_50ms_CM_boolean_adm 0 1 /end CHARACTERISTIC
/begin CHARACTERISTIC cfCC_SET_SPEED_Enable "[FIX] Fix on CC set speed from CCVS CAN Rx" VALUE 0xFC82A0 Scalar_UBYTE 0 CCVS_Rx_100ms_CM_FixEnableT 171 218 /end CHARACTERISTIC
/begin CHARACTERISTIC cfCC_SET_SPEED_Value "[FIX] Fix on CC set speed from CCVS CAN Rx" VALUE 0xFC829F Scalar_UBYTE 0 CCVS_Rx_100ms_CM_uint8_km_h 0 250 /end CHARACTERISTIC
/begin CHARACTERISTIC cfCC_SPD_OBJ_TX_Enable "[FIX] Fix su CC speed target (inviato al CAN)" VALUE 0xFC83C4 Scalar_UBYTE 0 CCVS_Tx_100ms_CM_FixEnableT 171 218 /end CHARACTERISTIC
/begin CHARACTERISTIC cfCC_SPD_OBJ_TX_Value "[FIX] Fix su CC speed target (inviato al CAN)" VALUE 0xFC83C3 Scalar_UBYTE 0 CCVS_Tx_100ms_CM_uint8_adm 0 255 /end CHARACTERISTIC
/begin CHARACTERISTIC cfCC_STATE_Enable "[FIX] Fix on CC state from CCVS CAN Rx" VALUE 0xFC829E Scalar_UBYTE 0 CCVS_Rx_100ms_CM_FixEnableT 171 218 /end CHARACTERISTIC
/begin CHARACTERISTIC cfCC_STATE_Value "[FIX] Fix on CC state from CCVS CAN Rx" VALUE 0xFC829D Scalar_UBYTE 0 CCVS_Rx_100ms_CM_uint8_adm 0 7 /end CHARACTERISTIC
/begin CHARACTERISTIC cfCHARG_SYS_POT_Enable "[FIX] SPN 167 - Charging System Potential" VALUE 0xFC847A Scalar_UBYTE 0 VEP1_Tx_1s_CM_FixEnableT 171 218 /end CHARACTERISTIC
/begin CHARACTERISTIC cfCHARG_SYS_POT_Value "[FIX] SPN 167 - Charging System Potential" VALUE 0xFC8478 Scalar_UWORD 0 VEP1_Tx_1s_CM_ufix16_Sp05_V 0 3212.75 /end CHARACTERISTIC
/begin CHARACTERISTIC cfCLUTCH_Enable "[FIX] Fix sullo switch frizione (ricevuto da CAN)" VALUE 0xFC829C Scalar_UBYTE 0 CCVS_Rx_100ms_CM_FixEnableT 171 218 /end CHARACTERISTIC
/begin CHARACTERISTIC cfCLUTCH_TX_Enable "[FIX] Fix sullo switch frizione (ricevuto da CAN)" VALUE 0xFC83C2 Scalar_UBYTE 0 CCVS_Tx_100ms_CM_FixEnableT 171 218 /end CHARACTERISTIC
/begin CHARACTERISTIC cfCLUTCH_TX_Value "[FIX] Fix sullo switch frizione (ricevuto da CAN)" VALUE 0xFC83C1 Scalar_BOOLEAN 0 CCVS_Tx_100ms_CM_boolean_adm 0 1 /end CHARACTERISTIC
/begin CHARACTERISTIC cfCLUTCH_Value "[FIX] Fix sullo switch frizione (ricevuto da CAN)" VALUE 0xFC829B Scalar_BOOLEAN 0 CCVS_Rx_100ms_CM_boolean_adm 0 1 /end CHARACTERISTIC
/begin CHARACTERISTIC cfCMU_LIM_LMP_CMD_Enable "[FIX] Cmu limitation lamp comand" VALUE 0xFC83C0 Scalar_UBYTE 0 PropB_0A_Tx_100ms_CM_FixEnableT 171 218 /end CHARACTERISTIC
/begin CHARACTERISTIC cfCMU_LIM_LMP_CMD_Value "[FIX] Cmu limitation lamp comand" VALUE 0xFC83BF Scalar_UBYTE 0 PropB_0A_Tx_100ms_CM_uint8_adm 0 2 /end CHARACTERISTIC
/begin CHARACTERISTIC cfCOLD_START_CAN_Enable "[FIX] Fix su inhibit per accensione lampade preriscaldo;" VALUE 0xFC853A Scalar_UBYTE 0 EDC2BC_Tx_50ms_CM_FixEnableT 171 218 /end CHARACTERISTIC
/begin CHARACTERISTIC cfCOLD_START_CAN_Value "[FIX] Fix su inhibit per accensione lampade preriscaldo;" VALUE 0xFC8539 Scalar_BOOLEAN 0 EDC2BC_Tx_50ms_CM_boolean_adm 0 1 /end CHARACTERISTIC
/begin CHARACTERISTIC cfCOMP_FAIL_Enable "[FIX] Fix on Components Fail Diagnosis Uego Sensor (01-Fail 00-No Fail)" VALUE 0xFC8360 Scalar_UBYTE 0 USS_Rx_50ms_CM_FixEnableT 171 218 /end CHARACTERISTIC
/begin CHARACTERISTIC cfCOMP_FAIL_Value "[FIX] Fix on Components Fail Diagnosis Uego Sensor (01-Fail 00-No Fail)" VALUE 0xFC835F Scalar_BOOLEAN 0 USS_Rx_50ms_CM_boolean_adm 0 1 /end CHARACTERISTIC
/begin CHARACTERISTIC cfCOM_ABNORM_Enable "[FIX] Fix on the Communication Abnormal Fault communicated by TURBO CONTROLLER (0 - No Fault)" VALUE 0xFC2C17 Scalar_UBYTE 0 TURBO2ECU_Rx_4ms_CM_FixEnableT 171 218 /end CHARACTERISTIC
/begin CHARACTERISTIC cfCOM_ABNORM_Value "[FIX] Fix on the Communication Abnormal Fault communicated by TURBO CONTROLLER (0 - No Fault)" VALUE 0xFC2C16 Scalar_BOOLEAN 0 TURBO2ECU_Rx_4ms_CM_boolean_deg 0 1 /end CHARACTERISTIC
/begin CHARACTERISTIC cfCRUISE_ACT_Enable "[FIX] Fix sul cruise control switch (ricevuta da CAN)" VALUE 0xFC829A Scalar_UBYTE 0 CCVS_Rx_100ms_CM_FixEnableT 171 218 /end CHARACTERISTIC
/begin CHARACTERISTIC cfCRUISE_ACT_TX_Enable "[FIX] Flag di richiesta attivazione Cruise Control" VALUE 0xFC83BE Scalar_UBYTE 0 CCVS_Tx_100ms_CM_FixEnableT 171 218 /end CHARACTERISTIC
/begin CHARACTERISTIC cfCRUISE_ACT_TX_Value "[FIX] Flag di richiesta attivazione Cruise Control" VALUE 0xFC83BD Scalar_BOOLEAN 0 CCVS_Tx_100ms_CM_boolean_adm 0 1 /end CHARACTERISTIC
/begin CHARACTERISTIC cfCRUISE_ACT_Value "[FIX] Fix sul cruise control switch (ricevuta da CAN)" VALUE 0xFC8299 Scalar_BOOLEAN 0 CCVS_Rx_100ms_CM_boolean_adm 0 1 /end CHARACTERISTIC
/begin CHARACTERISTIC cfCTRL_MODE_Enable "[FIX] Fix on the Control Mode communicated by TURBO CONTROLLER (0 - Control Impossibile; 1- Control Possibile)" VALUE 0xFC2C15 Scalar_UBYTE 0 TURBO2ECU_Rx_4ms_CM_FixEnableT 171 218 /end CHARACTERISTIC
/begin CHARACTERISTIC cfCTRL_MODE_Value "[FIX] Fix on the Control Mode communicated by TURBO CONTROLLER (0 - Control Impossibile; 1- Control Possibile)" VALUE 0xFC2C14 Scalar_BOOLEAN 0 TURBO2ECU_Rx_4ms_CM_boolean_deg 0 1 /end CHARACTERISTIC
/begin CHARACTERISTIC cfCURRENT_GEAR_Enable "[FIX] Fix sulla marcia effettivamente innestata (solo per cambio automatico)" VALUE 0xFC8298 Scalar_UBYTE 0 ETC2_Rx_100ms_CM_FixEnableT 171 218 /end CHARACTERISTIC
/begin CHARACTERISTIC cfCURRENT_GEAR_Value "[FIX] Fix sulla marcia effettivamente innestata (solo per cambio automatico)" VALUE 0xFC8297 Scalar_UBYTE 0 ETC2_Rx_100ms_CM_ufix8_Bn125_gear -125 125 /end CHARACTERISTIC
/begin CHARACTERISTIC cfCUTOFF_STATE_Enable "[Fix] Cut-Off Flag bit- j1939 CAN ECM2EPR Msg" VALUE 0xFC84A8 Scalar_UBYTE 0 ECM2EPR_Tx_4ms_CM_FixEnableT_adm 171 218 /end CHARACTERISTIC
/begin CHARACTERISTIC cfCUTOFF_STATE_Value "[Fix] Cut-Off Flag bit- j1939 CAN ECM2EPR Msg" VALUE 0xFC84A7 Scalar_BOOLEAN 0 ECM2EPR_Tx_4ms_CM_boolean_adm 0 1 /end CHARACTERISTIC
/begin CHARACTERISTIC cfDAY_Enable "[FIX] Fix sui giorni (ricevuti da CAN)" VALUE 0xFC82B8 Scalar_UBYTE 0 TIMEDATE_Rx_1s_CM_FixEnableT 171 218 /end CHARACTERISTIC
/begin CHARACTERISTIC cfDAY_Value "[FIX] Fix sui giorni (ricevuti da CAN)" VALUE 0xFC82B7 Scalar_UBYTE 0 TIMEDATE_Rx_1s_CM_ufix8_En2_day 0.25 31.75 /end CHARACTERISTIC
/begin CHARACTERISTIC cfDEW_POINT_EXC_Enable "[FIX] Fix on Dew Point Exceeded feedback for UEGO (Tx to CAN)" VALUE 0xFC83BC Scalar_UBYTE 0 EEC3_Tx_100ms_CM_FixEnableT 171 218 /end CHARACTERISTIC
/begin CHARACTERISTIC cfDEW_POINT_EXC_Value "[FIX] Fix on Dew Point Exceeded feedback for UEGO (Tx to CAN)" VALUE 0xFC83BB Scalar_BOOLEAN 0 EEC3_Tx_100ms_CM_boolean_adm 0 1 /end CHARACTERISTIC
/begin CHARACTERISTIC cfDRIVELINE_Enable "[FIX] Fix su informazione distribuzione-accoppiata al motore" VALUE 0xFC82FC Scalar_UBYTE 0 ETC1_Rx_4ms_CM_FixEnableT 171 218 /end CHARACTERISTIC
/begin CHARACTERISTIC cfDRIVELINE_Value "[FIX] Fix su informazione distribuzione-accoppiata al motore" VALUE 0xFC82FB Scalar_BOOLEAN 0 ETC1_Rx_4ms_CM_boolean_adm 0 1 /end CHARACTERISTIC
/begin CHARACTERISTIC cfDUTY_MONITOR_Enable "[FIX]  Fix on the Applied duty cycke [-100:100] percentage to the DC Motor communicated by TURBO CONTROLLER" VALUE 0xFC2C13 Scalar_UBYTE 0 TURBO2ECU_Rx_4ms_CM_FixEnableT 171 218 /end CHARACTERISTIC
/begin CHARACTERISTIC cfDUTY_MONITOR_Value "[FIX]  Fix on the Applied duty cycke [-100:100] percentage to the DC Motor communicated by TURBO CONTROLLER" VALUE 0xFC2C12 Scalar_BYTE 0 TURBO2ECU_Rx_4ms_CM_int8_deg -100 100 /end CHARACTERISTIC
/begin CHARACTERISTIC cfECU_TEMP_Enable "[FIX] Ecu Temperature transimetted via CAN msg ET2" VALUE 0xFC8476 Scalar_UBYTE 0 ET2_Tx_1s_CM_FixEnableT 171 218 /end CHARACTERISTIC
/begin CHARACTERISTIC cfECU_TEMP_Value "[FIX] Ecu Temperature transimetted via CAN msg ET2" VALUE 0xFC8474 Scalar_UWORD 0 ET2_Tx_1s_CM_ufix16_Bn40_km_h -40 150 /end CHARACTERISTIC
/begin CHARACTERISTIC cfENG_OVER_TEMP_Enable "[FIX] Fix su \"Engine over Temperature\" (Tx to CAN)" VALUE 0xFC8538 Scalar_UBYTE 0 EDC2BC_Tx_50ms_CM_FixEnableT 171 218 /end CHARACTERISTIC
/begin CHARACTERISTIC cfENG_OVER_TEMP_Value "[FIX] Fix su \"Engine over Temperature\" (Tx to CAN)" VALUE 0xFC8537 Scalar_UBYTE 0 EDC2BC_Tx_50ms_CM_uint8_adm 0 7 /end CHARACTERISTIC
/begin CHARACTERISTIC cfENG_TRQ_MODE_Enable "[FIX] Fix su \"Engine Torque Mode\" (Tx to CAN)" VALUE 0xFC84A6 Scalar_UBYTE 0 EEC1_Tx_4ms_CM_FixEnableT 171 218 /end CHARACTERISTIC
/begin CHARACTERISTIC cfENG_TRQ_MODE_Value "[FIX] Fix su \"Engine Torque Mode\" (Tx to CAN)" VALUE 0xFC84A5 Scalar_UBYTE 0 EEC1_Tx_4ms_CM_uint8_adm 0 15 /end CHARACTERISTIC
/begin CHARACTERISTIC cfEPR_COUNT_Enable "[FIX] DU-EPR CAN Message Counter - j1939 CAN EPR2ECM Msg" VALUE 0xFC8296 Scalar_UBYTE 0 EPR2ECM_Rx_100ms_CM_FixEnableT 171 218 /end CHARACTERISTIC
/begin CHARACTERISTIC cfEPR_COUNT_Value "[FIX] DU-EPR CAN Message Counter - j1939 CAN EPR2ECM Msg" VALUE 0xFC8295 Scalar_UBYTE 0 EPR2ECM_Rx_100ms_CM_uint8_adm 0 255 /end CHARACTERISTIC
/begin CHARACTERISTIC cfEPR_DIAG_MGS_Enable "[FIX] DU-EPR MGS component diagnosis - j1939 CAN EPR2ECM Msg" VALUE 0xFC8294 Scalar_UBYTE 0 EPR2ECM_Rx_100ms_CM_FixEnableT 171 218 /end CHARACTERISTIC
/begin CHARACTERISTIC cfEPR_DIAG_MGS_Value "[FIX] DU-EPR MGS component diagnosis - j1939 CAN EPR2ECM Msg" VALUE 0xFC8293 Scalar_UBYTE 0 EPR2ECM_Rx_100ms_CM_ufix3 0 4 /end CHARACTERISTIC
/begin CHARACTERISTIC cfEPR_DIAG_TECUCOND_Enable "[FIX] DU-EPR Ecu temperature functional diagnosis - j1939 CAN EPR2ECM Msg" VALUE 0xFC8292 Scalar_UBYTE 0 EPR2ECM_Rx_100ms_CM_FixEnableT 171 218 /end CHARACTERISTIC
/begin CHARACTERISTIC cfEPR_DIAG_TECUCOND_Value "[FIX] DU-EPR Ecu temperature functional diagnosis - j1939 CAN EPR2ECM Msg" VALUE 0xFC8291 Scalar_UBYTE 0 EPR2ECM_Rx_100ms_CM_ufix2 0 1 /end CHARACTERISTIC
/begin CHARACTERISTIC cfEPR_DIAG_TECU_Enable "[FIX] DU-EPR Ecu temperature functional diagnosis - j1939 CAN EPR2ECM Msg" VALUE 0xFC8290 Scalar_UBYTE 0 EPR2ECM_Rx_100ms_CM_FixEnableT 171 218 /end CHARACTERISTIC
/begin CHARACTERISTIC cfEPR_DIAG_TECU_Value "[FIX] DU-EPR  Ecu temperature electrical diagnosis - j1939 CAN EPR2ECM Msg" VALUE 0xFC828F Scalar_UBYTE 0 EPR2ECM_Rx_100ms_CM_ufix2 0 2 /end CHARACTERISTIC
/begin CHARACTERISTIC cfEPR_DIAG_VPW_Enable "[FIX] DU-EPR Ecu Voltage supply diagnosis - j1939 CAN EPR2ECM Msg" VALUE 0xFC828E Scalar_UBYTE 0 EPR2ECM_Rx_100ms_CM_FixEnableT 171 218 /end CHARACTERISTIC
/begin CHARACTERISTIC cfEPR_DIAG_VPW_Value "[FIX] DU-EPR Ecu Voltage supply diagnosis - j1939 CAN EPR2ECM Msg" VALUE 0xFC828D Scalar_UBYTE 0 EPR2ECM_Rx_100ms_CM_ufix2 0 2 /end CHARACTERISTIC
/begin CHARACTERISTIC cfEPR_ENABLE_Enable "[Fix] EPR Enabling signal - j1939 CAN ECM2EPR Msg" VALUE 0xFC84A4 Scalar_UBYTE 0 ECM2EPR_Tx_4ms_CM_FixEnableT_adm 171 218 /end CHARACTERISTIC
/begin CHARACTERISTIC cfEPR_ENABLE_Value "[Fix] EPR Enabling signal - j1939 CAN ECM2EPR Msg" VALUE 0xFC84A3 Scalar_BOOLEAN 0 ECM2EPR_Tx_4ms_CM_boolean_adm 0 1 /end CHARACTERISTIC
/begin CHARACTERISTIC cfEPR_EVDUTYCYCLE_Enable "[FIX] EV Applied DutyCycle - j1939 CAN EPR2ECM Msg" VALUE 0xFC828C Scalar_UBYTE 0 EPR2ECM_Rx_100ms_CM_FixEnableT 171 218 /end CHARACTERISTIC
/begin CHARACTERISTIC cfEPR_EVDUTYCYCLE_Value "[FIX] EV Applied DutyCycle - j1939 CAN EPR2ECM Msg" VALUE 0xFC828A Scalar_UWORD 0 EPR2ECM_Rx_100ms_CM_ufix16_Sp0030517578125__ 0 100 /end CHARACTERISTIC
/begin CHARACTERISTIC cfEPR_EVFREQ_Enable "[FIX] EV PWM Command applied frequency - j1939 CAN EPR2ECM Msg" VALUE 0xFC8288 Scalar_UBYTE 0 EPR2ECM_Rx_100ms_CM_FixEnableT 171 218 /end CHARACTERISTIC
/begin CHARACTERISTIC cfEPR_EVFREQ_Value "[FIX] EV PWM Command applied frequency - j1939 CAN EPR2ECM Msg" VALUE 0xFC8287 Scalar_UBYTE 0 EPR2ECM_Rx_100ms_CM_uint8_Hz 0 40 /end CHARACTERISTIC
/begin CHARACTERISTIC cfEPR_TECU_Enable "[FIX] DU-EPR Ecu temperature - j1939 CAN EPR2ECM Msg" VALUE 0xFC8286 Scalar_UBYTE 0 EPR2ECM_Rx_100ms_CM_FixEnableT 171 218 /end CHARACTERISTIC
/begin CHARACTERISTIC cfEPR_TECU_Value "[FIX] DU-EPR Ecu temperature - j1939 CAN EPR2ECM Msg" VALUE 0xFC8284 Scalar_SWORD 0 EPR2ECM_Rx_100ms_CM_sfix16_En7_degC -150 150 /end CHARACTERISTIC
/begin CHARACTERISTIC cfETASP_Enable "[FIX] Fix su \"Etasp\" (Tx to CAN)" VALUE 0xFC83BA Scalar_UBYTE 0 EEC3_Tx_100ms_CM_FixEnableT 171 218 /end CHARACTERISTIC
/begin CHARACTERISTIC cfETASP_Value "[FIX] Fix su \"Etasp\" (Tx to CAN)" VALUE 0xFC83B8 Scalar_UWORD 0 EEC3_Tx_100ms_CM_ufix16_En10_adm 0 3 /end CHARACTERISTIC
/begin CHARACTERISTIC cfFAN2_ACT_REQ_Enable "[FIX] Fix sul Richiesta gestione Elettroventole" VALUE 0xFC835E Scalar_UBYTE 0 BC2EDC2_Rx_50ms_CM_FixEnableT 171 218 /end CHARACTERISTIC
/begin CHARACTERISTIC cfFAN2_ACT_REQ_Value "[FIX] Fix sul Richiesta gestione Elettroventole" VALUE 0xFC835D Scalar_BOOLEAN 0 BC2EDC2_Rx_50ms_CM_boolean_adm 0 1 /end CHARACTERISTIC
/begin CHARACTERISTIC cfFAN_ACT_REQ_PWM_Enable "[FIX] Fix sul PWM attuato sulle elettroventole" VALUE 0xFC835C Scalar_UBYTE 0 BC2EDC2_Rx_50ms_CM_FixEnableT 171 218 /end CHARACTERISTIC
/begin CHARACTERISTIC cfFAN_ACT_REQ_PWM_Value "[FIX] Fix sul PWM attuato sulle elettroventole" VALUE 0xFC835B Scalar_UBYTE 0 BC2EDC2_Rx_50ms_CM_ufix8_Sp4__ 0 100 /end CHARACTERISTIC
/begin CHARACTERISTIC cfFUEL_IST_Enable "[FIX] Fix Instantaneous Fuel Economy (SPN 184)" VALUE 0xFC83B6 Scalar_UBYTE 0 LFE1_Tx_100ms_CM_FixEnableT 171 218 /end CHARACTERISTIC
/begin CHARACTERISTIC cfFUEL_IST_Value "[FIX] Fix Instantaneous Fuel Economy (SPN 184)" VALUE 0xFC83B4 Scalar_UWORD 0 LFE1_Tx_100ms_CM_ufix16_En9_km_l 0 125.5 /end CHARACTERISTIC
/begin CHARACTERISTIC cfFUEL_LEVEL_Enable "[FIX] Percentuale livello combustibile" VALUE 0xFC8472 Scalar_UBYTE 0 DD1_Tx_1s_CM_FixEnableT 171 218 /end CHARACTERISTIC
/begin CHARACTERISTIC cfFUEL_LEVEL_Value "[FIX] Percentuale livello combustibile" VALUE 0xFC8471 Scalar_UBYTE 0 DD1_Tx_1s_CM_ufix8_Sp4__ 0 100 /end CHARACTERISTIC
/begin CHARACTERISTIC cfFUEL_RATE_Enable "[FIX] Fix Fuel Rate (SPN 183)" VALUE 0xFC83B2 Scalar_UBYTE 0 LFE1_Tx_100ms_CM_FixEnableT 171 218 /end CHARACTERISTIC
/begin CHARACTERISTIC cfFUEL_RATE_Value "[FIX] Fix Fuel Rate (SPN 183)" VALUE 0xFC83B0 Scalar_UWORD 0 LFE1_Tx_100ms_CM_ufix16_Sp05_l_h 0 3212.75 /end CHARACTERISTIC
/begin CHARACTERISTIC cfFUEL_TOT_CONS_Enable "[FIX] Accumulated amount of fuel used during vehicle operation (SAE 5.2.5.66)" VALUE 0xFC8470 Scalar_UBYTE 0 LFC1_Tx_1s_CM_FixEnableT 171 218 /end CHARACTERISTIC
/begin CHARACTERISTIC cfFUEL_TOT_CONS_Value "[FIX] Accumulated amount of fuel used during vehicle operation (SAE 5.2.5.66) transmitted via CAN" VALUE 0xFC846C Scalar_ULONG 0 LFC1_Tx_1s_CM_ufix32_Sp05_l 0 210554060.75 /end CHARACTERISTIC
/begin CHARACTERISTIC cfFUEL_TRIP_Enable "[FIX] uel consumed during all or part of a trip (SAE 5.2.5.64)" VALUE 0xFC8468 Scalar_UBYTE 0 LFC1_Tx_1s_CM_FixEnableT 171 218 /end CHARACTERISTIC
/begin CHARACTERISTIC cfFUEL_TRIP_Value "[FIX] Fuel consumed during all or part of a trip (SAE 5.2.5.64)  transmitted via CAN" VALUE 0xFC8464 Scalar_ULONG 0 LFC1_Tx_1s_CM_ufix32_Sp05_l 0 210554060.75 /end CHARACTERISTIC
/begin CHARACTERISTIC cfHDS_ADV_Enable "[FIX] Fix su Anticipo accensione" VALUE 0xFC8536 Scalar_UBYTE 0 HDSECU1_Tx_50ms_CM_FixEnableT 171 218 /end CHARACTERISTIC
/begin CHARACTERISTIC cfHDS_ADV_Value "[FIX] Fix su Anticipo accensione" VALUE 0xFC8535 Scalar_UBYTE 0 HDSECU1_Tx_50ms_CM_ufix8_En1_Bn20_degree -20 60 /end CHARACTERISTIC
/begin CHARACTERISTIC cfHDS_AIR_MAIN_Enable "[FIX] Fix su Aria aspirata calcolata dal sensore principale in kg/h" VALUE 0xFC8534 Scalar_UBYTE 0 HDSECU1_Tx_50ms_CM_FixEnableT 171 218 /end CHARACTERISTIC
/begin CHARACTERISTIC cfHDS_AIR_MAIN_Value "[FIX] Fix su Aria aspirata calcolata dal sensore principale in kg/h" VALUE 0xFC8533 Scalar_UBYTE 0 HDSECU1_Tx_50ms_CM_ufix8_S5_kg_h 0 1000 /end CHARACTERISTIC
/begin CHARACTERISTIC cfHDS_CMU_PERC_REQ_DEF_Enable "[FIX] Fix su Percentuale finale di richiesta di Coppia Utile nel Manager" VALUE 0xFC8532 Scalar_UBYTE 0 HDSECU2_Tx_50ms_CM_FixEnableT 171 218 /end CHARACTERISTIC
/begin CHARACTERISTIC cfHDS_CMU_PERC_REQ_DEF_Value "[FIX] Fix su Percentuale finale di richiesta di Coppia Utile nel Manager" VALUE 0xFC8531 Scalar_UBYTE 0 HDSECU2_Tx_50ms_CM_uint8__ 0 100 /end CHARACTERISTIC
/begin CHARACTERISTIC cfHDS_CORR_ADAT_Enable "[FIX] Fix su Adaptive Air/Fuel Control Feedback" VALUE 0xFC8530 Scalar_UBYTE 0 HDSECU2_Tx_50ms_CM_FixEnableT 171 218 /end CHARACTERISTIC
/begin CHARACTERISTIC cfHDS_CORR_ADAT_Value "[FIX] Fix su Adaptive Air/Fuel Control Feedback" VALUE 0xFC852F Scalar_UBYTE 0 HDSECU2_Tx_50ms_CM_ufix8_En5_Bp75_adm 0.75 1.25 /end CHARACTERISTIC
/begin CHARACTERISTIC cfHDS_ENABLE_IDLE_CTRL_Enable "[FIX] Fix su Flag di stato per abilitare il vControllo in Idle" VALUE 0xFC852E Scalar_UBYTE 0 HDSECU2_Tx_50ms_CM_FixEnableT 171 218 /end CHARACTERISTIC
/begin CHARACTERISTIC cfHDS_ENABLE_IDLE_CTRL_Value "[FIX] Fix su Flag di stato per abilitare il vControllo in Idle" VALUE 0xFC852D Scalar_BOOLEAN 0 HDSECU2_Tx_50ms_CM_boolean_adm 0 1 /end CHARACTERISTIC
/begin CHARACTERISTIC cfHDS_ENG_MODE_Enable "[FIX] Fix su Modo motore" VALUE 0xFC852C Scalar_UBYTE 0 HDSECU2_Tx_50ms_CM_FixEnableT 171 218 /end CHARACTERISTIC
/begin CHARACTERISTIC cfHDS_ENG_MODE_Value "[FIX] Fix su Modo motore" VALUE 0xFC852B Scalar_UBYTE 0 HDSECU2_Tx_50ms_CM_uint8_adm 0 4 /end CHARACTERISTIC
/begin CHARACTERISTIC cfHDS_ENG_STATE_Enable "[FIX] Fix su Stato motore" VALUE 0xFC852A Scalar_UBYTE 0 HDSECU2_Tx_50ms_CM_FixEnableT 171 218 /end CHARACTERISTIC
/begin CHARACTERISTIC cfHDS_ENG_STATE_Value "[FIX] Fix su Stato motore" VALUE 0xFC8529 Scalar_UBYTE 0 HDSECU2_Tx_50ms_CM_uint8_adm 0 6 /end CHARACTERISTIC
/begin CHARACTERISTIC cfHDS_EOBD_CODERR_Enable "[FIX] Fix su codice errore diagnosi EOBD" VALUE 0xFC8528 Scalar_UBYTE 0 HDSECU2_Tx_50ms_CM_FixEnableT 171 218 /end CHARACTERISTIC
/begin CHARACTERISTIC cfHDS_EOBD_CODERR_Value "[FIX] Fix su codice errore diagnosi EOBD" VALUE 0xFC8527 Scalar_UBYTE 0 HDSECU2_Tx_50ms_CM_uint8_adm 0 250 /end CHARACTERISTIC
/begin CHARACTERISTIC cfHDS_KO2_Enable "[FIX] Fix su Air/Fuel Control Feedback" VALUE 0xFC8526 Scalar_UBYTE 0 HDSECU2_Tx_50ms_CM_FixEnableT 171 218 /end CHARACTERISTIC
/begin CHARACTERISTIC cfHDS_KO2_Value "[FIX] Fix su Air/Fuel Control Feedback" VALUE 0xFC8525 Scalar_UBYTE 0 HDSECU2_Tx_50ms_CM_ufix8_En5_Bp75_adm 0.75 1.25 /end CHARACTERISTIC
/begin CHARACTERISTIC cfHDS_LAMBDA_PRE_Enable "[FIX] Fix su Valore in mVolt della Sonda Lambda pre-catalizzatore" VALUE 0xFC8524 Scalar_UBYTE 0 HDSECU2_Tx_50ms_CM_FixEnableT 171 218 /end CHARACTERISTIC
/begin CHARACTERISTIC cfHDS_LAMBDA_PRE_Value "[FIX] Fix su Valore in mVolt della Sonda Lambda pre-catalizzatore" VALUE 0xFC8522 Scalar_UWORD 0 HDSECU2_Tx_50ms_CM_uint16_mV 0 1000 /end CHARACTERISTIC
/begin CHARACTERISTIC cfHDS_MAP_Enable "[FIX] Fix su Pressione nel collettore di aspirazione (assoluta)" VALUE 0xFC8520 Scalar_UBYTE 0 HDSECU1_Tx_50ms_CM_FixEnableT 171 218 /end CHARACTERISTIC
/begin CHARACTERISTIC cfHDS_MAP_Value "[FIX] Fix su Pressione nel collettore di aspirazione (assoluta)" VALUE 0xFC851F Scalar_UBYTE 0 HDSECU1_Tx_50ms_CM_ufix8_S10_mbar 0 2500 /end CHARACTERISTIC
/begin CHARACTERISTIC cfHDS_POTENZ_THR_Enable "[FIX] Fix su Potenziometro della farfalla motorizzata" VALUE 0xFC851E Scalar_UBYTE 0 HDSECU2_Tx_50ms_CM_FixEnableT 171 218 /end CHARACTERISTIC
/begin CHARACTERISTIC cfHDS_POTENZ_THR_Value "[FIX] Fix su Potenziometro della farfalla motorizzata" VALUE 0xFC851D Scalar_UBYTE 0 HDSECU2_Tx_50ms_CM_ufix8_Bn10__ -10 100 /end CHARACTERISTIC
/begin CHARACTERISTIC cfHDS_PRE_Enable "[FIX] Fix su Pressione collettore stimata dal predittore di pressione" VALUE 0xFC851C Scalar_UBYTE 0 HDSECU1_Tx_50ms_CM_FixEnableT 171 218 /end CHARACTERISTIC
/begin CHARACTERISTIC cfHDS_PRE_Value "[FIX] Fix su Pressione collettore stimata dal predittore di pressione" VALUE 0xFC851B Scalar_UBYTE 0 HDSECU1_Tx_50ms_CM_ufix8_S10_mbar 0 2500 /end CHARACTERISTIC
/begin CHARACTERISTIC cfHDS_P_RAIL_Enable "[FIX] Fix su Pressione metano nel rail (assoluta)" VALUE 0xFC851A Scalar_UBYTE 0 HDSECU1_Tx_50ms_CM_FixEnableT 171 218 /end CHARACTERISTIC
/begin CHARACTERISTIC cfHDS_P_RAIL_Value "[FIX] Fix su Pressione metano nel rail (assoluta)" VALUE 0xFC8519 Scalar_UBYTE 0 HDSECU1_Tx_50ms_CM_ufix8_S60_mbar 0 13800 /end CHARACTERISTIC
/begin CHARACTERISTIC cfHDS_QAIR_REQUEST_Enable "[FIX] Fix su Richiesta di aria calcolata nel ramo lento della Coppia" VALUE 0xFC8518 Scalar_UBYTE 0 HDSECU1_Tx_50ms_CM_FixEnableT 171 218 /end CHARACTERISTIC
/begin CHARACTERISTIC cfHDS_QAIR_REQUEST_Value "[FIX] Fix su Richiesta di aria calcolata nel ramo lento della Coppia" VALUE 0xFC8517 Scalar_UBYTE 0 HDSECU1_Tx_50ms_CM_ufix8_S5_kg_h 0 1000 /end CHARACTERISTIC
/begin CHARACTERISTIC cfHDS_RIF_PRESS_Enable "[FIX] Fix su Pressione metano nel rail (assoluta)" VALUE 0xFC8516 Scalar_UBYTE 0 HDSECU1_Tx_50ms_CM_FixEnableT 171 218 /end CHARACTERISTIC
/begin CHARACTERISTIC cfHDS_RIF_PRESS_Value "[FIX] Fix su Pressione metano nel rail (assoluta)" VALUE 0xFC8515 Scalar_UBYTE 0 HDSECU1_Tx_50ms_CM_ufix8_S10_mbar 0 2500 /end CHARACTERISTIC
/begin CHARACTERISTIC cfHDS_THROT_REF_PERC_Enable "[FIX] Fix su Richiesta farfalla motorizzata" VALUE 0xFC8514 Scalar_UBYTE 0 HDSECU2_Tx_50ms_CM_FixEnableT 171 218 /end CHARACTERISTIC
/begin CHARACTERISTIC cfHDS_THROT_REF_PERC_Value "[FIX] Fix su Richiesta farfalla motorizzata" VALUE 0xFC8513 Scalar_UBYTE 0 HDSECU2_Tx_50ms_CM_ufix8_Bn10__ -10 100 /end CHARACTERISTIC
/begin CHARACTERISTIC cfHDS_TORQUE_EFF_Enable "[FIX] Fix su Efficienza Coppia da CAN (Meas/Prog)" VALUE 0xFC8512 Scalar_UBYTE 0 HDSECU2_Tx_50ms_CM_FixEnableT 171 218 /end CHARACTERISTIC
/begin CHARACTERISTIC cfHDS_TORQUE_EFF_Value "[FIX] Fix su Efficienza Coppia da CAN (Meas/Prog)" VALUE 0xFC8511 Scalar_UBYTE 0 HDSECU2_Tx_50ms_CM_uint8__ 0 100 /end CHARACTERISTIC
/begin CHARACTERISTIC cfHDS_T_INJ_Enable "[FIX] Fix su Injection Time" VALUE 0xFC8510 Scalar_UBYTE 0 HDSECU1_Tx_50ms_CM_FixEnableT 171 218 /end CHARACTERISTIC
/begin CHARACTERISTIC cfHDS_T_INJ_Value "[FIX] Fix su Injection Time" VALUE 0xFC850F Scalar_UBYTE 0 HDSECU1_Tx_50ms_CM_ufix8_S280_us 0 65520 /end CHARACTERISTIC
/begin CHARACTERISTIC cfHDS_WG_DUTY_Enable "[FIX] Fix su duty cycle waste gate" VALUE 0xFC850E Scalar_UBYTE 0 HDSECU2_Tx_50ms_CM_FixEnableT 171 218 /end CHARACTERISTIC
/begin CHARACTERISTIC cfHDS_WG_DUTY_Value "[FIX] Fix su duty cycle waste gate" VALUE 0xFC850D Scalar_UBYTE 0 HDSECU2_Tx_50ms_CM_ufix8_E2__ 0 100 /end CHARACTERISTIC
/begin CHARACTERISTIC cfHEATER_CTRL_FAIL_Enable "[FIX] Fix on Heater Control Fail Diagnosis Uego Sensor (01-Fail 00-No Fail)" VALUE 0xFC835A Scalar_UBYTE 0 USS_Rx_50ms_CM_FixEnableT 171 218 /end CHARACTERISTIC
/begin CHARACTERISTIC cfHEATER_CTRL_FAIL_Value "[FIX] Fix on Heater Control Fail Diagnosis Uego Sensor (01-Fail 00-No Fail)" VALUE 0xFC8359 Scalar_BOOLEAN 0 USS_Rx_50ms_CM_boolean_adm 0 1 /end CHARACTERISTIC
/begin CHARACTERISTIC cfHIGH_GOV_Enable "[FIX] Fix su high governor parameter set" VALUE 0xFC8358 Scalar_UBYTE 0 VCM2ECM_Rx_50ms_CM_FixEnableT 171 218 /end CHARACTERISTIC
/begin CHARACTERISTIC cfHIGH_GOV_Value "[FIX] Fix su high governor parameter set" VALUE 0xFC8357 Scalar_UBYTE 0 VCM2ECM_Rx_50ms_CM_uint8_adm 0 7 /end CHARACTERISTIC
/begin CHARACTERISTIC cfHIGH_IDLE_Enable "[FIX] Fix sul low idle set point" VALUE 0xFC8356 Scalar_UBYTE 0 VCM2ECM_Rx_50ms_CM_FixEnableT 171 218 /end CHARACTERISTIC
/begin CHARACTERISTIC cfHIGH_IDLE_Value "[FIX] Fix sul low idle set point" VALUE 0xFC8354 Scalar_UWORD 0 VCM2ECM_Rx_50ms_CM_ufix16_En3_rpm 0 8031.875 /end CHARACTERISTIC
/begin CHARACTERISTIC cfHIGH_RPM_CMD_Enable "[FIX] High Engine Speed Lamp Command" VALUE 0xFC8462 Scalar_UBYTE 0 DLCC1_Tx_1s_CM_FixEnableT 171 218 /end CHARACTERISTIC
/begin CHARACTERISTIC cfHIGH_RPM_CMD_Value "[FIX] High Engine Speed Lamp Command" VALUE 0xFC8461 Scalar_UBYTE 0 DLCC1_Tx_1s_CM_uint8_adm 0 3 /end CHARACTERISTIC
/begin CHARACTERISTIC cfHOURS_Enable "[FIX] Fix sulle ore (ricevute da CAN)" VALUE 0xFC82B6 Scalar_UBYTE 0 TIMEDATE_Rx_1s_CM_FixEnableT 171 218 /end CHARACTERISTIC
/begin CHARACTERISTIC cfHOURS_Value "[FIX] Fix sulle ore (ricevute da CAN)" VALUE 0xFC82B5 Scalar_UBYTE 0 TIMEDATE_Rx_1s_CM_uint8_h 0 23 /end CHARACTERISTIC
/begin CHARACTERISTIC cfINIT_WAIT_INFO_Enable "[FIX] Fix on the Initializing Wait info communicated by TURBO CONTROLLER (0 -Null;1- Wait)" VALUE 0xFC2C11 Scalar_UBYTE 0 TURBO2ECU_Rx_4ms_CM_FixEnableT 171 218 /end CHARACTERISTIC
/begin CHARACTERISTIC cfINIT_WAIT_INFO_Value "[FIX] Fix on the Initializing Wait info communicated by TURBO CONTROLLER (0 -Null;1- Wait)" VALUE 0xFC2C10 Scalar_BOOLEAN 0 TURBO2ECU_Rx_4ms_CM_boolean_deg 0 1 /end CHARACTERISTIC
/begin CHARACTERISTIC cfINST_Q_INJ_Enable "[Fix] Instantaneous Fuel Quantity Injected - j1939 CAN ECM2EPR Msg" VALUE 0xFC84A2 Scalar_UBYTE 0 ECM2EPR_Tx_4ms_CM_FixEnableT_adm 171 218 /end CHARACTERISTIC
/begin CHARACTERISTIC cfINST_Q_INJ_Value "[Fix] Instantaneous Fuel Quantity Injected - j1939 CAN ECM2EPR Msg" VALUE 0xFC84A0 Scalar_UWORD 0 ECM2EPR_Tx_4ms_CM_ufix16_En8_kg_hour 0 140 /end CHARACTERISTIC
/begin CHARACTERISTIC cfINT_GOV_Enable "[FIX] Fix su Intermediate Speed Governor parameter set" VALUE 0xFC8352 Scalar_UBYTE 0 VCM2ECM_Rx_50ms_CM_FixEnableT 171 218 /end CHARACTERISTIC
/begin CHARACTERISTIC cfINT_GOV_Value "[FIX] Fix su Intermediate Speed Governor parameter set" VALUE 0xFC8351 Scalar_UBYTE 0 VCM2ECM_Rx_50ms_CM_uint8_adm 0 7 /end CHARACTERISTIC
/begin CHARACTERISTIC cfINT_RET_PER_TQ_Enable "[FIX] Fix su PATCH VCM" VALUE 0xFC8460 Scalar_UBYTE 0 ERC1_ER_Tx_1s_CM_FixEnableT 171 218 /end CHARACTERISTIC
/begin CHARACTERISTIC cfINT_RET_PER_TQ_Value "[FIX] Fix su PATCH VCM" VALUE 0xFC845F Scalar_UBYTE 0 ERC1_ER_Tx_1s_CM_ufix8_Bn125__ -125 125 /end CHARACTERISTIC
/begin CHARACTERISTIC cfIP_CURRENT_Enable "[FIX] Fix on current Ip of Uego Sensor (-12mA to 12mA)" VALUE 0xFC8350 Scalar_UBYTE 0 USS_Rx_50ms_CM_FixEnableT 171 218 /end CHARACTERISTIC
/begin CHARACTERISTIC cfIP_CURRENT_Value "[FIX] Fix on current Ip of Uego Sensor (-12mA to 12mA)" VALUE 0xFC834E Scalar_SWORD 0 USS_Rx_50ms_CM_sfix16_Sp001_Bn15_mA -12 12 /end CHARACTERISTIC
/begin CHARACTERISTIC cfKEY_SW_BAT_POT_Enable "[FIX] SPN 158 - Key Switch Battery Potential" VALUE 0xFC845E Scalar_UBYTE 0 VEP1_Tx_1s_CM_FixEnableT 171 218 /end CHARACTERISTIC
/begin CHARACTERISTIC cfKEY_SW_BAT_POT_Value "[FIX] SPN 158 - Key Switch Battery Potential" VALUE 0xFC845C Scalar_UWORD 0 VEP1_Tx_1s_CM_ufix16_Sp05_V 0 3212.75 /end CHARACTERISTIC
/begin CHARACTERISTIC cfKICK_DOWN_Enable "[FIX] Fix su \"Percent Load at Current Speed\" (Tx to CAN)" VALUE 0xFC850C Scalar_UBYTE 0 EEC2_Tx_50ms_CM_FixEnableT 171 218 /end CHARACTERISTIC
/begin CHARACTERISTIC cfKICK_DOWN_Value "[FIX] Fix su \"Percent Load at Current Speed\" (Tx to CAN)" VALUE 0xFC850B Scalar_UBYTE 0 EEC2_Tx_50ms_CM_uint8_adm 0 3 /end CHARACTERISTIC
/begin CHARACTERISTIC cfLOW_BATT_CMD_Enable "[FIX] Low Battery Voltage Lamp Command" VALUE 0xFC845A Scalar_UBYTE 0 DLCC2_Tx_1s_CM_FixEnableT 171 218 /end CHARACTERISTIC
/begin CHARACTERISTIC cfLOW_BATT_CMD_Value "[FIX] Low Battery Voltage Lamp Command" VALUE 0xFC8459 Scalar_UBYTE 0 DLCC2_Tx_1s_CM_uint8_adm 0 3 /end CHARACTERISTIC
/begin CHARACTERISTIC cfLOW_FUEL_CMD_Enable "[FIX] Low Fuel Level Lamp Command" VALUE 0xFC8458 Scalar_UBYTE 0 DLCC2_Tx_1s_CM_FixEnableT 171 218 /end CHARACTERISTIC
/begin CHARACTERISTIC cfLOW_FUEL_CMD_Value "[FIX] Low Fuel Level Lamp Command" VALUE 0xFC8457 Scalar_UBYTE 0 DLCC2_Tx_1s_CM_uint8_adm 0 3 /end CHARACTERISTIC
/begin CHARACTERISTIC cfLOW_GOV_Enable "[FIX] Fix sul low Governor parameter set" VALUE 0xFC834C Scalar_UBYTE 0 VCM2ECM_Rx_50ms_CM_FixEnableT 171 218 /end CHARACTERISTIC
/begin CHARACTERISTIC cfLOW_GOV_Value "[FIX] Fix sul low Governor parameter set" VALUE 0xFC834B Scalar_UBYTE 0 VCM2ECM_Rx_50ms_CM_uint8_adm 0 7 /end CHARACTERISTIC
/begin CHARACTERISTIC cfLOW_IDLE_Enable "[FIX] Fix sul low idle set point" VALUE 0xFC834A Scalar_UBYTE 0 VCM2ECM_Rx_50ms_CM_FixEnableT 171 218 /end CHARACTERISTIC
/begin CHARACTERISTIC cfLOW_IDLE_SW_Enable "[FIX] Fix su \"Low Idle Switch\" (Tx to CAN)" VALUE 0xFC850A Scalar_UBYTE 0 EEC2_Tx_50ms_CM_FixEnableT 171 218 /end CHARACTERISTIC
/begin CHARACTERISTIC cfLOW_IDLE_SW_Value "[FIX] Fix su \"Low Idle Switch\" (Tx to CAN)" VALUE 0xFC8509 Scalar_UBYTE 0 EEC2_Tx_50ms_CM_uint8_adm 0 3 /end CHARACTERISTIC
/begin CHARACTERISTIC cfLOW_IDLE_Value "[FIX] Fix sul low idle set point" VALUE 0xFC8348 Scalar_UWORD 0 VCM2ECM_Rx_50ms_CM_ufix16_En3_rpm 0 8031.875 /end CHARACTERISTIC
/begin CHARACTERISTIC cfLOW_OIL_CMD_Enable "[FIX] Low Level Engine Oil Lamp Command" VALUE 0xFC8456 Scalar_UBYTE 0 DLCC1_Tx_1s_CM_FixEnableT 171 218 /end CHARACTERISTIC
/begin CHARACTERISTIC cfLOW_OIL_CMD_Value "[FIX] Low Level Engine Oil Lamp Command" VALUE 0xFC8455 Scalar_UBYTE 0 DLCC1_Tx_1s_CM_uint8_adm 0 3 /end CHARACTERISTIC
/begin CHARACTERISTIC cfMAP_CAN_Enable "[FIX] Fix sulla Pressione MAP inviata via rete CAN" VALUE 0xFC83AE Scalar_UBYTE 0 INLET_COND_Tx_100ms_CM_FixEnableT 171 218 /end CHARACTERISTIC
/begin CHARACTERISTIC cfMAP_CAN_Value "[FIX] Fix sulla Pressione MAP inviata via rete CAN" VALUE 0xFC83AD Scalar_UBYTE 0 INLET_COND_Tx_100ms_CM_ufix8_E1_kPa 0 500 /end CHARACTERISTIC
/begin CHARACTERISTIC cfMECH_PTO_ENG_Enable "[FIX] Fix sullo stato MEchanical PTO Engaged" VALUE 0xFC8346 Scalar_UBYTE 0 BC2EDC2_Rx_50ms_CM_FixEnableT 171 218 /end CHARACTERISTIC
/begin CHARACTERISTIC cfMECH_PTO_ENG_Value "[FIX] Fix sullo stato MEchanical PTO Engaged" VALUE 0xFC8345 Scalar_UBYTE 0 BC2EDC2_Rx_50ms_CM_uint8_adm 0 1 /end CHARACTERISTIC
/begin CHARACTERISTIC cfMEM_ACCESS_ABNORM_Enable "[FIX] Fix on the Memory Accessl Abnormal Fault communicated by TURBO CONTROLLER (0 - No Fault)" VALUE 0xFC2C0F Scalar_UBYTE 0 TURBO2ECU_Rx_4ms_CM_FixEnableT 171 218 /end CHARACTERISTIC
/begin CHARACTERISTIC cfMEM_ACCESS_ABNORM_Value "[FIX] Fix on the Memory Accessl Abnormal Fault communicated by TURBO CONTROLLER (0 - No Fault)" VALUE 0xFC2C0E Scalar_BOOLEAN 0 TURBO2ECU_Rx_4ms_CM_boolean_deg 0 1 /end CHARACTERISTIC
/begin CHARACTERISTIC cfMIL_AVAIL_CAN_Enable "[FIX] Fix sulla disponibilità lampada MIL (0 available; 1 not available)" VALUE 0xFC8344 Scalar_UBYTE 0 BC2EDC1_Rx_50ms_CM_FixEnableT 171 218 /end CHARACTERISTIC
/begin CHARACTERISTIC cfMIL_AVAIL_CAN_Value "[FIX] Fix sulla disponibilità lampada MIL (0 available; 1 not available)" VALUE 0xFC8343 Scalar_BOOLEAN 0 BC2EDC1_Rx_50ms_CM_boolean_adm 0 1 /end CHARACTERISTIC
/begin CHARACTERISTIC cfMIL_CMD_Enable "[FIX] MIL Command" VALUE 0xFC8454 Scalar_UBYTE 0 DLCC1_Tx_1s_CM_FixEnableT 171 218 /end CHARACTERISTIC
/begin CHARACTERISTIC cfMIL_CMD_Value "[FIX] MIL Command" VALUE 0xFC8453 Scalar_UBYTE 0 DLCC1_Tx_1s_CM_uint8_adm 0 3 /end CHARACTERISTIC
/begin CHARACTERISTIC cfMIL_STATUS_Enable "[FIX] Fix su \"MIL lamp status\" (Tx to CAN)" VALUE 0xFC8508 Scalar_UBYTE 0 EDC2BC_Tx_50ms_CM_FixEnableT 171 218 /end CHARACTERISTIC
/begin CHARACTERISTIC cfMIL_STATUS_Value "[FIX] Fix su \"MIL lamp status\" (Tx to CAN)" VALUE 0xFC8507 Scalar_UBYTE 0 EDC2BC_Tx_50ms_CM_uint8_adm 0 3 /end CHARACTERISTIC
/begin CHARACTERISTIC cfMINUTES_Enable "[FIX] Fix sui minuti (ricevuti da CAN)" VALUE 0xFC82B4 Scalar_UBYTE 0 TIMEDATE_Rx_1s_CM_FixEnableT 171 218 /end CHARACTERISTIC
/begin CHARACTERISTIC cfMINUTES_Value "[FIX] Fix sui minuti (ricevuti da CAN)" VALUE 0xFC82B3 Scalar_UBYTE 0 TIMEDATE_Rx_1s_CM_uint8_min 0 59 /end CHARACTERISTIC
/begin CHARACTERISTIC cfMONTH_Enable "[FIX] Fix sui mesi (ricevuti da CAN)" VALUE 0xFC82B2 Scalar_UBYTE 0 TIMEDATE_Rx_1s_CM_FixEnableT 171 218 /end CHARACTERISTIC
/begin CHARACTERISTIC cfMONTH_Value "[FIX] Fix sui mesi (ricevuti da CAN)" VALUE 0xFC82B1 Scalar_UBYTE 0 TIMEDATE_Rx_1s_CM_uint8_month 1 12 /end CHARACTERISTIC
/begin CHARACTERISTIC cfMOTOR_SHORT_FAULT_Enable "[FIX] Fix on the Motor Short Fault communicated by TURBO CONTROLLER (0 - No Fault)" VALUE 0xFC2C0D Scalar_UBYTE 0 TURBO2ECU_Rx_4ms_CM_FixEnableT 171 218 /end CHARACTERISTIC
/begin CHARACTERISTIC cfMOTOR_SHORT_FAULT_Value "[FIX] Fix on the Motor Short Fault communicated by TURBO CONTROLLER (0 - No Fault)" VALUE 0xFC2C0C Scalar_BOOLEAN 0 TURBO2ECU_Rx_4ms_CM_boolean_deg 0 1 /end CHARACTERISTIC
/begin CHARACTERISTIC cfMPRAIL_CAN_Enable "[FIX] Fix Engine Fuel 1 Injector Metering Rail 1 Pressure (SPN 157)" VALUE 0xFC83AC Scalar_UBYTE 0 EFL_P2_Tx_100ms_CM_FixEnableT 171 218 /end CHARACTERISTIC
/begin CHARACTERISTIC cfMPRAIL_CAN_Value "[FIX] Fix Engine Fuel 1 Injector Metering Rail 1 Pressure (SPN 157)" VALUE 0xFC83AA Scalar_UWORD 0 EFL_P2_Tx_100ms_CM_ufix16_En8_MPa 0 250.996 /end CHARACTERISTIC
/begin CHARACTERISTIC cfNEUTRAL_Enable "[FIX] Fix su msg di Neutral ON - OFF" VALUE 0xFC8342 Scalar_UBYTE 0 BC2EDC2_Rx_50ms_CM_FixEnableT 171 218 /end CHARACTERISTIC
/begin CHARACTERISTIC cfNEUTRAL_Value "[FIX] Fix su msg di Neutral ON - OFF" VALUE 0xFC8341 Scalar_BOOLEAN 0 BC2EDC2_Rx_50ms_CM_boolean_adm 0 1 /end CHARACTERISTIC
/begin CHARACTERISTIC cfO2_CONC_Enable "[FIX] Fix on O2 concentration of Uego Sensor (-30% to 30%)" VALUE 0xFC8340 Scalar_UBYTE 0 USS_Rx_50ms_CM_FixEnableT 171 218 /end CHARACTERISTIC
/begin CHARACTERISTIC cfO2_CONC_Value "[FIX] Fix on O2 concentration of Uego Sensor (-30% to 30%)" VALUE 0xFC833E Scalar_SWORD 0 USS_Rx_50ms_CM_sfix16_Sp01_Bn40p96__ -30 30 /end CHARACTERISTIC
/begin CHARACTERISTIC cfO2_STAB_Enable "[FIX] Fix on O2 stable feedback of Uego Sensor (01-stable 00-not stable)" VALUE 0xFC833C Scalar_UBYTE 0 USS_Rx_50ms_CM_FixEnableT 171 218 /end CHARACTERISTIC
/begin CHARACTERISTIC cfO2_STAB_Value "[FIX] Fix on O2 stable feedback of Uego Sensor (01-stable 00-not stable)" VALUE 0xFC833B Scalar_UBYTE 0 USS_Rx_50ms_CM_uint8_adm 0 1 /end CHARACTERISTIC
/begin CHARACTERISTIC cfOIL_PRESS_STATE_Enable "[FIX] Fix su pressione olio sotto soglia" VALUE 0xFC8506 Scalar_UBYTE 0 EDC2BC_Tx_50ms_CM_FixEnableT 171 218 /end CHARACTERISTIC
/begin CHARACTERISTIC cfOIL_PRESS_STATE_Value "[FIX] Fix su pressione olio sotto soglia" VALUE 0xFC8505 Scalar_UBYTE 0 EDC2BC_Tx_50ms_CM_uint8_adm 0 3 /end CHARACTERISTIC
/begin CHARACTERISTIC cfOP_MODE_Enable "[FIX] Fix on the Operation Mode communicated by TURBO CONTROLLER (0 - Supply OFF Impossibile; 1- Supply OFF Possibile)" VALUE 0xFC2C0B Scalar_UBYTE 0 TURBO2ECU_Rx_4ms_CM_FixEnableT 171 218 /end CHARACTERISTIC
/begin CHARACTERISTIC cfOP_MODE_Value "[FIX] Fix on the Operation Mode communicated by TURBO CONTROLLER (0 - Supply OFF Impossibile; 1- Supply OFF Possibile)" VALUE 0xFC2C0A Scalar_BOOLEAN 0 TURBO2ECU_Rx_4ms_CM_boolean_deg 0 1 /end CHARACTERISTIC
/begin CHARACTERISTIC cfOP_RANGE_ABNORM_Enable "[FIX] Fix on the Operating Range Abnormal Value Fault communicated by TURBO CONTROLLER (0 - No Fault)" VALUE 0xFC2C09 Scalar_UBYTE 0 TURBO2ECU_Rx_4ms_CM_FixEnableT 171 218 /end CHARACTERISTIC
/begin CHARACTERISTIC cfOP_RANGE_ABNORM_Value "[FIX] Fix on the Operating Range Abnormal Value Fault communicated by TURBO CONTROLLER (0 - No Fault)" VALUE 0xFC2C08 Scalar_BOOLEAN 0 TURBO2ECU_Rx_4ms_CM_boolean_deg 0 1 /end CHARACTERISTIC
/begin CHARACTERISTIC cfOP_RANGE_MON_Enable "[FIX]  Fix on the Operating Range communicated by TURBO CONTROLLER" VALUE 0xFC2C07 Scalar_UBYTE 0 TURBO2ECU_Rx_4ms_CM_FixEnableT 171 218 /end CHARACTERISTIC
/begin CHARACTERISTIC cfOP_RANGE_MON_Value "[FIX] Fix on the Operating Range communicated by TURBO CONTROLLER" VALUE 0xFC2C06 Scalar_UBYTE 0 TURBO2ECU_Rx_4ms_CM_ufix8_Sp416_deg 0 106.08 /end CHARACTERISTIC
/begin CHARACTERISTIC cfOUT_SHF_SPD_Enable "[FIX] Fix su velocità della distribuzione fra gearbox e differenziale" VALUE 0xFC82FA Scalar_UBYTE 0 ETC1_Rx_4ms_CM_FixEnableT 171 218 /end CHARACTERISTIC
/begin CHARACTERISTIC cfOUT_SHF_SPD_Value "[FIX] Fix su velocità della distribuzione fra gearbox e differenziale" VALUE 0xFC82F8 Scalar_UWORD 0 ETC1_Rx_4ms_CM_ufix16_En3_rpm 0 8031.875 /end CHARACTERISTIC
/begin CHARACTERISTIC cfP1_IDLE_SPEED_Enable "[FIX] Fix su \"Engine Speed at Idle\" (Tx to CAN)" VALUE 0xFC8452 Scalar_UBYTE 0 ENG_CONF_Tx_1s_CM_FixEnableT 171 218 /end CHARACTERISTIC
/begin CHARACTERISTIC cfP1_IDLE_SPEED_Value "[FIX] Fix su \"Engine Speed at Idle\" (Tx to CAN)" VALUE 0xFC8450 Scalar_UWORD 0 ENG_CONF_Tx_1s_CM_ufix16_En3_rpm 0 8031 /end CHARACTERISTIC
/begin CHARACTERISTIC cfP1_PERC_CMU_Enable "[FIX] Fix su \"Percent Torque at Idle\" (Tx to CAN)" VALUE 0xFC844E Scalar_UBYTE 0 ENG_CONF_Tx_1s_CM_FixEnableT 171 218 /end CHARACTERISTIC
/begin CHARACTERISTIC cfP1_PERC_CMU_Value "[FIX] Fix su \"Percent Torque at Idle\" (Tx to CAN)" VALUE 0xFC844D Scalar_UBYTE 0 ENG_CONF_Tx_1s_CM_ufix8_Bn125__ -125 125 /end CHARACTERISTIC
/begin CHARACTERISTIC cfP2_END_SP_GOV_Enable "[FIX] Fix su \"Highest possible engine speed\" (Tx to CAN)" VALUE 0xFC844C Scalar_UBYTE 0 ENG_CONF_Tx_1s_CM_FixEnableT 171 218 /end CHARACTERISTIC
/begin CHARACTERISTIC cfP2_END_SP_GOV_Value "[FIX] Fix su \"Highest possible engine speed\" (Tx to CAN)" VALUE 0xFC844A Scalar_UWORD 0 ENG_CONF_Tx_1s_CM_ufix16_En3_rpm 0 8031 /end CHARACTERISTIC
/begin CHARACTERISTIC cfP2_PERC_CMU_Enable "[FIX] Fix su \"Percent Torque at highest speed\" (Tx to CAN)" VALUE 0xFC8448 Scalar_UBYTE 0 ENG_CONF_Tx_1s_CM_FixEnableT 171 218 /end CHARACTERISTIC
/begin CHARACTERISTIC cfP2_PERC_CMU_Value "[FIX] Fix su \"Percent Torque at highest speed\" (Tx to CAN)" VALUE 0xFC8447 Scalar_UBYTE 0 ENG_CONF_Tx_1s_CM_ufix8_Bn125__ -125 125 /end CHARACTERISTIC
/begin CHARACTERISTIC cfP3_DOWN_P4_SP_Enable "[FIX] Fix su \"Engine speed (point 3)\" (Tx to CAN)" VALUE 0xFC8446 Scalar_UBYTE 0 ENG_CONF_Tx_1s_CM_FixEnableT 171 218 /end CHARACTERISTIC
/begin CHARACTERISTIC cfP3_DOWN_P4_SP_Value "[FIX] Fix su \"Engine speed (point 3)\" (Tx to CAN)" VALUE 0xFC8444 Scalar_UWORD 0 ENG_CONF_Tx_1s_CM_ufix16_En3_rpm 0 8031 /end CHARACTERISTIC
/begin CHARACTERISTIC cfP3_PERC_CMU_Enable "[FIX] Fix su \"Percent Torque (point 3)\" (Tx to CAN)" VALUE 0xFC8442 Scalar_UBYTE 0 ENG_CONF_Tx_1s_CM_FixEnableT 171 218 /end CHARACTERISTIC
/begin CHARACTERISTIC cfP3_PERC_CMU_Value "[FIX] Fix su \"Percent Torque (point 3)\" (Tx to CAN)" VALUE 0xFC8441 Scalar_UBYTE 0 ENG_CONF_Tx_1s_CM_ufix8_Bn125__ -125 125 /end CHARACTERISTIC
/begin CHARACTERISTIC cfP4_DOWN_P5_SP_Enable "[FIX] Fix su \"Engine speed (point 4)\" (Tx to CAN)" VALUE 0xFC8440 Scalar_UBYTE 0 ENG_CONF_Tx_1s_CM_FixEnableT 171 218 /end CHARACTERISTIC
/begin CHARACTERISTIC cfP4_DOWN_P5_SP_Value "[FIX] Fix su \"Engine speed (point 4)\" (Tx to CAN)" VALUE 0xFC843E Scalar_UWORD 0 ENG_CONF_Tx_1s_CM_ufix16_En3_rpm 0 8031 /end CHARACTERISTIC
/begin CHARACTERISTIC cfP4_PERC_CMU_Enable "[FIX] Fix su \"Percent Torque (point 4)\" (Tx to CAN)" VALUE 0xFC843C Scalar_UBYTE 0 ENG_CONF_Tx_1s_CM_FixEnableT 171 218 /end CHARACTERISTIC
/begin CHARACTERISTIC cfP4_PERC_CMU_Value "[FIX] Fix su \"Percent Torque (point 4)\" (Tx to CAN)" VALUE 0xFC843B Scalar_UBYTE 0 ENG_CONF_Tx_1s_CM_ufix8_Bn125__ -125 125 /end CHARACTERISTIC
/begin CHARACTERISTIC cfP5_DOWN_END_SP_Enable "[FIX] Fix su \"Engine speed (point 5)\" (Tx to CAN)" VALUE 0xFC843A Scalar_UBYTE 0 ENG_CONF_Tx_1s_CM_FixEnableT 171 218 /end CHARACTERISTIC
/begin CHARACTERISTIC cfP5_DOWN_END_SP_Value "[FIX] Fix su \"Engine speed (point 5)\" (Tx to CAN)" VALUE 0xFC8438 Scalar_UWORD 0 ENG_CONF_Tx_1s_CM_ufix16_En3_rpm 0 8031 /end CHARACTERISTIC
/begin CHARACTERISTIC cfP5_PERC_CMU_Enable "[FIX] Fix su \"Percent Torque (point 5)\" (Tx to CAN)" VALUE 0xFC8436 Scalar_UBYTE 0 ENG_CONF_Tx_1s_CM_FixEnableT 171 218 /end CHARACTERISTIC
/begin CHARACTERISTIC cfP5_PERC_CMU_Value "[FIX] Fix su \"Percent Torque (point 5)\" (Tx to CAN)" VALUE 0xFC8435 Scalar_UBYTE 0 ENG_CONF_Tx_1s_CM_ufix8_Bn125__ -125 125 /end CHARACTERISTIC
/begin CHARACTERISTIC cfP6_GAIN_KP_Enable "[FIX] Fix su \"Gain of endspeed governor (point 6)\" (Tx to CAN)" VALUE 0xFC8434 Scalar_UBYTE 0 ENG_CONF_Tx_1s_CM_FixEnableT 171 218 /end CHARACTERISTIC
/begin CHARACTERISTIC cfP6_GAIN_KP_Value "[FIX] Fix su \"Gain of endspeed governor (point 6)\" (Tx to CAN)" VALUE 0xFC8432 Scalar_UWORD 0 ENG_CONF_Tx_1s_CM_ufix16_Sp00078125___rpm 0 50.2 /end CHARACTERISTIC
/begin CHARACTERISTIC cfP6_HIGH_IDLE_Enable "[FIX] Fix su \"Engine speed at High Idle (point 6)\" (Tx to CAN)" VALUE 0xFC8430 Scalar_UBYTE 0 ENG_CONF_Tx_1s_CM_FixEnableT 171 218 /end CHARACTERISTIC
/begin CHARACTERISTIC cfP6_HIGH_IDLE_Value "[FIX] Fix su \"Engine speed at High Idle (point 6)\" (Tx to CAN)" VALUE 0xFC842E Scalar_UWORD 0 ENG_CONF_Tx_1s_CM_ufix16_En3_rpm 0 8031 /end CHARACTERISTIC
/begin CHARACTERISTIC cfP6_REF_ENG_CMU_Enable "[FIX] Fix su \"Reference Engine Torque (point 6)\" (Tx to CAN)" VALUE 0xFC842C Scalar_UBYTE 0 ENG_CONF_Tx_1s_CM_FixEnableT 171 218 /end CHARACTERISTIC
/begin CHARACTERISTIC cfP6_REF_ENG_CMU_Value "[FIX] Fix su \"Reference Engine Torque (point 6)\" (Tx to CAN)" VALUE 0xFC842A Scalar_UWORD 0 ENG_CONF_Tx_1s_CM_uint16_N_m 0 64255 /end CHARACTERISTIC
/begin CHARACTERISTIC cfP7_MAX_TIME_OV_Enable "[FIX] Fix su \"Maximum momentary engine override time limit (point 7)\" (Tx to CAN)" VALUE 0xFC8428 Scalar_UBYTE 0 ENG_CONF_Tx_1s_CM_FixEnableT 171 218 /end CHARACTERISTIC
/begin CHARACTERISTIC cfP7_MAX_TIME_OV_Value "[FIX] Fix su \"Maximum momentary engine override time limit (point 7)\" (Tx to CAN)" VALUE 0xFC8427 Scalar_UBYTE 0 ENG_CONF_Tx_1s_CM_ufix8_Sp1_s 0 25 /end CHARACTERISTIC
/begin CHARACTERISTIC cfP7_MOM_OVER_SP_Enable "[FIX] Fix su \"Maximum momentary engine override speed (point 7)\" (Tx to CAN)" VALUE 0xFC8426 Scalar_UBYTE 0 ENG_CONF_Tx_1s_CM_FixEnableT 171 218 /end CHARACTERISTIC
/begin CHARACTERISTIC cfP7_MOM_OVER_SP_Value "[FIX] Fix su \"Maximum momentary engine override speed (point 7)\" (Tx to CAN)" VALUE 0xFC8424 Scalar_UWORD 0 ENG_CONF_Tx_1s_CM_ufix16_En3_rpm 0 8031 /end CHARACTERISTIC
/begin CHARACTERISTIC cfPARK_BRK_Enable "[FIX] Fix sul freno di stazionamento (ricevuta da CAN)" VALUE 0xFC8282 Scalar_UBYTE 0 CCVS_Rx_100ms_CM_FixEnableT 171 218 /end CHARACTERISTIC
/begin CHARACTERISTIC cfPARK_BRK_TX_Enable "[FIX] Fix sul freno di stazionamento (ricevuta da CAN)" VALUE 0xFC83A8 Scalar_UBYTE 0 CCVS_Tx_100ms_CM_FixEnableT 171 218 /end CHARACTERISTIC
/begin CHARACTERISTIC cfPARK_BRK_TX_Value "[FIX] Fix sul freno di stazionamento (ricevuta da CAN)" VALUE 0xFC83A7 Scalar_BOOLEAN 0 CCVS_Tx_100ms_CM_boolean_adm 0 1 /end CHARACTERISTIC
/begin CHARACTERISTIC cfPARK_BRK_Value "[FIX] Fix sul freno di stazionamento (ricevuta da CAN)" VALUE 0xFC8281 Scalar_BOOLEAN 0 CCVS_Rx_100ms_CM_boolean_adm 0 1 /end CHARACTERISTIC
/begin CHARACTERISTIC cfPBOOST_CAN_Enable "[FIX] Fix sulla Pressione di sovralimentazione inviata via rete CAN" VALUE 0xFC83A6 Scalar_UBYTE 0 INLET_COND_Tx_100ms_CM_FixEnableT 171 218 /end CHARACTERISTIC
/begin CHARACTERISTIC cfPBOOST_CAN_Value "[FIX] Fix sulla Pressione di sovralimentazione inviata via rete CAN" VALUE 0xFC83A5 Scalar_UBYTE 0 INLET_COND_Tx_100ms_CM_ufix8_E1_kPa 0 500 /end CHARACTERISTIC
/begin CHARACTERISTIC cfPDL_PERF_REQ_Enable "[FIX] Fix on Driver demand forwarded on CAN (Tx)" VALUE 0xFC849E Scalar_UBYTE 0 EEC1_Tx_4ms_CM_FixEnableT 171 218 /end CHARACTERISTIC
/begin CHARACTERISTIC cfPDL_PERF_REQ_Value "[FIX] Fix on Driver demand forwarded on CAN (Tx)" VALUE 0xFC849D Scalar_UBYTE 0 EEC1_Tx_4ms_CM_ufix8_Bn125__ -125 125 /end CHARACTERISTIC
/begin CHARACTERISTIC cfPERC_CMF_IST_Enable "[FIX] Fix su \"Nominal friction Percent Torque\" (Tx to CAN)" VALUE 0xFC83A4 Scalar_UBYTE 0 EEC3_Tx_100ms_CM_FixEnableT 171 218 /end CHARACTERISTIC
/begin CHARACTERISTIC cfPERC_CMF_IST_Value "[FIX] Fix su \"Nominal friction Percent Torque\" (Tx to CAN)" VALUE 0xFC83A3 Scalar_UBYTE 0 EEC3_Tx_100ms_CM_ufix8_Bn125__ -125 125 /end CHARACTERISTIC
/begin CHARACTERISTIC cfPER_CMU_IST_Enable "[FIX] Fix su \"Percent Load at Current Speed\" (Tx to CAN)" VALUE 0xFC8504 Scalar_UBYTE 0 EEC2_Tx_50ms_CM_FixEnableT 171 218 /end CHARACTERISTIC
/begin CHARACTERISTIC cfPER_CMU_IST_Value "[FIX] Fix su \"Percent Load at Current Speed\" (Tx to CAN)" VALUE 0xFC8503 Scalar_UBYTE 0 EEC2_Tx_50ms_CM_uint8__ 0 125 /end CHARACTERISTIC
/begin CHARACTERISTIC cfPER_CMU_IS_ABS_Enable "[FIX] Fix su \"Torque percent value\" (Tx to CAN)" VALUE 0xFC849C Scalar_UBYTE 0 EEC1_Tx_4ms_CM_FixEnableT 171 218 /end CHARACTERISTIC
/begin CHARACTERISTIC cfPER_CMU_IS_ABS_Value "[FIX] Fix su \"Torque percent value\" (Tx to CAN)" VALUE 0xFC849B Scalar_UBYTE 0 EEC1_Tx_4ms_CM_ufix8_Bn125__ -125 125 /end CHARACTERISTIC
/begin CHARACTERISTIC cfPER_CMU_REQ_Enable "[FIX] Fix su \"Engine Demand Percent Torque\" (Tx to CAN)" VALUE 0xFC849A Scalar_UBYTE 0 EEC1_Tx_4ms_CM_FixEnableT 171 218 /end CHARACTERISTIC
/begin CHARACTERISTIC cfPER_CMU_REQ_Value "[FIX] Fix su \"Engine Demand Percent Torque\" (Tx to CAN)" VALUE 0xFC8499 Scalar_UBYTE 0 EEC1_Tx_4ms_CM_ufix8_Bn125__ -125 125 /end CHARACTERISTIC
/begin CHARACTERISTIC cfPGAS_SUPPLY_CAN_Enable "[FIX] Fix sulla Pressione Metano Bombole (relativa) inviata via rete CAN" VALUE 0xFC83A2 Scalar_UBYTE 0 ALTERNATE_FUEL_Tx_100ms_CM_FixEnableT 171 218 /end CHARACTERISTIC
/begin CHARACTERISTIC cfPGAS_SUPPLY_CAN_Value "[FIX] Fix sulla Pressione Metano Bombole (relativa) inviata via rete CAN" VALUE 0xFC83A0 Scalar_UWORD 0 ALTERNATE_FUEL_Tx_100ms_CM_ufix16_En1_kPa 0 32127.5 /end CHARACTERISTIC
/begin CHARACTERISTIC cfPOIL_CAN_Enable "[FIX] Fix sulla Pressione Olio inviata via rete CAN" VALUE 0xFC839E Scalar_UBYTE 0 ENG_FLD_LEV_PRESS_Tx_100ms_CM_FixEnableT 171 218 /end CHARACTERISTIC
/begin CHARACTERISTIC cfPOIL_CAN_Value "[FIX] Fix sulla Pressione Olio inviata via rete CAN" VALUE 0xFC839D Scalar_UBYTE 0 ENG_FLD_LEV_PRESS_Tx_100ms_CM_ufix8_E2_kPa 0 1000 /end CHARACTERISTIC
/begin CHARACTERISTIC cfPOIL_UNDER_THR_Enable "[FIX] Soglia di warning sulla pressione olio" VALUE 0xFC8502 Scalar_UBYTE 0 EDC2BC_Tx_50ms_CM_FixEnableT 171 218 /end CHARACTERISTIC
/begin CHARACTERISTIC cfPOIL_UNDER_THR_Value "[FIX] Soglia di warning sulla pressione olio" VALUE 0xFC8500 Scalar_UWORD 0 EDC2BC_Tx_50ms_CM_uint16_mbar 250 6000 /end CHARACTERISTIC
/begin CHARACTERISTIC cfPOS_CTRL_ABNORM_Enable "[FIX] Fix on the Position Control Abnormal Fault communicated by TURBO CONTROLLER (0 - No Fault)" VALUE 0xFC2C05 Scalar_UBYTE 0 TURBO2ECU_Rx_4ms_CM_FixEnableT 171 218 /end CHARACTERISTIC
/begin CHARACTERISTIC cfPOS_CTRL_ABNORM_Value "[FIX] Fix on the Position Control Abnormal Fault communicated by TURBO CONTROLLER (0 - No Fault)" VALUE 0xFC2C04 Scalar_BOOLEAN 0 TURBO2ECU_Rx_4ms_CM_boolean_deg 0 1 /end CHARACTERISTIC
/begin CHARACTERISTIC cfPOTENZ_ACC_Enable "[FIX] Fix su \"Percent Load at Current Speed\" (Tx to CAN)" VALUE 0xFC84FF Scalar_UBYTE 0 EEC2_Tx_50ms_CM_FixEnableT 171 218 /end CHARACTERISTIC
/begin CHARACTERISTIC cfPOTENZ_ACC_Value "[FIX] Fix su \"Percent Load at Current Speed\" (Tx to CAN)" VALUE 0xFC84FE Scalar_UBYTE 0 EEC2_Tx_50ms_CM_ufix8_Sp4__ 0 100 /end CHARACTERISTIC
/begin CHARACTERISTIC cfPRAIL_CAN_Enable "[FIX] Fix sulla Pressione Metano (relativa) dopo regolatore di pressione inviata via rete CAN" VALUE 0xFC839C Scalar_UBYTE 0 ENG_FLD_LEV_PRESS_Tx_100ms_CM_FixEnableT 171 218 /end CHARACTERISTIC
/begin CHARACTERISTIC cfPRAIL_CAN_Value "[FIX] Fix sulla Pressione Metano (relativa) dopo regolatore di pressione inviata via rete CAN" VALUE 0xFC839A Scalar_UWORD 0 ENG_FLD_LEV_PRESS_Tx_100ms_CM_uint16_kPa 0 1000 /end CHARACTERISTIC
/begin CHARACTERISTIC cfPREHEATING_UEGO_Enable "[FIX] Fix on Switch on Preheating feedback for UEGO (Tx to CAN)" VALUE 0xFC8398 Scalar_UBYTE 0 EEC3_Tx_100ms_CM_FixEnableT 171 218 /end CHARACTERISTIC
/begin CHARACTERISTIC cfPREHEATING_UEGO_Value "[FIX] Fix on Switch on Preheating feedback for UEGO (Tx to CAN)" VALUE 0xFC8397 Scalar_BOOLEAN 0 EEC3_Tx_100ms_CM_boolean_adm 0 1 /end CHARACTERISTIC
/begin CHARACTERISTIC cfPROTECT_LAMP_CMD_Enable "[FIX] Th2o Lamp Command" VALUE 0xFC8422 Scalar_UBYTE 0 DLCC1_Tx_1s_CM_FixEnableT 171 218 /end CHARACTERISTIC
/begin CHARACTERISTIC cfPROTECT_LAMP_CMD_Value "[FIX] Th2o Lamp Command" VALUE 0xFC8421 Scalar_UBYTE 0 DLCC1_Tx_1s_CM_uint8_adm 0 3 /end CHARACTERISTIC
/begin CHARACTERISTIC cfPTO_OBJ_Enable "[FIX] Fix su Obiettivo PTO in Tx (Tx to CAN)" VALUE 0xFC8396 Scalar_UBYTE 0 EEC3_Tx_100ms_CM_FixEnableT 171 218 /end CHARACTERISTIC
/begin CHARACTERISTIC cfPTO_OBJ_Value "[FIX] Fix su Obiettivo PTO in Tx (Tx to CAN)" VALUE 0xFC8394 Scalar_UWORD 0 EEC3_Tx_100ms_CM_ufix16_En3_rpm 0 8191.875 /end CHARACTERISTIC
/begin CHARACTERISTIC cfPTO_STATE_Enable "[FIX] Fix su PTO state (ricevuto da CAN)" VALUE 0xFC8280 Scalar_UBYTE 0 CCVS_Rx_100ms_CM_FixEnableT 171 218 /end CHARACTERISTIC
/begin CHARACTERISTIC cfPTO_STATE_TX_Enable "[FIX] Fix su PTO state (ricevuto da CAN)" VALUE 0xFC8392 Scalar_UBYTE 0 CCVS_Tx_100ms_CM_FixEnableT 171 218 /end CHARACTERISTIC
/begin CHARACTERISTIC cfPTO_STATE_TX_Value "[FIX] Fix su PTO state (ricevuto da CAN)" VALUE 0xFC8391 Scalar_UBYTE 0 CCVS_Tx_100ms_CM_uint8_adm 0 31 /end CHARACTERISTIC
/begin CHARACTERISTIC cfPTO_STATE_Value "[FIX] Fix su PTO state (ricevuto da CAN)" VALUE 0xFC827F Scalar_UBYTE 0 CCVS_Rx_100ms_CM_uint8_adm 0 17 /end CHARACTERISTIC
/begin CHARACTERISTIC cfRAIL_PRESSURE_Enable "[Fix] Rail Pressure - j1939 CAN ECM2EPR Msg" VALUE 0xFC8498 Scalar_UBYTE 0 ECM2EPR_Tx_4ms_CM_FixEnableT_barA 171 218 /end CHARACTERISTIC
/begin CHARACTERISTIC cfRAIL_PRESSURE_Value "[Fix] Rail Pressure - j1939 CAN ECM2EPR Msg" VALUE 0xFC8496 Scalar_UWORD 0 ECM2EPR_Tx_4ms_CM_ufix16_En8_barA 0 15 /end CHARACTERISTIC
/begin CHARACTERISTIC cfRAIL_TARGET_PRESSURE_Enable "[Fix] Rail Target Pressure - j1939 CAN ECM2EPR Msg" VALUE 0xFC8494 Scalar_UBYTE 0 ECM2EPR_Tx_4ms_CM_FixEnableT_barA 171 218 /end CHARACTERISTIC
/begin CHARACTERISTIC cfRAIL_TARGET_PRESSURE_Value "[Fix] Rail Target Pressure - j1939 CAN ECM2EPR Msg" VALUE 0xFC8492 Scalar_UWORD 0 ECM2EPR_Tx_4ms_CM_ufix16_En8_barA 0 15 /end CHARACTERISTIC
/begin CHARACTERISTIC cfRED_LAMP_CMD_Enable "[FIX] RED Lamp command" VALUE 0xFC8420 Scalar_UBYTE 0 DLCC1_Tx_1s_CM_FixEnableT 171 218 /end CHARACTERISTIC
/begin CHARACTERISTIC cfRED_LAMP_CMD_Value "[FIX] RED Lamp command" VALUE 0xFC841F Scalar_UBYTE 0 DLCC1_Tx_1s_CM_uint8_adm 0 3 /end CHARACTERISTIC
/begin CHARACTERISTIC cfRET_BRK_ASS_Enable "[FIX] Fix su PATCH VCM" VALUE 0xFC841E Scalar_UBYTE 0 ERC1_ER_Tx_1s_CM_FixEnableT 171 218 /end CHARACTERISTIC
/begin CHARACTERISTIC cfRET_BRK_ASS_Value "[FIX] Fix su PATCH VCM" VALUE 0xFC841D Scalar_UBYTE 0 ERC1_ER_Tx_1s_CM_uint8_adm 0 3 /end CHARACTERISTIC
/begin CHARACTERISTIC cfRET_CTRL_MTD_Enable "[FIX] Fix su PATCH VCM (Tx to CAN)" VALUE 0xFC841C Scalar_UBYTE 0 RET_CONF_Tx_1s_CM_FixEnableT 171 218 /end CHARACTERISTIC
/begin CHARACTERISTIC cfRET_CTRL_MTD_Value "[FIX] Fix su PATCH VCM (Tx to CAN)" VALUE 0xFC841B Scalar_UBYTE 0 RET_CONF_Tx_1s_CM_uint8_adm 0 255 /end CHARACTERISTIC
/begin CHARACTERISTIC cfRET_P1_PERC_Enable "[FIX] Fix su PATCH VCM (Tx to CAN)" VALUE 0xFC841A Scalar_UBYTE 0 RET_CONF_Tx_1s_CM_FixEnableT 171 218 /end CHARACTERISTIC
/begin CHARACTERISTIC cfRET_P1_PERC_Value "[FIX] Fix su PATCH VCM (Tx to CAN)" VALUE 0xFC8419 Scalar_UBYTE 0 RET_CONF_Tx_1s_CM_ufix8_Bn125__ -125 125 /end CHARACTERISTIC
/begin CHARACTERISTIC cfRET_P1_SPEED_Enable "[FIX] Fix su PATCH VCM (Tx to CAN)" VALUE 0xFC8418 Scalar_UBYTE 0 RET_CONF_Tx_1s_CM_FixEnableT 171 218 /end CHARACTERISTIC
/begin CHARACTERISTIC cfRET_P1_SPEED_Value "[FIX] Fix su PATCH VCM (Tx to CAN)" VALUE 0xFC8416 Scalar_UWORD 0 RET_CONF_Tx_1s_CM_ufix16_En3_rpm 0 8031 /end CHARACTERISTIC
/begin CHARACTERISTIC cfRET_P2_PERC_Enable "[FIX] Fix su PATCH VCM (Tx to CAN)" VALUE 0xFC8414 Scalar_UBYTE 0 RET_CONF_Tx_1s_CM_FixEnableT 171 218 /end CHARACTERISTIC
/begin CHARACTERISTIC cfRET_P2_PERC_Value "[FIX] Fix su PATCH VCM (Tx to CAN)" VALUE 0xFC8413 Scalar_UBYTE 0 RET_CONF_Tx_1s_CM_ufix8_Bn125__ -125 125 /end CHARACTERISTIC
/begin CHARACTERISTIC cfRET_P2_SPEED_Enable "[FIX] Fix su PATCH VCM (Tx to CAN)" VALUE 0xFC8412 Scalar_UBYTE 0 RET_CONF_Tx_1s_CM_FixEnableT 171 218 /end CHARACTERISTIC
/begin CHARACTERISTIC cfRET_P2_SPEED_Value "[FIX] Fix su PATCH VCM (Tx to CAN)" VALUE 0xFC8410 Scalar_UWORD 0 RET_CONF_Tx_1s_CM_ufix16_En3_rpm 0 8031 /end CHARACTERISTIC
/begin CHARACTERISTIC cfRET_P3_PERC_Enable "[FIX] Fix su PATCH VCM (Tx to CAN)" VALUE 0xFC840E Scalar_UBYTE 0 RET_CONF_Tx_1s_CM_FixEnableT 171 218 /end CHARACTERISTIC
/begin CHARACTERISTIC cfRET_P3_PERC_Value "[FIX] Fix su PATCH VCM (Tx to CAN)" VALUE 0xFC840D Scalar_UBYTE 0 RET_CONF_Tx_1s_CM_ufix8_Bn125__ -125 125 /end CHARACTERISTIC
/begin CHARACTERISTIC cfRET_P3_SPEED_Enable "[FIX] Fix su PATCH VCM (Tx to CAN)" VALUE 0xFC840C Scalar_UBYTE 0 RET_CONF_Tx_1s_CM_FixEnableT 171 218 /end CHARACTERISTIC
/begin CHARACTERISTIC cfRET_P3_SPEED_Value "[FIX] Fix su PATCH VCM (Tx to CAN)" VALUE 0xFC840A Scalar_UWORD 0 RET_CONF_Tx_1s_CM_ufix16_En3_rpm 0 8031 /end CHARACTERISTIC
/begin CHARACTERISTIC cfRET_P4_PERC_Enable "[FIX] Fix su PATCH VCM (Tx to CAN)" VALUE 0xFC8408 Scalar_UBYTE 0 RET_CONF_Tx_1s_CM_FixEnableT 171 218 /end CHARACTERISTIC
/begin CHARACTERISTIC cfRET_P4_PERC_Value "[FIX] Fix su PATCH VCM (Tx to CAN)" VALUE 0xFC8407 Scalar_UBYTE 0 RET_CONF_Tx_1s_CM_ufix8_Bn125__ -125 125 /end CHARACTERISTIC
/begin CHARACTERISTIC cfRET_P4_SPEED_Enable "[FIX] Fix su PATCH VCM (Tx to CAN)" VALUE 0xFC8406 Scalar_UBYTE 0 RET_CONF_Tx_1s_CM_FixEnableT 171 218 /end CHARACTERISTIC
/begin CHARACTERISTIC cfRET_P4_SPEED_Value "[FIX] Fix su PATCH VCM (Tx to CAN)" VALUE 0xFC8404 Scalar_UWORD 0 RET_CONF_Tx_1s_CM_ufix16_En3_rpm 0 8031 /end CHARACTERISTIC
/begin CHARACTERISTIC cfRET_P5_PERC_Enable "[FIX] Fix su PATCH VCM (Tx to CAN)" VALUE 0xFC8402 Scalar_UBYTE 0 RET_CONF_Tx_1s_CM_FixEnableT 171 218 /end CHARACTERISTIC
/begin CHARACTERISTIC cfRET_P5_PERC_Value "[FIX] Fix su PATCH VCM (Tx to CAN)" VALUE 0xFC8401 Scalar_UBYTE 0 RET_CONF_Tx_1s_CM_ufix8_Bn125__ -125 125 /end CHARACTERISTIC
/begin CHARACTERISTIC cfRET_P5_SPEED_Enable "[FIX] Fix su PATCH VCM (Tx to CAN)" VALUE 0xFC8400 Scalar_UBYTE 0 RET_CONF_Tx_1s_CM_FixEnableT 171 218 /end CHARACTERISTIC
/begin CHARACTERISTIC cfRET_P5_SPEED_Value "[FIX] Fix su PATCH VCM (Tx to CAN)" VALUE 0xFC83FE Scalar_UWORD 0 RET_CONF_Tx_1s_CM_ufix16_En3_rpm 0 8031 /end CHARACTERISTIC
/begin CHARACTERISTIC cfRET_REF_TORQ_Enable "[FIX] Fix su PATCH VCM (Tx to CAN)" VALUE 0xFC83FC Scalar_UBYTE 0 RET_CONF_Tx_1s_CM_FixEnableT 171 218 /end CHARACTERISTIC
/begin CHARACTERISTIC cfRET_REF_TORQ_Value "[FIX] Fix su PATCH VCM (Tx to CAN)" VALUE 0xFC83FA Scalar_UWORD 0 RET_CONF_Tx_1s_CM_uint16_N_m 0 64255 /end CHARACTERISTIC
/begin CHARACTERISTIC cfRET_SHIFT_ASS_Enable "[FIX] Fix su PATCH VCM" VALUE 0xFC83F8 Scalar_UBYTE 0 ERC1_ER_Tx_1s_CM_FixEnableT 171 218 /end CHARACTERISTIC
/begin CHARACTERISTIC cfRET_SHIFT_ASS_Value "[FIX] Fix su PATCH VCM" VALUE 0xFC83F7 Scalar_UBYTE 0 ERC1_ER_Tx_1s_CM_uint8_adm 0 3 /end CHARACTERISTIC
/begin CHARACTERISTIC cfRET_TYPE_LOC_Enable "[FIX] Fix su PATCH VCM (Tx to CAN)" VALUE 0xFC83F6 Scalar_UBYTE 0 RET_CONF_Tx_1s_CM_FixEnableT 171 218 /end CHARACTERISTIC
/begin CHARACTERISTIC cfRET_TYPE_LOC_Value "[FIX] Fix su PATCH VCM (Tx to CAN)" VALUE 0xFC83F5 Scalar_UBYTE 0 RET_CONF_Tx_1s_CM_uint8_adm 0 255 /end CHARACTERISTIC
/begin CHARACTERISTIC cfRPM_Enable "[FIX] Fix su \"Engine Speed\" (Tx to CAN)" VALUE 0xFC8490 Scalar_UBYTE 0 EEC1_Tx_4ms_CM_FixEnableT 171 218 /end CHARACTERISTIC
/begin CHARACTERISTIC cfRPM_Value "[FIX] Fix su \"Engine Speed\" (Tx to CAN)" VALUE 0xFC848E Scalar_UWORD 0 EEC1_Tx_4ms_CM_ufix16_En3_rpm 0 8031.875 /end CHARACTERISTIC
/begin CHARACTERISTIC cfSECONDS_Enable "[FIX] Fix sui secondi (ricevuti da CAN)" VALUE 0xFC82B0 Scalar_UBYTE 0 TIMEDATE_Rx_1s_CM_FixEnableT 171 218 /end CHARACTERISTIC
/begin CHARACTERISTIC cfSECONDS_Value "[FIX] Fix sui secondi (ricevuti da CAN)" VALUE 0xFC82AF Scalar_UBYTE 0 TIMEDATE_Rx_1s_CM_ufix8_En2_s 0 59.75 /end CHARACTERISTIC
/begin CHARACTERISTIC cfSELF_REC_MODE_Enable "[FIX] Fix on the Self Recovery Mode communicated by TURBO CONTROLLER (1-Self Recovery active)" VALUE 0xFC2C03 Scalar_UBYTE 0 TURBO2ECU_Rx_4ms_CM_FixEnableT 171 218 /end CHARACTERISTIC
/begin CHARACTERISTIC cfSELF_REC_MODE_Value "[FIX] Fix on the Self Recovery Mode communicated by TURBO CONTROLLER (1-Self Recovery active)" VALUE 0xFC2C02 Scalar_BOOLEAN 0 TURBO2ECU_Rx_4ms_CM_boolean_deg 0 1 /end CHARACTERISTIC
/begin CHARACTERISTIC cfSEL_GEAR_Enable "[FIX] Fix sulla marcia selezionata (solo per cambio automatico)" VALUE 0xFC827E Scalar_UBYTE 0 ETC2_Rx_100ms_CM_FixEnableT 171 218 /end CHARACTERISTIC
/begin CHARACTERISTIC cfSEL_GEAR_Value "[FIX] Fix sulla marcia selezionata (solo per cambio automatico)" VALUE 0xFC827D Scalar_UBYTE 0 ETC2_Rx_100ms_CM_ufix8_Bn125_gear -125 125 /end CHARACTERISTIC
/begin CHARACTERISTIC cfSENS_ABNORM_HI_FAULT_Enable "[FIX] Fix on the Sensor Abnormal High Value Fault communicated by TURBO CONTROLLER (0 - No Fault)" VALUE 0xFC2C01 Scalar_UBYTE 0 TURBO2ECU_Rx_4ms_CM_FixEnableT 171 218 /end CHARACTERISTIC
/begin CHARACTERISTIC cfSENS_ABNORM_HI_FAULT_Value "[FIX] Fix on the Sensor Abnormal High Value Fault communicated by TURBO CONTROLLER (0 - No Fault)" VALUE 0xFC2C00 Scalar_BOOLEAN 0 TURBO2ECU_Rx_4ms_CM_boolean_deg 0 1 /end CHARACTERISTIC
/begin CHARACTERISTIC cfSENS_ABNORM_LO_FAULT_Enable "[FIX] Fix on the Sensor Abnormal Low Value Fault communicated by TURBO CONTROLLER (0 - No Fault)" VALUE 0xFC2BFF Scalar_UBYTE 0 TURBO2ECU_Rx_4ms_CM_FixEnableT 171 218 /end CHARACTERISTIC
/begin CHARACTERISTIC cfSENS_ABNORM_LO_FAULT_Value "[FIX] Fix on the Sensor Abnormal Low Value Fault communicated by TURBO CONTROLLER (0 - No Fault)" VALUE 0xFC2BFE Scalar_BOOLEAN 0 TURBO2ECU_Rx_4ms_CM_boolean_deg 0 1 /end CHARACTERISTIC
/begin CHARACTERISTIC cfSENS_SUP_V1_Enable "[FIX] SPN 3509 - Sensor supply voltage 1" VALUE 0xFC83F4 Scalar_UBYTE 0 SEP1_Tx_1s_CM_FixEnableT 171 218 /end CHARACTERISTIC
/begin CHARACTERISTIC cfSENS_SUP_V1_Value "[FIX] SPN 3509 - Sensor supply voltage 1" VALUE 0xFC83F2 Scalar_UWORD 0 SEP1_Tx_1s_CM_ufix16_En10_V 0 5 /end CHARACTERISTIC
/begin CHARACTERISTIC cfSENS_SUP_V2_Enable "[FIX] SPN 3510 - Sensor supply voltage 2" VALUE 0xFC83F0 Scalar_UBYTE 0 SEP1_Tx_1s_CM_FixEnableT 171 218 /end CHARACTERISTIC
/begin CHARACTERISTIC cfSENS_SUP_V2_Value "[FIX] SPN 3510 - Sensor supply voltage 2" VALUE 0xFC83EE Scalar_UWORD 0 SEP1_Tx_1s_CM_ufix16_En10_V 0 5 /end CHARACTERISTIC
/begin CHARACTERISTIC cfSENS_SUP_V3_Enable "[FIX] SPN 3511 - Sensor supply voltage 3" VALUE 0xFC83EC Scalar_UBYTE 0 SEP1_Tx_1s_CM_FixEnableT 171 218 /end CHARACTERISTIC
/begin CHARACTERISTIC cfSENS_SUP_V3_Value "[FIX] SPN 3511 - Sensor supply voltage 3" VALUE 0xFC83EA Scalar_UWORD 0 SEP1_Tx_1s_CM_ufix16_En10_V 0 5 /end CHARACTERISTIC
/begin CHARACTERISTIC cfSHIFT_PRO_Enable "[FIX] Fix su informazione shift in progress (distribuzione-accoppiata al motore)" VALUE 0xFC82F6 Scalar_UBYTE 0 ETC1_Rx_4ms_CM_FixEnableT 171 218 /end CHARACTERISTIC
/begin CHARACTERISTIC cfSHIFT_PRO_Value "[FIX] Fix su informazione shift in progress (distribuzione-accoppiata al motore)" VALUE 0xFC82F5 Scalar_BOOLEAN 0 ETC1_Rx_4ms_CM_boolean_adm 0 1 /end CHARACTERISTIC
/begin CHARACTERISTIC cfSHUTDOWN_CAN_Enable "[FIX] Fix su spegnimento motore da MF3 in caso di malfunzionamento del micro principale;" VALUE 0xFC83E8 Scalar_UBYTE 0 SHUTDOWN_Tx_1s_CM_FixEnableT 171 218 /end CHARACTERISTIC
/begin CHARACTERISTIC cfSHUTDOWN_CAN_Value "[FIX] Fix su spegnimento motore da MF3 in caso di malfunzionamento del micro principale;" VALUE 0xFC83E7 Scalar_UBYTE 0 SHUTDOWN_Tx_1s_CM_uint8_adm 0 1 /end CHARACTERISTIC
/begin CHARACTERISTIC cfSHUT_DOWN_Enable "[FIX] Fix sullo switch high governor parameter set" VALUE 0xFC833A Scalar_UBYTE 0 BC2EDC2_Rx_50ms_CM_FixEnableT 171 218 /end CHARACTERISTIC
/begin CHARACTERISTIC cfSHUT_DOWN_Value "[FIX] Fix sullo switch high governor parameter set" VALUE 0xFC8339 Scalar_BOOLEAN 0 BC2EDC2_Rx_50ms_CM_boolean_adm 0 1 /end CHARACTERISTIC
/begin CHARACTERISTIC cfSPEED_LIMITER_CAN_Enable "[FIX] Fix on speed limitation from BC2EDC1 CAN Rx" VALUE 0xFC8338 Scalar_UBYTE 0 BC2EDC1_Rx_50ms_CM_FixEnableT 171 218 /end CHARACTERISTIC
/begin CHARACTERISTIC cfSPEED_LIMITER_CAN_Value "[FIX] Fix on speed limitation from BC2EDC1 CAN Rx" VALUE 0xFC8337 Scalar_UBYTE 0 BC2EDC1_Rx_50ms_CM_uint8_km_h 0 250 /end CHARACTERISTIC
/begin CHARACTERISTIC cfSPEED_LIM_CAN_Enable "[FIX] Fix sulla richiesta di limitazione giri" VALUE 0xFC82F4 Scalar_UBYTE 0 TSC1_VE_LIMIT_Rx_4ms_CM_FixEnableT 171 218 /end CHARACTERISTIC
/begin CHARACTERISTIC cfSPEED_LIM_CAN_Value "[FIX] Fix sulla richiesta di limitazione giri" VALUE 0xFC82F2 Scalar_UWORD 0 TSC1_VE_LIMIT_Rx_4ms_CM_ufix16_En3_rpm 0 8031.875 /end CHARACTERISTIC
/begin CHARACTERISTIC cfSPEED_REQ_2_CAN_Enable "[FIX] Fix sulla richiesta regime obiettivo nel secondo TSC1_Ctrl2" VALUE 0xFC82F0 Scalar_UBYTE 0 TSC1_VE_CONTROL2_Rx_4ms_CM_FixEnableT 171 218 /end CHARACTERISTIC
/begin CHARACTERISTIC cfSPEED_REQ_2_CAN_Value "[FIX] Fix sulla richiesta regime obiettivo nel secondo TSC1_Ctrl2" VALUE 0xFC82EE Scalar_UWORD 0 TSC1_VE_CONTROL2_Rx_4ms_CM_ufix16_En3_rpm 0 8031.875 /end CHARACTERISTIC
/begin CHARACTERISTIC cfSPEED_REQ_CAN_Enable "[FIX] Fix sulla richiesta regime obiettivo" VALUE 0xFC82EC Scalar_UBYTE 0 TSC1_VE_CONTROL_Rx_4ms_CM_FixEnableT 171 218 /end CHARACTERISTIC
/begin CHARACTERISTIC cfSPEED_REQ_CAN_Value "[FIX] Fix sulla richiesta regime obiettivo" VALUE 0xFC82EA Scalar_UWORD 0 TSC1_VE_CONTROL_Rx_4ms_CM_ufix16_En3_rpm 0 8031.875 /end CHARACTERISTIC
/begin CHARACTERISTIC cfSRC_ADD_CTRL_DRC_Enable "[FIX] Fix su PATCH VCM" VALUE 0xFC83E6 Scalar_UBYTE 0 ERC1_ER_Tx_1s_CM_FixEnableT 171 218 /end CHARACTERISTIC
/begin CHARACTERISTIC cfSRC_ADD_CTRL_DRC_Value "[FIX] Fix su PATCH VCM" VALUE 0xFC83E5 Scalar_UBYTE 0 ERC1_ER_Tx_1s_CM_uint8_adm 0 253 /end CHARACTERISTIC
/begin CHARACTERISTIC cfSTART_CBT_Enable "[FIX] Fix su pulsante di Start da vano motore" VALUE 0xFC84FD Scalar_UBYTE 0 EDC2BC_Tx_50ms_CM_FixEnableT 171 218 /end CHARACTERISTIC
/begin CHARACTERISTIC cfSTART_CBT_Value "[FIX] Fix su pulsante di Start da vano motore" VALUE 0xFC84FC Scalar_BOOLEAN 0 EDC2BC_Tx_50ms_CM_boolean_adm 0 1 /end CHARACTERISTIC
/begin CHARACTERISTIC cfSTATUS_ERC1_Enable "[FIX] Fix su PATCH VCM" VALUE 0xFC83E4 Scalar_UBYTE 0 ERC1_ER_Tx_1s_CM_FixEnableT 171 218 /end CHARACTERISTIC
/begin CHARACTERISTIC cfSTATUS_ERC1_Value "[FIX] Fix su PATCH VCM" VALUE 0xFC83E3 Scalar_UBYTE 0 ERC1_ER_Tx_1s_CM_uint8_adm 0 15 /end CHARACTERISTIC
/begin CHARACTERISTIC cfSTOP_CBT_Enable "[FIX] Fix su pulsante di Stop da vano motore" VALUE 0xFC84FB Scalar_UBYTE 0 EDC2BC_Tx_50ms_CM_FixEnableT 171 218 /end CHARACTERISTIC
/begin CHARACTERISTIC cfSTOP_CBT_Value "[FIX] Fix su pulsante di Stop da vano motore" VALUE 0xFC84FA Scalar_BOOLEAN 0 EDC2BC_Tx_50ms_CM_boolean_adm 0 1 /end CHARACTERISTIC
/begin CHARACTERISTIC cfSUP_VOLT_HIGH_Enable "[FIX] Fix on the Supply Voltage too high Fault communicated by TURBO CONTROLLER (0 - No Fault)" VALUE 0xFC2BFD Scalar_UBYTE 0 TURBO2ECU_Rx_4ms_CM_FixEnableT 171 218 /end CHARACTERISTIC
/begin CHARACTERISTIC cfSUP_VOLT_HIGH_Value "[FIX] Fix on the Supply Voltage too high Fault communicated by TURBO CONTROLLER (0 - No Fault)" VALUE 0xFC2BFC Scalar_BOOLEAN 0 TURBO2ECU_Rx_4ms_CM_boolean_deg 0 1 /end CHARACTERISTIC
/begin CHARACTERISTIC cfSUP_VOLT_LOW_Enable "[FIX] Fix on the Supply Voltage too low Fault communicated by TURBO CONTROLLER (0 - No Fault)" VALUE 0xFC2BFB Scalar_UBYTE 0 TURBO2ECU_Rx_4ms_CM_FixEnableT 171 218 /end CHARACTERISTIC
/begin CHARACTERISTIC cfSUP_VOLT_LOW_Value "[FIX] Fix on the Supply Voltage too low Fault communicated by TURBO CONTROLLER (0 - No Fault)" VALUE 0xFC2BFA Scalar_BOOLEAN 0 TURBO2ECU_Rx_4ms_CM_boolean_deg 0 1 /end CHARACTERISTIC
/begin CHARACTERISTIC cfSUP_VOLT_MONITOR_Enable "[FIX] Fix on the Supply voltage monitor communicated by TURBO CONTROLLER" VALUE 0xFC2BF9 Scalar_UBYTE 0 TURBO2ECU_Rx_4ms_CM_FixEnableT 171 218 /end CHARACTERISTIC
/begin CHARACTERISTIC cfSUP_VOLT_MONITOR_Value "[FIX] Fix on the Supply voltage monitor communicated by TURBO CONTROLLER" VALUE 0xFC2BF8 Scalar_UBYTE 0 TURBO2ECU_Rx_4ms_CM_ufix8_Sp152_V 0 38.76 /end CHARACTERISTIC
/begin CHARACTERISTIC cfTAIR_CAN_Enable "[FIX] Fix sulla Temperatura Aria inviata via rete CAN" VALUE 0xFC8390 Scalar_UBYTE 0 INLET_COND_Tx_100ms_CM_FixEnableT 171 218 /end CHARACTERISTIC
/begin CHARACTERISTIC cfTAIR_CAN_Value "[FIX] Fix sulla Temperatura Aria inviata via rete CAN" VALUE 0xFC838F Scalar_UBYTE 0 INLET_COND_Tx_100ms_CM_ufix8_Bn40_degC -40 210 /end CHARACTERISTIC
/begin CHARACTERISTIC cfTANK_PRESSURE_Enable "[Fix] Tank Pressure- j1939 CAN ECM2EPR Msg" VALUE 0xFC848C Scalar_UBYTE 0 ECM2EPR_Tx_4ms_CM_FixEnableT_barG 171 218 /end CHARACTERISTIC
/begin CHARACTERISTIC cfTANK_PRESSURE_Value "[Fix] Tank Pressure- j1939 CAN ECM2EPR Msg" VALUE 0xFC848A Scalar_UWORD 0 ECM2EPR_Tx_4ms_CM_ufix16_Sp01_barG 0 255 /end CHARACTERISTIC
/begin CHARACTERISTIC cfTEMP_FAIL_Enable "[FIX] Fix on Temperature Control Fail Diagnosis Uego Sensor (01-Fail 00-No Fail)" VALUE 0xFC8336 Scalar_UBYTE 0 USS_Rx_50ms_CM_FixEnableT 171 218 /end CHARACTERISTIC
/begin CHARACTERISTIC cfTEMP_FAIL_Value "[FIX] Fix on Temperature Control Fail Diagnosis Uego Sensor (01-Fail 00-No Fail)" VALUE 0xFC8335 Scalar_BOOLEAN 0 USS_Rx_50ms_CM_boolean_adm 0 1 /end CHARACTERISTIC
/begin CHARACTERISTIC cfTEXH_HIGH_LMP_CMD_Enable "[FIX] Exhaust temperature lamp comand" VALUE 0xFC838E Scalar_UBYTE 0 PropB_0A_Tx_100ms_CM_FixEnableT 171 218 /end CHARACTERISTIC
/begin CHARACTERISTIC cfTEXH_HIGH_LMP_CMD_Value "[FIX] Exhaust temperature lamp comand" VALUE 0xFC838D Scalar_UBYTE 0 PropB_0A_Tx_100ms_CM_uint8_adm 0 15 /end CHARACTERISTIC
/begin CHARACTERISTIC cfTH2O_CAN_Enable "[FIX] FIX on raw value sent on CAN J1939 for Coolant Temperature" VALUE 0xFC83E2 Scalar_UBYTE 0 ENG_TEMP_Tx_1s_CM_FixEnableT 171 218 /end CHARACTERISTIC
/begin CHARACTERISTIC cfTH2O_CAN_Value "[FIX] FIX on raw value sent on CAN J1939 for Coolant Temperature" VALUE 0xFC83E1 Scalar_UBYTE 0 ENG_TEMP_Tx_1s_CM_ufix8_Bn40_degC -40 210 /end CHARACTERISTIC
/begin CHARACTERISTIC cfTH2O_HIGH_CMD_Enable "[FIX] High Coolant Temperature Lamp Command" VALUE 0xFC83E0 Scalar_UBYTE 0 DLCC1_Tx_1s_CM_FixEnableT 171 218 /end CHARACTERISTIC
/begin CHARACTERISTIC cfTH2O_HIGH_CMD_Value "[FIX] High Coolant Temperature Lamp Command" VALUE 0xFC83DF Scalar_UBYTE 0 DLCC1_Tx_1s_CM_uint8_adm 0 3 /end CHARACTERISTIC
/begin CHARACTERISTIC cfTOIL_CAN_Enable "[FIX] FIX on raw value sent on CAN J1939 for Oil Temperature" VALUE 0xFC83DE Scalar_UBYTE 0 ENG_TEMP_Tx_1s_CM_FixEnableT 171 218 /end CHARACTERISTIC
/begin CHARACTERISTIC cfTOIL_CAN_Value "[FIX] FIX on raw value sent on CAN J1939 for Oil Temperature" VALUE 0xFC83DC Scalar_UWORD 0 ENG_TEMP_Tx_1s_CM_ufix16_En5_Bn273_degC -273 1735 /end CHARACTERISTIC
/begin CHARACTERISTIC cfTORQUE_LIM_CAN_Enable "[FIX] Fix sulla richiesta di limitazione coppia" VALUE 0xFC82E8 Scalar_UBYTE 0 TSC1_VE_LIMIT_Rx_4ms_CM_FixEnableT 171 218 /end CHARACTERISTIC
/begin CHARACTERISTIC cfTORQUE_LIM_CAN_Value "[FIX] Fix sulla richiesta di limitazione coppia" VALUE 0xFC82E7 Scalar_UBYTE 0 TSC1_VE_LIMIT_Rx_4ms_CM_ufix8_Bn125__ -125 125 /end CHARACTERISTIC
/begin CHARACTERISTIC cfTORQUE_REQ_2_CAN_Enable "[FIX] Fix sulla richiesta coppia obiettivo nel secondo TSC1_Ctrl2" VALUE 0xFC82E6 Scalar_UBYTE 0 TSC1_VE_CONTROL2_Rx_4ms_CM_FixEnableT 171 218 /end CHARACTERISTIC
/begin CHARACTERISTIC cfTORQUE_REQ_2_CAN_Value "[FIX] Fix sulla richiesta coppia obiettivo nel secondo TSC1_Ctrl2" VALUE 0xFC82E5 Scalar_UBYTE 0 TSC1_VE_CONTROL2_Rx_4ms_CM_ufix8_Bn125__ -125 125 /end CHARACTERISTIC
/begin CHARACTERISTIC cfTORQUE_REQ_CAN_Enable "[FIX] Fix sulla richiesta coppia obiettivo" VALUE 0xFC82E4 Scalar_UBYTE 0 TSC1_VE_CONTROL_Rx_4ms_CM_FixEnableT 171 218 /end CHARACTERISTIC
/begin CHARACTERISTIC cfTORQUE_REQ_CAN_Value "[FIX] Fix sulla richiesta coppia obiettivo" VALUE 0xFC82E3 Scalar_UBYTE 0 TSC1_VE_CONTROL_Rx_4ms_CM_ufix8_Bn125__ -125 125 /end CHARACTERISTIC
/begin CHARACTERISTIC cfTOT_ENG_HOURS_Enable "[FIX] Fix su \"Accumulated time of operation of engine\" (Tx to CAN)" VALUE 0xFC838C Scalar_UBYTE 0 ENG_HOURS_REV_Tx_100ms_CM_FixEnableT 171 218 /end CHARACTERISTIC
/begin CHARACTERISTIC cfTOT_ENG_HOURS_Value "[FIX] Fix su \"Accumulated time of operation of engine\" (Tx to CAN)" VALUE 0xFC8388 Scalar_ULONG 0 ENG_HOURS_REV_Tx_100ms_CM_ufix32_Sp05_hour 0 210554060.75 /end CHARACTERISTIC
/begin CHARACTERISTIC cfTOT_ENG_REVOL_Enable "[FIX] Fix su \"Accumulated number of revolution of engine\" (Tx to CAN)" VALUE 0xFC8384 Scalar_UBYTE 0 ENG_HOURS_REV_Tx_100ms_CM_FixEnableT 171 218 /end CHARACTERISTIC
/begin CHARACTERISTIC cfTOT_ENG_REVOL_Value "[FIX] Fix su \"Accumulated number of revolution of engine\" (Tx to CAN)" VALUE 0xFC8380 Scalar_ULONG 0 ENG_HOURS_REV_Tx_100ms_CM_ufix32_S1000_round 0 4.211081215E+12 /end CHARACTERISTIC
/begin CHARACTERISTIC cfTRAIL_CAN_Enable "[FIX] FIX on raw value sent on CAN J1939 for Fuel Temperature" VALUE 0xFC83DB Scalar_UBYTE 0 ENG_TEMP_Tx_1s_CM_FixEnableT 171 218 /end CHARACTERISTIC
/begin CHARACTERISTIC cfTRAIL_CAN_Value "[FIX] FIX on raw value sent on CAN J1939 for Fuel Temperature" VALUE 0xFC83DA Scalar_UBYTE 0 ENG_TEMP_Tx_1s_CM_ufix8_Bn40_degC -40 210 /end CHARACTERISTIC
/begin CHARACTERISTIC cfTR_DC_BITS_CAN_Enable "[FIX] Fix for condition request for message TSC1 TR" VALUE 0xFC8334 Scalar_UBYTE 0 TSC1_TR_RETARDER_Rx_50ms_CM_FixEnableT 171 218 /end CHARACTERISTIC
/begin CHARACTERISTIC cfTR_DC_BITS_CAN_Value "[FIX] Fix for condition request for message TSC1 TR" VALUE 0xFC8333 Scalar_UBYTE 0 TSC1_TR_RETARDER_Rx_50ms_CM_uint8_adm 0 3 /end CHARACTERISTIC
/begin CHARACTERISTIC cfTR_MC_BITS_CAN_Enable "[FIX] Fix for mode request for message TSC1 TR" VALUE 0xFC8332 Scalar_UBYTE 0 TSC1_TR_RETARDER_Rx_50ms_CM_FixEnableT 171 218 /end CHARACTERISTIC
/begin CHARACTERISTIC cfTR_MC_BITS_CAN_Value "[FIX] Fix for mode request for message TSC1 TR" VALUE 0xFC8331 Scalar_UBYTE 0 TSC1_TR_RETARDER_Rx_50ms_CM_uint8_adm 0 3 /end CHARACTERISTIC
/begin CHARACTERISTIC cfTR_PC_BITS_CAN_Enable "[FIX] Fix for priority request for message TSC1 TR" VALUE 0xFC8330 Scalar_UBYTE 0 TSC1_TR_RETARDER_Rx_50ms_CM_FixEnableT 171 218 /end CHARACTERISTIC
/begin CHARACTERISTIC cfTR_PC_BITS_CAN_Value "[FIX] Fix for priority request for message TSC1 TR" VALUE 0xFC832F Scalar_UBYTE 0 TSC1_TR_RETARDER_Rx_50ms_CM_uint8_adm 0 3 /end CHARACTERISTIC
/begin CHARACTERISTIC cfTR_SPEED_REQ_CAN_Enable "[FIX] Fix for engine speed request for message TSC1 TR" VALUE 0xFC832E Scalar_UBYTE 0 TSC1_TR_RETARDER_Rx_50ms_CM_FixEnableT 171 218 /end CHARACTERISTIC
/begin CHARACTERISTIC cfTR_SPEED_REQ_CAN_Value "[FIX] Fix for engine speed request for message TSC1 TR" VALUE 0xFC832C Scalar_UWORD 0 TSC1_TR_RETARDER_Rx_50ms_CM_ufix16_En3_rpm 0 8031.875 /end CHARACTERISTIC
/begin CHARACTERISTIC cfTR_TORQUE_REQ_CAN_Enable "[FIX] Fix for engine torque request for message TSC1 TR" VALUE 0xFC832A Scalar_UBYTE 0 TSC1_TR_RETARDER_Rx_50ms_CM_FixEnableT 171 218 /end CHARACTERISTIC
/begin CHARACTERISTIC cfTR_TORQUE_REQ_CAN_Value "[FIX] Fix for engine torque request for message TSC1 TR" VALUE 0xFC8329 Scalar_UBYTE 0 TSC1_TR_RETARDER_Rx_50ms_CM_ufix8_Bn125__ -125 125 /end CHARACTERISTIC
/begin CHARACTERISTIC cfT_EXH_CAN_Enable "[FIX] Temperatura gas di scaricoe (MsgTxCAN INLET_COND - Byte 6-7)" VALUE 0xFC837C Scalar_UBYTE 0 INLET_COND_Tx_100ms_CM_FixEnableT 171 218 /end CHARACTERISTIC
/begin CHARACTERISTIC cfT_EXH_CAN_Value "[FIX] Temperatura gas di scaricoe (MsgTxCAN INLET_COND - Byte 6-7)" VALUE 0xFC837A Scalar_UWORD 0 INLET_COND_Tx_100ms_CM_ufix16_En5_Bn273_degC -273 1734.96875 /end CHARACTERISTIC
/begin CHARACTERISTIC cfUNDER_BRAKE_Enable "[FIX] Fix su Under Braking Status" VALUE 0xFC8328 Scalar_UBYTE 0 VCM2ECM_Rx_50ms_CM_FixEnableT 171 218 /end CHARACTERISTIC
/begin CHARACTERISTIC cfUNDER_BRAKE_Value "[FIX] Fix su Under Braking Status" VALUE 0xFC8327 Scalar_BOOLEAN 0 VCM2ECM_Rx_50ms_CM_boolean_adm 0 1 /end CHARACTERISTIC
/begin CHARACTERISTIC cfVEH_SPEED_Enable "[FIX] Fix su Vehicle Speed da TCO1" VALUE 0xFC827C Scalar_UBYTE 0 CCVS_Rx_100ms_CM_FixEnableT 171 218 /end CHARACTERISTIC
/begin CHARACTERISTIC cfVEH_SPEED_TX_Enable "[FIX] Fix su Vehicle Speed da TCO1" VALUE 0xFC8378 Scalar_UBYTE 0 CCVS_Tx_100ms_CM_FixEnableT 171 218 /end CHARACTERISTIC
/begin CHARACTERISTIC cfVEH_SPEED_TX_Value "[FIX] Fix su Vehicle Speed da TCO1" VALUE 0xFC8376 Scalar_UWORD 0 CCVS_Tx_100ms_CM_ufix16_En8_km_h 0 250.99609375 /end CHARACTERISTIC
/begin CHARACTERISTIC cfVEH_SPEED_Value "[FIX] Fix su Vehicle Speed da TCO1" VALUE 0xFC827A Scalar_UWORD 0 CCVS_Rx_100ms_CM_ufix16_En8_km_h 0 250.99609375 /end CHARACTERISTIC
/begin CHARACTERISTIC cfVEH_TCO1SPD_Enable "[FIX] Fix su Vehicle Speed da TCO1" VALUE 0xFC8326 Scalar_UBYTE 0 TCO1_Rx_50ms_CM_FixEnableT 171 218 /end CHARACTERISTIC
/begin CHARACTERISTIC cfVEH_TCO1SPD_Value "[FIX] Fix su Vehicle Speed da TCO1" VALUE 0xFC8324 Scalar_UWORD 0 TCO1_Rx_50ms_CM_ufix16_En8_km_h 0 250.99609375 /end CHARACTERISTIC
/begin CHARACTERISTIC cfVERY_HIGH_RPM_CMD_Enable "[FIX] High Engine Speed Lamp Command" VALUE 0xFC83D9 Scalar_UBYTE 0 DLCC1_Tx_1s_CM_FixEnableT 171 218 /end CHARACTERISTIC
/begin CHARACTERISTIC cfVERY_HIGH_RPM_CMD_Value "[FIX] High Engine Speed Lamp Command" VALUE 0xFC83D8 Scalar_UBYTE 0 DLCC1_Tx_1s_CM_uint8_adm 0 3 /end CHARACTERISTIC
/begin CHARACTERISTIC cfVE_DC_BITS_2_CAN_Enable "[FIX] Fix sulla modalità di richiesta di performance (nel secondo TSC1_Ctrl2)" VALUE 0xFC82E2 Scalar_UBYTE 0 TSC1_VE_CONTROL2_Rx_4ms_CM_FixEnableT 171 218 /end CHARACTERISTIC
/begin CHARACTERISTIC cfVE_DC_BITS_2_CAN_Value "[FIX] Fix sulla modalità di richiesta di performance (nel secondo TSC1_Ctrl2)" VALUE 0xFC82E1 Scalar_UBYTE 0 TSC1_VE_CONTROL2_Rx_4ms_CM_uint8_adm 0 3 /end CHARACTERISTIC
/begin CHARACTERISTIC cfVE_DC_BITS_CAN_Enable "[FIX] Fix sulla modalità di richiesta di performance (TSC1_VE_CONTROL)" VALUE 0xFC82E0 Scalar_UBYTE 0 TSC1_VE_CONTROL_Rx_4ms_CM_FixEnableT 171 218 /end CHARACTERISTIC
/begin CHARACTERISTIC cfVE_DC_BITS_CAN_Value "[FIX] Fix sulla modalità di richiesta di performance (TSC1_VE_CONTROL)" VALUE 0xFC82DF Scalar_UBYTE 0 TSC1_VE_CONTROL_Rx_4ms_CM_uint8_adm 0 3 /end CHARACTERISTIC
/begin CHARACTERISTIC cfVE_DL_BITS_CAN_Enable "[FIX] Fix sulla modalità di richiesta di performance (TSC1_VE_LIMIT)" VALUE 0xFC82DE Scalar_UBYTE 0 TSC1_VE_LIMIT_Rx_4ms_CM_FixEnableT 171 218 /end CHARACTERISTIC
/begin CHARACTERISTIC cfVE_DL_BITS_CAN_Value "[FIX] Fix sulla modalità di richiesta di performance (TSC1_VE_LIMIT)" VALUE 0xFC82DD Scalar_UBYTE 0 TSC1_VE_LIMIT_Rx_4ms_CM_uint8_adm 0 3 /end CHARACTERISTIC
/begin CHARACTERISTIC cfVE_MC_BITS_2_CAN_Enable "[FIX] Fix sulla modalità di richiesta di performance (nel secondo TSC1_Ctrl2)" VALUE 0xFC82DC Scalar_UBYTE 0 TSC1_VE_CONTROL2_Rx_4ms_CM_FixEnableT 171 218 /end CHARACTERISTIC
/begin CHARACTERISTIC cfVE_MC_BITS_2_CAN_Value "[FIX] Fix sulla modalità di richiesta di performance (nel secondo TSC1_Ctrl2)" VALUE 0xFC82DB Scalar_UBYTE 0 TSC1_VE_CONTROL2_Rx_4ms_CM_uint8_adm 0 3 /end CHARACTERISTIC
/begin CHARACTERISTIC cfVE_MC_BITS_CAN_Enable "[FIX] Fix sulla modalità di richiesta di performance (TSC1_VE_CONTROL)" VALUE 0xFC82DA Scalar_UBYTE 0 TSC1_VE_CONTROL_Rx_4ms_CM_FixEnableT 171 218 /end CHARACTERISTIC
/begin CHARACTERISTIC cfVE_MC_BITS_CAN_Value "[FIX] Fix sulla modalità di richiesta di performance (TSC1_VE_CONTROL)" VALUE 0xFC82D9 Scalar_UBYTE 0 TSC1_VE_CONTROL_Rx_4ms_CM_uint8_adm 0 3 /end CHARACTERISTIC
/begin CHARACTERISTIC cfVE_ML_BITS_CAN_Enable "[FIX] Fix sulla modalità di richiesta di performance (TSC1_VE_LIMIT)" VALUE 0xFC82D8 Scalar_UBYTE 0 TSC1_VE_LIMIT_Rx_4ms_CM_FixEnableT 171 218 /end CHARACTERISTIC
/begin CHARACTERISTIC cfVE_ML_BITS_CAN_Value "[FIX] Fix sulla modalità di richiesta di performance (TSC1_VE_LIMIT)" VALUE 0xFC82D7 Scalar_UBYTE 0 TSC1_VE_LIMIT_Rx_4ms_CM_uint8_adm 0 3 /end CHARACTERISTIC
/begin CHARACTERISTIC cfVE_PC_BITS_2_CAN_Enable "[FIX] Fix sulla priorità di richiesta di performance (nel secondo TSC1_Ctrl2)" VALUE 0xFC82D6 Scalar_UBYTE 0 TSC1_VE_CONTROL2_Rx_4ms_CM_FixEnableT 171 218 /end CHARACTERISTIC
/begin CHARACTERISTIC cfVE_PC_BITS_2_CAN_Value "[FIX] Fix sulla priorità di richiesta di performance (nel secondo TSC1_Ctrl2)" VALUE 0xFC82D5 Scalar_UBYTE 0 TSC1_VE_CONTROL2_Rx_4ms_CM_uint8_adm 0 3 /end CHARACTERISTIC
/begin CHARACTERISTIC cfVE_PC_BITS_CAN_Enable "[FIX] Fix sulla priorità di richiesta di performance (TSC1_VE_CONTROL)" VALUE 0xFC82D4 Scalar_UBYTE 0 TSC1_VE_CONTROL_Rx_4ms_CM_FixEnableT 171 218 /end CHARACTERISTIC
/begin CHARACTERISTIC cfVE_PC_BITS_CAN_Value "[FIX] Fix sulla priorità di richiesta di performance (TSC1_VE_CONTROL)" VALUE 0xFC82D3 Scalar_UBYTE 0 TSC1_VE_CONTROL_Rx_4ms_CM_uint8_adm 0 3 /end CHARACTERISTIC
/begin CHARACTERISTIC cfVE_PL_BITS_CAN_Enable "[FIX] Fix sulla priorità di richiesta di performance (TSC1_VE_LIMIT)" VALUE 0xFC82D2 Scalar_UBYTE 0 TSC1_VE_LIMIT_Rx_4ms_CM_FixEnableT 171 218 /end CHARACTERISTIC
/begin CHARACTERISTIC cfVE_PL_BITS_CAN_Value "[FIX] Fix sulla priorità di richiesta di performance (TSC1_VE_LIMIT)" VALUE 0xFC82D1 Scalar_UBYTE 0 TSC1_VE_LIMIT_Rx_4ms_CM_uint8_adm 0 3 /end CHARACTERISTIC
/begin CHARACTERISTIC cfWGT_CTRL_MODE_Enable "[FIX] Fix on the CAN Turbo Controller mode (1 - ON)" VALUE 0xFC2C26 Scalar_UBYTE 0 ECU2TURBO_Tx_4ms_CM_FixEnableT 171 218 /end CHARACTERISTIC
/begin CHARACTERISTIC cfWGT_CTRL_MODE_Value "[FIX] Fix on the CAN Turbo Controller mode (1 - ON)" VALUE 0xFC2C25 Scalar_BOOLEAN 0 ECU2TURBO_Tx_4ms_CM_boolean_adm 0 1 /end CHARACTERISTIC
/begin CHARACTERISTIC cfWGT_DUTY_Enable "[FIX] Fix on the WasteGate percentage position requested as target to the CAN Turbo Controller" VALUE 0xFC2C24 Scalar_UBYTE 0 ECU2TURBO_Tx_4ms_CM_FixEnableT 171 218 /end CHARACTERISTIC
/begin CHARACTERISTIC cfWGT_DUTY_Value "[FIX] Fix on the WasteGate percentage position requested as target to the CAN Turbo Controller" VALUE 0xFC2C22 Scalar_UWORD 0 ECU2TURBO_Tx_4ms_CM_ufix16_En3__ 0 100 /end CHARACTERISTIC
/begin CHARACTERISTIC cfWRN_LAMP_CMD_Enable "[FIX] Warning Lamp Command" VALUE 0xFC83D7 Scalar_UBYTE 0 DLCC1_Tx_1s_CM_FixEnableT 171 218 /end CHARACTERISTIC
/begin CHARACTERISTIC cfWRN_LAMP_CMD_Value "[FIX] Warning Lamp Command" VALUE 0xFC83D6 Scalar_UBYTE 0 DLCC1_Tx_1s_CM_uint8_adm 0 3 /end CHARACTERISTIC
/begin CHARACTERISTIC cfYEAR_Enable "[FIX] Fix sugli anni (ricevuti da CAN)" VALUE 0xFC82AE Scalar_UBYTE 0 TIMEDATE_Rx_1s_CM_FixEnableT 171 218 /end CHARACTERISTIC
/begin CHARACTERISTIC cfYEAR_Value "[FIX] Fix sugli anni (ricevuti da CAN)" VALUE 0xFC82AD Scalar_UBYTE 0 TIMEDATE_Rx_1s_CM_ufix8_B1985_year 1985 2235 /end CHARACTERISTIC
/begin CHARACTERISTIC cs02_CONC_REC "Recovery on O2 concentration of Uego Sensor (-30% to 30%)" VALUE 0xFC8322 Scalar_SWORD 0 USS_Rx_50ms_CM_sfix16_Sp01_Bn40p96__ -30 30 /end CHARACTERISTIC
/begin CHARACTERISTIC cs02_STAB_REC "Recovery on O2 stable feedback of Uego Sensor (01-stable 00-not stable)" VALUE 0xFC8320 Scalar_UBYTE 0 USS_Rx_50ms_CM_uint8_adm 0 1 /end CHARACTERISTIC
/begin CHARACTERISTIC csACTUAL_POS "Recovery value for Actual position (0-100%) communicated by TURBO CONTROLLER" VALUE 0xFC2BF6 Scalar_UWORD 0 TURBO2ECU_Rx_4ms_CM_ufix16_Sp1__ 0 100 /end CHARACTERISTIC
/begin CHARACTERISTIC csACT_GEAR_R_REC "Valore di recovery sul rapporto al cambio attualmente in uso (solo per cambio automatico)" VALUE 0xFC8278 Scalar_UWORD 0 ETC2_Rx_100ms_CM_ufix16_En10_adm 0 62.7490234375 /end CHARACTERISTIC
/begin CHARACTERISTIC csALTERNATE_FUEL_ENABLE "Abilitazione Messaggio J1939 - ALTERNATE_FUEL" VALUE 0xFC8374 Scalar_BOOLEAN 0 ALTERNATE_FUEL_Tx_100ms_CM_boolean_adm 0 1 /end CHARACTERISTIC
/begin CHARACTERISTIC csAV_POIL_LOW_THR "Disponibilità segnale di POil sotto la soglia" VALUE 0xFC84E4 Scalar_BOOLEAN 0 EDC2BC_Tx_50ms_CM_boolean_adm 0 1 /end CHARACTERISTIC
/begin MEASUREMENT csAct_Gear_Ratio "Valore ricevuto via CAN sul rapporto al cambio effettivo (solo per cambio automatico)" UWORD J1939dl_Rx100ms_CM_ufix16_En10_adm 0 0 0 63.999 ECU_ADDRESS 0x4000333A /end MEASUREMENT
/begin MEASUREMENT csActualPos "Actual position (0-100%) communicated by TURBO CONTROLLER" UWORD CanPvt_Rx4ms_CM_ufix16_Sp1__ 0 0 0 100 ECU_ADDRESS 0x400022E2 /end MEASUREMENT
/begin MEASUREMENT csApplVehSpeedLim "Limite applicato di Velocità veicolo da inviare via CAN" UBYTE MVS_Tx_1s_CM_uint8_km_h 0 0 0 250 ECU_ADDRESS 0x40003440 /end MEASUREMENT
/begin MEASUREMENT csAvOutShaftSpd "vailability Vehicle Speed from ETC1 CAN Rx (1 = Av, 0 = Not Av)" UBYTE J1939dl_Rx4ms_CM_boolean_adm 0 0 0 1 ECU_ADDRESS 0x40003361 /end MEASUREMENT
/begin MEASUREMENT csAvParkBrk_R "Parking brake switch from CAN Module (1 -> Avaiable, 0 -> Not Avaiable)" UBYTE J1939dl_Rx100ms_CM_boolean_adm 0 0 0 1 ECU_ADDRESS 0x40003330 /end MEASUREMENT
/begin MEASUREMENT csAvVehSpeedTCO1 "vailability Vehicle Speed from TCO1 CAN Rx (1 = Av, 0 = Not Av)" UBYTE J1939dl_Rx50ms_CM_boolean_adm 0 0 0 1 ECU_ADDRESS 0x40003399 /end MEASUREMENT
/begin MEASUREMENT csAvVehicleSpeed_R "peed vehicle available from CCVS CAN Rx (1 = Av, 0 = Not Av)" UBYTE DiagSym100ms_CM_boolean_adm 0 0 0 1 ECU_ADDRESS 0x4000332F /end MEASUREMENT
/begin CHARACTERISTIC csBAT_FAIL_HIGH_REC "Recovery on Bat High Fail Diagnosis Uego Sensor (01-Fail 00-No Fail)" VALUE 0xFC831F Scalar_BOOLEAN 0 USS_Rx_50ms_CM_boolean_adm 0 1 /end CHARACTERISTIC
/begin CHARACTERISTIC csBAT_FAIL_LOW_REC "Recovery on Bat Low Fail Diagnosis Uego Sensor (01-Fail 00-No Fail)" VALUE 0xFC831E Scalar_BOOLEAN 0 USS_Rx_50ms_CM_boolean_adm 0 1 /end CHARACTERISTIC
/begin CHARACTERISTIC csBRAKE_REC "Valore di recovery sullo switch freno" VALUE 0xFC8276 Scalar_BOOLEAN 0 CCVS_Rx_100ms_CM_boolean_adm 0 1 /end CHARACTERISTIC
/begin MEASUREMENT csBatFailHighUEGO "igh Bat Failure on Uego Sensor (1-Fail,0-No Fail)" UBYTE J1939dl_Rx50ms_CM_boolean_adm 0 0 0 1 ECU_ADDRESS 0x40003398 /end MEASUREMENT
/begin MEASUREMENT csBatFailLowUEGO "ow Bat Failure on Uego Sensor (1-Fail,0-No Fail)" UBYTE J1939dl_Rx50ms_CM_boolean_adm 0 0 0 1 ECU_ADDRESS 0x40003397 /end MEASUREMENT
/begin MEASUREMENT csBatPot "SPN 168 - Battery Potential - Power Input 1" UWORD VEP1_Tx_1s_CM_ufix16_Sp05_V 0 0 0 3212.75 ECU_ADDRESS 0x40003462 /end MEASUREMENT
/begin MEASUREMENT csBatPotCAN "Battery Potentia - Power Input 1 (MsgTxCAN VEP1 - Byte 5,6)" UWORD VEP1_Tx_1s_CM_uint16_adm 0 0 0 65535 ECU_ADDRESS 0x40003460 /end MEASUREMENT
/begin MEASUREMENT csBrake_R "Brake switch from CCVS CAN Rx (1 = Pressed, 0 = Not Pressed)" UBYTE J1939dl_Rx100ms_CM_boolean_adm 0 0 0 1 ECU_ADDRESS 0x4000332E /end MEASUREMENT
/begin CHARACTERISTIC csCANCEL_INIT_REQUEST "Cancel the initialization routine ( 0 - Request; 1 - Wait)." VALUE 0xFC2C20 Scalar_BOOLEAN 0 ECU2TURBO_Tx_4ms_CM_boolean_adm 0 1 /end CHARACTERISTIC
/begin CHARACTERISTIC csCAN_FAIL_REC "Recovery on Can Comunication Fail Diagnosis Uego Sensor (01-Fail 00-No Fail)" VALUE 0xFC831D Scalar_BOOLEAN 0 USS_Rx_50ms_CM_boolean_adm 0 1 /end CHARACTERISTIC
/begin MEASUREMENT csCCSetSpeed_R "ruise Control set speed from CCVS CAN Rx" UBYTE J1939dl_Rx100ms_CM_uint8_km_h 0 0 0 250 ECU_ADDRESS 0x40003337 /end MEASUREMENT
/begin MEASUREMENT csCCState_R "ruise Control state from CCVS CAN Rx" UBYTE J1939dl_Rx100ms_CM_uint8_adm 0 0 0 7 ECU_ADDRESS 0x40003336 /end MEASUREMENT
/begin CHARACTERISTIC csCCVS_ENABLE "Abilitazione Messaggio J1939 - CCVS" VALUE 0xFC8373 Scalar_BOOLEAN 0 CCVS_Tx_100ms_CM_boolean_adm 0 1 /end CHARACTERISTIC
/begin CHARACTERISTIC csCC_SET_SPEED_REC "CC set speed Recovery (CCVS CAN Rx)" VALUE 0xFC8275 Scalar_UBYTE 0 CCVS_Rx_100ms_CM_uint8_km_h 0 250 /end CHARACTERISTIC
/begin CHARACTERISTIC csCC_STATE_REC "CC state Recovery (CCVS CAN Rx)" VALUE 0xFC8274 Scalar_UBYTE 0 CCVS_Rx_100ms_CM_uint8_adm 0 7 /end CHARACTERISTIC
/begin MEASUREMENT csCDriveL_Eng "Informazione su distribuzione-accoppiata al cambio" UBYTE J1939dl_Rx4ms_CM_boolean_adm 0 0 0 1 ECU_ADDRESS 0x40003363 /end MEASUREMENT
/begin CHARACTERISTIC csCLUTCH_REC "Valore di recovery sullo switch frizione" VALUE 0xFC8273 Scalar_BOOLEAN 0 CCVS_Rx_100ms_CM_boolean_adm 0 1 /end CHARACTERISTIC
/begin CHARACTERISTIC csCOMP_FAIL_REC "Recovery on Components Fail Diagnosis Uego Sensor (01-Fail 00-No Fail)" VALUE 0xFC831C Scalar_BOOLEAN 0 USS_Rx_50ms_CM_boolean_adm 0 1 /end CHARACTERISTIC
/begin CHARACTERISTIC csCRUISE_ACT_REC "Valore di recovery sul cruise control switch" VALUE 0xFC8272 Scalar_BOOLEAN 0 CCVS_Rx_100ms_CM_boolean_adm 0 1 /end CHARACTERISTIC
/begin CHARACTERISTIC csCURR_GEAR_REC "Valore di recovery sulla marcia effettivamente innestata (solo per cambio automatico)" VALUE 0xFC8271 Scalar_UBYTE 0 ETC2_Rx_100ms_CM_ufix8_Bn125_gear -125 125 /end CHARACTERISTIC
/begin MEASUREMENT csCabinTiltState "Stato Cabin Tilt" UBYTE EDC2BC_Tx_50ms_CM_uint8_adm 0 0 0 3 ECU_ADDRESS 0x40003481 /end MEASUREMENT
/begin MEASUREMENT csCanFailUEGO "an Failure on Uego Sensor (1-Fail,0-No Fail)" UBYTE J1939dl_Rx50ms_CM_boolean_adm 0 0 0 1 ECU_ADDRESS 0x40003396 /end MEASUREMENT
/begin MEASUREMENT csCanRxErrorFlag "Flag di plausibilità Bus CAN OFF (NO Msg = 1; Msg OK = 0)" UBYTE J1939dl_Rx4ms_CM_boolean_adm 0 0 0 1 ECU_ADDRESS 0x40003360 /end MEASUREMENT
/begin MEASUREMENT csChargSysPot "SPN 167 - Charging System Potential" UWORD VEP1_Tx_1s_CM_ufix16_Sp05_V 0 0 0 3212.75 ECU_ADDRESS 0x4000345E /end MEASUREMENT
/begin MEASUREMENT csChargSysPotCAN "Charging System Potential (MsgTxCAN VEP1 - Byte 3,4)" UWORD VEP1_Tx_1s_CM_uint16_adm 0 0 0 65535 ECU_ADDRESS 0x4000345C /end MEASUREMENT
/begin MEASUREMENT csClutch_R "Clutch switch from CCVS CAN Rx (1 = Actuated, 0 = Not Actuated)" UBYTE J1939dl_Rx100ms_CM_boolean_adm 0 0 0 1 ECU_ADDRESS 0x4000332C /end MEASUREMENT
/begin MEASUREMENT csCmuLimLmpCmd "Cmu limitation lamp comand" UBYTE PropB_0A_Tx_100ms_CM_uint8_adm 0 0 0 2 ECU_ADDRESS 0x40003409 /end MEASUREMENT
/begin MEASUREMENT csComAbnorm "Communication Abnormal Fault communicated by TURBO CONTROLLER (0 - No Fault)" UBYTE CanPvt_Rx4ms_CM_boolean_adm 0 0 0 1 ECU_ADDRESS 0x400022D6 /end MEASUREMENT
/begin MEASUREMENT csCompFailUEGO "omponents Ctrl Failure on Uego Sensor (1-Fail,0-No Fail)" UBYTE J1939dl_Rx50ms_CM_boolean_adm 0 0 0 1 ECU_ADDRESS 0x40003393 /end MEASUREMENT
/begin MEASUREMENT csCruiseAct_R "Cruise control switch from CCVS CAN Rx (1 = on, 0 = off)" UBYTE J1939dl_Rx100ms_CM_boolean_adm 0 0 0 1 ECU_ADDRESS 0x4000332D /end MEASUREMENT
/begin MEASUREMENT csCtrlMode "Control Mode communicated by TURBO CONTROLLER (0 - Control Impossibile; 1- Control Possibile)" UBYTE CanPvt_Rx4ms_CM_boolean_adm 0 0 0 1 ECU_ADDRESS 0x400022D2 /end MEASUREMENT
/begin MEASUREMENT csCurrent_Gear "Valore ricevuto via CAN sulla marcia effettiva innestata (solo per cambio automatico)" UBYTE J1939dl_Rx100ms_CM_ufix8_Bn125_gear 0 0 -125 125 ECU_ADDRESS 0x40003326 /end MEASUREMENT
/begin CHARACTERISTIC csDAY_REC "Valore di recovery sui giorni" VALUE 0xFC82AC Scalar_UBYTE 0 TIMEDATE_Rx_1s_CM_ufix8_En2_day 0.25 31.75 /end CHARACTERISTIC
/begin CHARACTERISTIC csDD1_ENABLE "Abilitazione Messaggio J1939 - DD1" VALUE 0xFC83D5 Scalar_BOOLEAN 0 DD1_Tx_1s_CM_boolean_adm 0 1 /end CHARACTERISTIC
/begin CHARACTERISTIC csDLCC1_ENABLE "Abilitazione Messaggio J1939 - DLCC1" VALUE 0xFC83D4 Scalar_BOOLEAN 0 DLCC1_Tx_1s_CM_boolean_adm 0 1 /end CHARACTERISTIC
/begin CHARACTERISTIC csDLCC2_ENABLE "Abilitazione Messaggio J1939 - DLCC2" VALUE 0xFC83D3 Scalar_BOOLEAN 0 DLCC2_Tx_1s_CM_boolean_adm 0 1 /end CHARACTERISTIC
/begin CHARACTERISTIC csDN_KICK_DOWN "Flag Digital Output Kickdown (0 -> Direct DI, 1 -> Neg DI)" VALUE 0xFCC666 Scalar_BOOLEAN 0 TE_DigOutput100ms_CM_boolean_adm 0 1 /end CHARACTERISTIC
/begin CHARACTERISTIC csDRIVEL_ENG_REC "Valore di recovery sullo switch disribuzione-accoppiata al motore" VALUE 0xFC82D0 Scalar_BOOLEAN 0 ETC1_Rx_4ms_CM_boolean_adm 0 1 /end CHARACTERISTIC
/begin CHARACTERISTIC csDUTY_MONITOR "Recovery value for Applied duty cycke [-100:100] percentage to the DC Motor communicated by TURBO CONTROLLER" VALUE 0xFC2BF4 Scalar_BYTE 0 TURBO2ECU_Rx_4ms_CM_int8__ -100 100 /end CHARACTERISTIC
/begin MEASUREMENT csDutyMonitor "Applied duty cycke [-100:100] percentage to the DC Motor communicated by TURBO CONTROLLER" SBYTE CanPvt_Rx4ms_CM_int8__ 0 0 -100 100 ECU_ADDRESS 0x400022E0 /end MEASUREMENT
/begin CHARACTERISTIC csECM2EPR_ENABLE "Enabling J1939 CAN Msg - ECM2EPR" VALUE 0xFC8489 Scalar_BOOLEAN 0 ECM2EPR_Tx_4ms_CM_boolean_adm 0 1 /end CHARACTERISTIC
/begin CHARACTERISTIC csECU2TURBO_ENABLE "Enabling transmission of CAN PVT message - ECU2TURBO" VALUE 0xFC2C1F Scalar_BOOLEAN 0 ECU2TURBO_Tx_4ms_CM_boolean_adm 0 1 /end CHARACTERISTIC
/begin CHARACTERISTIC csEDC2BC_ENABLE "Abilitazione Messaggio J1939 - EDBC2BC" VALUE 0xFC84E3 Scalar_BOOLEAN 0 EDC2BC_Tx_50ms_CM_boolean_adm 0 1 /end CHARACTERISTIC
/begin CHARACTERISTIC csEEC1_ENABLE "Abilitazione Messaggio J1939 - EEC1" VALUE 0xFC8488 Scalar_BOOLEAN 0 EEC1_Tx_4ms_CM_boolean_adm 0 1 /end CHARACTERISTIC
/begin CHARACTERISTIC csEEC2_ENABLE "Abilitazione Messaggio J1939 - EEC2" VALUE 0xFC84E2 Scalar_BOOLEAN 0 EEC2_Tx_50ms_CM_boolean_adm 0 1 /end CHARACTERISTIC
/begin CHARACTERISTIC csEEC3_ENABLE "Abilitazione Messaggio J1939 - EEC3" VALUE 0xFC8372 Scalar_BOOLEAN 0 EEC3_Tx_100ms_CM_boolean_adm 0 1 /end CHARACTERISTIC
/begin CHARACTERISTIC csEFL_ENABLE "Abilitazione Messaggio J1939 - FLUID_LEVEL_PRESS" VALUE 0xFC8371 Scalar_BOOLEAN 0 ENG_FLD_LEV_PRESS_Tx_100ms_CM_boolean_adm 0 1 /end CHARACTERISTIC
/begin CHARACTERISTIC csEFL_P2_ENABLE "Abilitazione Messaggio J1939 - EFL_P2" VALUE 0xFC8370 Scalar_BOOLEAN 0 EFL_P2_Tx_100ms_CM_boolean_adm 0 1 /end CHARACTERISTIC
/begin CHARACTERISTIC csENG_CONF_ENABLE "Abilitazione Messaggio J1939 - ENG_CONF" VALUE 0xFC83D2 Scalar_BOOLEAN 0 ENG_CONF_Tx_1s_CM_boolean_adm 0 1 /end CHARACTERISTIC
/begin CHARACTERISTIC csENG_HOURS_ENABLE "Abilitazione Messaggio J1939 - ENG_HOURS" VALUE 0xFC836F Scalar_BOOLEAN 0 ENG_HOURS_REV_Tx_100ms_CM_boolean_adm 0 1 /end CHARACTERISTIC
/begin CHARACTERISTIC csENG_TEMP_ENABLE "Abilitazione Messaggio J1939 - ENG_TEMP" VALUE 0xFC83D1 Scalar_BOOLEAN 0 ENG_TEMP_Tx_1s_CM_boolean_adm 0 1 /end CHARACTERISTIC
/begin CHARACTERISTIC csEN_HIGH_RES_RPM "Abilitazione alla trasmissione dei giri ad alta risoluzione" VALUE 0xFC8487 Scalar_BOOLEAN 0 EEC1_Tx_4ms_CM_boolean_adm 0 1 /end CHARACTERISTIC
/begin MEASUREMENT csEPRCount "DU-EPR CAN Message Counter - j1939 CAN EPR2ECM Msg" UBYTE J1939dl_Rx100ms_CM_uint8_adm 0 0 0 255 ECU_ADDRESS 0x40003333 /end MEASUREMENT
/begin MEASUREMENT csEPRDiagMGS "DU-EPR MGS component diagnosis - j1939 CAN EPR2ECM Msg" UBYTE Epr4ms_CM_ufix3_adm 0 0 0 4 ECU_ADDRESS 0x4000332B /end MEASUREMENT
/begin MEASUREMENT csEPRDiagTEcu "DU-EPR  Ecu temperature electrical diagnosis - j1939 CAN EPR2ECM Msg" UBYTE Epr4ms_CM_ufix2_adm 0 0 0 2 ECU_ADDRESS 0x40003329 /end MEASUREMENT
/begin MEASUREMENT csEPRDiagTEcuCond "DU-EPR Ecu temperature functional diagnosis - j1939 CAN EPR2ECM Msg" UBYTE Epr4ms_CM_ufix2_adm 0 0 0 1 ECU_ADDRESS 0x4000332A /end MEASUREMENT
/begin MEASUREMENT csEPRDiagVPW "DU-EPR Ecu Voltage supply diagnosis - j1939 CAN EPR2ECM Msg" UBYTE Epr4ms_CM_ufix2_adm 0 0 0 2 ECU_ADDRESS 0x40003328 /end MEASUREMENT
/begin MEASUREMENT csEPRDutyCycle "EV Applied DutyCycle - j1939 CAN EPR2ECM Msg" UWORD J1939dl_Rx100ms_CM_ufix16_Sp0030517578125__ 0 0 0 100 ECU_ADDRESS 0x4000333E /end MEASUREMENT
/begin MEASUREMENT csEPRFreq "EV PWM Command applied frequency - j1939 CAN EPR2ECM Msg" UBYTE J1939dl_Rx100ms_CM_uint8_Hz 0 0 0 40 ECU_ADDRESS 0x40003335 /end MEASUREMENT
/begin MEASUREMENT csEPRTEcu "DU-EPR Ecu temperature - j1939 CAN EPR2ECM Msg" SWORD J1939dl_Rx100ms_CM_sfix16_En7_degC 0 0 -150 150 ECU_ADDRESS 0x4000333C /end MEASUREMENT
/begin CHARACTERISTIC csEPR_COUNT_REC "[FIX] DU-EPR CAN Message Counter - j1939 CAN EPR2ECM Msg" VALUE 0xFC8270 Scalar_UBYTE 0 EPR2ECM_Rx_100ms_CM_uint8 0 255 /end CHARACTERISTIC
/begin CHARACTERISTIC csEPR_DIAG_MGS_REC "[FIX] DU-EPR MGS component diagnosis - j1939 CAN EPR2ECM Msg" VALUE 0xFC826F Scalar_UBYTE 0 EPR2ECM_Rx_100ms_CM_ufix3 0 4 /end CHARACTERISTIC
/begin CHARACTERISTIC csEPR_DIAG_TECUCOND_REC "[FIX] DU-EPR Ecu temperature functional diagnosis - j1939 CAN EPR2ECM Msg" VALUE 0xFC826E Scalar_UBYTE 0 EPR2ECM_Rx_100ms_CM_ufix2 0 1 /end CHARACTERISTIC
/begin CHARACTERISTIC csEPR_DIAG_TECU_REC "[FIX] DU-EPR Ecu temperature functional diagnosis - j1939 CAN EPR2ECM Msg" VALUE 0xFC826D Scalar_UBYTE 0 EPR2ECM_Rx_100ms_CM_ufix2 0 2 /end CHARACTERISTIC
/begin CHARACTERISTIC csEPR_DIAG_VPW_REC "[FIX] DU-EPR Ecu temperature functional diagnosis - j1939 CAN EPR2ECM Msg" VALUE 0xFC826C Scalar_UBYTE 0 EPR2ECM_Rx_100ms_CM_ufix2 0 2 /end CHARACTERISTIC
/begin CHARACTERISTIC csEPR_EVDUTYCYCLE_REC "[FIX] EV Applied DutyCycle - j1939 CAN EPR2ECM Msg" VALUE 0xFC826A Scalar_UWORD 0 EPR2ECM_Rx_100ms_CM_ufix16_Sp0030517578125 0 100 /end CHARACTERISTIC
/begin CHARACTERISTIC csEPR_EVFREQ_REC "[FIX] EV PWM Command applied frequency - j1939 CAN EPR2ECM Msg" VALUE 0xFC8268 Scalar_UBYTE 0 EPR2ECM_Rx_100ms_CM_uint8 0 40 /end CHARACTERISTIC
/begin CHARACTERISTIC csEPR_TECU_REC "[FIX] DU-EPR Ecu temperature - j1939 CAN EPR2ECM Msg" VALUE 0xFC8266 Scalar_SWORD 0 EPR2ECM_Rx_100ms_CM_sfix16_En7 -150 150 /end CHARACTERISTIC
/begin COMPU_METHOD ALTERNATE_FUEL_Tx_100ms_CM_FixEnableT "Enumerated data type: FixEnableT" TAB_VERB "%0.6" "" COMPU_TAB_REF VTAB_FOR_ALTERNATE_FUEL_Tx_100ms_CM_FixEnableT /end COMPU_METHOD
/begin COMPU_METHOD ALTERNATE_FUEL_Tx_100ms_CM_boolean_adm "Q = V" RAT_FUNC "%1.0" "adm" COEFFS 0 1 0 0 0 1 /end COMPU_METHOD
/begin COMPU_METHOD ALTERNATE_FUEL_Tx_100ms_CM_ufix16_En1_kPa "Q = V*2.000000" RAT_FUNC "%6.1" "kPa" COEFFS 0 2 0 0 0 1 /end COMPU_METHOD
/begin COMPU_METHOD BC2EDC1_Rx_50ms_CM_FixEnableT "Enumerated data type: FixEnableT" TAB_VERB "%0.6" "" COMPU_TAB_REF VTAB_FOR_BC2EDC1_Rx_50ms_CM_FixEnableT /end COMPU_METHOD
/begin COMPU_METHOD BC2EDC1_Rx_50ms_CM_boolean_adm "Q = V" RAT_FUNC "%1.0" "adm" COEFFS 0 1 0 0 0 1 /end COMPU_METHOD
/begin COMPU_METHOD BC2EDC1_Rx_50ms_CM_uint8_km_h "Q = V" RAT_FUNC "%3.0" "km/h" COEFFS 0 1 0 0 0 1 /end COMPU_METHOD
/begin COMPU_METHOD BC2EDC2_Rx_50ms_CM_FixEnableT "Enumerated data type: FixEnableT" TAB_VERB "%0.6" "" COMPU_TAB_REF VTAB_FOR_BC2EDC2_Rx_50ms_CM_FixEnableT /end COMPU_METHOD
/begin COMPU_METHOD BC2EDC2_Rx_50ms_CM_boolean_adm "Q = V" RAT_FUNC "%1.0" "adm" COEFFS 0 1 0 0 0 1 /end COMPU_METHOD
/begin COMPU_METHOD BC2EDC2_Rx_50ms_CM_ufix8_Sp4__ "Q = V*2.500000" RAT_FUNC "%0.6" "%" COEFFS 0 2.5 0 0 0 1 /end COMPU_METHOD
/begin COMPU_METHOD BC2EDC2_Rx_50ms_CM_uint8_adm "Q = V" RAT_FUNC "%3.0" "adm" COEFFS 0 1 0 0 0 1 /end COMPU_METHOD
/begin COMPU_METHOD CCVS_Rx_100ms_CM_FixEnableT "Enumerated data type: FixEnableT" TAB_VERB "%0.6" "" COMPU_TAB_REF VTAB_FOR_CCVS_Rx_100ms_CM_FixEnableT /end COMPU_METHOD
/begin COMPU_METHOD CCVS_Rx_100ms_CM_boolean_adm "Q = V" RAT_FUNC "%1.0" "adm" COEFFS 0 1 0 0 0 1 /end COMPU_METHOD
/begin COMPU_METHOD CCVS_Rx_100ms_CM_ufix16_En8_km_h "Q = V*256.000000" RAT_FUNC "%11.8" "km/h" COEFFS 0 256 0 0 0 1 /end COMPU_METHOD
/begin COMPU_METHOD CCVS_Rx_100ms_CM_uint8_adm "Q = V" RAT_FUNC "%3.0" "adm" COEFFS 0 1 0 0 0 1 /end COMPU_METHOD
/begin COMPU_METHOD CCVS_Rx_100ms_CM_uint8_km_h "Q = V" RAT_FUNC "%3.0" "km/h" COEFFS 0 1 0 0 0 1 /end COMPU_METHOD
/begin COMPU_METHOD CCVS_Tx_100ms_CM_FixEnableT "Enumerated data type: FixEnableT" TAB_VERB "%0.6" "" COMPU_TAB_REF VTAB_FOR_CCVS_Tx_100ms_CM_FixEnableT /end COMPU_METHOD
/begin COMPU_METHOD CCVS_Tx_100ms_CM_boolean_adm "Q = V" RAT_FUNC "%1.0" "adm" COEFFS 0 1 0 0 0 1 /end COMPU_METHOD
/begin COMPU_METHOD CCVS_Tx_100ms_CM_ufix16_En8_km_h "Q = V*256.000000" RAT_FUNC "%11.8" "km/h" COEFFS 0 256 0 0 0 1 /end COMPU_METHOD
/begin COMPU_METHOD CCVS_Tx_100ms_CM_uint8_adm "Q = V" RAT_FUNC "%3.0" "adm" COEFFS 0 1 0 0 0 1 /end COMPU_METHOD
/begin COMPU_METHOD CanPvt_Rx4ms_CM_boolean_adm "Q = V" RAT_FUNC "%1.0" "adm" COEFFS 0 1 0 0 0 1 /end COMPU_METHOD
/begin COMPU_METHOD CanPvt_Rx4ms_CM_int8__ "Q = V" RAT_FUNC "%3.0" "%" COEFFS 0 1 0 0 0 1 /end COMPU_METHOD
/begin COMPU_METHOD CanPvt_Rx4ms_CM_ufix16_Sp1__ "Q = V*10.000000" RAT_FUNC "%0.6" "%" COEFFS 0 10 0 0 0 1 /end COMPU_METHOD
/begin COMPU_METHOD Ctit_UEGOHeater4ms_CM_uint16_adm "Q = V" RAT_FUNC "%5.0" "adm" COEFFS 0 1 0 0 0 1 /end COMPU_METHOD
/begin COMPU_METHOD DD1_Tx_1s_CM_FixEnableT "Enumerated data type: FixEnableT" TAB_VERB "%0.6" "" COMPU_TAB_REF VTAB_FOR_DD1_Tx_1s_CM_FixEnableT /end COMPU_METHOD
/begin COMPU_METHOD DD1_Tx_1s_CM_boolean_adm "Q = V" RAT_FUNC "%1.0" "adm" COEFFS 0 1 0 0 0 1 /end COMPU_METHOD
/begin COMPU_METHOD DD1_Tx_1s_CM_ufix8_Sp4__ "Q = V*2.500000" RAT_FUNC "%0.6" "%" COEFFS 0 2.5 0 0 0 1 /end COMPU_METHOD
/begin COMPU_METHOD DLCC1_Tx_1s_CM_FixEnableT "Enumerated data type: FixEnableT" TAB_VERB "%0.6" "" COMPU_TAB_REF VTAB_FOR_DLCC1_Tx_1s_CM_FixEnableT /end COMPU_METHOD
/begin COMPU_METHOD DLCC1_Tx_1s_CM_boolean_adm "Q = V" RAT_FUNC "%1.0" "adm" COEFFS 0 1 0 0 0 1 /end COMPU_METHOD
/begin COMPU_METHOD DLCC1_Tx_1s_CM_uint8_adm "Q = V" RAT_FUNC "%3.0" "adm" COEFFS 0 1 0 0 0 1 /end COMPU_METHOD
/begin COMPU_METHOD DLCC2_Tx_1s_CM_FixEnableT "Enumerated data type: FixEnableT" TAB_VERB "%0.6" "" COMPU_TAB_REF VTAB_FOR_DLCC2_Tx_1s_CM_FixEnableT /end COMPU_METHOD
/begin COMPU_METHOD DLCC2_Tx_1s_CM_boolean_adm "Q = V" RAT_FUNC "%1.0" "adm" COEFFS 0 1 0 0 0 1 /end COMPU_METHOD
/begin COMPU_METHOD DLCC2_Tx_1s_CM_uint8_adm "Q = V" RAT_FUNC "%3.0" "adm" COEFFS 0 1 0 0 0 1 /end COMPU_METHOD
/begin COMPU_METHOD Dcat_Diagnosis100ms_CM_tKeyState_adm "Enumerated data type: tKeyState" TAB_VERB "%0.6" "adm" COMPU_TAB_REF VTAB_FOR_Dcat_Diagnosis100ms_CM_tKeyState_adm /end COMPU_METHOD
/begin COMPU_METHOD Dcat_Diagnosis100ms_CM_ufix16_En3_mg_cc "Q = V*8.000000" RAT_FUNC "%7.3" "mg/cc" COEFFS 0 8 0 0 0 1 /end COMPU_METHOD
/begin COMPU_METHOD Dcat_Diagnosis100ms_CM_ufix16_En4_kg_h "Q = V*16.000000" RAT_FUNC "%8.4" "kg/h" COEFFS 0 16 0 0 0 1 /end COMPU_METHOD
/begin COMPU_METHOD Dcat_Diagnosis100ms_CM_uint16_km_h "Q = V" RAT_FUNC "%5.0" "km/h" COEFFS 0 1 0 0 0 1 /end COMPU_METHOD
/begin COMPU_METHOD Dcat_Diagnosis100ms_CM_uint16_mbar "Q = V" RAT_FUNC "%5.0" "mbar" COEFFS 0 1 0 0 0 1 /end COMPU_METHOD
/begin COMPU_METHOD Dcat_DiagnosisTDC_CM_boolean_adm "Q = V" RAT_FUNC "%1.0" "adm" COEFFS 0 1 0 0 0 1 /end COMPU_METHOD
/begin COMPU_METHOD Dcat_DiagnosisTDC_CM_ufix16_En15_adm "Q = V*32768.000000" RAT_FUNC "%16.15" "adm" COEFFS 0 32768 0 0 0 1 /end COMPU_METHOD
/begin COMPU_METHOD Dcat_DiagnosisTDC_CM_uint16_mV "Q = V" RAT_FUNC "%5.0" "mV" COEFFS 0 1 0 0 0 1 /end COMPU_METHOD
/begin COMPU_METHOD Dcat_DiagnosisTDC_CM_uint16_mbar "Q = V" RAT_FUNC "%5.0" "mbar" COEFFS 0 1 0 0 0 1 /end COMPU_METHOD
/begin COMPU_METHOD Dcat_DiagnosisTDC_CM_uint32_adm "Q = V" RAT_FUNC "%10.0" "adm" COEFFS 0 1 0 0 0 1 /end COMPU_METHOD
/begin COMPU_METHOD Dcat_DiagnosisTDC_CM_uint8_adm "Q = V" RAT_FUNC "%3.0" "adm" COEFFS 0 1 0 0 0 1 /end COMPU_METHOD
/begin COMPU_METHOD DiagSym100ms_CM_boolean_adm "Q = V" RAT_FUNC "%1.0" "adm" COEFFS 0 1 0 0 0 1 /end COMPU_METHOD
/begin COMPU_METHOD DiagSym100ms_CM_eEGMD_adm "Enumerated data type: eEGMD" TAB_VERB "%0.6" "adm" COMPU_TAB_REF VTAB_FOR_DiagSym100ms_CM_eEGMD_adm /end COMPU_METHOD
/begin COMPU_METHOD DiagSym100ms_CM_eEGST_adm "Enumerated data type: eEGST" TAB_VERB "%0.6" "adm" COMPU_TAB_REF VTAB_FOR_DiagSym100ms_CM_eEGST_adm /end COMPU_METHOD
/begin COMPU_METHOD DiagSym100ms_CM_ufix16_En10_adm "Q = V*1024.000000" RAT_FUNC "%12.10" "adm" COEFFS 0 1024 0 0 0 1 /end COMPU_METHOD
/begin COMPU_METHOD DiagSym100ms_CM_ufix16_En15_adm "Q = V*32768.000000" RAT_FUNC "%16.15" "adm" COEFFS 0 32768 0 0 0 1 /end COMPU_METHOD
/begin COMPU_METHOD DiagSym100ms_CM_ufix16_En3__ "Q = V*8.000000" RAT_FUNC "%7.3" "%" COEFFS 0 8 0 0 0 1 /end COMPU_METHOD
/begin COMPU_METHOD DiagSym100ms_CM_ufix16_S50_mV "Q = V/50.000000" RAT_FUNC "%0.6" "mV" COEFFS 0 1 0 0 0 50 /end COMPU_METHOD
/begin COMPU_METHOD DiagSym100ms_CM_ufix8_Bn40_degC "Q = (V+40.000000)/1.000000" RAT_FUNC "%0.6" "degC" COEFFS 0 1 40 0 0 1 /end COMPU_METHOD
/begin COMPU_METHOD DiagSym100ms_CM_uint16_mbar "Q = V" RAT_FUNC "%5.0" "mbar" COEFFS 0 1 0 0 0 1 /end COMPU_METHOD
/begin COMPU_METHOD DiagSym100ms_CM_uint32_min "Q = V" RAT_FUNC "%10.0" "min" COEFFS 0 1 0 0 0 1 /end COMPU_METHOD
/begin COMPU_METHOD DiagSym4ms_CM_ufix16_Bn40_adm "Q = (V+40.000000)/1.000000" RAT_FUNC "%0.6" "adm" COEFFS 0 1 40 0 0 1 /end COMPU_METHOD
/begin COMPU_METHOD DiagSym4ms_CM_ufix16_Bn40_degC "Q = (V+40.000000)/1.000000" RAT_FUNC "%0.6" "degC" COEFFS 0 1 40 0 0 1 /end COMPU_METHOD
/begin COMPU_METHOD Diag_LineSTOH100ms_CM_eEGST_adm "Enumerated data type: eEGST" TAB_VERB "%0.6" "adm" COMPU_TAB_REF VTAB_FOR_Diag_LineSTOH100ms_CM_eEGST_adm /end COMPU_METHOD
/begin COMPU_METHOD Diag_LineSTOH100ms_CM_tKeyState_adm "Enumerated data type: tKeyState" TAB_VERB "%0.6" "adm" COMPU_TAB_REF VTAB_FOR_Diag_LineSTOH100ms_CM_tKeyState_adm /end COMPU_METHOD
/begin COMPU_METHOD Diag_LineSTOH100ms_CM_ufix16_Bn40_degC "Q = (V+40.000000)/1.000000" RAT_FUNC "%0.6" "degC" COEFFS 0 1 40 0 0 1 /end COMPU_METHOD
/begin COMPU_METHOD Digin4ms_CM_boolean_adm "Q = V" RAT_FUNC "%1.0" "adm" COEFFS 0 1 0 0 0 1 /end COMPU_METHOD
/begin COMPU_METHOD Digin4ms_CM_tKeyState_adm "Enumerated data type: tKeyState" TAB_VERB "%0.6" "adm" COMPU_TAB_REF VTAB_FOR_Digin4ms_CM_tKeyState_adm /end COMPU_METHOD
/begin COMPU_METHOD ECM2EPR_Tx_4ms_CM_FixEnableT_adm "Enumerated data type: FixEnableT" TAB_VERB "%0.6" "adm" COMPU_TAB_REF VTAB_FOR_ECM2EPR_Tx_4ms_CM_FixEnableT_adm /end COMPU_METHOD
/begin COMPU_METHOD ECM2EPR_Tx_4ms_CM_FixEnableT_barA "Enumerated data type: FixEnableT" TAB_VERB "%0.6" "barA" COMPU_TAB_REF VTAB_FOR_ECM2EPR_Tx_4ms_CM_FixEnableT_barA /end COMPU_METHOD
/begin COMPU_METHOD ECM2EPR_Tx_4ms_CM_FixEnableT_barG "Enumerated data type: FixEnableT" TAB_VERB "%0.6" "barG" COMPU_TAB_REF VTAB_FOR_ECM2EPR_Tx_4ms_CM_FixEnableT_barG /end COMPU_METHOD
/begin COMPU_METHOD ECM2EPR_Tx_4ms_CM_boolean_adm "Q = V" RAT_FUNC "%1.0" "adm" COEFFS 0 1 0 0 0 1 /end COMPU_METHOD
/begin COMPU_METHOD ECM2EPR_Tx_4ms_CM_ufix16_En8_barA "Q = V*256.000000" RAT_FUNC "%11.8" "barA" COEFFS 0 256 0 0 0 1 /end COMPU_METHOD
/begin COMPU_METHOD ECM2EPR_Tx_4ms_CM_ufix16_En8_kg_hour "Q = V*256.000000" RAT_FUNC "%11.8" "kg/hour" COEFFS 0 256 0 0 0 1 /end COMPU_METHOD
/begin COMPU_METHOD ECM2EPR_Tx_4ms_CM_ufix16_Sp01_barG "Q = V*100.000000" RAT_FUNC "%0.6" "barG" COEFFS 0 100 0 0 0 1 /end COMPU_METHOD
/begin COMPU_METHOD ECU2TURBO_Tx_4ms_CM_FixEnableT "Enumerated data type: FixEnableT" TAB_VERB "%0.6" "" COMPU_TAB_REF VTAB_FOR_ECU2TURBO_Tx_4ms_CM_FixEnableT /end COMPU_METHOD
/begin COMPU_METHOD ECU2TURBO_Tx_4ms_CM_boolean_adm "Q = V" RAT_FUNC "%1.0" "adm" COEFFS 0 1 0 0 0 1 /end COMPU_METHOD
/begin COMPU_METHOD ECU2TURBO_Tx_4ms_CM_ufix16_En3__ "Q = V*8.000000" RAT_FUNC "%7.3" "%" COEFFS 0 8 0 0 0 1 /end COMPU_METHOD
/begin COMPU_METHOD EDC2BC_Tx_50ms_CM_FixEnableT "Enumerated data type: FixEnableT" TAB_VERB "%0.6" "" COMPU_TAB_REF VTAB_FOR_EDC2BC_Tx_50ms_CM_FixEnableT /end COMPU_METHOD
/begin COMPU_METHOD EDC2BC_Tx_50ms_CM_boolean_adm "Q = V" RAT_FUNC "%1.0" "adm" COEFFS 0 1 0 0 0 1 /end COMPU_METHOD
/begin COMPU_METHOD EDC2BC_Tx_50ms_CM_uint16_mbar "Q = V" RAT_FUNC "%5.0" "mbar" COEFFS 0 1 0 0 0 1 /end COMPU_METHOD
/begin COMPU_METHOD EDC2BC_Tx_50ms_CM_uint8_adm "Q = V" RAT_FUNC "%3.0" "adm" COEFFS 0 1 0 0 0 1 /end COMPU_METHOD
/begin COMPU_METHOD EEC1_Tx_4ms_CM_FixEnableT "Enumerated data type: FixEnableT" TAB_VERB "%0.6" "" COMPU_TAB_REF VTAB_FOR_EEC1_Tx_4ms_CM_FixEnableT /end COMPU_METHOD
/begin COMPU_METHOD EEC1_Tx_4ms_CM_boolean_adm "Q = V" RAT_FUNC "%1.0" "adm" COEFFS 0 1 0 0 0 1 /end COMPU_METHOD
/begin COMPU_METHOD EEC1_Tx_4ms_CM_ufix16_En3_rpm "Q = V*8.000000" RAT_FUNC "%7.3" "rpm" COEFFS 0 8 0 0 0 1 /end COMPU_METHOD
/begin COMPU_METHOD EEC1_Tx_4ms_CM_ufix8_Bn125__ "Q = (V+125.000000)/1.000000" RAT_FUNC "%0.6" "%" COEFFS 0 1 125 0 0 1 /end COMPU_METHOD
/begin COMPU_METHOD EEC1_Tx_4ms_CM_uint8_adm "Q = V" RAT_FUNC "%3.0" "adm" COEFFS 0 1 0 0 0 1 /end COMPU_METHOD
/begin COMPU_METHOD EEC2_Tx_50ms_CM_FixEnableT "Enumerated data type: FixEnableT" TAB_VERB "%0.6" "" COMPU_TAB_REF VTAB_FOR_EEC2_Tx_50ms_CM_FixEnableT /end COMPU_METHOD
/begin COMPU_METHOD EEC2_Tx_50ms_CM_boolean_adm "Q = V" RAT_FUNC "%1.0" "adm" COEFFS 0 1 0 0 0 1 /end COMPU_METHOD
/begin COMPU_METHOD EEC2_Tx_50ms_CM_ufix8_Sp4__ "Q = V*2.500000" RAT_FUNC "%0.6" "%" COEFFS 0 2.5 0 0 0 1 /end COMPU_METHOD
/begin COMPU_METHOD EEC2_Tx_50ms_CM_uint8__ "Q = V" RAT_FUNC "%3.0" "%" COEFFS 0 1 0 0 0 1 /end COMPU_METHOD
/begin COMPU_METHOD EEC2_Tx_50ms_CM_uint8_adm "Q = V" RAT_FUNC "%3.0" "adm" COEFFS 0 1 0 0 0 1 /end COMPU_METHOD
/begin COMPU_METHOD EEC3_Tx_100ms_CM_FixEnableT "Enumerated data type: FixEnableT" TAB_VERB "%0.6" "" COMPU_TAB_REF VTAB_FOR_EEC3_Tx_100ms_CM_FixEnableT /end COMPU_METHOD
/begin COMPU_METHOD EEC3_Tx_100ms_CM_boolean_adm "Q = V" RAT_FUNC "%1.0" "adm" COEFFS 0 1 0 0 0 1 /end COMPU_METHOD
/begin COMPU_METHOD EEC3_Tx_100ms_CM_ufix16_En10_adm "Q = V*1024.000000" RAT_FUNC "%12.10" "adm" COEFFS 0 1024 0 0 0 1 /end COMPU_METHOD
/begin COMPU_METHOD EEC3_Tx_100ms_CM_ufix16_En3_rpm "Q = V*8.000000" RAT_FUNC "%7.3" "rpm" COEFFS 0 8 0 0 0 1 /end COMPU_METHOD
/begin COMPU_METHOD EEC3_Tx_100ms_CM_ufix8_Bn125__ "Q = (V+125.000000)/1.000000" RAT_FUNC "%0.6" "%" COEFFS 0 1 125 0 0 1 /end COMPU_METHOD
/begin COMPU_METHOD EFL_P2_Tx_100ms_CM_FixEnableT "Enumerated data type: FixEnableT" TAB_VERB "%0.6" "" COMPU_TAB_REF VTAB_FOR_EFL_P2_Tx_100ms_CM_FixEnableT /end COMPU_METHOD
/begin COMPU_METHOD EFL_P2_Tx_100ms_CM_boolean_adm "Q = V" RAT_FUNC "%1.0" "adm" COEFFS 0 1 0 0 0 1 /end COMPU_METHOD
/begin COMPU_METHOD EFL_P2_Tx_100ms_CM_ufix16_En8_MPa "Q = V*256.000000" RAT_FUNC "%11.8" "MPa" COEFFS 0 256 0 0 0 1 /end COMPU_METHOD
/begin COMPU_METHOD ENG_CONF_Tx_1s_CM_FixEnableT "Enumerated data type: FixEnableT" TAB_VERB "%0.6" "" COMPU_TAB_REF VTAB_FOR_ENG_CONF_Tx_1s_CM_FixEnableT /end COMPU_METHOD
/begin COMPU_METHOD ENG_CONF_Tx_1s_CM_boolean_adm "Q = V" RAT_FUNC "%1.0" "adm" COEFFS 0 1 0 0 0 1 /end COMPU_METHOD
/begin COMPU_METHOD ENG_CONF_Tx_1s_CM_ufix16_En3_rpm "Q = V*8.000000" RAT_FUNC "%7.3" "rpm" COEFFS 0 8 0 0 0 1 /end COMPU_METHOD
/begin COMPU_METHOD ENG_CONF_Tx_1s_CM_ufix16_Sp00078125___rpm "Q = V*1280.000000" RAT_FUNC "%0.6" "%/rpm" COEFFS 0 1280 0 0 0 1 /end COMPU_METHOD
/begin COMPU_METHOD ENG_CONF_Tx_1s_CM_ufix8_Bn125__ "Q = (V+125.000000)/1.000000" RAT_FUNC "%0.6" "%" COEFFS 0 1 125 0 0 1 /end COMPU_METHOD
/begin COMPU_METHOD ENG_CONF_Tx_1s_CM_ufix8_Sp1_s "Q = V*10.000000" RAT_FUNC "%0.6" "s" COEFFS 0 10 0 0 0 1 /end COMPU_METHOD
/begin COMPU_METHOD ENG_CONF_Tx_1s_CM_uint16_N_m "Q = V" RAT_FUNC "%5.0" "N*m" COEFFS 0 1 0 0 0 1 /end COMPU_METHOD
/begin COMPU_METHOD ENG_FLD_LEV_PRESS_Tx_100ms_CM_FixEnableT "Enumerated data type: FixEnableT" TAB_VERB "%0.6" "" COMPU_TAB_REF VTAB_FOR_ENG_FLD_LEV_PRESS_Tx_100ms_CM_FixEnableT /end COMPU_METHOD
/begin COMPU_METHOD ENG_FLD_LEV_PRESS_Tx_100ms_CM_boolean_adm "Q = V" RAT_FUNC "%1.0" "adm" COEFFS 0 1 0 0 0 1 /end COMPU_METHOD
/begin COMPU_METHOD ENG_FLD_LEV_PRESS_Tx_100ms_CM_ufix8_E2_kPa "Q = V/4.000000" RAT_FUNC "%3.0" "kPa" COEFFS 0 1 0 0 0 4 /end COMPU_METHOD
/begin COMPU_METHOD ENG_FLD_LEV_PRESS_Tx_100ms_CM_uint16_kPa "Q = V" RAT_FUNC "%5.0" "kPa" COEFFS 0 1 0 0 0 1 /end COMPU_METHOD
/begin COMPU_METHOD ENG_HOURS_REV_Tx_100ms_CM_FixEnableT "Enumerated data type: FixEnableT" TAB_VERB "%0.6" "" COMPU_TAB_REF VTAB_FOR_ENG_HOURS_REV_Tx_100ms_CM_FixEnableT /end COMPU_METHOD
/begin COMPU_METHOD ENG_HOURS_REV_Tx_100ms_CM_boolean_adm "Q = V" RAT_FUNC "%1.0" "adm" COEFFS 0 1 0 0 0 1 /end COMPU_METHOD
/begin COMPU_METHOD ENG_HOURS_REV_Tx_100ms_CM_ufix32_S1000_round "Q = V/1000.000000" RAT_FUNC "%0.6" "round" COEFFS 0 1 0 0 0 1000 /end COMPU_METHOD
/begin COMPU_METHOD ENG_HOURS_REV_Tx_100ms_CM_ufix32_Sp05_hour "Q = V*20.000000" RAT_FUNC "%0.6" "hour" COEFFS 0 20 0 0 0 1 /end COMPU_METHOD
/begin COMPU_METHOD ENG_TEMP_Tx_1s_CM_FixEnableT "Enumerated data type: FixEnableT" TAB_VERB "%0.6" "" COMPU_TAB_REF VTAB_FOR_ENG_TEMP_Tx_1s_CM_FixEnableT /end COMPU_METHOD
/begin COMPU_METHOD ENG_TEMP_Tx_1s_CM_boolean_adm "Q = V" RAT_FUNC "%1.0" "adm" COEFFS 0 1 0 0 0 1 /end COMPU_METHOD
/begin COMPU_METHOD ENG_TEMP_Tx_1s_CM_ufix16_En5_Bn273_degC "Q = (V+273.000000)*32.000000" RAT_FUNC "%0.6" "degC" COEFFS 0 32 8736 0 0 1 /end COMPU_METHOD
/begin COMPU_METHOD ENG_TEMP_Tx_1s_CM_ufix8_Bn40_degC "Q = (V+40.000000)/1.000000" RAT_FUNC "%0.6" "degC" COEFFS 0 1 40 0 0 1 /end COMPU_METHOD
/begin COMPU_METHOD EPR2ECM_Rx_100ms_CM_FixEnableT "Enumerated data type: FixEnableT" TAB_VERB "%0.6" "" COMPU_TAB_REF VTAB_FOR_EPR2ECM_Rx_100ms_CM_FixEnableT /end COMPU_METHOD
/begin COMPU_METHOD EPR2ECM_Rx_100ms_CM_sfix16_En7 "Q = V*128.000000" RAT_FUNC "%10.7" "" COEFFS 0 128 0 0 0 1 /end COMPU_METHOD
/begin COMPU_METHOD EPR2ECM_Rx_100ms_CM_sfix16_En7_degC "Q = V*128.000000" RAT_FUNC "%10.7" "degC" COEFFS 0 128 0 0 0 1 /end COMPU_METHOD
/begin COMPU_METHOD EPR2ECM_Rx_100ms_CM_ufix16_Sp0030517578125 "Q = V*327.680000" RAT_FUNC "%0.6" "" COEFFS 0 327.68 0 0 0 1 /end COMPU_METHOD
/begin COMPU_METHOD EPR2ECM_Rx_100ms_CM_ufix16_Sp0030517578125__ "Q = V*327.680000" RAT_FUNC "%0.6" "%" COEFFS 0 327.68 0 0 0 1 /end COMPU_METHOD
/begin COMPU_METHOD EPR2ECM_Rx_100ms_CM_ufix2 "Q = V/1.000000" RAT_FUNC "%3.0" "" COEFFS 0 1 0 0 0 1 /end COMPU_METHOD
/begin COMPU_METHOD EPR2ECM_Rx_100ms_CM_ufix3 "Q = V/1.000000" RAT_FUNC "%3.0" "" COEFFS 0 1 0 0 0 1 /end COMPU_METHOD
/begin COMPU_METHOD EPR2ECM_Rx_100ms_CM_uint8 "Q = V" RAT_FUNC "%3.0" "" COEFFS 0 1 0 0 0 1 /end COMPU_METHOD
/begin COMPU_METHOD EPR2ECM_Rx_100ms_CM_uint8_Hz "Q = V" RAT_FUNC "%3.0" "Hz" COEFFS 0 1 0 0 0 1 /end COMPU_METHOD
/begin COMPU_METHOD EPR2ECM_Rx_100ms_CM_uint8_adm "Q = V" RAT_FUNC "%3.0" "adm" COEFFS 0 1 0 0 0 1 /end COMPU_METHOD
/begin COMPU_METHOD ERC1_ER_Tx_1s_CM_FixEnableT "Enumerated data type: FixEnableT" TAB_VERB "%0.6" "" COMPU_TAB_REF VTAB_FOR_ERC1_ER_Tx_1s_CM_FixEnableT /end COMPU_METHOD
/begin COMPU_METHOD ERC1_ER_Tx_1s_CM_ufix8_Bn125__ "Q = (V+125.000000)/1.000000" RAT_FUNC "%0.6" "%" COEFFS 0 1 125 0 0 1 /end COMPU_METHOD
/begin COMPU_METHOD ERC1_ER_Tx_1s_CM_uint8_adm "Q = V" RAT_FUNC "%3.0" "adm" COEFFS 0 1 0 0 0 1 /end COMPU_METHOD
/begin COMPU_METHOD ET2_Tx_1s_CM_FixEnableT "Enumerated data type: FixEnableT" TAB_VERB "%0.6" "" COMPU_TAB_REF VTAB_FOR_ET2_Tx_1s_CM_FixEnableT /end COMPU_METHOD
/begin COMPU_METHOD ET2_Tx_1s_CM_ufix16_Bn40_km_h "Q = (V+40.000000)/1.000000" RAT_FUNC "%0.6" "km/h" COEFFS 0 1 40 0 0 1 /end COMPU_METHOD
/begin COMPU_METHOD ETC1_Rx_4ms_CM_FixEnableT "Enumerated data type: FixEnableT" TAB_VERB "%0.6" "" COMPU_TAB_REF VTAB_FOR_ETC1_Rx_4ms_CM_FixEnableT /end COMPU_METHOD
/begin COMPU_METHOD ETC1_Rx_4ms_CM_boolean_adm "Q = V" RAT_FUNC "%1.0" "adm" COEFFS 0 1 0 0 0 1 /end COMPU_METHOD
/begin COMPU_METHOD ETC1_Rx_4ms_CM_ufix16_En3_rpm "Q = V*8.000000" RAT_FUNC "%7.3" "rpm" COEFFS 0 8 0 0 0 1 /end COMPU_METHOD
/begin COMPU_METHOD ETC2_Rx_100ms_CM_FixEnableT "Enumerated data type: FixEnableT" TAB_VERB "%0.6" "" COMPU_TAB_REF VTAB_FOR_ETC2_Rx_100ms_CM_FixEnableT /end COMPU_METHOD
/begin COMPU_METHOD ETC2_Rx_100ms_CM_ufix16_En10_adm "Q = V*1024.000000" RAT_FUNC "%12.10" "adm" COEFFS 0 1024 0 0 0 1 /end COMPU_METHOD
/begin COMPU_METHOD ETC2_Rx_100ms_CM_ufix8_Bn125_gear "Q = (V+125.000000)/1.000000" RAT_FUNC "%0.6" "gear" COEFFS 0 1 125 0 0 1 /end COMPU_METHOD
/begin COMPU_METHOD Ecut1s_CM_tKeyState_adm "Enumerated data type: tKeyState" TAB_VERB "%0.6" "adm" COMPU_TAB_REF VTAB_FOR_Ecut1s_CM_tKeyState_adm /end COMPU_METHOD
/begin COMPU_METHOD Egbrk50ms_CM_eEGMD_adm "Enumerated data type: eEGMD" TAB_VERB "%0.6" "adm" COMPU_TAB_REF VTAB_FOR_Egbrk50ms_CM_eEGMD_adm /end COMPU_METHOD
/begin COMPU_METHOD Egbrk50ms_CM_ufix16_E4_us "Q = V/16.000000" RAT_FUNC "%5.0" "us" COEFFS 0 1 0 0 0 16 /end COMPU_METHOD
/begin COMPU_METHOD EgmdTDC_CM_eEGMD_adm "Enumerated data type: eEGMD" TAB_VERB "%0.6" "adm" COMPU_TAB_REF VTAB_FOR_EgmdTDC_CM_eEGMD_adm /end COMPU_METHOD
/begin COMPU_METHOD EgmdTDC_CM_ePhCrank_adm "Enumerated data type: ePhCrank" TAB_VERB "%0.6" "adm" COMPU_TAB_REF VTAB_FOR_EgmdTDC_CM_ePhCrank_adm /end COMPU_METHOD
/begin COMPU_METHOD EgmdTDC_CM_ufix16_Bn40_degC "Q = (V+40.000000)/1.000000" RAT_FUNC "%0.6" "degC" COEFFS 0 1 40 0 0 1 /end COMPU_METHOD
/begin COMPU_METHOD EgrMgm4ms_CM_eCutOff_adm "Enumerated data type: eCutOff" TAB_VERB "%0.6" "adm" COMPU_TAB_REF VTAB_FOR_EgrMgm4ms_CM_eCutOff_adm /end COMPU_METHOD
/begin COMPU_METHOD EgrMgm4ms_CM_eEGST_adm "Enumerated data type: eEGST" TAB_VERB "%0.6" "adm" COMPU_TAB_REF VTAB_FOR_EgrMgm4ms_CM_eEGST_adm /end COMPU_METHOD
/begin COMPU_METHOD EgrMgm4ms_CM_ufix16_En10_adm "Q = V*1024.000000" RAT_FUNC "%12.10" "adm" COEFFS 0 1024 0 0 0 1 /end COMPU_METHOD
/begin COMPU_METHOD Egst4ms_CM_eEGST_adm "Enumerated data type: eEGST" TAB_VERB "%0.6" "adm" COMPU_TAB_REF VTAB_FOR_Egst4ms_CM_eEGST_adm /end COMPU_METHOD
/begin COMPU_METHOD Egst4ms_CM_tKeyState_adm "Enumerated data type: tKeyState" TAB_VERB "%0.6" "adm" COMPU_TAB_REF VTAB_FOR_Egst4ms_CM_tKeyState_adm /end COMPU_METHOD
/begin COMPU_METHOD Egst_EngineIgnited100ms_CM_boolean_adm "Q = V" RAT_FUNC "%1.0" "adm" COEFFS 0 1 0 0 0 1 /end COMPU_METHOD
/begin COMPU_METHOD Egt100ms_CM_tKeyState_adm "Enumerated data type: tKeyState" TAB_VERB "%0.6" "adm" COMPU_TAB_REF VTAB_FOR_Egt100ms_CM_tKeyState_adm /end COMPU_METHOD
/begin COMPU_METHOD Epr4ms_CM_ufix16_En10_adm "Q = V*1024.000000" RAT_FUNC "%12.10" "adm" COEFFS 0 1024 0 0 0 1 /end COMPU_METHOD
/begin COMPU_METHOD Epr4ms_CM_ufix16_En7_mg_cc "Q = V*128.000000" RAT_FUNC "%10.7" "mg/cc" COEFFS 0 128 0 0 0 1 /end COMPU_METHOD
/begin COMPU_METHOD Epr4ms_CM_ufix2_adm "Q = V/1.000000" RAT_FUNC "%3.0" "adm" COEFFS 0 1 0 0 0 1 /end COMPU_METHOD
/begin COMPU_METHOD Epr4ms_CM_ufix3_adm "Q = V/1.000000" RAT_FUNC "%3.0" "adm" COEFFS 0 1 0 0 0 1 /end COMPU_METHOD
/begin COMPU_METHOD HDSECU1_Tx_50ms_CM_FixEnableT "Enumerated data type: FixEnableT" TAB_VERB "%0.6" "" COMPU_TAB_REF VTAB_FOR_HDSECU1_Tx_50ms_CM_FixEnableT /end COMPU_METHOD
/begin COMPU_METHOD HDSECU1_Tx_50ms_CM_ufix8_En1_Bn20_degree "Q = (V+20.000000)*2.000000" RAT_FUNC "%0.6" "degree" COEFFS 0 2 40 0 0 1 /end COMPU_METHOD
/begin COMPU_METHOD HDSECU1_Tx_50ms_CM_ufix8_S10_mbar "Q = V/10.000000" RAT_FUNC "%0.6" "mbar" COEFFS 0 1 0 0 0 10 /end COMPU_METHOD
/begin COMPU_METHOD HDSECU1_Tx_50ms_CM_ufix8_S280_us "Q = V/280.000000" RAT_FUNC "%0.6" "us" COEFFS 0 1 0 0 0 280 /end COMPU_METHOD
/begin COMPU_METHOD HDSECU1_Tx_50ms_CM_ufix8_S5_kg_h "Q = V/5.000000" RAT_FUNC "%0.6" "kg/h" COEFFS 0 1 0 0 0 5 /end COMPU_METHOD
/begin COMPU_METHOD HDSECU1_Tx_50ms_CM_ufix8_S60_mbar "Q = V/60.000000" RAT_FUNC "%0.6" "mbar" COEFFS 0 1 0 0 0 60 /end COMPU_METHOD
/begin COMPU_METHOD HDSECU2_Tx_50ms_CM_FixEnableT "Enumerated data type: FixEnableT" TAB_VERB "%0.6" "" COMPU_TAB_REF VTAB_FOR_HDSECU2_Tx_50ms_CM_FixEnableT /end COMPU_METHOD
/begin COMPU_METHOD HDSECU2_Tx_50ms_CM_boolean_adm "Q = V" RAT_FUNC "%1.0" "adm" COEFFS 0 1 0 0 0 1 /end COMPU_METHOD
/begin COMPU_METHOD HDSECU2_Tx_50ms_CM_ufix8_Bn10__ "Q = (V+10.000000)/1.000000" RAT_FUNC "%0.6" "%" COEFFS 0 1 10 0 0 1 /end COMPU_METHOD
/begin COMPU_METHOD HDSECU2_Tx_50ms_CM_ufix8_E2__ "Q = V/4.000000" RAT_FUNC "%3.0" "%" COEFFS 0 1 0 0 0 4 /end COMPU_METHOD
/begin COMPU_METHOD HDSECU2_Tx_50ms_CM_ufix8_En5_Bp75_adm "Q = (V-0.750000)*32.000000" RAT_FUNC "%0.6" "adm" COEFFS 0 32 -24 0 0 1 /end COMPU_METHOD
/begin COMPU_METHOD HDSECU2_Tx_50ms_CM_uint16_mV "Q = V" RAT_FUNC "%5.0" "mV" COEFFS 0 1 0 0 0 1 /end COMPU_METHOD
/begin COMPU_METHOD HDSECU2_Tx_50ms_CM_uint8__ "Q = V" RAT_FUNC "%3.0" "%" COEFFS 0 1 0 0 0 1 /end COMPU_METHOD
/begin COMPU_METHOD HDSECU2_Tx_50ms_CM_uint8_adm "Q = V" RAT_FUNC "%3.0" "adm" COEFFS 0 1 0 0 0 1 /end COMPU_METHOD
/begin COMPU_METHOD INLET_COND_Tx_100ms_CM_FixEnableT "Enumerated data type: FixEnableT" TAB_VERB "%0.6" "" COMPU_TAB_REF VTAB_FOR_INLET_COND_Tx_100ms_CM_FixEnableT /end COMPU_METHOD
/begin COMPU_METHOD INLET_COND_Tx_100ms_CM_ufix16_En5_Bn273_degC "Q = (V+273.000000)*32.000000" RAT_FUNC "%0.6" "degC" COEFFS 0 32 8736 0 0 1 /end COMPU_METHOD
/begin COMPU_METHOD INLET_COND_Tx_100ms_CM_ufix8_Bn40_degC "Q = (V+40.000000)/1.000000" RAT_FUNC "%0.6" "degC" COEFFS 0 1 40 0 0 1 /end COMPU_METHOD
/begin COMPU_METHOD INLET_COND_Tx_100ms_CM_ufix8_E1_kPa "Q = V/2.000000" RAT_FUNC "%3.0" "kPa" COEFFS 0 1 0 0 0 2 /end COMPU_METHOD
/begin COMPU_METHOD J1939dl_Rx100ms_CM_boolean_adm "Q = V" RAT_FUNC "%1.0" "adm" COEFFS 0 1 0 0 0 1 /end COMPU_METHOD
/begin COMPU_METHOD J1939dl_Rx100ms_CM_sfix16_En7_degC "Q = V*128.000000" RAT_FUNC "%10.7" "degC" COEFFS 0 128 0 0 0 1 /end COMPU_METHOD
/begin COMPU_METHOD J1939dl_Rx100ms_CM_ufix16_En10_adm "Q = V*1024.000000" RAT_FUNC "%12.10" "adm" COEFFS 0 1024 0 0 0 1 /end COMPU_METHOD
/begin COMPU_METHOD J1939dl_Rx100ms_CM_ufix16_Sp0030517578125__ "Q = V*327.680000" RAT_FUNC "%0.6" "%" COEFFS 0 327.68 0 0 0 1 /end COMPU_METHOD
/begin COMPU_METHOD J1939dl_Rx100ms_CM_ufix8_Bn125_gear "Q = (V+125.000000)/1.000000" RAT_FUNC "%0.6" "gear" COEFFS 0 1 125 0 0 1 /end COMPU_METHOD
/begin COMPU_METHOD J1939dl_Rx100ms_CM_uint8_Hz "Q = V" RAT_FUNC "%3.0" "Hz" COEFFS 0 1 0 0 0 1 /end COMPU_METHOD
/begin COMPU_METHOD J1939dl_Rx100ms_CM_uint8_adm "Q = V" RAT_FUNC "%3.0" "adm" COEFFS 0 1 0 0 0 1 /end COMPU_METHOD
/begin COMPU_METHOD J1939dl_Rx100ms_CM_uint8_km_h "Q = V" RAT_FUNC "%3.0" "km/h" COEFFS 0 1 0 0 0 1 /end COMPU_METHOD
/begin COMPU_METHOD J1939dl_Rx4ms_CM_boolean_adm "Q = V" RAT_FUNC "%1.0" "adm" COEFFS 0 1 0 0 0 1 /end COMPU_METHOD
/begin COMPU_METHOD J1939dl_Rx50ms_CM_boolean_adm "Q = V" RAT_FUNC "%1.0" "adm" COEFFS 0 1 0 0 0 1 /end COMPU_METHOD
/begin COMPU_METHOD J1939dl_Tx1s_CM_boolean_adm "Q = V" RAT_FUNC "%1.0" "adm" COEFFS 0 1 0 0 0 1 /end COMPU_METHOD
/begin COMPU_METHOD J1939dl_Tx1s_CM_uint8_adm "Q = V" RAT_FUNC "%3.0" "adm" COEFFS 0 1 0 0 0 1 /end COMPU_METHOD
/begin COMPU_METHOD LFC1_Tx_1s_CM_FixEnableT "Enumerated data type: FixEnableT" TAB_VERB "%0.6" "" COMPU_TAB_REF VTAB_FOR_LFC1_Tx_1s_CM_FixEnableT /end COMPU_METHOD
/begin COMPU_METHOD LFC1_Tx_1s_CM_ufix32_Sp05_l "Q = V*20.000000" RAT_FUNC "%0.6" "l" COEFFS 0 20 0 0 0 1 /end COMPU_METHOD
/begin COMPU_METHOD LFE1_Tx_100ms_CM_FixEnableT "Enumerated data type: FixEnableT" TAB_VERB "%0.6" "" COMPU_TAB_REF VTAB_FOR_LFE1_Tx_100ms_CM_FixEnableT /end COMPU_METHOD
/begin COMPU_METHOD LFE1_Tx_100ms_CM_ufix16_En9_km_l "Q = V*512.000000" RAT_FUNC "%12.9" "km/l" COEFFS 0 512 0 0 0 1 /end COMPU_METHOD
/begin COMPU_METHOD LFE1_Tx_100ms_CM_ufix16_Sp05_l_h "Q = V*20.000000" RAT_FUNC "%0.6" "l/h" COEFFS 0 20 0 0 0 1 /end COMPU_METHOD
/begin COMPU_METHOD Lamp100ms_CM_boolean_adm "Q = V" RAT_FUNC "%1.0" "adm" COEFFS 0 1 0 0 0 1 /end COMPU_METHOD
/begin COMPU_METHOD Lamp100ms_CM_uint8_adm "Q = V" RAT_FUNC "%3.0" "adm" COEFFS 0 1 0 0 0 1 /end COMPU_METHOD
/begin COMPU_METHOD MVS_Tx_1s_CM_FixEnableT "Enumerated data type: FixEnableT" TAB_VERB "%0.6" "" COMPU_TAB_REF VTAB_FOR_MVS_Tx_1s_CM_FixEnableT /end COMPU_METHOD
/begin COMPU_METHOD MVS_Tx_1s_CM_uint8_km_h "Q = V" RAT_FUNC "%3.0" "km/h" COEFFS 0 1 0 0 0 1 /end COMPU_METHOD
/begin COMPU_METHOD PropB_0A_Tx_100ms_CM_FixEnableT "Enumerated data type: FixEnableT" TAB_VERB "%0.6" "" COMPU_TAB_REF VTAB_FOR_PropB_0A_Tx_100ms_CM_FixEnableT /end COMPU_METHOD
/begin COMPU_METHOD PropB_0A_Tx_100ms_CM_uint8_adm "Q = V" RAT_FUNC "%3.0" "adm" COEFFS 0 1 0 0 0 1 /end COMPU_METHOD
/begin COMPU_METHOD RET_CONF_Tx_1s_CM_FixEnableT "Enumerated data type: FixEnableT" TAB_VERB "%0.6" "" COMPU_TAB_REF VTAB_FOR_RET_CONF_Tx_1s_CM_FixEnableT /end COMPU_METHOD
/begin COMPU_METHOD RET_CONF_Tx_1s_CM_ufix16_En3_rpm "Q = V*8.000000" RAT_FUNC "%7.3" "rpm" COEFFS 0 8 0 0 0 1 /end COMPU_METHOD
/begin COMPU_METHOD RET_CONF_Tx_1s_CM_ufix8_Bn125__ "Q = (V+125.000000)/1.000000" RAT_FUNC "%0.6" "%" COEFFS 0 1 125 0 0 1 /end COMPU_METHOD
/begin COMPU_METHOD RET_CONF_Tx_1s_CM_uint16_N_m "Q = V" RAT_FUNC "%5.0" "N*m" COEFFS 0 1 0 0 0 1 /end COMPU_METHOD
/begin COMPU_METHOD RET_CONF_Tx_1s_CM_uint8_adm "Q = V" RAT_FUNC "%3.0" "adm" COEFFS 0 1 0 0 0 1 /end COMPU_METHOD
/begin COMPU_METHOD SEP1_Tx_1s_CM_FixEnableT "Enumerated data type: FixEnableT" TAB_VERB "%0.6" "" COMPU_TAB_REF VTAB_FOR_SEP1_Tx_1s_CM_FixEnableT /end COMPU_METHOD
/begin COMPU_METHOD SEP1_Tx_1s_CM_ufix16_En10_V "Q = V*1024.000000" RAT_FUNC "%12.10" "V" COEFFS 0 1024 0 0 0 1 /end COMPU_METHOD
/begin COMPU_METHOD SHUTDOWN_Tx_1s_CM_FixEnableT "Enumerated data type: FixEnableT" TAB_VERB "%0.6" "" COMPU_TAB_REF VTAB_FOR_SHUTDOWN_Tx_1s_CM_FixEnableT /end COMPU_METHOD
/begin COMPU_METHOD SHUTDOWN_Tx_1s_CM_uint8_adm "Q = V" RAT_FUNC "%3.0" "adm" COEFFS 0 1 0 0 0 1 /end COMPU_METHOD
/begin COMPU_METHOD TCO1_Rx_50ms_CM_FixEnableT "Enumerated data type: FixEnableT" TAB_VERB "%0.6" "" COMPU_TAB_REF VTAB_FOR_TCO1_Rx_50ms_CM_FixEnableT /end COMPU_METHOD
/begin COMPU_METHOD TCO1_Rx_50ms_CM_ufix16_En8_km_h "Q = V*256.000000" RAT_FUNC "%11.8" "km/h" COEFFS 0 256 0 0 0 1 /end COMPU_METHOD
/begin COMPU_METHOD TE_DigOutput100ms_CM_boolean_adm "Q = V" RAT_FUNC "%1.0" "adm" COEFFS 0 1 0 0 0 1 /end COMPU_METHOD
/begin COMPU_METHOD TIMEDATE_Rx_1s_CM_FixEnableT "Enumerated data type: FixEnableT" TAB_VERB "%0.6" "" COMPU_TAB_REF VTAB_FOR_TIMEDATE_Rx_1s_CM_FixEnableT /end COMPU_METHOD
/begin COMPU_METHOD TIMEDATE_Rx_1s_CM_ufix8_B1985_year "Q = (V-1985.000000)/1.000000" RAT_FUNC "%0.6" "year" COEFFS 0 1 -1985 0 0 1 /end COMPU_METHOD
/begin COMPU_METHOD TIMEDATE_Rx_1s_CM_ufix8_En2_day "Q = V*4.000000" RAT_FUNC "%4.2" "day" COEFFS 0 4 0 0 0 1 /end COMPU_METHOD
/begin COMPU_METHOD TIMEDATE_Rx_1s_CM_ufix8_En2_s "Q = V*4.000000" RAT_FUNC "%4.2" "s" COEFFS 0 4 0 0 0 1 /end COMPU_METHOD
/begin COMPU_METHOD TIMEDATE_Rx_1s_CM_uint8_h "Q = V" RAT_FUNC "%3.0" "h" COEFFS 0 1 0 0 0 1 /end COMPU_METHOD
/begin COMPU_METHOD TIMEDATE_Rx_1s_CM_uint8_min "Q = V" RAT_FUNC "%3.0" "min" COEFFS 0 1 0 0 0 1 /end COMPU_METHOD
/begin COMPU_METHOD TIMEDATE_Rx_1s_CM_uint8_month "Q = V" RAT_FUNC "%3.0" "month" COEFFS 0 1 0 0 0 1 /end COMPU_METHOD
/begin COMPU_METHOD TSC1_TR_RETARDER_Rx_50ms_CM_FixEnableT "Enumerated data type: FixEnableT" TAB_VERB "%0.6" "" COMPU_TAB_REF VTAB_FOR_TSC1_TR_RETARDER_Rx_50ms_CM_FixEnableT /end COMPU_METHOD
/begin COMPU_METHOD TSC1_TR_RETARDER_Rx_50ms_CM_ufix16_En3_rpm "Q = V*8.000000" RAT_FUNC "%7.3" "rpm" COEFFS 0 8 0 0 0 1 /end COMPU_METHOD
/begin COMPU_METHOD TSC1_TR_RETARDER_Rx_50ms_CM_ufix8_Bn125__ "Q = (V+125.000000)/1.000000" RAT_FUNC "%0.6" "%" COEFFS 0 1 125 0 0 1 /end COMPU_METHOD
/begin COMPU_METHOD TSC1_TR_RETARDER_Rx_50ms_CM_uint8_adm "Q = V" RAT_FUNC "%3.0" "adm" COEFFS 0 1 0 0 0 1 /end COMPU_METHOD
/begin COMPU_METHOD TSC1_VE_CONTROL2_Rx_4ms_CM_FixEnableT "Enumerated data type: FixEnableT" TAB_VERB "%0.6" "" COMPU_TAB_REF VTAB_FOR_TSC1_VE_CONTROL2_Rx_4ms_CM_FixEnableT /end COMPU_METHOD
/begin COMPU_METHOD TSC1_VE_CONTROL2_Rx_4ms_CM_ufix16_En3_rpm "Q = V*8.000000" RAT_FUNC "%7.3" "rpm" COEFFS 0 8 0 0 0 1 /end COMPU_METHOD
/begin COMPU_METHOD TSC1_VE_CONTROL2_Rx_4ms_CM_ufix8_Bn125__ "Q = (V+125.000000)/1.000000" RAT_FUNC "%0.6" "%" COEFFS 0 1 125 0 0 1 /end COMPU_METHOD
/begin COMPU_METHOD TSC1_VE_CONTROL2_Rx_4ms_CM_uint8_adm "Q = V" RAT_FUNC "%3.0" "adm" COEFFS 0 1 0 0 0 1 /end COMPU_METHOD
/begin COMPU_METHOD TSC1_VE_CONTROL_Rx_4ms_CM_FixEnableT "Enumerated data type: FixEnableT" TAB_VERB "%0.6" "" COMPU_TAB_REF VTAB_FOR_TSC1_VE_CONTROL_Rx_4ms_CM_FixEnableT /end COMPU_METHOD
/begin COMPU_METHOD TSC1_VE_CONTROL_Rx_4ms_CM_ufix16_En3_rpm "Q = V*8.000000" RAT_FUNC "%7.3" "rpm" COEFFS 0 8 0 0 0 1 /end COMPU_METHOD
/begin COMPU_METHOD TSC1_VE_CONTROL_Rx_4ms_CM_ufix8_Bn125__ "Q = (V+125.000000)/1.000000" RAT_FUNC "%0.6" "%" COEFFS 0 1 125 0 0 1 /end COMPU_METHOD
/begin COMPU_METHOD TSC1_VE_CONTROL_Rx_4ms_CM_uint8_adm "Q = V" RAT_FUNC "%3.0" "adm" COEFFS 0 1 0 0 0 1 /end COMPU_METHOD
/begin COMPU_METHOD TSC1_VE_LIMIT_Rx_4ms_CM_FixEnableT "Enumerated data type: FixEnableT" TAB_VERB "%0.6" "" COMPU_TAB_REF VTAB_FOR_TSC1_VE_LIMIT_Rx_4ms_CM_FixEnableT /end COMPU_METHOD
/begin COMPU_METHOD TSC1_VE_LIMIT_Rx_4ms_CM_ufix16_En3_rpm "Q = V*8.000000" RAT_FUNC "%7.3" "rpm" COEFFS 0 8 0 0 0 1 /end COMPU_METHOD
/begin COMPU_METHOD TSC1_VE_LIMIT_Rx_4ms_CM_ufix8_Bn125__ "Q = (V+125.000000)/1.000000" RAT_FUNC "%0.6" "%" COEFFS 0 1 125 0 0 1 /end COMPU_METHOD
/begin COMPU_METHOD TSC1_VE_LIMIT_Rx_4ms_CM_uint8_adm "Q = V" RAT_FUNC "%3.0" "adm" COEFFS 0 1 0 0 0 1 /end COMPU_METHOD
/begin COMPU_METHOD TURBO2ECU_Rx_4ms_CM_FixEnableT "Enumerated data type: FixEnableT" TAB_VERB "%0.6" "" COMPU_TAB_REF VTAB_FOR_TURBO2ECU_Rx_4ms_CM_FixEnableT /end COMPU_METHOD
/begin COMPU_METHOD TURBO2ECU_Rx_4ms_CM_boolean_deg "Q = V" RAT_FUNC "%1.0" "deg" COEFFS 0 1 0 0 0 1 /end COMPU_METHOD
/begin COMPU_METHOD TURBO2ECU_Rx_4ms_CM_int8__ "Q = V" RAT_FUNC "%3.0" "%" COEFFS 0 1 0 0 0 1 /end COMPU_METHOD
/begin COMPU_METHOD TURBO2ECU_Rx_4ms_CM_int8_deg "Q = V" RAT_FUNC "%3.0" "deg" COEFFS 0 1 0 0 0 1 /end COMPU_METHOD
/begin COMPU_METHOD TURBO2ECU_Rx_4ms_CM_ufix16_Sp1__ "Q = V*10.000000" RAT_FUNC "%0.6" "%" COEFFS 0 10 0 0 0 1 /end COMPU_METHOD
/begin COMPU_METHOD TURBO2ECU_Rx_4ms_CM_ufix16_Sp1_deg "Q = V*10.000000" RAT_FUNC "%0.6" "deg" COEFFS 0 10 0 0 0 1 /end COMPU_METHOD
/begin COMPU_METHOD TURBO2ECU_Rx_4ms_CM_ufix8_Sp152_V "Q = V*6.578947" RAT_FUNC "%0.6" "V" COEFFS 0 6.578947 0 0 0 1 /end COMPU_METHOD
/begin COMPU_METHOD TURBO2ECU_Rx_4ms_CM_ufix8_Sp416_deg "Q = V*2.403846" RAT_FUNC "%0.6" "deg" COEFFS 0 2.403846 0 0 0 1 /end COMPU_METHOD
/begin COMPU_METHOD USS_Rx_50ms_CM_FixEnableT "Enumerated data type: FixEnableT" TAB_VERB "%0.6" "" COMPU_TAB_REF VTAB_FOR_USS_Rx_50ms_CM_FixEnableT /end COMPU_METHOD
/begin COMPU_METHOD USS_Rx_50ms_CM_boolean_adm "Q = V" RAT_FUNC "%1.0" "adm" COEFFS 0 1 0 0 0 1 /end COMPU_METHOD
/begin COMPU_METHOD USS_Rx_50ms_CM_sfix16_Sp001_Bn15_mA "Q = (V+15.000000)*1000.000000" RAT_FUNC "%0.6" "mA" COEFFS 0 1000 15000 0 0 1 /end COMPU_METHOD
/begin COMPU_METHOD USS_Rx_50ms_CM_sfix16_Sp01_Bn40p96__ "Q = (V+40.960000)*100.000000" RAT_FUNC "%0.6" "%" COEFFS 0 100 4096 0 0 1 /end COMPU_METHOD
/begin COMPU_METHOD USS_Rx_50ms_CM_uint8_adm "Q = V" RAT_FUNC "%3.0" "adm" COEFFS 0 1 0 0 0 1 /end COMPU_METHOD
/begin COMPU_METHOD VCM2ECM_Rx_50ms_CM_FixEnableT "Enumerated data type: FixEnableT" TAB_VERB "%0.6" "" COMPU_TAB_REF VTAB_FOR_VCM2ECM_Rx_50ms_CM_FixEnableT /end COMPU_METHOD
/begin COMPU_METHOD VCM2ECM_Rx_50ms_CM_boolean_adm "Q = V" RAT_FUNC "%1.0" "adm" COEFFS 0 1 0 0 0 1 /end COMPU_METHOD
/begin COMPU_METHOD VCM2ECM_Rx_50ms_CM_ufix16_En3_rpm "Q = V*8.000000" RAT_FUNC "%7.3" "rpm" COEFFS 0 8 0 0 0 1 /end COMPU_METHOD
/begin COMPU_METHOD VCM2ECM_Rx_50ms_CM_uint8_adm "Q = V" RAT_FUNC "%3.0" "adm" COEFFS 0 1 0 0 0 1 /end COMPU_METHOD
/begin COMPU_METHOD VEP1_Tx_1s_CM_FixEnableT "Enumerated data type: FixEnableT" TAB_VERB "%0.6" "" COMPU_TAB_REF VTAB_FOR_VEP1_Tx_1s_CM_FixEnableT /end COMPU_METHOD
/begin COMPU_METHOD VEP1_Tx_1s_CM_ufix16_Sp05_V "Q = V*20.000000" RAT_FUNC "%0.6" "V" COEFFS 0 20 0 0 0 1 /end COMPU_METHOD
/begin COMPU_METHOD VEP1_Tx_1s_CM_uint16_adm "Q = V" RAT_FUNC "%5.0" "adm" COEFFS 0 1 0 0 0 1 /end COMPU_METHOD
/begin COMPU_METHOD bsScaleFactor.Conversion "" TAB_VERB "%.0" "" COMPU_TAB_REF bsScaleFactor.Conversion /end COMPU_METHOD
/begin COMPU_METHOD bsScaleHpf.Conversion "" TAB_VERB "%.0" "" COMPU_TAB_REF bsScaleHpf.Conversion /end COMPU_METHOD
/begin COMPU_METHOD bsScaleLpf.Conversion "" TAB_VERB "%.0" "" COMPU_TAB_REF bsScaleLpf.Conversion /end COMPU_METHOD
/begin COMPU_METHOD bsSetMinus.Conversion "" LINEAR "%.3" "adm" COEFFS_LINEAR 1 0 /end COMPU_METHOD
/begin COMPU_METHOD bsSetPlus.Conversion "" LINEAR "%.3" "adm" COEFFS_LINEAR 1 0 /end COMPU_METHOD
/begin COMPU_METHOD bsStartAccDecCbt.Conversion "" LINEAR "%.3" "adm" COEFFS_LINEAR 1 0 /end COMPU_METHOD
/begin COMPU_METHOD bsStopCbt.Conversion "" LINEAR "%.3" "adm" COEFFS_LINEAR 1 0 /end COMPU_METHOD
/begin COMPU_METHOD bsT6Vect.Conversion "" LINEAR "%.3" "us" COEFFS_LINEAR 1 0 /end COMPU_METHOD
/begin COMPU_METHOD bsTAirBit.Conversion "" LINEAR "%.3" "bit" COEFFS_LINEAR 1 0 /end COMPU_METHOD
/begin COMPU_METHOD bsTBoostBit.Conversion "" LINEAR "%.3" "bit" COEFFS_LINEAR 1 0 /end COMPU_METHOD
/begin COMPU_METHOD bsTEgrCoolerBit.Conversion "" LINEAR "%.3" "bit" COEFFS_LINEAR 1 0 /end COMPU_METHOD
/begin COMPU_METHOD bsTExhBit.Conversion "" LINEAR "%.3" "bit" COEFFS_LINEAR 1 0 /end COMPU_METHOD
/begin COMPU_METHOD bsTInjPostDiag.Conversion "" LINEAR "%.3" "us" COEFFS_LINEAR 16 0 /end COMPU_METHOD
/begin COMPU_METHOD bsTKLOnDTime.Conversion "" LINEAR "%.3" "s" COEFFS_LINEAR 0.1 0 /end COMPU_METHOD
/begin COMPU_METHOD bsTKLOnDTimeOld.Conversion "" LINEAR "%.3" "s" COEFFS_LINEAR 0.1 0 /end COMPU_METHOD
/begin COMPU_METHOD bsTKLOnTime.Conversion "" LINEAR "%.3" "s" COEFFS_LINEAR 0.1 0 /end COMPU_METHOD
/begin COMPU_METHOD bsTKLOnTimeOld.Conversion "" LINEAR "%.3" "s" COEFFS_LINEAR 0.1 0 /end COMPU_METHOD
/begin COMPU_METHOD bsTKatBit.Conversion "" LINEAR "%.3" "bit" COEFFS_LINEAR 1 0 /end COMPU_METHOD
/begin COMPU_METHOD bsTMAFBit.Conversion "" LINEAR "%.3" "bit" COEFFS_LINEAR 1 0 /end COMPU_METHOD
/begin COMPU_METHOD bsTOOTH_HOLE_PES.Conversion "" LINEAR "%.3" "adm" COEFFS_LINEAR 1 0 /end COMPU_METHOD
/begin COMPU_METHOD bsTOOTH_PES_PEA.Conversion "" LINEAR "%.3" "adm" COEFFS_LINEAR 1 0 /end COMPU_METHOD
/begin COMPU_METHOD bsTOilBit.Conversion "" LINEAR "%.3" "bit" COEFFS_LINEAR 1 0 /end COMPU_METHOD
/begin COMPU_METHOD bsTRailBit.Conversion "" LINEAR "%.3" "bit" COEFFS_LINEAR 1 0 /end COMPU_METHOD
/begin COMPU_METHOD bsTco1ErrFlag.Conversion "" LINEAR "%.3" "adm" COEFFS_LINEAR 1 0 /end COMPU_METHOD
/begin COMPU_METHOD bsTdcIdx.Conversion "" LINEAR "%.3" "adm" COEFFS_LINEAR 1 0 /end COMPU_METHOD
/begin COMPU_METHOD bsTh2oBit.Conversion "" LINEAR "%.3" "bit" COEFFS_LINEAR 1 0 /end COMPU_METHOD
/begin COMPU_METHOD bsTh2oLamp.Conversion "" LINEAR "%.3" "adm" COEFFS_LINEAR 1 0 /end COMPU_METHOD
/begin COMPU_METHOD bsThrotPwmSignal.Conversion "" LINEAR "%.3" "%" COEFFS_LINEAR 0.125 0 /end COMPU_METHOD
/begin COMPU_METHOD bsThrottleEnable.Conversion "" LINEAR "%.3" "adm" COEFFS_LINEAR 1 0 /end COMPU_METHOD
/begin COMPU_METHOD bsTimeDateErrFlag.Conversion "" LINEAR "%.3" "adm" COEFFS_LINEAR 1 0 /end COMPU_METHOD
/begin COMPU_METHOD bsTotEngHours.Conversion "" LINEAR "%.3" "hours" COEFFS_LINEAR 0.05 0 /end COMPU_METHOD
/begin COMPU_METHOD bsTotEngHoursE2prom.Conversion "" LINEAR "%.3" "hours" COEFFS_LINEAR 0.05 0 /end COMPU_METHOD
/begin COMPU_METHOD bsTotEngMinutes.Conversion "" LINEAR "%.3" "minutes" COEFFS_LINEAR 1 0 /end COMPU_METHOD
/begin COMPU_METHOD bsTotEngMinutesE2prom.Conversion "" LINEAR "%.3" "minutes" COEFFS_LINEAR 1 0 /end COMPU_METHOD
/begin COMPU_METHOD bsTotEngRevol.Conversion "" LINEAR "%.3" "revolutions" COEFFS_LINEAR 1000 0 /end COMPU_METHOD
/begin COMPU_METHOD bsTotEngRevolE2prom.Conversion "" LINEAR "%.3" "revolutions" COEFFS_LINEAR 1000 0 /end COMPU_METHOD
/begin COMPU_METHOD bsTotWorkedMinutes.Conversion "" LINEAR "%.3" "minutes" COEFFS_LINEAR 1 0 /end COMPU_METHOD
/begin COMPU_METHOD bsTotWorkedMinutesE2prom.Conversion "" LINEAR "%.3" "minutes" COEFFS_LINEAR 1 0 /end COMPU_METHOD
/begin COMPU_METHOD bsTsc1Ctrl1ErrFlag.Conversion "" LINEAR "%.3" "adm" COEFFS_LINEAR 1 0 /end COMPU_METHOD
/begin COMPU_METHOD bsTsc1Ctrl2ErrFlag.Conversion "" LINEAR "%.3" "adm" COEFFS_LINEAR 1 0 /end COMPU_METHOD
/begin COMPU_METHOD bsTsc1LErrFlag.Conversion "" LINEAR "%.3" "adm" COEFFS_LINEAR 1 0 /end COMPU_METHOD
/begin COMPU_METHOD bsTsc1RetErrFlag.Conversion "" LINEAR "%.3" "adm" COEFFS_LINEAR 1 0 /end COMPU_METHOD
/begin COMPU_METHOD bsTurbo2EcuErrFlag.Conversion "" LINEAR "%.3" "adm" COEFFS_LINEAR 1 0 /end COMPU_METHOD
/begin COMPU_METHOD bsUSSErrFlag.Conversion "" LINEAR "%.3" "adm" COEFFS_LINEAR 1 0 /end COMPU_METHOD
/begin COMPU_METHOD bsUegoForceStart.Conversion "" LINEAR "%.3" "adm" COEFFS_LINEAR 1 0 /end COMPU_METHOD
/begin COMPU_METHOD bsUegoInRunning.Conversion "" LINEAR "%.3" "adm" COEFFS_LINEAR 1 0 /end COMPU_METHOD
/begin COMPU_METHOD bsUegoIp.Conversion "" LINEAR "%.3" "mA" COEFFS_LINEAR 0.0001 -3 /end COMPU_METHOD
/begin COMPU_METHOD bsUegoIpOk.Conversion "" LINEAR "%.3" "adm" COEFFS_LINEAR 1 0 /end COMPU_METHOD
/begin COMPU_METHOD bsUegoRawIp.Conversion "" LINEAR "%.3" "mA" COEFFS_LINEAR 0.0001 -3 /end COMPU_METHOD
/begin COMPU_METHOD bsUegoRie.Conversion "" LINEAR "%.3" "Ohm" COEFFS_LINEAR 1 0 /end COMPU_METHOD
/begin COMPU_METHOD bsUegoRieTarget.Conversion "" LINEAR "%.3" "Ohm" COEFFS_LINEAR 1 0 /end COMPU_METHOD
/begin COMPU_METHOD bsVBPWBit.Conversion "" LINEAR "%.3" "bit" COEFFS_LINEAR 1 0 /end COMPU_METHOD
/begin COMPU_METHOD bsVBPWStatus.Conversion "" LINEAR "%.3" "adm" COEFFS_LINEAR 1 0 /end COMPU_METHOD
/begin COMPU_METHOD bsVBPW_STATUS_COUNTER.Conversion "" LINEAR "%.3" "ms" COEFFS_LINEAR 4 0 /end COMPU_METHOD
/begin COMPU_METHOD bsVBattBit.Conversion "" LINEAR "%.3" "bit" COEFFS_LINEAR 1 0 /end COMPU_METHOD
/begin COMPU_METHOD bsVS1Bit.Conversion "" LINEAR "%.3" "bit" COEFFS_LINEAR 1 0 /end COMPU_METHOD
/begin COMPU_METHOD bsVS2Bit.Conversion "" LINEAR "%.3" "bit" COEFFS_LINEAR 1 0 /end COMPU_METHOD
/begin COMPU_METHOD bsVS3Bit.Conversion "" LINEAR "%.3" "bit" COEFFS_LINEAR 1 0 /end COMPU_METHOD
/begin COMPU_METHOD bsV_Nlp.Conversion "" LINEAR "%.3" "V" COEFFS_LINEAR 0.0009765625 0 /end COMPU_METHOD
/begin COMPU_METHOD bsV_Nlp_Ram.Conversion "" LINEAR "%.3" "V" COEFFS_LINEAR 0.0009765625 0 /end COMPU_METHOD
/begin COMPU_METHOD bsV_Uma.Conversion "" LINEAR "%.3" "V" COEFFS_LINEAR 0.0009765625 0 /end COMPU_METHOD
/begin COMPU_METHOD bsV_Uma_Ram.Conversion "" LINEAR "%.3" "V" COEFFS_LINEAR 0.0009765625 0 /end COMPU_METHOD
/begin COMPU_METHOD bsVcm2EcmErrFlag.Conversion "" LINEAR "%.3" "adm" COEFFS_LINEAR 1 0 /end COMPU_METHOD
/begin COMPU_METHOD bsVehSpeedLim.Conversion "" LINEAR "%.3" "adm" COEFFS_LINEAR 1 0 /end COMPU_METHOD
/begin COMPU_METHOD bsVehSpeedSens.Conversion "" LINEAR "%.3" "Km/h" COEFFS_LINEAR 1 0 /end COMPU_METHOD
/begin COMPU_METHOD bsWGTDuty.Conversion "" LINEAR "%.3" "%" COEFFS_LINEAR 0.125 0 /end COMPU_METHOD
/begin COMPU_METHOD bsWinAdv.Conversion "" LINEAR "%.3" "degree" COEFFS_LINEAR 0.1 0 /end COMPU_METHOD
/begin COMPU_METHOD bsWinLength.Conversion "" LINEAR "%.3" "degree" COEFFS_LINEAR 0.1 0 /end COMPU_METHOD
/begin COMPU_METHOD bsWinStartAngle.Conversion "" LINEAR "%.3" "degree" COEFFS_LINEAR 0.1 0 /end COMPU_METHOD
/begin COMPU_METHOD bsWorkedMinutes.Conversion "" LINEAR "%.3" "min" COEFFS_LINEAR 1 0 /end COMPU_METHOD
/begin COMPU_METHOD bsWrnLamp.Conversion "" LINEAR "%.3" "adm" COEFFS_LINEAR 1 0 /end COMPU_METHOD
/begin COMPU_METHOD bs_DiagMgmCan1_THR.Conversion "" LINEAR "%.3" "adm" COEFFS_LINEAR 1 0 /end COMPU_METHOD
/begin COMPU_METHOD bs_DiagMgmCan2_THR.Conversion "" LINEAR "%.3" "adm" COEFFS_LINEAR 1 0 /end COMPU_METHOD
/begin COMPU_METHOD bs_DiagMgmCan3_THR.Conversion "" LINEAR "%.3" "adm" COEFFS_LINEAR 1 0 /end COMPU_METHOD
/begin COMPU_METHOD bs_DiagMgmCan4_THR.Conversion "" LINEAR "%.3" "adm" COEFFS_LINEAR 1 0 /end COMPU_METHOD
/begin COMPU_METHOD bs_DiagMgm_AcClutch_PresRed_THR.Conversion "" LINEAR "%.3" "adm" COEFFS_LINEAR 1 0 /end COMPU_METHOD
/begin COMPU_METHOD bs_DiagMgm_BlowBy_THR.Conversion "" LINEAR "%.3" "adm" COEFFS_LINEAR 1 0 /end COMPU_METHOD
/begin COMPU_METHOD bs_DiagMgm_DumpValve_THR.Conversion "" LINEAR "%.3" "adm" COEFFS_LINEAR 1 0 /end COMPU_METHOD
/begin COMPU_METHOD bs_DiagMgm_EPMGEN_CAM_THR.Conversion "" LINEAR "%.3" "adm" COEFFS_LINEAR 1 0 /end COMPU_METHOD
/begin COMPU_METHOD bs_DiagMgm_EPMGEN_CRK_THR.Conversion "" LINEAR "%.3" "adm" COEFFS_LINEAR 1 0 /end COMPU_METHOD
/begin COMPU_METHOD bs_DiagMgm_EngBrake_THR.Conversion "" LINEAR "%.3" "adm" COEFFS_LINEAR 1 0 /end COMPU_METHOD
/begin COMPU_METHOD bs_DiagMgm_Fan1_THR.Conversion "" LINEAR "%.3" "adm" COEFFS_LINEAR 1 0 /end COMPU_METHOD
/begin COMPU_METHOD bs_DiagMgm_Fan2_THR.Conversion "" LINEAR "%.3" "adm" COEFFS_LINEAR 1 0 /end COMPU_METHOD
/begin COMPU_METHOD bs_DiagMgm_FuelPumpHs_THR.Conversion "" LINEAR "%.3" "adm" COEFFS_LINEAR 1 0 /end COMPU_METHOD
/begin COMPU_METHOD bs_DiagMgm_FuelPumpLs_THR.Conversion "" LINEAR "%.3" "adm" COEFFS_LINEAR 1 0 /end COMPU_METHOD
/begin COMPU_METHOD bs_DiagMgm_HBridgeCmdxx_THR.Conversion "" LINEAR "%.3" "adm" COEFFS_LINEAR 1 0 /end COMPU_METHOD
/begin COMPU_METHOD bs_DiagMgm_IgnCmdxx_THR.Conversion "" LINEAR "%.3" "adm" COEFFS_LINEAR 1 0 /end COMPU_METHOD
/begin COMPU_METHOD bs_DiagMgm_InjCmdxx_THR.Conversion "" LINEAR "%.3" "adm" COEFFS_LINEAR 1 0 /end COMPU_METHOD
/begin COMPU_METHOD bs_DiagMgm_LoadRelay_THR.Conversion "" LINEAR "%.3" "adm" COEFFS_LINEAR 1 0 /end COMPU_METHOD
/begin COMPU_METHOD bs_DiagMgm_Mil_THR.Conversion "" LINEAR "%.3" "adm" COEFFS_LINEAR 1 0 /end COMPU_METHOD
/begin COMPU_METHOD bs_DiagMgm_PostCatHeater_THR.Conversion "" LINEAR "%.3" "adm" COEFFS_LINEAR 1 0 /end COMPU_METHOD
/begin COMPU_METHOD bs_DiagMgm_PreCatHeater_THR.Conversion "" LINEAR "%.3" "adm" COEFFS_LINEAR 1 0 /end COMPU_METHOD
/begin COMPU_METHOD bs_DiagMgm_PresRegValve_THR.Conversion "" LINEAR "%.3" "adm" COEFFS_LINEAR 1 0 /end COMPU_METHOD
/begin COMPU_METHOD bs_DiagMgm_RedLamp_THR.Conversion "" LINEAR "%.3" "adm" COEFFS_LINEAR 1 0 /end COMPU_METHOD
/begin COMPU_METHOD bs_DiagMgm_Rpm_THR.Conversion "" LINEAR "%.3" "adm" COEFFS_LINEAR 1 0 /end COMPU_METHOD
/begin COMPU_METHOD bs_DiagMgm_StarterHs_THR.Conversion "" LINEAR "%.3" "adm" COEFFS_LINEAR 1 0 /end COMPU_METHOD
/begin COMPU_METHOD bs_DiagMgm_StarterLs_THR.Conversion "" LINEAR "%.3" "adm" COEFFS_LINEAR 1 0 /end COMPU_METHOD
/begin COMPU_METHOD bs_DiagMgm_TankValve1_THR.Conversion "" LINEAR "%.3" "adm" COEFFS_LINEAR 1 0 /end COMPU_METHOD
/begin COMPU_METHOD bs_DiagMgm_TankValve2_THR.Conversion "" LINEAR "%.3" "adm" COEFFS_LINEAR 1 0 /end COMPU_METHOD
/begin COMPU_METHOD bs_DiagMgm_Turbo_THR.Conversion "" LINEAR "%.3" "adm" COEFFS_LINEAR 1 0 /end COMPU_METHOD
/begin COMPU_METHOD bs_DiagMgm_UegoHeater_THR.Conversion "" LINEAR "%.3" "adm" COEFFS_LINEAR 1 0 /end COMPU_METHOD
/begin COMPU_METHOD bs_DiagMgm_UegoSensor_THR.Conversion "" LINEAR "%.3" "adm" COEFFS_LINEAR 1 0 /end COMPU_METHOD
/begin COMPU_METHOD bs_DiagMgm_WarnLamp_THR.Conversion "" LINEAR "%.3" "adm" COEFFS_LINEAR 1 0 /end COMPU_METHOD
/begin COMPU_METHOD bvAdvCOILx.Conversion "" LINEAR "%.3" "degree" COEFFS_LINEAR 0.0625 0 /end COMPU_METHOD
/begin COMPU_METHOD bvCOILx_DwTime.Conversion "" LINEAR "%.3" "us" COEFFS_LINEAR 2 0 /end COMPU_METHOD
/begin COMPU_METHOD bvEcuTCnt.Conversion "" LINEAR "%.3" "times" COEFFS_LINEAR 1 0 /end COMPU_METHOD
/begin COMPU_METHOD bvEcuTCntEE.Conversion "" LINEAR "%.3" "times" COEFFS_LINEAR 1 0 /end COMPU_METHOD
/begin COMPU_METHOD bvIgnPhysicalChannel.Conversion "" TAB_VERB "%.0" "" COMPU_TAB_REF bvIgnPhysicalChannel.Conversion /end COMPU_METHOD
/begin COMPU_METHOD bvInjPhysicalChannel.Conversion "" TAB_VERB "%.0" "" COMPU_TAB_REF bvInjPhysicalChannel.Conversion /end COMPU_METHOD
/begin COMPU_METHOD bvTINJx.Conversion "" LINEAR "%.3" "us" COEFFS_LINEAR 16 0 /end COMPU_METHOD
/begin COMPU_METHOD bvVcoMdc1GEE.Conversion "" LINEAR "%.3" "adm" COEFFS_LINEAR 1 0 /end COMPU_METHOD
/begin COMPU_METHOD bvVcoMdc2GEE.Conversion "" LINEAR "%.3" "adm" COEFFS_LINEAR 1 0 /end COMPU_METHOD
/begin COMPU_METHOD bvVcoMdc3GEE.Conversion "" LINEAR "%.3" "adm" COEFFS_LINEAR 1 0 /end COMPU_METHOD
/begin COMPU_METHOD bvVcoMdc4GEE.Conversion "" LINEAR "%.3" "adm" COEFFS_LINEAR 1 0 /end COMPU_METHOD
/begin COMPU_METHOD bvVcoMdc5GEE.Conversion "" LINEAR "%.3" "adm" COEFFS_LINEAR 1 0 /end COMPU_METHOD
/begin COMPU_METHOD bvVcoMdc6GEE.Conversion "" LINEAR "%.3" "adm" COEFFS_LINEAR 1 0 /end COMPU_METHOD
/begin COMPU_METHOD bvVcoMdc7GEE.Conversion "" LINEAR "%.3" "adm" COEFFS_LINEAR 1 0 /end COMPU_METHOD
/begin COMPU_METHOD bvVcoMdc8GEE.Conversion "" LINEAR "%.3" "adm" COEFFS_LINEAR 1 0 /end COMPU_METHOD
/begin COMPU_METHOD eDiagStatus.Conversion "" TAB_VERB "%.0" "" COMPU_TAB_REF eDiagStatus.Conversion /end COMPU_METHOD
/begin COMPU_VTAB VTAB_FOR_ALTERNATE_FUEL_Tx_100ms_CM_FixEnableT "Enumerated data type: FixEnableT" TAB_VERB 2 171 "Enable" 218 "Disable" /end COMPU_VTAB
/begin COMPU_VTAB VTAB_FOR_BC2EDC1_Rx_50ms_CM_FixEnableT "Enumerated data type: FixEnableT" TAB_VERB 2 171 "Enable" 218 "Disable" /end COMPU_VTAB
/begin COMPU_VTAB VTAB_FOR_BC2EDC2_Rx_50ms_CM_FixEnableT "Enumerated data type: FixEnableT" TAB_VERB 2 171 "Enable" 218 "Disable" /end COMPU_VTAB
/begin COMPU_VTAB VTAB_FOR_CCVS_Rx_100ms_CM_FixEnableT "Enumerated data type: FixEnableT" TAB_VERB 2 171 "Enable" 218 "Disable" /end COMPU_VTAB
/begin COMPU_VTAB VTAB_FOR_CCVS_Tx_100ms_CM_FixEnableT "Enumerated data type: FixEnableT" TAB_VERB 2 171 "Enable" 218 "Disable" /end COMPU_VTAB
/begin COMPU_VTAB VTAB_FOR_DD1_Tx_1s_CM_FixEnableT "Enumerated data type: FixEnableT" TAB_VERB 2 171 "Enable" 218 "Disable" /end COMPU_VTAB
/begin COMPU_VTAB VTAB_FOR_DLCC1_Tx_1s_CM_FixEnableT "Enumerated data type: FixEnableT" TAB_VERB 2 171 "Enable" 218 "Disable" /end COMPU_VTAB
/begin COMPU_VTAB VTAB_FOR_DLCC2_Tx_1s_CM_FixEnableT "Enumerated data type: FixEnableT" TAB_VERB 2 171 "Enable" 218 "Disable" /end COMPU_VTAB
/begin COMPU_VTAB VTAB_FOR_Dcat_Diagnosis100ms_CM_tKeyState_adm "Enumerated data type: tKeyState" TAB_VERB 2 0 "KEY_OFF" 1 "KEY_ON" /end COMPU_VTAB
/begin COMPU_VTAB VTAB_FOR_DiagSym100ms_CM_eEGMD_adm "Enumerated data type: eEGMD" TAB_VERB 5 0 "NOT_DETERM" 1 "CRANK" 2 "IDLE" 3 "NORMAL" 4 "CUT_OFF" /end COMPU_VTAB
/begin COMPU_VTAB VTAB_FOR_DiagSym100ms_CM_eEGST_adm "Enumerated data type: eEGST" TAB_VERB 7 0 "POWER_ON" 1 "WAIT" 2 "RUN" 3 "POWER_LATCH" 4 "POWER_OFF" 5 "SHUTDOWN" 6 "ACTDIAG_WAIT" /end COMPU_VTAB
/begin COMPU_VTAB VTAB_FOR_Diag_LineSTOH100ms_CM_eEGST_adm "Enumerated data type: eEGST" TAB_VERB 7 0 "POWER_ON" 1 "WAIT" 2 "RUN" 3 "POWER_LATCH" 4 "POWER_OFF" 5 "SHUTDOWN" 6 "ACTDIAG_WAIT" /end COMPU_VTAB
/begin COMPU_VTAB VTAB_FOR_Diag_LineSTOH100ms_CM_tKeyState_adm "Enumerated data type: tKeyState" TAB_VERB 2 0 "KEY_OFF" 1 "KEY_ON" /end COMPU_VTAB
/begin COMPU_VTAB VTAB_FOR_Digin4ms_CM_tKeyState_adm "Enumerated data type: tKeyState" TAB_VERB 2 0 "KEY_OFF" 1 "KEY_ON" /end COMPU_VTAB
/begin COMPU_VTAB VTAB_FOR_ECM2EPR_Tx_4ms_CM_FixEnableT_adm "Enumerated data type: FixEnableT" TAB_VERB 2 171 "Enable" 218 "Disable" /end COMPU_VTAB
/begin COMPU_VTAB VTAB_FOR_ECM2EPR_Tx_4ms_CM_FixEnableT_barA "Enumerated data type: FixEnableT" TAB_VERB 2 171 "Enable" 218 "Disable" /end COMPU_VTAB
/begin COMPU_VTAB VTAB_FOR_ECM2EPR_Tx_4ms_CM_FixEnableT_barG "Enumerated data type: FixEnableT" TAB_VERB 2 171 "Enable" 218 "Disable" /end COMPU_VTAB
/begin COMPU_VTAB VTAB_FOR_ECU2TURBO_Tx_4ms_CM_FixEnableT "Enumerated data type: FixEnableT" TAB_VERB 2 171 "Enable" 218 "Disable" /end COMPU_VTAB
/begin COMPU_VTAB VTAB_FOR_EDC2BC_Tx_50ms_CM_FixEnableT "Enumerated data type: FixEnableT" TAB_VERB 2 171 "Enable" 218 "Disable" /end COMPU_VTAB
/begin COMPU_VTAB VTAB_FOR_EEC1_Tx_4ms_CM_FixEnableT "Enumerated data type: FixEnableT" TAB_VERB 2 171 "Enable" 218 "Disable" /end COMPU_VTAB
/begin COMPU_VTAB VTAB_FOR_EEC2_Tx_50ms_CM_FixEnableT "Enumerated data type: FixEnableT" TAB_VERB 2 171 "Enable" 218 "Disable" /end COMPU_VTAB
/begin COMPU_VTAB VTAB_FOR_EEC3_Tx_100ms_CM_FixEnableT "Enumerated data type: FixEnableT" TAB_VERB 2 171 "Enable" 218 "Disable" /end COMPU_VTAB
/begin COMPU_VTAB VTAB_FOR_EFL_P2_Tx_100ms_CM_FixEnableT "Enumerated data type: FixEnableT" TAB_VERB 2 171 "Enable" 218 "Disable" /end COMPU_VTAB
/begin COMPU_VTAB VTAB_FOR_ENG_CONF_Tx_1s_CM_FixEnableT "Enumerated data type: FixEnableT" TAB_VERB 2 171 "Enable" 218 "Disable" /end COMPU_VTAB
/begin COMPU_VTAB VTAB_FOR_ENG_FLD_LEV_PRESS_Tx_100ms_CM_FixEnableT "Enumerated data type: FixEnableT" TAB_VERB 2 171 "Enable" 218 "Disable" /end COMPU_VTAB
/begin COMPU_VTAB VTAB_FOR_ENG_HOURS_REV_Tx_100ms_CM_FixEnableT "Enumerated data type: FixEnableT" TAB_VERB 2 171 "Enable" 218 "Disable" /end COMPU_VTAB
/begin COMPU_VTAB VTAB_FOR_ENG_TEMP_Tx_1s_CM_FixEnableT "Enumerated data type: FixEnableT" TAB_VERB 2 171 "Enable" 218 "Disable" /end COMPU_VTAB
/begin COMPU_VTAB VTAB_FOR_EPR2ECM_Rx_100ms_CM_FixEnableT "Enumerated data type: FixEnableT" TAB_VERB 2 171 "Enable" 218 "Disable" /end COMPU_VTAB
/begin COMPU_VTAB VTAB_FOR_ERC1_ER_Tx_1s_CM_FixEnableT "Enumerated data type: FixEnableT" TAB_VERB 2 171 "Enable" 218 "Disable" /end COMPU_VTAB
/begin COMPU_VTAB VTAB_FOR_ET2_Tx_1s_CM_FixEnableT "Enumerated data type: FixEnableT" TAB_VERB 2 171 "Enable" 218 "Disable" /end COMPU_VTAB
/begin COMPU_VTAB VTAB_FOR_ETC1_Rx_4ms_CM_FixEnableT "Enumerated data type: FixEnableT" TAB_VERB 2 171 "Enable" 218 "Disable" /end COMPU_VTAB
/begin COMPU_VTAB VTAB_FOR_ETC2_Rx_100ms_CM_FixEnableT "Enumerated data type: FixEnableT" TAB_VERB 2 171 "Enable" 218 "Disable" /end COMPU_VTAB
/begin COMPU_VTAB VTAB_FOR_Ecut1s_CM_tKeyState_adm "Enumerated data type: tKeyState" TAB_VERB 2 0 "KEY_OFF" 1 "KEY_ON" /end COMPU_VTAB
/begin COMPU_VTAB VTAB_FOR_Egbrk50ms_CM_eEGMD_adm "Enumerated data type: eEGMD" TAB_VERB 5 0 "NOT_DETERM" 1 "CRANK" 2 "IDLE" 3 "NORMAL" 4 "CUT_OFF" /end COMPU_VTAB
/begin COMPU_VTAB VTAB_FOR_EgmdTDC_CM_eEGMD_adm "Enumerated data type: eEGMD" TAB_VERB 5 0 "NOT_DETERM" 1 "CRANK" 2 "IDLE" 3 "NORMAL" 4 "CUT_OFF" /end COMPU_VTAB
/begin COMPU_VTAB VTAB_FOR_EgmdTDC_CM_ePhCrank_adm "Enumerated data type: ePhCrank" TAB_VERB 5 0 "PH_NULL" 1 "PHASE1" 2 "PHASE2" 3 "PHASE3" 4 "END_CRANK" /end COMPU_VTAB
/begin COMPU_VTAB VTAB_FOR_EgrMgm4ms_CM_eCutOff_adm "Enumerated data type: eCutOff" TAB_VERB 5 0 "WAIT_CUT_OFF" 1 "CUT_OFF_ENTRY" 2 "CUT_OFF_ACTIVE" 3 "EXIT_CUT_OFF_RPM" 4 "EXIT_CUT_OFF_THROT" /end COMPU_VTAB
/begin COMPU_VTAB VTAB_FOR_EgrMgm4ms_CM_eEGST_adm "Enumerated data type: eEGST" TAB_VERB 8 0 "POWER_ON" 1 "WAIT" 2 "RUN" 3 "POWER_LATCH" 4 "POWER_OFF" 5 "SHUTDOWN" 6 "ACTDIAG_WAIT" 7 "SAFETY_CHECK" /end COMPU_VTAB
/begin COMPU_VTAB VTAB_FOR_Egst4ms_CM_eEGST_adm "Enumerated data type: eEGST" TAB_VERB 8 0 "POWER_ON" 1 "WAIT" 2 "RUN" 3 "POWER_LATCH" 4 "POWER_OFF" 5 "SHUTDOWN" 6 "ACTDIAG_WAIT" 7 "SAFETY_CHECK" /end COMPU_VTAB
/begin COMPU_VTAB VTAB_FOR_Egst4ms_CM_tKeyState_adm "Enumerated data type: tKeyState" TAB_VERB 2 0 "KEY_OFF" 1 "KEY_ON" /end COMPU_VTAB
/begin COMPU_VTAB VTAB_FOR_Egt100ms_CM_tKeyState_adm "Enumerated data type: tKeyState" TAB_VERB 2 0 "KEY_OFF" 1 "KEY_ON" /end COMPU_VTAB
/begin COMPU_VTAB VTAB_FOR_HDSECU1_Tx_50ms_CM_FixEnableT "Enumerated data type: FixEnableT" TAB_VERB 2 171 "Enable" 218 "Disable" /end COMPU_VTAB
/begin COMPU_VTAB VTAB_FOR_HDSECU2_Tx_50ms_CM_FixEnableT "Enumerated data type: FixEnableT" TAB_VERB 2 171 "Enable" 218 "Disable" /end COMPU_VTAB
/begin COMPU_VTAB VTAB_FOR_INLET_COND_Tx_100ms_CM_FixEnableT "Enumerated data type: FixEnableT" TAB_VERB 2 171 "Enable" 218 "Disable" /end COMPU_VTAB
/begin COMPU_VTAB VTAB_FOR_LFC1_Tx_1s_CM_FixEnableT "Enumerated data type: FixEnableT" TAB_VERB 2 171 "Enable" 218 "Disable" /end COMPU_VTAB
/begin COMPU_VTAB VTAB_FOR_LFE1_Tx_100ms_CM_FixEnableT "Enumerated data type: FixEnableT" TAB_VERB 2 171 "Enable" 218 "Disable" /end COMPU_VTAB
/begin COMPU_VTAB VTAB_FOR_MVS_Tx_1s_CM_FixEnableT "Enumerated data type: FixEnableT" TAB_VERB 2 171 "Enable" 218 "Disable" /end COMPU_VTAB
/begin COMPU_VTAB VTAB_FOR_PropB_0A_Tx_100ms_CM_FixEnableT "Enumerated data type: FixEnableT" TAB_VERB 2 171 "Enable" 218 "Disable" /end COMPU_VTAB
/begin COMPU_VTAB VTAB_FOR_RET_CONF_Tx_1s_CM_FixEnableT "Enumerated data type: FixEnableT" TAB_VERB 2 171 "Enable" 218 "Disable" /end COMPU_VTAB
/begin COMPU_VTAB VTAB_FOR_SEP1_Tx_1s_CM_FixEnableT "Enumerated data type: FixEnableT" TAB_VERB 2 171 "Enable" 218 "Disable" /end COMPU_VTAB
/begin COMPU_VTAB VTAB_FOR_SHUTDOWN_Tx_1s_CM_FixEnableT "Enumerated data type: FixEnableT" TAB_VERB 2 171 "Enable" 218 "Disable" /end COMPU_VTAB
/begin COMPU_VTAB VTAB_FOR_TCO1_Rx_50ms_CM_FixEnableT "Enumerated data type: FixEnableT" TAB_VERB 2 171 "Enable" 218 "Disable" /end COMPU_VTAB
/begin COMPU_VTAB VTAB_FOR_TIMEDATE_Rx_1s_CM_FixEnableT "Enumerated data type: FixEnableT" TAB_VERB 2 171 "Enable" 218 "Disable" /end COMPU_VTAB
/begin COMPU_VTAB VTAB_FOR_TSC1_TR_RETARDER_Rx_50ms_CM_FixEnableT "Enumerated data type: FixEnableT" TAB_VERB 2 171 "Enable" 218 "Disable" /end COMPU_VTAB
/begin COMPU_VTAB VTAB_FOR_TSC1_VE_CONTROL2_Rx_4ms_CM_FixEnableT "Enumerated data type: FixEnableT" TAB_VERB 2 171 "Enable" 218 "Disable" /end COMPU_VTAB
/begin COMPU_VTAB VTAB_FOR_TSC1_VE_CONTROL_Rx_4ms_CM_FixEnableT "Enumerated data type: FixEnableT" TAB_VERB 2 171 "Enable" 218 "Disable" /end COMPU_VTAB
/begin COMPU_VTAB VTAB_FOR_TSC1_VE_LIMIT_Rx_4ms_CM_FixEnableT "Enumerated data type: FixEnableT" TAB_VERB 2 171 "Enable" 218 "Disable" /end COMPU_VTAB
/begin COMPU_VTAB VTAB_FOR_TURBO2ECU_Rx_4ms_CM_FixEnableT "Enumerated data type: FixEnableT" TAB_VERB 2 171 "Enable" 218 "Disable" /end COMPU_VTAB
/begin COMPU_VTAB VTAB_FOR_USS_Rx_50ms_CM_FixEnableT "Enumerated data type: FixEnableT" TAB_VERB 2 171 "Enable" 218 "Disable" /end COMPU_VTAB
/begin COMPU_VTAB VTAB_FOR_VCM2ECM_Rx_50ms_CM_FixEnableT "Enumerated data type: FixEnableT" TAB_VERB 2 171 "Enable" 218 "Disable" /end COMPU_VTAB
/begin COMPU_VTAB VTAB_FOR_VEP1_Tx_1s_CM_FixEnableT "Enumerated data type: FixEnableT" TAB_VERB 2 171 "Enable" 218 "Disable" /end COMPU_VTAB
/begin COMPU_VTAB bsScaleFactor.Conversion "" TAB_VERB 5 0 "DECFILTER_SCALE_FACTOR_1" 1 "DECFILTER_SCALE_FACTOR_4" 2 "DECFILTER_SCALE_FACTOR_8" 3 "DECFILTER_SCALE_FACTOR_16" 4 "DECFILTER_SCALE_FACTOR_NULL" /end COMPU_VTAB
/begin COMPU_VTAB bsScaleHpf.Conversion "" TAB_VERB 5 0 "DECFILTER_SCALE_FACTOR_1" 1 "DECFILTER_SCALE_FACTOR_4" 2 "DECFILTER_SCALE_FACTOR_8" 3 "DECFILTER_SCALE_FACTOR_16" 4 "DECFILTER_SCALE_FACTOR_NULL" /end COMPU_VTAB
/begin COMPU_VTAB bsScaleLpf.Conversion "" TAB_VERB 5 0 "DECFILTER_SCALE_FACTOR_1" 1 "DECFILTER_SCALE_FACTOR_4" 2 "DECFILTER_SCALE_FACTOR_8" 3 "DECFILTER_SCALE_FACTOR_16" 4 "DECFILTER_SCALE_FACTOR_NULL" /end COMPU_VTAB
/begin COMPU_VTAB bvIgnPhysicalChannel.Conversion "" TAB_VERB 8 0 "IgnCmdA1_OF" 1 "IgnCmdA2_OF" 2 "IgnCmdB1_OF" 3 "IgnCmdB2_OF" 4 "IgnCmdC1_OF" 5 "IgnCmdC2_OF" 6 "IgnCmdD_OF" 7 "IgnCmdD2_OF" /end COMPU_VTAB
/begin COMPU_VTAB bvInjPhysicalChannel.Conversion "" TAB_VERB 8 0 "InjA1_OPH" 1 "InjA2_OPH" 2 "InjB1_OPH" 3 "InjB2_OPH" 4 "InjC1_OPH" 5 "InjC2_OPH" 6 "InjD1_OPH" 7 "InjD2_OPH" /end COMPU_VTAB
/begin COMPU_VTAB eDiagStatus.Conversion "" TAB_VERB 27 0 "DIAG_STATUS_OK" 1 "DIAG_GENERIC_FAULT" 2 "DIAG_SHORT_GND" 3 "DIAG_SHORT_VCC" 4 "DIAG_SHORT_OVER_LOAD" 5 "DIAG_SHORT_HS_VCC" 6 "DIAG_SHORT_LS_VCC" 7 "DIAG_SHORT_HS_GND" 8 "DIAG_SHORT_LS_GND" 9 "DIAG_SHORT_HS_LS" 10 "DIAG_SHORT_HS_LS_GND" 11 "DIAG_SHORT_HS_LS_VCC" 12 "DIAG_OPEN_LOAD" 13 "DIAG_SHORT_GND_OR_OPEN_LOAD" 14 "DIAG_SHORT_VCC_OR_OPEN_LOAD" 15 "DIAG_OPEN_SECONDARY" 16 "DIAG_OVER_LOAD" 17 "DIAG_OVER_LOAD_LS" 18 "DIAG_OVER_LOAD_HS" 19 "DIAG_OVER_CURRENT" 20 "DIAG_POWER_SUPPLY_FAIL" 21 "DIAG_TEMPERATURE_FAULT" 22 "DIAG_TEMPERATURE_WARNING" 23 "DIAG_CURRENT_LIMITATION" 24 "DIAG_UNDERVOLTAGE" 25 "DIAG_LOAD_ENABLE" 26 "DIAG_BUS_OFF" /end COMPU_VTAB
/begin RECORD_LAYOUT Scalar_BOOLEAN FNC_VALUES 1 UBYTE COLUMN_DIR DIRECT /end RECORD_LAYOUT
/begin RECORD_LAYOUT Scalar_BYTE FNC_VALUES 1 SBYTE COLUMN_DIR DIRECT /end RECORD_LAYOUT
/begin RECORD_LAYOUT Scalar_SWORD FNC_VALUES 1 SWORD COLUMN_DIR DIRECT /end RECORD_LAYOUT
/begin RECORD_LAYOUT Scalar_UBYTE FNC_VALUES 1 UBYTE COLUMN_DIR DIRECT /end RECORD_LAYOUT
/begin RECORD_LAYOUT Scalar_ULONG FNC_VALUES 1 ULONG COLUMN_DIR DIRECT /end RECORD_LAYOUT
/begin RECORD_LAYOUT Scalar_UWORD FNC_VALUES 1 UWORD COLUMN_DIR DIRECT /end RECORD_LAYOUT
/begin RECORD_LAYOUT __UBYTE_Z FNC_VALUES 1 UBYTE ROW_DIR DIRECT /end RECORD_LAYOUT
/begin RECORD_LAYOUT __UWORD_Z FNC_VALUES 1 UWORD ROW_DIR DIRECT /end RECORD_LAYOUT
/end MODULE
/end PROJECT
